[part 2 of 2: packages /AUTOSAR_Rte/BswModuleEntrys to /AUTOSAR_Rte/SwAddrMethods]
AUTOSAR XML (schema 4-2-2)
package /AUTOSAR_Rte/BswModuleEntrys
  821 x bsw module entry:
    Rte_ActivateRE: call-type=REGULAR
    Rte_Call_Dcm_RoutineServices_DcmDspRoutine_CheckPgmPreCond_RequestResults: call-type=REGULAR
    Rte_Call_Dcm_RoutineServices_DcmDspRoutine_CheckPgmPreCond_Start: call-type=REGULAR
    Rte_Call_Dcm_RoutineServices_DcmDspRoutine_CheckPgmPreCond_Stop: call-type=REGULAR
    Rte_Call_Dcm_RoutineServices_DcmDspRoutine_Test_RequestResults: call-type=REGULAR
    Rte_Call_Dcm_RoutineServices_DcmDspRoutine_Test_Start: call-type=REGULAR
    Rte_Call_Dcm_RoutineServices_DcmDspRoutine_Test_Stop: call-type=REGULAR
    Rte_Call_Dcm_SecurityAccess_DSP_SEC_LEV_L1_CompareKey: call-type=REGULAR
    Rte_Call_Dcm_SecurityAccess_DSP_SEC_LEV_L1_GetSeed: call-type=REGULAR
    Rte_Call_Dcm_SecurityAccess_DSP_SEC_LEV_L2_CompareKey: call-type=REGULAR
    Rte_Call_Dcm_SecurityAccess_DSP_SEC_LEV_L2_GetSeed: call-type=REGULAR
    Rte_Call_Dcm_SecurityAccess_DSP_SEC_LEV_L3_CompareKey: call-type=REGULAR
    Rte_Call_Dcm_SecurityAccess_DSP_SEC_LEV_L3_GetSeed: call-type=REGULAR
    Rte_Call_Dcm_SecurityAccess_DSP_SEC_LEV_L4_CompareKey: call-type=REGULAR
    Rte_Call_Dcm_SecurityAccess_DSP_SEC_LEV_L4_GetSeed: call-type=REGULAR
    Rte_Call_Dem_CBStatusComp_DemComponent_BusOff1_ComponentStatusChanged: call-type=REGULAR
    Rte_Call_Dem_CBStatusComp_DemComponent_BusOff2_ComponentStatusChanged: call-type=REGULAR
    Rte_Call_Dem_CBStatusComp_DemComponent_BusOff_ComponentStatusChanged: call-type=REGULAR
    Rte_Call_Dem_CBStatusComp_DemComponent_MCAL_Status_ComponentStatusChanged: call-type=REGULAR
    Rte_Call_Dem_CBStatusComp_DemComponent_MCU_Status_ComponentStatusChanged: call-type=REGULAR
    Rte_Call_Dem_CBStatusComp_DemComponent_MPDU_CommStatus_ComponentStatusChanged: call-type=REGULAR
    Rte_Call_Dem_CBStatusComp_DemComponent_NvM_ReadErr_ComponentStatusChanged: call-type=REGULAR
    Rte_Call_Dem_CBStatusComp_DemComponent_NvM_WriteErr_ComponentStatusChanged: call-type=REGULAR
    Rte_Call_Dem_CBStatusComp_DemComponent_SEN_1_CommStatus_ComponentStatusChanged: call-type=REGULAR
    Rte_Call_Dem_CBStatusComp_DemComponent_SEN_CommStatus_ComponentStatusChanged: call-type=REGULAR
    Rte_Call_Dem_CBStatusComp_DemComponent_VCU_DC01_AliveCounter_ComponentStatusChanged: call-type=REGULAR
    Rte_Call_Dem_CBStatusComp_DemComponent_VCU_DC01_CheckSum_ComponentStatusChanged: call-type=REGULAR
    Rte_Call_Dem_CBStatusComp_DemComponent_VCU_DC01_DLC_ComponentStatusChanged: call-type=REGULAR
    Rte_Call_Dem_CBStatusComp_DemComponent_VCU_DC01_Tiout_ComponentStatusChanged: call-type=REGULAR
    Rte_Call_Diag_SWC_RPort_ControlDTCSuppression_SetDTCSuppression: call-type=REGULAR
    Rte_Call_Diag_SWC_RPort_DCMServices_GetActiveProtocol: call-type=REGULAR
    Rte_Call_Diag_SWC_RPort_DCMServices_GetSecurityLevel: call-type=REGULAR
    Rte_Call_Diag_SWC_RPort_DCMServices_GetSesCtrlType: call-type=REGULAR
    Rte_Call_Diag_SWC_RPort_DCMServices_ResetToDefaultSession: call-type=REGULAR
    Rte_Call_Diag_SWC_RPort_EcuMSelectResetTarget_SelectShutdownTarget: call-type=REGULAR
    Rte_Call_Diag_SWC_RPort_Event_Event_LostComm_MPDU_ClearPrestoredFreezeFrame: call-type=REGULAR
    Rte_Call_Diag_SWC_RPort_Event_Event_LostComm_MPDU_PrestoreFreezeFrame: call-type=REGULAR
    Rte_Call_Diag_SWC_RPort_Event_Event_LostComm_MPDU_ResetEventStatus: call-type=REGULAR
    Rte_Call_Diag_SWC_RPort_Event_Event_LostComm_MPDU_SetEventStatus: call-type=REGULAR
    Rte_Call_Diag_SWC_RPort_Event_Event_LostComm_SEN_1_ClearPrestoredFreezeFrame: call-type=REGULAR
    Rte_Call_Diag_SWC_RPort_Event_Event_LostComm_SEN_1_PrestoreFreezeFrame: call-type=REGULAR
    Rte_Call_Diag_SWC_RPort_Event_Event_LostComm_SEN_1_ResetEventStatus: call-type=REGULAR
    Rte_Call_Diag_SWC_RPort_Event_Event_LostComm_SEN_1_SetEventStatus: call-type=REGULAR
    Rte_Call_Diag_SWC_RPort_Event_Event_LostComm_SEN_ClearPrestoredFreezeFrame: call-type=REGULAR
    Rte_Call_Diag_SWC_RPort_Event_Event_LostComm_SEN_PrestoreFreezeFrame: call-type=REGULAR
    Rte_Call_Diag_SWC_RPort_Event_Event_LostComm_SEN_ResetEventStatus: call-type=REGULAR
    Rte_Call_Diag_SWC_RPort_Event_Event_LostComm_SEN_SetEventStatus: call-type=REGULAR
    Rte_Call_Diag_SWC_RPort_EvtInfo_Event_LostComm_MPDU_GetDTCOfEvent: call-type=REGULAR
    Rte_Call_Diag_SWC_RPort_EvtInfo_Event_LostComm_MPDU_GetEventFailed: call-type=REGULAR
    Rte_Call_Diag_SWC_RPort_EvtInfo_Event_LostComm_MPDU_GetEventStatus: call-type=REGULAR
    Rte_Call_Diag_SWC_RPort_EvtInfo_Event_LostComm_MPDU_GetEventTested: call-type=REGULAR
    Rte_Call_Diag_SWC_RPort_EvtInfo_Event_LostComm_MPDU_GetFaultDetectionCounter: call-type=REGULAR
    Rte_Call_Diag_SWC_RPort_EvtInfo_Event_LostComm_SEN_1_GetDTCOfEvent: call-type=REGULAR
    Rte_Call_Diag_SWC_RPort_EvtInfo_Event_LostComm_SEN_1_GetEventFailed: call-type=REGULAR
    Rte_Call_Diag_SWC_RPort_EvtInfo_Event_LostComm_SEN_1_GetEventStatus: call-type=REGULAR
    Rte_Call_Diag_SWC_RPort_EvtInfo_Event_LostComm_SEN_1_GetEventTested: call-type=REGULAR
    Rte_Call_Diag_SWC_RPort_EvtInfo_Event_LostComm_SEN_1_GetFaultDetectionCounter: call-type=REGULAR
    Rte_Call_Diag_SWC_RPort_EvtInfo_Event_LostComm_SEN_GetDTCOfEvent: call-type=REGULAR
    Rte_Call_Diag_SWC_RPort_EvtInfo_Event_LostComm_SEN_GetEventFailed: call-type=REGULAR
    Rte_Call_Diag_SWC_RPort_EvtInfo_Event_LostComm_SEN_GetEventStatus: call-type=REGULAR
    Rte_Call_Diag_SWC_RPort_EvtInfo_Event_LostComm_SEN_GetEventTested: call-type=REGULAR
    Rte_Call_Diag_SWC_RPort_EvtInfo_Event_LostComm_SEN_GetFaultDetectionCounter: call-type=REGULAR
    Rte_Call_Diag_SWC_RPort_FiMFID_0_GetFunctionPermission: call-type=REGULAR
    Rte_Call_Diag_SWC_RPort_OpCycle_DemOperationCycle_0_SetOperationCycleState: call-type=REGULAR
    Rte_Call_NvM_SWC_RPort_NvM_SWC_BlockNative_1024_EraseBlock: call-type=REGULAR
    Rte_Call_NvM_SWC_RPort_NvM_SWC_BlockNative_1024_GetDataIndex: call-type=REGULAR
    Rte_Call_NvM_SWC_RPort_NvM_SWC_BlockNative_1024_GetErrorStatus: call-type=REGULAR
    Rte_Call_NvM_SWC_RPort_NvM_SWC_BlockNative_1024_InvalidateNvBlock: call-type=REGULAR
    Rte_Call_NvM_SWC_RPort_NvM_SWC_BlockNative_1024_ReadBlock: call-type=REGULAR
    Rte_Call_NvM_SWC_RPort_NvM_SWC_BlockNative_1024_RestoreBlockDefaults: call-type=REGULAR
    Rte_Call_NvM_SWC_RPort_NvM_SWC_BlockNative_1024_SetDataIndex: call-type=REGULAR
    Rte_Call_NvM_SWC_RPort_NvM_SWC_BlockNative_1024_SetRamBlockStatus: call-type=REGULAR
    Rte_Call_NvM_SWC_RPort_NvM_SWC_BlockNative_1024_WriteBlock: call-type=REGULAR
    Rte_Call_NvM_SWC_RPort_NvM_SWC_BlockRedundant_1024_EraseBlock: call-type=REGULAR
    Rte_Call_NvM_SWC_RPort_NvM_SWC_BlockRedundant_1024_GetDataIndex: call-type=REGULAR
    Rte_Call_NvM_SWC_RPort_NvM_SWC_BlockRedundant_1024_GetErrorStatus: call-type=REGULAR
    Rte_Call_NvM_SWC_RPort_NvM_SWC_BlockRedundant_1024_InvalidateNvBlock: call-type=REGULAR
    Rte_Call_NvM_SWC_RPort_NvM_SWC_BlockRedundant_1024_ReadBlock: call-type=REGULAR
    Rte_Call_NvM_SWC_RPort_NvM_SWC_BlockRedundant_1024_RestoreBlockDefaults: call-type=REGULAR
    Rte_Call_NvM_SWC_RPort_NvM_SWC_BlockRedundant_1024_SetDataIndex: call-type=REGULAR
    Rte_Call_NvM_SWC_RPort_NvM_SWC_BlockRedundant_1024_SetRamBlockStatus: call-type=REGULAR
    Rte_Call_NvM_SWC_RPort_NvM_SWC_BlockRedundant_1024_WriteBlock: call-type=REGULAR
    Rte_Call_NvM_SWC_RPort_ShutdownTarget_GetLastShutdownTarget: call-type=REGULAR
    Rte_Call_NvM_SWC_RPort_ShutdownTarget_GetShutdownCause: call-type=REGULAR
    Rte_Call_NvM_SWC_RPort_ShutdownTarget_GetShutdownTarget: call-type=REGULAR
    Rte_Call_NvM_SWC_RPort_ShutdownTarget_SelectShutdownCause: call-type=REGULAR
    Rte_Call_NvM_SWC_RPort_ShutdownTarget_SelectShutdownTarget: call-type=REGULAR
    Rte_Call_SWC_CSPF_RP_SWC_IoHwAb_ADC_BSW_HwVer_IoHwAb_ADC_GetPhyVoltage: call-type=REGULAR
    Rte_Call_SWC_HSPF_RP_SWC_DEM_HSPF_VerMatchFailureFail_SetEventStatus: call-type=REGULAR
    Rte_Call_SWC_HSPF_RP_SWC_Dem_HSPF_InvOpenFail_SetEventStatus: call-type=REGULAR
    Rte_Call_SWC_HSPF_RP_SWC_Dem_HSPF_IphaOffCalFail_SetEventStatus: call-type=REGULAR
    Rte_Call_SWC_HSPF_RP_SWC_Dem_HSPF_MotorOpenFail_SetEventStatus: call-type=REGULAR
    Rte_Call_SWC_HSPF_RP_SWC_Dem_HSPF_tDBCTempCmpFail_SetEventStatus: call-type=REGULAR
    Rte_Call_SWC_HSPF_RP_SWC_FIM_HSPF_Sttr1Err_GetFunctionPermission: call-type=REGULAR
    Rte_Call_SWC_HSPF_RP_SWC_FIM_HSPF_Sttr2Err_GetFunctionPermission: call-type=REGULAR
    Rte_Call_SWC_HSPF_RP_SWC_FIM_HSPF_tDBCTempCmpErr_GetFunctionPermission: call-type=REGULAR
    Rte_Call_SWC_HSPF_RP_SWC_IoHwAb_ADC_BSW_HwVer_IoHwAb_ADC_GetPhyVoltage: call-type=REGULAR
    Rte_Call_SWC_HSPF_RP_SWC_IoHwAb_ADC_BSW_tCoolantTemp_IoHwAb_ADC_GetPhyVoltage: call-type=REGULAR
    Rte_Call_SWC_HSPF_RP_SWC_IoHwAb_ADC_BSW_tStrrTemp1_IoHwAb_ADC_GetPhyVoltage: call-type=REGULAR
    Rte_Call_SWC_HSPF_RP_SWC_IoHwAb_ADC_BSW_tStrrTemp2_IoHwAb_ADC_GetPhyVoltage: call-type=REGULAR
    Rte_Call_SWC_HSPF_RP_SWC_IoHwAb_ADC_BSW_uKl30_IoHwAb_ADC_GetPhyVoltage: call-type=REGULAR
    Rte_Call_SWC_HSPF_RP_SWC_IoHwAb_DIO_Get_BSW_Wake_IoHwAb_DIO_Get: call-type=REGULAR
    Rte_Call_SWC_HSPF_RP_SWC_IoHwAb_DIO_Get_BSW_bt15_IoHwAb_DIO_Get: call-type=REGULAR
    Rte_Call_SWC_HSPF_RP_SWC_IoHwAb_DIO_Get_BSW_flgCrash_IoHwAb_DIO_Get: call-type=REGULAR
    Rte_Call_SWC_HSPF_RP_SWC_IoHwAb_DIO_Get_BSW_flgMcuOpen_IoHwAb_DIO_Get: call-type=REGULAR
    Rte_Call_SWC_HSPF_RP_SWC_IoHwAb_DIO_Get_BSW_flgMotorOpen_IoHwAb_DIO_Get: call-type=REGULAR
    Rte_Call_SWC_HSPF_RP_SWC_IoHwAb_DIO_Set_HSPF_flgSwtTSttr1_IoHwAb_DIO_Set: call-type=REGULAR
    Rte_Call_SWC_HSPF_RP_SWC_IoHwAb_DIO_Set_HSPF_flgSwtTSttr2_IoHwAb_DIO_Set: call-type=REGULAR
    Rte_Call_SWC_MDF_RP_SWC_Dem_MDF_AlOfsNoPlausFail_SetEventStatus: call-type=REGULAR
    Rte_Call_SWC_MDF_RP_SWC_Dem_MDF_DiashCirNoPsblFail_SetEventStatus: call-type=REGULAR
    Rte_Call_SWC_MDF_RP_SWC_Dem_MDF_EmacBlkdFail_SetEventStatus: call-type=REGULAR
    Rte_Call_SWC_MDF_RP_SWC_Dem_MDF_EmacBlkdWarn_SetEventStatus: call-type=REGULAR
    Rte_Call_SWC_MDF_RP_SWC_Dem_MDF_ICtlRatFail_SetEventStatus: call-type=REGULAR
    Rte_Call_SWC_MDF_RP_SWC_Dem_MDF_IsOvHiFail_SetEventStatus: call-type=REGULAR
    Rte_Call_SWC_MDF_RP_SWC_Dem_MDF_OpenCirNoPsblFail_SetEventStatus: call-type=REGULAR
    Rte_Call_SWC_MDF_RP_SWC_Dem_MDF_OperOutdRngFail_SetEventStatus: call-type=REGULAR
    Rte_Call_SWC_MDF_RP_SWC_Dem_MDF_PhaseLossFaultFail_SetEventStatus: call-type=REGULAR
    Rte_Call_SWC_MDF_RP_SWC_Dem_MDF_PrfElDrvFail_SetEventStatus: call-type=REGULAR
    Rte_Call_SWC_MDF_RP_SWC_FIM_MDFIsOvHiErr_GetFunctionPermission: call-type=REGULAR
    Rte_Call_SWC_MDF_RP_SWC_FIM_MDF_AlOfsNoPlausErr_GetFunctionPermission: call-type=REGULAR
    Rte_Call_SWC_MDF_RP_SWC_FIM_MDF_DiagPrfChkElecDt_GetFunctionPermission: call-type=REGULAR
    Rte_Call_SWC_MDF_RP_SWC_FIM_MDF_DiashCirNoPsblErr_GetFunctionPermission: call-type=REGULAR
    Rte_Call_SWC_MDF_RP_SWC_FIM_MDF_EmacBlkdWarn_GetFunctionPermission: call-type=REGULAR
    Rte_Call_SWC_MDF_RP_SWC_FIM_MDF_IctlRat_GetFunctionPermission: call-type=REGULAR
    Rte_Call_SWC_MDF_RP_SWC_FIM_MDF_OpenCirNoPsblErr_GetFunctionPermission: call-type=REGULAR
    Rte_Call_SWC_MDF_RP_SWC_FIM_MDF_OperOutdRngErr_GetFunctionPermission: call-type=REGULAR
    Rte_Call_SWC_MDF_RP_SWC_FIM_MDF_PhaseLossFaultErr_GetFunctionPermission: call-type=REGULAR
    Rte_Call_SWC_PCF_RP_SWC_Dem_PCF_ActOvTiErr_SetEventStatus: call-type=REGULAR
    Rte_Call_SWC_PCF_RP_SWC_Dem_PCF_IdcOvErr_SetEventStatus: call-type=REGULAR
    Rte_Call_SWC_PCF_RP_SWC_Dem_PCF_SelfcheckErr_SetEventStatus: call-type=REGULAR
    Rte_Call_SWC_PCF_RP_SWC_Dem_PCF_SenClbErr_SetEventStatus: call-type=REGULAR
    Rte_Call_SWC_PCF_RP_SWC_Dem_PCF_SenOvErr_SetEventStatus: call-type=REGULAR
    Rte_Call_SWC_PCF_RP_SWC_Dem_PCF_StallRetryErr_SetEventStatus: call-type=REGULAR
    Rte_Call_SWC_PCF_RP_SWC_Dem_PCF_StallWarn_SetEventStatus: call-type=REGULAR
    Rte_Call_SWC_PCF_RP_SWC_Dem_PCF_UnexpPosErr_SetEventStatus: call-type=REGULAR
    Rte_Call_SWC_PCF_RP_SWC_IoHwAb_ADC_BSW_IUBPCF_IoHwAb_ADC_GetPhyVoltage: call-type=REGULAR
    Rte_Call_SWC_PCF_RP_SWC_IoHwAb_ADC_BSW_UBRPCF_IoHwAb_ADC_GetPhyVoltage: call-type=REGULAR
    Rte_Call_SWC_PCF_RP_SWC_IoHwAb_ADC_BSW_VDD5PCF_IoHwAb_ADC_GetPhyVoltage: call-type=REGULAR
    Rte_Call_SWC_PCF_RP_SWC_IoHwAb_ADC_BSW_tEpc_IoHwAb_ADC_GetPhyVoltage: call-type=REGULAR
    Rte_Call_SWC_PCF_RP_SWC_IoHwAb_DIO_Get_BSW_EnPcfEFUSE_IoHwAb_DIO_Get: call-type=REGULAR
    Rte_Call_SWC_PCF_RP_SWC_IoHwAb_DIO_Get_BSW_ParkHard_IoHwAb_DIO_Get: call-type=REGULAR
    Rte_Call_SWC_PCF_RP_SWC_IoHwAb_DIO_Get_BSW_bt15_IoHwAb_DIO_Get: call-type=REGULAR
    Rte_Call_SWC_PCF_RP_SWC_IoHwAb_DIO_Get_BSW_flgPcfOc_IoHwAb_DIO_Get: call-type=REGULAR
    Rte_Call_SWC_PCF_RP_SWC_IoHwAb_DIO_Set_PCF_enMos_IoHwAb_DIO_Set: call-type=REGULAR
    Rte_Call_SWC_RCF_RP_SWC_DEM_RCF_AccOvTiErr_SetEventStatus: call-type=REGULAR
    Rte_Call_SWC_RCF_RP_SWC_DEM_RCF_EstOfsErr_SetEventStatus: call-type=REGULAR
    Rte_Call_SWC_RCF_RP_SWC_DEM_RCF_FwlBwdOvTiErr_SetEventStatus: call-type=REGULAR
    Rte_Call_SWC_RCF_RP_SWC_DEM_RCF_FwlFwdOvTiErr_SetEventStatus: call-type=REGULAR
    Rte_Call_SWC_RCF_RP_SWC_DEM_RCF_OfsClbFailErr_SetEventStatus: call-type=REGULAR
    Rte_Call_SWC_RCF_RP_SWC_DEM_RCF_PsiOvErr_SetEventStatus: call-type=REGULAR
    Rte_Call_SWC_SCF_RP_SWC_DEM_SCF_DisChgOvTiFail_SetEventStatus: call-type=REGULAR
    Rte_Call_SWC_SCF_RP_SWC_DEM_SCF_LowPwrShtDwnOvTiFail_SetEventStatus: call-type=REGULAR
    Rte_Call_SWC_SCF_RP_SWC_DEM_SCF_RunToDisChaFail_SetEventStatus: call-type=REGULAR
    Rte_Call_SWC_SCF_RP_SWC_FIM_FiM_FlagforFR_GetFunctionPermission: call-type=REGULAR
    Rte_Call_SWC_SCF_RP_SWC_FIM_ReqFailrMod_GetFunctionPermission: call-type=REGULAR
    Rte_Call_SWC_SCF_RP_SWC_FIM_VCUComTimeOut_GetFunctionPermission: call-type=REGULAR
    Rte_Call_SWC_SCF_RP_SWC_FIM_flgDchaFailr_GetFunctionPermission: call-type=REGULAR
    Rte_Call_SWC_SCF_RP_SWC_FIM_flgFaultLvFive_GetFunctionPermission: call-type=REGULAR
    Rte_Call_SWC_SCF_RP_SWC_FIM_flgFaultLvFour_GetFunctionPermission: call-type=REGULAR
    Rte_Call_SWC_Snapshot_RP_SWC_IoHwAb_ADC_BSW_UBR_Vol_IoHwAb_ADC_GetPhyVoltage: call-type=REGULAR
    Rte_Call_SWC_Snapshot_RP_SWC_IoHwAb_ADC_BSW_VDD18L_Vol_IoHwAb_ADC_GetPhyVoltage: call-type=REGULAR
    Rte_Call_SWC_Snapshot_RP_SWC_IoHwAb_ADC_BSW_VDD5T1_Vol_IoHwAb_ADC_GetPhyVoltage: call-type=REGULAR
    Rte_Call_SWC_Snapshot_RP_SWC_IoHwAb_ADC_BSW_VDD5T2_Vol_IoHwAb_ADC_GetPhyVoltage: call-type=REGULAR
    Rte_Call_SWC_TPC_RP_SWC_Dem_TPC_SpdOvHiLimFail_SetEventStatus: call-type=REGULAR
    Rte_Call_SWC_TPC_RP_SWC_Dem_TPC_SpdOvHiWarn_SetEventStatus: call-type=REGULAR
    Rte_Call_SWC_TPC_RP_SWC_Dem_TPC_TCoolantOvHiWarn_SetEventStatus: call-type=REGULAR
    Rte_Call_SWC_TPC_RP_SWC_Dem_TPC_TDbcOvHiWarn_SetEventStatus: call-type=REGULAR
    Rte_Call_SWC_TPC_RP_SWC_Dem_TPC_TDbcOvLoWarn_SetEventStatus: call-type=REGULAR
    Rte_Call_SWC_TPC_RP_SWC_Dem_TPC_TDbcUHiLimFail_SetEventStatus: call-type=REGULAR
    Rte_Call_SWC_TPC_RP_SWC_Dem_TPC_TDbcULoLimFail_SetEventStatus: call-type=REGULAR
    Rte_Call_SWC_TPC_RP_SWC_Dem_TPC_TDbcVHiLimFail_SetEventStatus: call-type=REGULAR
    Rte_Call_SWC_TPC_RP_SWC_Dem_TPC_TDbcVLoLimFail_SetEventStatus: call-type=REGULAR
    Rte_Call_SWC_TPC_RP_SWC_Dem_TPC_TDbcWHiLimFail_SetEventStatus: call-type=REGULAR
    Rte_Call_SWC_TPC_RP_SWC_Dem_TPC_TDbcWLoLimFail_SetEventStatus: call-type=REGULAR
    Rte_Call_SWC_TPC_RP_SWC_Dem_TPC_TDrvBoardOvHiWarn_SetEventStatus: call-type=REGULAR
    Rte_Call_SWC_TPC_RP_SWC_Dem_TPC_TIGBTOvHiLimFail_SetEventStatus: call-type=REGULAR
    Rte_Call_SWC_TPC_RP_SWC_Dem_TPC_TIGBTOvHiWarn_SetEventStatus: call-type=REGULAR
    Rte_Call_SWC_TPC_RP_SWC_Dem_TPC_TIGBTOvLoWarn_SetEventStatus: call-type=REGULAR
    Rte_Call_SWC_TPC_RP_SWC_Dem_TPC_TSttrOvHiLimFail_SetEventStatus: call-type=REGULAR
    Rte_Call_SWC_TPC_RP_SWC_Dem_TPC_TSttrOvHiWarn_SetEventStatus: call-type=REGULAR
    Rte_Call_SWC_TPC_RP_SWC_Dem_TPC_TSttrOvLoWarn_SetEventStatus: call-type=REGULAR
    Rte_Call_SWC_TPC_RP_SWC_Dem_TPC_iDcLnkOvCLimFail_SetEventStatus: call-type=REGULAR
    Rte_Call_SWC_TPC_RP_SWC_Dem_TPC_iDcLnkOvcWarn_SetEventStatus: call-type=REGULAR
    Rte_Call_SWC_TPC_RP_SWC_Dem_TPC_uDcLnkOvVLimFail_SetEventStatus: call-type=REGULAR
    Rte_Call_SWC_TPC_RP_SWC_Dem_TPC_uDcLnkOvWarn_SetEventStatus: call-type=REGULAR
    Rte_Call_SWC_TPC_RP_SWC_Dem_TPC_uDcLnkUnVLimFail_SetEventStatus: call-type=REGULAR
    Rte_Call_SWC_TPC_RP_SWC_Dem_TPC_uDcLnkUnvWarn_SetEventStatus: call-type=REGULAR
    Rte_Call_SWC_TPC_RP_SWC_FIM_PwrLimLvFour_GetFunctionPermission: call-type=REGULAR
    Rte_Call_SWC_TPC_RP_SWC_FIM_PwrLimLvOne_GetFunctionPermission: call-type=REGULAR
    Rte_Call_SWC_TPC_RP_SWC_FIM_PwrLimLvThree_GetFunctionPermission: call-type=REGULAR
    Rte_Call_SWC_TPC_RP_SWC_FIM_PwrLimLvTwo_GetFunctionPermission: call-type=REGULAR
    Rte_Call_SWC_TPC_RP_SWC_FIM_TrqLimLvFour_GetFunctionPermission: call-type=REGULAR
    Rte_Call_SWC_TPC_RP_SWC_FIM_TrqLimLvOne_GetFunctionPermission: call-type=REGULAR
    Rte_Call_SWC_TPC_RP_SWC_FIM_TrqLimLvThree_GetFunctionPermission: call-type=REGULAR
    Rte_Call_SWC_TPC_RP_SWC_FIM_TrqLimLvTwo_GetFunctionPermission: call-type=REGULAR
    Rte_Call_SWC_VCF_RP_SWC_FIM_IGBTOvTempWarn_GetFunctionPermission: call-type=REGULAR
    Rte_Call_SWC_VCF_RP_SWC_FIM_MtrOvTempWarn_GetFunctionPermission: call-type=REGULAR
    Rte_Call_SWC_VCF_RP_SWC_FIM_ReqFailrMod_GetFunctionPermission: call-type=REGULAR
    Rte_DecrementWaitingCount: call-type=REGULAR
    Rte_GetCurrentTaskIndex: call-type=REGULAR
    Rte_MainFunction: call-type=REGULAR
    Rte_Mode_Dcm_Rp_Mdg2_MDGP_Mdg2: call-type=REGULAR
    Rte_Mode_Diag_SWC_RPort_DcmDiagnosticSessionControl_MDGP_DcmDiagnosticSessionControl: call-type=REGULAR
    Rte_Mode_Diag_SWC_RPort_DcmEcuReset_MDGP_DcmEcuReset: call-type=REGULAR
    Rte_ReadQueue: call-type=REGULAR
    Rte_Read_BswM_RP_BswMArbitration_BswM_MRP_SWC_RequestAfterRun_SCF_stSysCtl: call-type=REGULAR
    Rte_Read_BswM_RP_BswMArbitration_BswM_MRP_SWC_RequestShutDown_SCF_stSysCtl: call-type=REGULAR
    Rte_Read_Dcm_R_DataServices_DspData_ASW_VER_F189_Data: call-type=REGULAR
    Rte_Read_Dcm_R_DataServices_DspData_MANU_DATE_F18B_Data: call-type=REGULAR
    Rte_Read_Dcm_R_DataServices_DspData_SYS_SUP_ID_F18A_Data: call-type=REGULAR
    Rte_Read_Diag_SWC_RPort_DataServices_DspData_SYS_SUP_ID_F18A_Data: call-type=REGULAR
    Rte_Read_NvM_SWC_RP_SWC_PCF_PCF_SLInPLimt: call-type=REGULAR
    Rte_Read_NvM_SWC_RP_SWC_PCF_PCF_flgSLWD: call-type=REGULAR
    Rte_Read_NvM_SWC_RP_SWC_RCF_RCF_AutoClbOffset: call-type=REGULAR
    Rte_Read_NvM_SWC_RP_SWC_RCF_RCF_flgOfsClbSucToNVM: call-type=REGULAR
    Rte_Read_SWC_BCC_RP_SWC_HSPF_HSPF_tCoolantTempFlt: call-type=REGULAR
    Rte_Read_SWC_BCC_RP_SWC_HSPF_HSPF_tDBCTempUFlt: call-type=REGULAR
    Rte_Read_SWC_BCC_RP_SWC_HSPF_HSPF_tDBCTempVFlt: call-type=REGULAR
    Rte_Read_SWC_BCC_RP_SWC_HSPF_HSPF_tDBCTempWFlt: call-type=REGULAR
    Rte_Read_SWC_BCC_RP_SWC_HSPF_HSPF_uDcLnkSlowFlt: call-type=REGULAR
    Rte_Read_SWC_BCC_RP_SWC_MCF_MCF_DycU: call-type=REGULAR
    Rte_Read_SWC_BCC_RP_SWC_MCF_MCF_DycV: call-type=REGULAR
    Rte_Read_SWC_BCC_RP_SWC_MCF_MCF_DycW: call-type=REGULAR
    Rte_Read_SWC_BCC_RP_SWC_MCF_MCF_Is: call-type=REGULAR
    Rte_Read_SWC_BCC_RP_SWC_MCF_MCF_frqPwm: call-type=REGULAR
    Rte_Read_SWC_BCC_RP_SWC_MCF_MCF_iU: call-type=REGULAR
    Rte_Read_SWC_BCC_RP_SWC_MCF_MCF_iV: call-type=REGULAR
    Rte_Read_SWC_BCC_RP_SWC_MCF_MCF_iW: call-type=REGULAR
    Rte_Read_SWC_BCC_RP_SWC_MCF_MCF_secVolt: call-type=REGULAR
    Rte_Read_SWC_BCC_RP_SWC_MCF_MCF_tiLock: call-type=REGULAR
    Rte_Read_SWC_BCC_RP_SWC_MPC_MPC_dtCorFac: call-type=REGULAR
    Rte_Read_SWC_BCC_RP_SWC_Rdc_Rdc_nWoFlt: call-type=REGULAR
    Rte_Read_SWC_BCC_RP_SWC_SCF_SCF_stGateDrv: call-type=REGULAR
    Rte_Read_SWC_BCC_RP_SWC_TPC_TPC_stMotorMod: call-type=REGULAR
    Rte_Read_SWC_CSPF_RP_SWC_BCC_BCC_iDcLnkEstFlt: call-type=REGULAR
    Rte_Read_SWC_CSPF_RP_SWC_Com_Com_BMS01_BattCurr: call-type=REGULAR
    Rte_Read_SWC_CSPF_RP_SWC_Com_Com_BMS01_BattVoLt: call-type=REGULAR
    Rte_Read_SWC_CSPF_RP_SWC_Com_Com_BMS01_stMainReLay: call-type=REGULAR
    Rte_Read_SWC_CSPF_RP_SWC_Com_Com_RecflgDchaReq: call-type=REGULAR
    Rte_Read_SWC_CSPF_RP_SWC_Com_Com_VCU01_UdcMax: call-type=REGULAR
    Rte_Read_SWC_CSPF_RP_SWC_Com_Com_VCU01_UdcMin: call-type=REGULAR
    Rte_Read_SWC_CSPF_RP_SWC_Com_Com_VCU01_idcMax: call-type=REGULAR
    Rte_Read_SWC_CSPF_RP_SWC_Com_Com_VCU01_idcMin: call-type=REGULAR
    Rte_Read_SWC_CSPF_RP_SWC_Com_Com_VCU01_stHvbMaiRly: call-type=REGULAR
    Rte_Read_SWC_CSPF_RP_SWC_Com_Com_VCU02_KpHighNCtL: call-type=REGULAR
    Rte_Read_SWC_CSPF_RP_SWC_Com_Com_VCU02_KpLowNCtL: call-type=REGULAR
    Rte_Read_SWC_CSPF_RP_SWC_Com_Com_VCU02_NDiffMax: call-type=REGULAR
    Rte_Read_SWC_CSPF_RP_SWC_Com_Com_VCU02_TrqMaxNCtL: call-type=REGULAR
    Rte_Read_SWC_CSPF_RP_SWC_Com_Com_VCU02_TrqMinNCtL: call-type=REGULAR
    Rte_Read_SWC_CSPF_RP_SWC_Com_Com_VCU03_TrqMax: call-type=REGULAR
    Rte_Read_SWC_CSPF_RP_SWC_Com_Com_VCU03_TrqMin: call-type=REGULAR
    Rte_Read_SWC_CSPF_RP_SWC_Com_Com_VCU03_cTrqSlopeMax: call-type=REGULAR
    Rte_Read_SWC_CSPF_RP_SWC_Com_Com_VCU04_MotDir: call-type=REGULAR
    Rte_Read_SWC_CSPF_RP_SWC_Com_Com_VCU04_NSetP: call-type=REGULAR
    Rte_Read_SWC_CSPF_RP_SWC_Com_Com_VCU04_TrqSetP: call-type=REGULAR
    Rte_Read_SWC_CSPF_RP_SWC_Com_Com_VCU04_bKL15: call-type=REGULAR
    Rte_Read_SWC_CSPF_RP_SWC_Com_Com_VCU04_stModeReq: call-type=REGULAR
    Rte_Read_SWC_CSPF_RP_SWC_Com_Com_VCU05_OfsAL: call-type=REGULAR
    Rte_Read_SWC_CSPF_RP_SWC_Com_Com_VCU05_TrqDmpMax: call-type=REGULAR
    Rte_Read_SWC_CSPF_RP_SWC_Com_Com_VCU05_TrqDmpMin: call-type=REGULAR
    Rte_Read_SWC_CSPF_RP_SWC_Com_Com_VCU05_bSetOfsAL: call-type=REGULAR
    Rte_Read_SWC_CSPF_RP_SWC_Com_Com_VCU05_kDmp: call-type=REGULAR
    Rte_Read_SWC_CSPF_RP_SWC_Com_Com_VCU05_stDmpCtLReq: call-type=REGULAR
    Rte_Read_SWC_CSPF_RP_SWC_Com_Com_VCU_flgCrash: call-type=REGULAR
    Rte_Read_SWC_CSPF_RP_SWC_Cpld_Cpld_CpldSwVer: call-type=REGULAR
    Rte_Read_SWC_CSPF_RP_SWC_Cpld_Cpld_IgbtState: call-type=REGULAR
    Rte_Read_SWC_CSPF_RP_SWC_DiagCalib_DiagCalib_FailCode{1..8}: call-type=REGULAR
    Rte_Read_SWC_CSPF_RP_SWC_HSPF_HSPF_nSlowFlt: call-type=REGULAR
    Rte_Read_SWC_CSPF_RP_SWC_HSPF_HSPF_tCoolantTempFlt: call-type=REGULAR
    Rte_Read_SWC_CSPF_RP_SWC_HSPF_HSPF_tDBCTempUFlt: call-type=REGULAR
    Rte_Read_SWC_CSPF_RP_SWC_HSPF_HSPF_tDBCTempVFlt: call-type=REGULAR
    Rte_Read_SWC_CSPF_RP_SWC_HSPF_HSPF_tDBCTempWFlt: call-type=REGULAR
    Rte_Read_SWC_CSPF_RP_SWC_HSPF_HSPF_tStrrTemp1Flt: call-type=REGULAR
    Rte_Read_SWC_CSPF_RP_SWC_HSPF_HSPF_tStrrTemp2Flt: call-type=REGULAR
    Rte_Read_SWC_CSPF_RP_SWC_HSPF_HSPF_uDcLnkSlowFlt: call-type=REGULAR
    Rte_Read_SWC_CSPF_RP_SWC_HSPF_HSPF_uKl30Flt: call-type=REGULAR
    Rte_Read_SWC_CSPF_RP_SWC_HvMcu_HvMcu_HvMcuVer: call-type=REGULAR
    Rte_Read_SWC_CSPF_RP_SWC_MPC_MPC_IsFlt: call-type=REGULAR
    Rte_Read_SWC_CSPF_RP_SWC_MPC_MPC_TrqMechFlt: call-type=REGULAR
    Rte_Read_SWC_CSPF_RP_SWC_MPC_MPC_isdFlt: call-type=REGULAR
    Rte_Read_SWC_CSPF_RP_SWC_MPC_MPC_isqFlt: call-type=REGULAR
    Rte_Read_SWC_CSPF_RP_SWC_RCF_RCF_AutoClbOffset: call-type=REGULAR
    Rte_Read_SWC_CSPF_RP_SWC_RCF_RCF_flgOfsClbSuc: call-type=REGULAR
    Rte_Read_SWC_CSPF_RP_SWC_Rdc_Rdc_ArctanAgRtr: call-type=REGULAR
    Rte_Read_SWC_CSPF_RP_SWC_SCF_SCF_bHvReady: call-type=REGULAR
    Rte_Read_SWC_CSPF_RP_SWC_SCF_SCF_stDisChg: call-type=REGULAR
    Rte_Read_SWC_CSPF_RP_SWC_SCF_SCF_stDrvCtl: call-type=REGULAR
    Rte_Read_SWC_CSPF_RP_SWC_SCF_SCF_stGateDrv: call-type=REGULAR
    Rte_Read_SWC_CSPF_RP_SWC_SCF_SCF_stSysCtl: call-type=REGULAR
    Rte_Read_SWC_CSPF_RP_SWC_TDC_TDC_TrqDes: call-type=REGULAR
    Rte_Read_SWC_CSPF_RP_SWC_TDC_TDC_flgTrqLmtActv: call-type=REGULAR
    Rte_Read_SWC_CSPF_RP_SWC_TPC_TPC_TrqMax: call-type=REGULAR
    Rte_Read_SWC_CSPF_RP_SWC_TPC_TPC_TrqMin: call-type=REGULAR
    Rte_Read_SWC_CSPF_RP_SWC_TPC_TPC_bDernCAN: call-type=REGULAR
    Rte_Read_SWC_CSPF_RP_SWC_TPC_TPC_bDernCoolantTemp: call-type=REGULAR
    Rte_Read_SWC_CSPF_RP_SWC_TPC_TPC_bDernDbcTemp: call-type=REGULAR
    Rte_Read_SWC_CSPF_RP_SWC_TPC_TPC_bDernDrvBoardTemp: call-type=REGULAR
    Rte_Read_SWC_CSPF_RP_SWC_TPC_TPC_bDernExcMax: call-type=REGULAR
    Rte_Read_SWC_CSPF_RP_SWC_TPC_TPC_bDernExcMin: call-type=REGULAR
    Rte_Read_SWC_CSPF_RP_SWC_TPC_TPC_bDernMtrSpd: call-type=REGULAR
    Rte_Read_SWC_CSPF_RP_SWC_TPC_TPC_bDernOvrIdc: call-type=REGULAR
    Rte_Read_SWC_CSPF_RP_SWC_TPC_TPC_bDernOvrUdc: call-type=REGULAR
    Rte_Read_SWC_CSPF_RP_SWC_TPC_TPC_bDernStrTemp: call-type=REGULAR
    Rte_Read_SWC_CSPF_RP_SWC_TPC_TPC_bDernUndrUdc: call-type=REGULAR
    Rte_Read_SWC_CSPF_RP_SWC_TPC_TPC_stTrqEmMax: call-type=REGULAR
    Rte_Read_SWC_CSPF_RP_SWC_TPC_TPC_stTrqEmMin: call-type=REGULAR
    Rte_Read_SWC_Epark_RP_SWC_PCF_PCF_MotDir: call-type=REGULAR
    Rte_Read_SWC_Epark_RP_SWC_PCF_PCF_dycPWM: call-type=REGULAR
    Rte_Read_SWC_HSPF_RP_SWC_BCC_BCC_iDcLnkEstFlt: call-type=REGULAR
    Rte_Read_SWC_HSPF_RP_SWC_BCC_BCC_tCoolantTj: call-type=REGULAR
    Rte_Read_SWC_HSPF_RP_SWC_BCC_BCC_tIgbtTj: call-type=REGULAR
    Rte_Read_SWC_HSPF_RP_SWC_Cpld_Cpld_CpldSwVer: call-type=REGULAR
    Rte_Read_SWC_HSPF_RP_SWC_Cpld_Cpld_ProjectNum: call-type=REGULAR
    Rte_Read_SWC_HSPF_RP_SWC_HvMcu_HvMcu_HvMcuVer: call-type=REGULAR
    Rte_Read_SWC_HSPF_RP_SWC_HvMcu_HvMcu_tDBCTempU: call-type=REGULAR
    Rte_Read_SWC_HSPF_RP_SWC_HvMcu_HvMcu_tDBCTempV: call-type=REGULAR
    Rte_Read_SWC_HSPF_RP_SWC_HvMcu_HvMcu_tDBCTempW: call-type=REGULAR
    Rte_Read_SWC_HSPF_RP_SWC_HvMcu_HvMcu_tDrvBoardTemp: call-type=REGULAR
    Rte_Read_SWC_HSPF_RP_SWC_MCF_MCF_uDcLnk: call-type=REGULAR
    Rte_Read_SWC_HSPF_RP_SWC_MDF_MDF_bFaultEMBlkWarnSt: call-type=REGULAR
    Rte_Read_SWC_HSPF_RP_SWC_PhC_PhC_iUNoOff: call-type=REGULAR
    Rte_Read_SWC_HSPF_RP_SWC_PhC_PhC_iVNoOff: call-type=REGULAR
    Rte_Read_SWC_HSPF_RP_SWC_PhC_PhC_iWNoOff: call-type=REGULAR
    Rte_Read_SWC_HSPF_RP_SWC_Rdc_Rdc_nWoFlt: call-type=REGULAR
    Rte_Read_SWC_HSPF_RP_SWC_SCF_SCF_stPreDrvCtl: call-type=REGULAR
    Rte_Read_SWC_HvMcu_RP_SWC_RCF_RCF_stAgRtrOfsCal: call-type=REGULAR
    Rte_Read_SWC_HvMcu_RP_SWC_SCF_SCF_flgEmgReqInvDcha: call-type=REGULAR
    Rte_Read_SWC_MCF_RP_SWC_BCC_BCC_iDcLnkEstFlt: call-type=REGULAR
    Rte_Read_SWC_MCF_RP_SWC_HSPF_HSPF_iPhaUOffset: call-type=REGULAR
    Rte_Read_SWC_MCF_RP_SWC_HSPF_HSPF_iPhaVOffset: call-type=REGULAR
    Rte_Read_SWC_MCF_RP_SWC_HSPF_HSPF_iPhaWOffset: call-type=REGULAR
    Rte_Read_SWC_MCF_RP_SWC_HSPF_HSPF_stIphaOffCal: call-type=REGULAR
    Rte_Read_SWC_MCF_RP_SWC_HSPF_HSPF_tStrrTempFlt: call-type=REGULAR
    Rte_Read_SWC_MCF_RP_SWC_HvMcu_HvMcu_uDcLnkHvMcu: call-type=REGULAR
    Rte_Read_SWC_MCF_RP_SWC_MDF_MDF_bFaultEMBlkWarnSt: call-type=REGULAR
    Rte_Read_SWC_MCF_RP_SWC_MPC_MPC_CofRandomPwm: call-type=REGULAR
    Rte_Read_SWC_MCF_RP_SWC_MPC_MPC_Ld: call-type=REGULAR
    Rte_Read_SWC_MCF_RP_SWC_MPC_MPC_LdSubLq: call-type=REGULAR
    Rte_Read_SWC_MCF_RP_SWC_MPC_MPC_Lq: call-type=REGULAR
    Rte_Read_SWC_MCF_RP_SWC_MPC_MPC_OmBw: call-type=REGULAR
    Rte_Read_SWC_MCF_RP_SWC_MPC_MPC_Psi: call-type=REGULAR
    Rte_Read_SWC_MCF_RP_SWC_MPC_MPC_Rs: call-type=REGULAR
    Rte_Read_SWC_MCF_RP_SWC_MPC_MPC_Rv: call-type=REGULAR
    Rte_Read_SWC_MCF_RP_SWC_MPC_MPC_TrqMechFlt: call-type=REGULAR
    Rte_Read_SWC_MCF_RP_SWC_MPC_MPC_frqPwmVF: call-type=REGULAR
    Rte_Read_SWC_MCF_RP_SWC_MPC_MPC_isdFF: call-type=REGULAR
    Rte_Read_SWC_MCF_RP_SWC_MPC_MPC_isdMTPA: call-type=REGULAR
    Rte_Read_SWC_MCF_RP_SWC_MPC_MPC_isdMTPV: call-type=REGULAR
    Rte_Read_SWC_MCF_RP_SWC_NvM_NvM_AngAutoClbOffset: call-type=REGULAR
    Rte_Read_SWC_MCF_RP_SWC_NvM_NvM_flgAngAutoClbOffset: call-type=REGULAR
    Rte_Read_SWC_MCF_RP_SWC_PhC_PhC_iUNoOff: call-type=REGULAR
    Rte_Read_SWC_MCF_RP_SWC_PhC_PhC_iVNoOff: call-type=REGULAR
    Rte_Read_SWC_MCF_RP_SWC_PhC_PhC_iWNoOff: call-type=REGULAR
    Rte_Read_SWC_MCF_RP_SWC_PhC_PhC_uDcLnkLowMcu: call-type=REGULAR
    Rte_Read_SWC_MCF_RP_SWC_RCF_RCF_UsAlfaScalSet: call-type=REGULAR
    Rte_Read_SWC_MCF_RP_SWC_RCF_RCF_UsBetaScalSet: call-type=REGULAR
    Rte_Read_SWC_MCF_RP_SWC_RCF_RCF_agRtrOffsEstimd: call-type=REGULAR
    Rte_Read_SWC_MCF_RP_SWC_RCF_RCF_flgUseUsSet: call-type=REGULAR
    Rte_Read_SWC_MCF_RP_SWC_Rdc_Rdc_ArctanAgRtr: call-type=REGULAR
    Rte_Read_SWC_MCF_RP_SWC_Rdc_Rdc_nWoFlt: call-type=REGULAR
    Rte_Read_SWC_MCF_RP_SWC_SCF_SCF_FIM_ReqFailrMod: call-type=REGULAR
    Rte_Read_SWC_MCF_RP_SWC_SCF_SCF_flgEnDchaToMc: call-type=REGULAR
    Rte_Read_SWC_MCF_RP_SWC_SCF_SCF_flginitPI: call-type=REGULAR
    Rte_Read_SWC_MCF_RP_SWC_SCF_SCF_stGateDrv: call-type=REGULAR
    Rte_Read_SWC_MCF_RP_SWC_SCF_SCF_stPwmMode: call-type=REGULAR
    Rte_Read_SWC_MCF_RP_SWC_TDC_TDC_TrqDes: call-type=REGULAR
    Rte_Read_SWC_MCF_RP_SWC_TPC_TPC_TDbcTrqMax: call-type=REGULAR
    Rte_Read_SWC_MDF_RP_SWC_HSPF_HSPF_PwrDcLnk: call-type=REGULAR
    Rte_Read_SWC_MDF_RP_SWC_HSPF_HSPF_nSlowFlt: call-type=REGULAR
    Rte_Read_SWC_MDF_RP_SWC_HSPF_HSPF_tCoolantTempFlt: call-type=REGULAR
    Rte_Read_SWC_MDF_RP_SWC_HSPF_HSPF_tDBCTempUFlt: call-type=REGULAR
    Rte_Read_SWC_MDF_RP_SWC_HSPF_HSPF_tDBCTempVFlt: call-type=REGULAR
    Rte_Read_SWC_MDF_RP_SWC_HSPF_HSPF_tDBCTempWFlt: call-type=REGULAR
    Rte_Read_SWC_MDF_RP_SWC_HSPF_HSPF_tStrrTempFlt: call-type=REGULAR
    Rte_Read_SWC_MDF_RP_SWC_HSPF_HSPF_uDcLnkSlowFlt: call-type=REGULAR
    Rte_Read_SWC_MDF_RP_SWC_MCF_MCF_dtPwm: call-type=REGULAR
    Rte_Read_SWC_MDF_RP_SWC_MCF_MCF_iU: call-type=REGULAR
    Rte_Read_SWC_MDF_RP_SWC_MCF_MCF_iV: call-type=REGULAR
    Rte_Read_SWC_MDF_RP_SWC_MCF_MCF_iW: call-type=REGULAR
    Rte_Read_SWC_MDF_RP_SWC_MCF_MCF_idDes: call-type=REGULAR
    Rte_Read_SWC_MDF_RP_SWC_MCF_MCF_iqDes: call-type=REGULAR
    Rte_Read_SWC_MDF_RP_SWC_MCF_MCF_udDes: call-type=REGULAR
    Rte_Read_SWC_MDF_RP_SWC_MCF_MCF_uqDes: call-type=REGULAR
    Rte_Read_SWC_MDF_RP_SWC_MPC_MPC_IsFlt: call-type=REGULAR
    Rte_Read_SWC_MDF_RP_SWC_MPC_MPC_Ld: call-type=REGULAR
    Rte_Read_SWC_MDF_RP_SWC_MPC_MPC_Lq: call-type=REGULAR
    Rte_Read_SWC_MDF_RP_SWC_MPC_MPC_Psi: call-type=REGULAR
    Rte_Read_SWC_MDF_RP_SWC_MPC_MPC_Rs: call-type=REGULAR
    Rte_Read_SWC_MDF_RP_SWC_MPC_MPC_TrqMech: call-type=REGULAR
    Rte_Read_SWC_MDF_RP_SWC_MPC_MPC_isdFlt: call-type=REGULAR
    Rte_Read_SWC_MDF_RP_SWC_MPC_MPC_isqFlt: call-type=REGULAR
    Rte_Read_SWC_MDF_RP_SWC_RCF_RCF_stAgRtrOfsCal: call-type=REGULAR
    Rte_Read_SWC_MDF_RP_SWC_Rdc_Rdc_nWoFlt: call-type=REGULAR
    Rte_Read_SWC_MDF_RP_SWC_SCF_SCF_stDrvCtl: call-type=REGULAR
    Rte_Read_SWC_MDF_RP_SWC_SCF_SCF_stGateDrv: call-type=REGULAR
    Rte_Read_SWC_MDF_RP_SWC_SCF_SCF_stSysCtl: call-type=REGULAR
    Rte_Read_SWC_MDF_RP_SWC_VCF_VCF_TrqDes: call-type=REGULAR
    Rte_Read_SWC_MPC_RP_SWC_HSPF_HSPF_nSlowFlt: call-type=REGULAR
    Rte_Read_SWC_MPC_RP_SWC_HSPF_HSPF_tStrrTempFlt: call-type=REGULAR
    Rte_Read_SWC_MPC_RP_SWC_MCF_MCF_Is: call-type=REGULAR
    Rte_Read_SWC_MPC_RP_SWC_MCF_MCF_VoltModuRate: call-type=REGULAR
    Rte_Read_SWC_MPC_RP_SWC_MCF_MCF_idDes: call-type=REGULAR
    Rte_Read_SWC_MPC_RP_SWC_MCF_MCF_iqDes: call-type=REGULAR
    Rte_Read_SWC_MPC_RP_SWC_MCF_MCF_isd: call-type=REGULAR
    Rte_Read_SWC_MPC_RP_SWC_MCF_MCF_isq: call-type=REGULAR
    Rte_Read_SWC_MPC_RP_SWC_MCF_MCF_uDcLnk: call-type=REGULAR
    Rte_Read_SWC_MPC_RP_SWC_MCF_MCF_udDes: call-type=REGULAR
    Rte_Read_SWC_MPC_RP_SWC_MCF_MCF_uqDes: call-type=REGULAR
    Rte_Read_SWC_MPC_RP_SWC_TDC_TDC_TrqDes: call-type=REGULAR
    Rte_Read_SWC_MPC_RP_SWC_TPC_TPC_stMotorMod: call-type=REGULAR
    Rte_Read_SWC_PCF_RP_SWC_Com_Com_VCU06_Park: call-type=REGULAR
    Rte_Read_SWC_PCF_RP_SWC_Com_Com_VCU06_VehGrad: call-type=REGULAR
    Rte_Read_SWC_PCF_RP_SWC_Com_Com_VCU06_stBelt: call-type=REGULAR
    Rte_Read_SWC_PCF_RP_SWC_Com_Com_VCU06_stBreak: call-type=REGULAR
    Rte_Read_SWC_PCF_RP_SWC_Com_Com_VCU06_stDoor: call-type=REGULAR
    Rte_Read_SWC_PCF_RP_SWC_Epark_Epark_iPcf: call-type=REGULAR
    Rte_Read_SWC_PCF_RP_SWC_Epark_Epark_posPcf: call-type=REGULAR
    Rte_Read_SWC_PCF_RP_SWC_Epark_Epark_posPcfMon: call-type=REGULAR
    Rte_Read_SWC_PCF_RP_SWC_HSPF_HSPF_nSlowFlt: call-type=REGULAR
    Rte_Read_SWC_PCF_RP_SWC_NvM_NvM_SLFnh: call-type=REGULAR
    Rte_Read_SWC_PCF_RP_SWC_NvM_NvM_SLInPLimt: call-type=REGULAR
    Rte_Read_SWC_Pwm3ph_RP_SWC_MCF_MCF_DycU: call-type=REGULAR
    Rte_Read_SWC_Pwm3ph_RP_SWC_MCF_MCF_DycV: call-type=REGULAR
    Rte_Read_SWC_Pwm3ph_RP_SWC_MCF_MCF_DycW: call-type=REGULAR
    Rte_Read_SWC_Pwm3ph_RP_SWC_MCF_MCF_frqPwm: call-type=REGULAR
    Rte_Read_SWC_Pwm3ph_RP_SWC_MCF_MCF_stPwmMode: call-type=REGULAR
    Rte_Read_SWC_RCF_RP_SWC_CSPF_CSPF_RecstModeReq: call-type=REGULAR
    Rte_Read_SWC_RCF_RP_SWC_HSPF_HSPF_nSlowFlt: call-type=REGULAR
    Rte_Read_SWC_RCF_RP_SWC_HvMcu_HvMcu_AlOfsClb_TimeStamp: call-type=REGULAR
    Rte_Read_SWC_RCF_RP_SWC_HvMcu_HvMcu_flgUphaEdgeRiseCo: call-type=REGULAR
    Rte_Read_SWC_RCF_RP_SWC_MDF_MDF_stFrwhl: call-type=REGULAR
    Rte_Read_SWC_RCF_RP_SWC_NvM_NvM_flgAngAutoClbOffset: call-type=REGULAR
    Rte_Read_SWC_RCF_RP_SWC_Rdc_Rdc_ArctanAgRtr: call-type=REGULAR
    Rte_Read_SWC_RCF_RP_SWC_Rdc_Rdc_nWoFlt: call-type=REGULAR
    Rte_Read_SWC_RCF_RP_SWC_SCF_SCF_stDrvCtl: call-type=REGULAR
    Rte_Read_SWC_Rdc_PP_SWC_MCF_MCF_cofFrqPwm: call-type=REGULAR
    Rte_Read_SWC_SCF_RP_SWC_CSPF_CSPF_RecflgCrash: call-type=REGULAR
    Rte_Read_SWC_SCF_RP_SWC_CSPF_CSPF_RecflgDchaReq: call-type=REGULAR
    Rte_Read_SWC_SCF_RP_SWC_CSPF_CSPF_RecstMainReLay: call-type=REGULAR
    Rte_Read_SWC_SCF_RP_SWC_HSPF_HSPF_Wake: call-type=REGULAR
    Rte_Read_SWC_SCF_RP_SWC_HSPF_HSPF_bt15: call-type=REGULAR
    Rte_Read_SWC_SCF_RP_SWC_HSPF_HSPF_flgCrash: call-type=REGULAR
    Rte_Read_SWC_SCF_RP_SWC_HSPF_HSPF_nSlowFlt: call-type=REGULAR
    Rte_Read_SWC_SCF_RP_SWC_HSPF_HSPF_stIphaOffCal: call-type=REGULAR
    Rte_Read_SWC_SCF_RP_SWC_HSPF_HSPF_uDcLnkSlowFlt: call-type=REGULAR
    Rte_Read_SWC_SCF_RP_SWC_Igbt_Igbt_flgGateDrvRdyHs: call-type=REGULAR
    Rte_Read_SWC_SCF_RP_SWC_Igbt_Igbt_flgGateDrvRdyLs: call-type=REGULAR
    Rte_Read_SWC_SCF_RP_SWC_LvPower_LvPower_stLowpowerUp: call-type=REGULAR
    Rte_Read_SWC_SCF_RP_SWC_MDF_MDF_stFrwhl: call-type=REGULAR
    Rte_Read_SWC_SCF_RP_SWC_MPC_MPC_IsFlt: call-type=REGULAR
    Rte_Read_SWC_SCF_RP_SWC_NvM_NvM_flgAngAutoClbOffset: call-type=REGULAR
    Rte_Read_SWC_SCF_RP_SWC_PCF_PCF_SLEnMotorAcc: call-type=REGULAR
    Rte_Read_SWC_SCF_RP_SWC_PCF_PCF_Status: call-type=REGULAR
    Rte_Read_SWC_SCF_RP_SWC_PCF_PCF_flgAllowPwmRun: call-type=REGULAR
    Rte_Read_SWC_SCF_RP_SWC_PCF_PCF_flgShtDwnReq: call-type=REGULAR
    Rte_Read_SWC_SCF_RP_SWC_PCF_PCF_stParkCtl: call-type=REGULAR
    Rte_Read_SWC_SCF_RP_SWC_RCF_RCF_stAgRtrOfsCal: call-type=REGULAR
    Rte_Read_SWC_SCF_RP_SWC_RCF_RCF_stEstAlRtrOfs: call-type=REGULAR
    Rte_Read_SWC_SCF_RP_SWC_Snapshot_Snapshot_flgPostDrvDone: call-type=REGULAR
    Rte_Read_SWC_SCF_RP_SWC_Tja1043_Tja1043_flgCAN_WakeUp: call-type=REGULAR
    Rte_Read_SWC_SCF_RP_SWC_VCF_VCF_stModeReq: call-type=REGULAR
    Rte_Read_SWC_Snapshot_RP_SWC_HvMcu_HvMcu_VDD15L_Vol: call-type=REGULAR
    Rte_Read_SWC_Snapshot_RP_SWC_HvMcu_HvMcu_uDcLnkHvMcu: call-type=REGULAR
    Rte_Read_SWC_Snapshot_RP_SWC_PhC_PhC_iUNoOff: call-type=REGULAR
    Rte_Read_SWC_Snapshot_RP_SWC_PhC_PhC_iVNoOff: call-type=REGULAR
    Rte_Read_SWC_Snapshot_RP_SWC_PhC_PhC_iWNoOff: call-type=REGULAR
    Rte_Read_SWC_Snapshot_RP_SWC_Rdc_Rdc_ArctanAgRtr: call-type=REGULAR
    Rte_Read_SWC_Snapshot_RP_SWC_SCF_SCF_stFFAction: call-type=REGULAR
    Rte_Read_SWC_TDC_RP_SWC_Rdc_Rdc_nWoFlt: call-type=REGULAR
    Rte_Read_SWC_TDC_RP_SWC_SCF_SCF_stModeReqToTdc: call-type=REGULAR
    Rte_Read_SWC_TDC_RP_SWC_TPC_TPC_TrqMax: call-type=REGULAR
    Rte_Read_SWC_TDC_RP_SWC_TPC_TPC_TrqMin: call-type=REGULAR
    Rte_Read_SWC_TDC_RP_SWC_VCF_VCF_HoldStartTrq: call-type=REGULAR
    Rte_Read_SWC_TDC_RP_SWC_VCF_VCF_KpNCtl: call-type=REGULAR
    Rte_Read_SWC_TDC_RP_SWC_VCF_VCF_NsetPReq: call-type=REGULAR
    Rte_Read_SWC_TDC_RP_SWC_VCF_VCF_TrqDes: call-type=REGULAR
    Rte_Read_SWC_TDC_RP_SWC_VCF_VCF_stModeReq: call-type=REGULAR
    Rte_Read_SWC_TDC_RP_SWC_VCF_VCF_trqRamp: call-type=REGULAR
    Rte_Read_SWC_TPC_RP_SWC_CSPF_CSPF_RecTrqMax: call-type=REGULAR
    Rte_Read_SWC_TPC_RP_SWC_CSPF_CSPF_RecTrqMaxNCtL: call-type=REGULAR
    Rte_Read_SWC_TPC_RP_SWC_CSPF_CSPF_RecTrqMin: call-type=REGULAR
    Rte_Read_SWC_TPC_RP_SWC_CSPF_CSPF_RecTrqMinNCtL: call-type=REGULAR
    Rte_Read_SWC_TPC_RP_SWC_CSPF_CSPF_RecUdcMax: call-type=REGULAR
    Rte_Read_SWC_TPC_RP_SWC_CSPF_CSPF_RecUdcMin: call-type=REGULAR
    Rte_Read_SWC_TPC_RP_SWC_CSPF_CSPF_RecidcMax: call-type=REGULAR
    Rte_Read_SWC_TPC_RP_SWC_CSPF_CSPF_RecidcMin: call-type=REGULAR
    Rte_Read_SWC_TPC_RP_SWC_HSPF_HSPF_iDcLnkEstFlt: call-type=REGULAR
    Rte_Read_SWC_TPC_RP_SWC_HSPF_HSPF_nSlowFlt: call-type=REGULAR
    Rte_Read_SWC_TPC_RP_SWC_HSPF_HSPF_tCoolantTempFlt: call-type=REGULAR
    Rte_Read_SWC_TPC_RP_SWC_HSPF_HSPF_tCoolantTjFlt: call-type=REGULAR
    Rte_Read_SWC_TPC_RP_SWC_HSPF_HSPF_tDBCTempUFlt: call-type=REGULAR
    Rte_Read_SWC_TPC_RP_SWC_HSPF_HSPF_tDBCTempVFlt: call-type=REGULAR
    Rte_Read_SWC_TPC_RP_SWC_HSPF_HSPF_tDBCTempWFlt: call-type=REGULAR
    Rte_Read_SWC_TPC_RP_SWC_HSPF_HSPF_tDrvBoardTempFlt: call-type=REGULAR
    Rte_Read_SWC_TPC_RP_SWC_HSPF_HSPF_tIgbtTjFlt: call-type=REGULAR
    Rte_Read_SWC_TPC_RP_SWC_HSPF_HSPF_tStrrTempFlt: call-type=REGULAR
    Rte_Read_SWC_TPC_RP_SWC_HSPF_HSPF_uDcLnkSlowFlt: call-type=REGULAR
    Rte_Read_SWC_TPC_RP_SWC_MCF_MCF_Is: call-type=REGULAR
    Rte_Read_SWC_TPC_RP_SWC_MPC_MPC_TrqMech: call-type=REGULAR
    Rte_Read_SWC_TPC_RP_SWC_MPC_MPC_TrqMechFlt: call-type=REGULAR
    Rte_Read_SWC_TPC_RP_SWC_SCF_SCF_flgUdcLowToTpc: call-type=REGULAR
    Rte_Read_SWC_TPC_RP_SWC_VCF_VCF_TrqDes: call-type=REGULAR
    Rte_Read_SWC_TPC_RP_SWC_VCF_VCF_stModeReq: call-type=REGULAR
    Rte_Read_SWC_VCF_RP_SWC_CSPF_CSPF_RecKpDmp: call-type=REGULAR
    Rte_Read_SWC_VCF_RP_SWC_CSPF_CSPF_RecKpHighNCtL: call-type=REGULAR
    Rte_Read_SWC_VCF_RP_SWC_CSPF_CSPF_RecKpLowNCtL: call-type=REGULAR
    Rte_Read_SWC_VCF_RP_SWC_CSPF_CSPF_RecNDiffMax: call-type=REGULAR
    Rte_Read_SWC_VCF_RP_SWC_CSPF_CSPF_RecNSetP: call-type=REGULAR
    Rte_Read_SWC_VCF_RP_SWC_CSPF_CSPF_RecTrqDmpMax: call-type=REGULAR
    Rte_Read_SWC_VCF_RP_SWC_CSPF_CSPF_RecTrqDmpMin: call-type=REGULAR
    Rte_Read_SWC_VCF_RP_SWC_CSPF_CSPF_RecTrqSLope: call-type=REGULAR
    Rte_Read_SWC_VCF_RP_SWC_CSPF_CSPF_RecTrqSetP: call-type=REGULAR
    Rte_Read_SWC_VCF_RP_SWC_CSPF_CSPF_RecstDmpCtLReq: call-type=REGULAR
    Rte_Read_SWC_VCF_RP_SWC_CSPF_CSPF_RecstModeReq: call-type=REGULAR
    Rte_Read_SWC_VCF_RP_SWC_HSPF_HSPF_nSlowFlt: call-type=REGULAR
    Rte_Read_SWC_VCF_RP_SWC_MPC_MPC_TrqMechFlt: call-type=REGULAR
    Rte_Read_SWC_VCF_RP_SWC_PCF_PCF_SLtrqDes: call-type=REGULAR
    Rte_Read_SWC_VCF_RP_SWC_PCF_PCF_stParkCtl: call-type=REGULAR
    Rte_Read_SWC_VCF_RP_SWC_RCF_RCF_TrqEmDesOfsClb: call-type=REGULAR
    Rte_Read_SWC_VCF_RP_SWC_RCF_RCF_cTrqSlpOfsClb: call-type=REGULAR
    Rte_Read_SWC_VCF_RP_SWC_Rdc_Rdc_nWoFlt: call-type=REGULAR
    Rte_Read_SWC_VCF_RP_SWC_SCF_SCF_stDrvCtl: call-type=REGULAR
    Rte_Read_SWC_VCF_RP_SWC_TDC_TDC_TrqDes: call-type=REGULAR
    Rte_Read_SWC_VCF_RP_SWC_TPC_TPC_SgnRotDir: call-type=REGULAR
    Rte_Read_SWC_VCF_RP_SWC_TPC_TPC_SgnTrqMechDir: call-type=REGULAR
    Rte_SetEvent: call-type=REGULAR
    Rte_Start: call-type=REGULAR
    Rte_StartHook_Return: call-type=CALLBACK
    Rte_StartHook_Start: call-type=CALLBACK
    Rte_Stop: call-type=REGULAR
    Rte_StopHook_Return: call-type=CALLBACK
    Rte_StopHook_Start: call-type=CALLBACK
    Rte_Switch_Dcm_Pp_DcmCommunicationControl_ComMChannel_Can_Network_0_Channel_MDGP_DcmCommunicationControl_ComMChannel_Can_Network_0_Channel: call-type=REGULAR
    Rte_Switch_Dcm_Pp_DcmCommunicationControl_ComMChannel_Can_Network_1_Channel_MDGP_DcmCommunicationControl_ComMChannel_Can_Network_1_Channel: call-type=REGULAR
    Rte_Switch_Dcm_Pp_DcmControlDTCSetting_MDGP_DcmControlDTCSetting: call-type=REGULAR
    Rte_Switch_Dcm_Pp_DcmDiagnosticSessionControl_MDGP_DcmDiagnosticSessionControl: call-type=REGULAR
    Rte_Switch_Dcm_Pp_DcmEcuReset_MDGP_DcmEcuReset: call-type=REGULAR
    Rte_Switch_Diag_SWC_PPort_Mdg2_MDGP_Mdg2: call-type=REGULAR
    Rte_Task_Activate: call-type=CALLBACK
    Rte_WaitWithTimeout: call-type=REGULAR
    Rte_WriteQueue: call-type=REGULAR
    Rte_Write_Dcm_P_DataServices_DspData_ASW_VER_F189_Data: call-type=REGULAR
    Rte_Write_Dcm_P_DataServices_DspData_SYS_SUP_ID_F18A_Data: call-type=REGULAR
    Rte_Write_Diag_SWC_PPort_DataServices_DspData_ASW_VER_F189_Data: call-type=REGULAR
    Rte_Write_Diag_SWC_PPort_DataServices_DspData_MANU_DATE_F18B_Data: call-type=REGULAR
    Rte_Write_Diag_SWC_PPort_DataServices_DspData_SYS_SUP_ID_F18A_Data: call-type=REGULAR
    Rte_Write_Diag_SWC_PPort_Diag_Request_Shutdown_uint16: call-type=REGULAR
    Rte_Write_Diag_SWC_PPort_TST_FimPermisison_TST_FimPermission: call-type=REGULAR
    Rte_Write_NvM_SWC_PP_SWC_NvM_NvM_AngAutoClbOffset: call-type=REGULAR
    Rte_Write_NvM_SWC_PP_SWC_NvM_NvM_SLFnh: call-type=REGULAR
    Rte_Write_NvM_SWC_PP_SWC_NvM_NvM_SLInPLimt: call-type=REGULAR
    Rte_Write_NvM_SWC_PP_SWC_NvM_NvM_flgAngAutoClbOffset: call-type=REGULAR
    Rte_Write_NvM_SWC_PPort_NvM_Request_Shutdown_uint16: call-type=REGULAR
    Rte_Write_SWC_BCC_PP_SWC_BCC_BCC_iDcLnkEstFlt: call-type=REGULAR
    Rte_Write_SWC_BCC_PP_SWC_BCC_BCC_tCoolantTj: call-type=REGULAR
    Rte_Write_SWC_BCC_PP_SWC_BCC_BCC_tIgbtTj: call-type=REGULAR
    Rte_Write_SWC_CSPF_PP_SWC_CSPF_CSPF_RecKpDmp: call-type=REGULAR
    Rte_Write_SWC_CSPF_PP_SWC_CSPF_CSPF_RecKpHighNCtL: call-type=REGULAR
    Rte_Write_SWC_CSPF_PP_SWC_CSPF_CSPF_RecKpLowNCtL: call-type=REGULAR
    Rte_Write_SWC_CSPF_PP_SWC_CSPF_CSPF_RecNDiffMax: call-type=REGULAR
    Rte_Write_SWC_CSPF_PP_SWC_CSPF_CSPF_RecNSetP: call-type=REGULAR
    Rte_Write_SWC_CSPF_PP_SWC_CSPF_CSPF_RecTrqDmpMax: call-type=REGULAR
    Rte_Write_SWC_CSPF_PP_SWC_CSPF_CSPF_RecTrqDmpMin: call-type=REGULAR
    Rte_Write_SWC_CSPF_PP_SWC_CSPF_CSPF_RecTrqMax: call-type=REGULAR
    Rte_Write_SWC_CSPF_PP_SWC_CSPF_CSPF_RecTrqMaxNCtL: call-type=REGULAR
    Rte_Write_SWC_CSPF_PP_SWC_CSPF_CSPF_RecTrqMin: call-type=REGULAR
    Rte_Write_SWC_CSPF_PP_SWC_CSPF_CSPF_RecTrqMinNCtL: call-type=REGULAR
    Rte_Write_SWC_CSPF_PP_SWC_CSPF_CSPF_RecTrqSLope: call-type=REGULAR
    Rte_Write_SWC_CSPF_PP_SWC_CSPF_CSPF_RecTrqSetP: call-type=REGULAR
    Rte_Write_SWC_CSPF_PP_SWC_CSPF_CSPF_RecUdcMax: call-type=REGULAR
    Rte_Write_SWC_CSPF_PP_SWC_CSPF_CSPF_RecUdcMin: call-type=REGULAR
    Rte_Write_SWC_CSPF_PP_SWC_CSPF_CSPF_RecflgCrash: call-type=REGULAR
    Rte_Write_SWC_CSPF_PP_SWC_CSPF_CSPF_RecflgDchaReq: call-type=REGULAR
    Rte_Write_SWC_CSPF_PP_SWC_CSPF_CSPF_RecidcMax: call-type=REGULAR
    Rte_Write_SWC_CSPF_PP_SWC_CSPF_CSPF_RecidcMin: call-type=REGULAR
    Rte_Write_SWC_CSPF_PP_SWC_CSPF_CSPF_RecstDmpCtLReq: call-type=REGULAR
    Rte_Write_SWC_CSPF_PP_SWC_CSPF_CSPF_RecstMainReLay: call-type=REGULAR
    Rte_Write_SWC_CSPF_PP_SWC_CSPF_CSPF_RecstModeReq: call-type=REGULAR
    Rte_Write_SWC_CSPF_PP_SWC_CSPF_CSPF_TraCodeVer: call-type=REGULAR
    Rte_Write_SWC_CSPF_PP_SWC_CSPF_CSPF_TraCpldVer: call-type=REGULAR
    Rte_Write_SWC_CSPF_PP_SWC_CSPF_CSPF_TraDataVer: call-type=REGULAR
    Rte_Write_SWC_CSPF_PP_SWC_CSPF_CSPF_TraFailCode{1..8}: call-type=REGULAR
    Rte_Write_SWC_CSPF_PP_SWC_CSPF_CSPF_TraHvMcuVer: call-type=REGULAR
    Rte_Write_SWC_CSPF_PP_SWC_CSPF_CSPF_TraHwVer: call-type=REGULAR
    Rte_Write_SWC_CSPF_PP_SWC_CSPF_CSPF_TraNCurr: call-type=REGULAR
    Rte_Write_SWC_CSPF_PP_SWC_CSPF_CSPF_TraOfsAL: call-type=REGULAR
    Rte_Write_SWC_CSPF_PP_SWC_CSPF_CSPF_TraTempCurrCooL: call-type=REGULAR
    Rte_Write_SWC_CSPF_PP_SWC_CSPF_CSPF_TraTempCurrStr1: call-type=REGULAR
    Rte_Write_SWC_CSPF_PP_SWC_CSPF_CSPF_TraTempCurrStr2: call-type=REGULAR
    Rte_Write_SWC_CSPF_PP_SWC_CSPF_CSPF_TraTrqAbsMax: call-type=REGULAR
    Rte_Write_SWC_CSPF_PP_SWC_CSPF_CSPF_TraTrqAbsMin: call-type=REGULAR
    Rte_Write_SWC_CSPF_PP_SWC_CSPF_CSPF_TraTrqCurr: call-type=REGULAR
    Rte_Write_SWC_CSPF_PP_SWC_CSPF_CSPF_TraTrqCurrWoDmpC: call-type=REGULAR
    Rte_Write_SWC_CSPF_PP_SWC_CSPF_CSPF_TraUT30Curr: call-type=REGULAR
    Rte_Write_SWC_CSPF_PP_SWC_CSPF_CSPF_TraUdcCurr: call-type=REGULAR
    Rte_Write_SWC_CSPF_PP_SWC_CSPF_CSPF_TraagRtrELecSnsr: call-type=REGULAR
    Rte_Write_SWC_CSPF_PP_SWC_CSPF_CSPF_TrabDernCAN: call-type=REGULAR
    Rte_Write_SWC_CSPF_PP_SWC_CSPF_CSPF_TrabDernDrvBoardTemp: call-type=REGULAR
    Rte_Write_SWC_CSPF_PP_SWC_CSPF_CSPF_TrabDernN: call-type=REGULAR
    Rte_Write_SWC_CSPF_PP_SWC_CSPF_CSPF_TrabDernOvrUdc: call-type=REGULAR
    Rte_Write_SWC_CSPF_PP_SWC_CSPF_CSPF_TrabDernOvridc: call-type=REGULAR
    Rte_Write_SWC_CSPF_PP_SWC_CSPF_CSPF_TrabDernStrTemp: call-type=REGULAR
    Rte_Write_SWC_CSPF_PP_SWC_CSPF_CSPF_TrabDernTempCooL: call-type=REGULAR
    Rte_Write_SWC_CSPF_PP_SWC_CSPF_CSPF_TrabDernTempiGBT: call-type=REGULAR
    Rte_Write_SWC_CSPF_PP_SWC_CSPF_CSPF_TrabDernTrqMax: call-type=REGULAR
    Rte_Write_SWC_CSPF_PP_SWC_CSPF_CSPF_TrabDernTrqMin: call-type=REGULAR
    Rte_Write_SWC_CSPF_PP_SWC_CSPF_CSPF_TrabDernUndrUdc: call-type=REGULAR
    Rte_Write_SWC_CSPF_PP_SWC_CSPF_CSPF_TrabDmpCActv: call-type=REGULAR
    Rte_Write_SWC_CSPF_PP_SWC_CSPF_CSPF_TrabReadyHv: call-type=REGULAR
    Rte_Write_SWC_CSPF_PP_SWC_CSPF_CSPF_TraiGBTTempU: call-type=REGULAR
    Rte_Write_SWC_CSPF_PP_SWC_CSPF_CSPF_TraiGBTTempV: call-type=REGULAR
    Rte_Write_SWC_CSPF_PP_SWC_CSPF_CSPF_TraiGBTTempW: call-type=REGULAR
    Rte_Write_SWC_CSPF_PP_SWC_CSPF_CSPF_TraidcCurr: call-type=REGULAR
    Rte_Write_SWC_CSPF_PP_SWC_CSPF_CSPF_TraisCurr: call-type=REGULAR
    Rte_Write_SWC_CSPF_PP_SWC_CSPF_CSPF_Traisd: call-type=REGULAR
    Rte_Write_SWC_CSPF_PP_SWC_CSPF_CSPF_Traisq: call-type=REGULAR
    Rte_Write_SWC_CSPF_PP_SWC_CSPF_CSPF_TrastDischg: call-type=REGULAR
    Rte_Write_SWC_CSPF_PP_SWC_CSPF_CSPF_TrastGateDrv: call-type=REGULAR
    Rte_Write_SWC_CSPF_PP_SWC_CSPF_CSPF_TrastMode: call-type=REGULAR
    Rte_Write_SWC_CSPF_PP_SWC_CSPF_CSPF_TrastTrqEmMax: call-type=REGULAR
    Rte_Write_SWC_CSPF_PP_SWC_CSPF_CSPF_TrastTrqEmMin: call-type=REGULAR
    Rte_Write_SWC_Cpld_PP_SWC_Cpld_Cpld_CpldSwVer: call-type=REGULAR
    Rte_Write_SWC_Cpld_PP_SWC_Cpld_Cpld_IgbtState: call-type=REGULAR
    Rte_Write_SWC_Cpld_PP_SWC_Cpld_Cpld_ProjectNum: call-type=REGULAR
    Rte_Write_SWC_DiagCalib_PP_SWC_DiagCalib_DiagCalib_FailCode{1..8}: call-type=REGULAR
    Rte_Write_SWC_Epark_PP_SWC_Epark_Epark_iPcf: call-type=REGULAR
    Rte_Write_SWC_Epark_PP_SWC_Epark_Epark_posPcf: call-type=REGULAR
    Rte_Write_SWC_Epark_PP_SWC_Epark_Epark_posPcfMon: call-type=REGULAR
    Rte_Write_SWC_HSPF_PP_SWC_HSPF_HSPF_INV_Open: call-type=REGULAR
    Rte_Write_SWC_HSPF_PP_SWC_HSPF_HSPF_Motor_Open: call-type=REGULAR
    Rte_Write_SWC_HSPF_PP_SWC_HSPF_HSPF_PwrDcLnk: call-type=REGULAR
    Rte_Write_SWC_HSPF_PP_SWC_HSPF_HSPF_Wake: call-type=REGULAR
    Rte_Write_SWC_HSPF_PP_SWC_HSPF_HSPF_bt15: call-type=REGULAR
    Rte_Write_SWC_HSPF_PP_SWC_HSPF_HSPF_flgCrash: call-type=REGULAR
    Rte_Write_SWC_HSPF_PP_SWC_HSPF_HSPF_iDcLnkEstFlt: call-type=REGULAR
    Rte_Write_SWC_HSPF_PP_SWC_HSPF_HSPF_iPhaUOffset: call-type=REGULAR
    Rte_Write_SWC_HSPF_PP_SWC_HSPF_HSPF_iPhaVOffset: call-type=REGULAR
    Rte_Write_SWC_HSPF_PP_SWC_HSPF_HSPF_iPhaWOffset: call-type=REGULAR
    Rte_Write_SWC_HSPF_PP_SWC_HSPF_HSPF_nSlowFlt: call-type=REGULAR
    Rte_Write_SWC_HSPF_PP_SWC_HSPF_HSPF_stIphaOffCal: call-type=REGULAR
    Rte_Write_SWC_HSPF_PP_SWC_HSPF_HSPF_tCoolantTempFlt: call-type=REGULAR
    Rte_Write_SWC_HSPF_PP_SWC_HSPF_HSPF_tCoolantTjFlt: call-type=REGULAR
    Rte_Write_SWC_HSPF_PP_SWC_HSPF_HSPF_tDBCTempUFlt: call-type=REGULAR
    Rte_Write_SWC_HSPF_PP_SWC_HSPF_HSPF_tDBCTempVFlt: call-type=REGULAR
    Rte_Write_SWC_HSPF_PP_SWC_HSPF_HSPF_tDBCTempWFlt: call-type=REGULAR
    Rte_Write_SWC_HSPF_PP_SWC_HSPF_HSPF_tDrvBoardTempFlt: call-type=REGULAR
    Rte_Write_SWC_HSPF_PP_SWC_HSPF_HSPF_tIgbtTjFlt: call-type=REGULAR
    Rte_Write_SWC_HSPF_PP_SWC_HSPF_HSPF_tStrrTemp1Flt: call-type=REGULAR
    Rte_Write_SWC_HSPF_PP_SWC_HSPF_HSPF_tStrrTemp2Flt: call-type=REGULAR
    Rte_Write_SWC_HSPF_PP_SWC_HSPF_HSPF_tStrrTempFlt: call-type=REGULAR
    Rte_Write_SWC_HSPF_PP_SWC_HSPF_HSPF_uDcLnkSlowFlt: call-type=REGULAR
    Rte_Write_SWC_HSPF_PP_SWC_HSPF_HSPF_uKl30Flt: call-type=REGULAR
    Rte_Write_SWC_HvMcu_PP_SWC_HvMcu_HvMcu_AlOfsClb_TimeStamp: call-type=REGULAR
    Rte_Write_SWC_HvMcu_PP_SWC_HvMcu_HvMcu_HvMcuVer: call-type=REGULAR
    Rte_Write_SWC_HvMcu_PP_SWC_HvMcu_HvMcu_VDD15L_Vol: call-type=REGULAR
    Rte_Write_SWC_HvMcu_PP_SWC_HvMcu_HvMcu_flgUphaEdgeRiseCo: call-type=REGULAR
    Rte_Write_SWC_HvMcu_PP_SWC_HvMcu_HvMcu_tDBCTempU: call-type=REGULAR
    Rte_Write_SWC_HvMcu_PP_SWC_HvMcu_HvMcu_tDBCTempV: call-type=REGULAR
    Rte_Write_SWC_HvMcu_PP_SWC_HvMcu_HvMcu_tDBCTempW: call-type=REGULAR
    Rte_Write_SWC_HvMcu_PP_SWC_HvMcu_HvMcu_tDrvBoardTemp: call-type=REGULAR
    Rte_Write_SWC_HvMcu_PP_SWC_HvMcu_HvMcu_uBackEMF_U: call-type=REGULAR
    Rte_Write_SWC_HvMcu_PP_SWC_HvMcu_HvMcu_uBackEMF_V: call-type=REGULAR
    Rte_Write_SWC_HvMcu_PP_SWC_HvMcu_HvMcu_uBackEMF_W: call-type=REGULAR
    Rte_Write_SWC_HvMcu_PP_SWC_HvMcu_HvMcu_uDcLnkHvMcu: call-type=REGULAR
    Rte_Write_SWC_Igbt_PP_SWC_Igbt_Igbt_flgGateDrvRdyHs: call-type=REGULAR
    Rte_Write_SWC_Igbt_PP_SWC_Igbt_Igbt_flgGateDrvRdyLs: call-type=REGULAR
    Rte_Write_SWC_LvPower_PP_SWC_LvPower_LvPower_stLowpowerUp: call-type=REGULAR
    Rte_Write_SWC_MCF_PP_SWC_MCF_MCF_DycU: call-type=REGULAR
    Rte_Write_SWC_MCF_PP_SWC_MCF_MCF_DycV: call-type=REGULAR
    Rte_Write_SWC_MCF_PP_SWC_MCF_MCF_DycW: call-type=REGULAR
    Rte_Write_SWC_MCF_PP_SWC_MCF_MCF_Is: call-type=REGULAR
    Rte_Write_SWC_MCF_PP_SWC_MCF_MCF_VoltModuRate: call-type=REGULAR
    Rte_Write_SWC_MCF_PP_SWC_MCF_MCF_cofFrqPwm: call-type=REGULAR
    Rte_Write_SWC_MCF_PP_SWC_MCF_MCF_dtPwm: call-type=REGULAR
    Rte_Write_SWC_MCF_PP_SWC_MCF_MCF_frqPwm: call-type=REGULAR
    Rte_Write_SWC_MCF_PP_SWC_MCF_MCF_iU: call-type=REGULAR
    Rte_Write_SWC_MCF_PP_SWC_MCF_MCF_iV: call-type=REGULAR
    Rte_Write_SWC_MCF_PP_SWC_MCF_MCF_iW: call-type=REGULAR
    Rte_Write_SWC_MCF_PP_SWC_MCF_MCF_idDes: call-type=REGULAR
    Rte_Write_SWC_MCF_PP_SWC_MCF_MCF_iqDes: call-type=REGULAR
    Rte_Write_SWC_MCF_PP_SWC_MCF_MCF_isd: call-type=REGULAR
    Rte_Write_SWC_MCF_PP_SWC_MCF_MCF_isq: call-type=REGULAR
    Rte_Write_SWC_MCF_PP_SWC_MCF_MCF_secVolt: call-type=REGULAR
    Rte_Write_SWC_MCF_PP_SWC_MCF_MCF_stPwmMode: call-type=REGULAR
    Rte_Write_SWC_MCF_PP_SWC_MCF_MCF_tiLock: call-type=REGULAR
    Rte_Write_SWC_MCF_PP_SWC_MCF_MCF_uDcLnk: call-type=REGULAR
    Rte_Write_SWC_MCF_PP_SWC_MCF_MCF_udDes: call-type=REGULAR
    Rte_Write_SWC_MCF_PP_SWC_MCF_MCF_uqDes: call-type=REGULAR
    Rte_Write_SWC_MDF_PP_SWC_MDF_MDF_bFaultEMBlkWarnSt: call-type=REGULAR
    Rte_Write_SWC_MDF_PP_SWC_MDF_MDF_stFrwhl: call-type=REGULAR
    Rte_Write_SWC_MPC_PP_SWC_MPC_MPC_CofRandomPwm: call-type=REGULAR
    Rte_Write_SWC_MPC_PP_SWC_MPC_MPC_IsFlt: call-type=REGULAR
    Rte_Write_SWC_MPC_PP_SWC_MPC_MPC_Ld: call-type=REGULAR
    Rte_Write_SWC_MPC_PP_SWC_MPC_MPC_LdSubLq: call-type=REGULAR
    Rte_Write_SWC_MPC_PP_SWC_MPC_MPC_Lq: call-type=REGULAR
    Rte_Write_SWC_MPC_PP_SWC_MPC_MPC_OmBw: call-type=REGULAR
    Rte_Write_SWC_MPC_PP_SWC_MPC_MPC_Psi: call-type=REGULAR
    Rte_Write_SWC_MPC_PP_SWC_MPC_MPC_Rs: call-type=REGULAR
    Rte_Write_SWC_MPC_PP_SWC_MPC_MPC_Rv: call-type=REGULAR
    Rte_Write_SWC_MPC_PP_SWC_MPC_MPC_TrqMech: call-type=REGULAR
    Rte_Write_SWC_MPC_PP_SWC_MPC_MPC_TrqMechFlt: call-type=REGULAR
    Rte_Write_SWC_MPC_PP_SWC_MPC_MPC_dtCorFac: call-type=REGULAR
    Rte_Write_SWC_MPC_PP_SWC_MPC_MPC_frqPwmVF: call-type=REGULAR
    Rte_Write_SWC_MPC_PP_SWC_MPC_MPC_isdFF: call-type=REGULAR
    Rte_Write_SWC_MPC_PP_SWC_MPC_MPC_isdFlt: call-type=REGULAR
    Rte_Write_SWC_MPC_PP_SWC_MPC_MPC_isdMTPA: call-type=REGULAR
    Rte_Write_SWC_MPC_PP_SWC_MPC_MPC_isdMTPV: call-type=REGULAR
    Rte_Write_SWC_MPC_PP_SWC_MPC_MPC_isqFlt: call-type=REGULAR
    Rte_Write_SWC_PCF_PP_SWC_PCF_PCF_MotDir: call-type=REGULAR
    Rte_Write_SWC_PCF_PP_SWC_PCF_PCF_Pos1: call-type=REGULAR
    Rte_Write_SWC_PCF_PP_SWC_PCF_PCF_SLEnMotorAcc: call-type=REGULAR
    Rte_Write_SWC_PCF_PP_SWC_PCF_PCF_SLInPLimt: call-type=REGULAR
    Rte_Write_SWC_PCF_PP_SWC_PCF_PCF_SLInPLimtPos: call-type=REGULAR
    Rte_Write_SWC_PCF_PP_SWC_PCF_PCF_SLtrqDes: call-type=REGULAR
    Rte_Write_SWC_PCF_PP_SWC_PCF_PCF_Status: call-type=REGULAR
    Rte_Write_SWC_PCF_PP_SWC_PCF_PCF_dycPWM: call-type=REGULAR
    Rte_Write_SWC_PCF_PP_SWC_PCF_PCF_enMos: call-type=REGULAR
    Rte_Write_SWC_PCF_PP_SWC_PCF_PCF_flgAllowPwmRun: call-type=REGULAR
    Rte_Write_SWC_PCF_PP_SWC_PCF_PCF_flgSLWD: call-type=REGULAR
    Rte_Write_SWC_PCF_PP_SWC_PCF_PCF_flgShtDwnReq: call-type=REGULAR
    Rte_Write_SWC_PCF_PP_SWC_PCF_PCF_iPcf: call-type=REGULAR
    Rte_Write_SWC_PCF_PP_SWC_PCF_PCF_stParkCtl: call-type=REGULAR
    Rte_Write_SWC_PhC_PP_SWC_PhC_PhC_iUNoOff: call-type=REGULAR
    Rte_Write_SWC_PhC_PP_SWC_PhC_PhC_iVNoOff: call-type=REGULAR
    Rte_Write_SWC_PhC_PP_SWC_PhC_PhC_iWNoOff: call-type=REGULAR
    Rte_Write_SWC_PhC_PP_SWC_PhC_PhC_uDcLnkLowMcu: call-type=REGULAR
    Rte_Write_SWC_RCF_PP_SWC_RCF_RCF_AutoClbOffset: call-type=REGULAR
    Rte_Write_SWC_RCF_PP_SWC_RCF_RCF_TrqEmDesOfsClb: call-type=REGULAR
    Rte_Write_SWC_RCF_PP_SWC_RCF_RCF_UsAlfaScalSet: call-type=REGULAR
    Rte_Write_SWC_RCF_PP_SWC_RCF_RCF_UsBetaScalSet: call-type=REGULAR
    Rte_Write_SWC_RCF_PP_SWC_RCF_RCF_agRtrOffsEstimd: call-type=REGULAR
    Rte_Write_SWC_RCF_PP_SWC_RCF_RCF_cTrqSlpOfsClb: call-type=REGULAR
    Rte_Write_SWC_RCF_PP_SWC_RCF_RCF_flgOfsClbSuc: call-type=REGULAR
    Rte_Write_SWC_RCF_PP_SWC_RCF_RCF_flgOfsClbSucToNVM: call-type=REGULAR
    Rte_Write_SWC_RCF_PP_SWC_RCF_RCF_flgUseUsSet: call-type=REGULAR
    Rte_Write_SWC_RCF_PP_SWC_RCF_RCF_stAgRtrOfsCal: call-type=REGULAR
    Rte_Write_SWC_RCF_PP_SWC_RCF_RCF_stEstAlRtrOfs: call-type=REGULAR
    Rte_Write_SWC_Rdc_PP_SWC_Rdc_Rdc_ArctanAgRtr: call-type=REGULAR
    Rte_Write_SWC_Rdc_PP_SWC_Rdc_Rdc_nWoFlt: call-type=REGULAR
    Rte_Write_SWC_SCF_PP_SWC_SCF_SCF_FIM_ReqFailrMod: call-type=REGULAR
    Rte_Write_SWC_SCF_PP_SWC_SCF_SCF_bHvReady: call-type=REGULAR
    Rte_Write_SWC_SCF_PP_SWC_SCF_SCF_flgActvDcha: call-type=REGULAR
    Rte_Write_SWC_SCF_PP_SWC_SCF_SCF_flgDataStrgBgnToBsw: call-type=REGULAR
    Rte_Write_SWC_SCF_PP_SWC_SCF_SCF_flgEmgReqInvDcha: call-type=REGULAR
    Rte_Write_SWC_SCF_PP_SWC_SCF_SCF_flgEnDchaToMc: call-type=REGULAR
    Rte_Write_SWC_SCF_PP_SWC_SCF_SCF_flgUdcLowToTpc: call-type=REGULAR
    Rte_Write_SWC_SCF_PP_SWC_SCF_SCF_flginitPI: call-type=REGULAR
    Rte_Write_SWC_SCF_PP_SWC_SCF_SCF_stDisChg: call-type=REGULAR
    Rte_Write_SWC_SCF_PP_SWC_SCF_SCF_stDrvCtl: call-type=REGULAR
    Rte_Write_SWC_SCF_PP_SWC_SCF_SCF_stFFAction: call-type=REGULAR
    Rte_Write_SWC_SCF_PP_SWC_SCF_SCF_stGateDrv: call-type=REGULAR
    Rte_Write_SWC_SCF_PP_SWC_SCF_SCF_stModeReqToTdc: call-type=REGULAR
    Rte_Write_SWC_SCF_PP_SWC_SCF_SCF_stPreDrvCtl: call-type=REGULAR
    Rte_Write_SWC_SCF_PP_SWC_SCF_SCF_stPwmMode: call-type=REGULAR
    Rte_Write_SWC_SCF_PP_SWC_SCF_SCF_stSysCtl: call-type=REGULAR
    Rte_Write_SWC_Snapshot_PP_SWC_Snapshot_Snapshot_flgPostDrvDone: call-type=REGULAR
    Rte_Write_SWC_TDC_PP_SWC_TDC_TDC_TrqDes: call-type=REGULAR
    Rte_Write_SWC_TDC_PP_SWC_TDC_TDC_flgTrqLmtActv: call-type=REGULAR
    Rte_Write_SWC_TPC_PP_SWC_TPC_TPC_SgnRotDir: call-type=REGULAR
    Rte_Write_SWC_TPC_PP_SWC_TPC_TPC_SgnTrqMechDir: call-type=REGULAR
    Rte_Write_SWC_TPC_PP_SWC_TPC_TPC_TDbcTrqMax: call-type=REGULAR
    Rte_Write_SWC_TPC_PP_SWC_TPC_TPC_TrqMax: call-type=REGULAR
    Rte_Write_SWC_TPC_PP_SWC_TPC_TPC_TrqMaxTrans: call-type=REGULAR
    Rte_Write_SWC_TPC_PP_SWC_TPC_TPC_TrqMin: call-type=REGULAR
    Rte_Write_SWC_TPC_PP_SWC_TPC_TPC_TrqMinTrans: call-type=REGULAR
    Rte_Write_SWC_TPC_PP_SWC_TPC_TPC_bDernCAN: call-type=REGULAR
    Rte_Write_SWC_TPC_PP_SWC_TPC_TPC_bDernCoolantTemp: call-type=REGULAR
    Rte_Write_SWC_TPC_PP_SWC_TPC_TPC_bDernDbcTemp: call-type=REGULAR
    Rte_Write_SWC_TPC_PP_SWC_TPC_TPC_bDernDrvBoardTemp: call-type=REGULAR
    Rte_Write_SWC_TPC_PP_SWC_TPC_TPC_bDernElecOvrIdc: call-type=REGULAR
    Rte_Write_SWC_TPC_PP_SWC_TPC_TPC_bDernExcMax: call-type=REGULAR
    Rte_Write_SWC_TPC_PP_SWC_TPC_TPC_bDernExcMin: call-type=REGULAR
    Rte_Write_SWC_TPC_PP_SWC_TPC_TPC_bDernGenOvrIdc: call-type=REGULAR
    Rte_Write_SWC_TPC_PP_SWC_TPC_TPC_bDernIGBTTemp: call-type=REGULAR
    Rte_Write_SWC_TPC_PP_SWC_TPC_TPC_bDernMtrSpd: call-type=REGULAR
    Rte_Write_SWC_TPC_PP_SWC_TPC_TPC_bDernOvrIdc: call-type=REGULAR
    Rte_Write_SWC_TPC_PP_SWC_TPC_TPC_bDernOvrUdc: call-type=REGULAR
    Rte_Write_SWC_TPC_PP_SWC_TPC_TPC_bDernStrTemp: call-type=REGULAR
    Rte_Write_SWC_TPC_PP_SWC_TPC_TPC_bDernUndrUdc: call-type=REGULAR
    Rte_Write_SWC_TPC_PP_SWC_TPC_TPC_stMotorMod: call-type=REGULAR
    Rte_Write_SWC_TPC_PP_SWC_TPC_TPC_stTrqEmMax: call-type=REGULAR
    Rte_Write_SWC_TPC_PP_SWC_TPC_TPC_stTrqEmMin: call-type=REGULAR
    Rte_Write_SWC_Tja1043_PP_SWC_Tja1043_Tja1043_flgCAN_WakeUp: call-type=REGULAR
    Rte_Write_SWC_VCF_PP_SWC_VCF_VCF_HoldStartTrq: call-type=REGULAR
    Rte_Write_SWC_VCF_PP_SWC_VCF_VCF_KpNCtl: call-type=REGULAR
    Rte_Write_SWC_VCF_PP_SWC_VCF_VCF_NsetPReq: call-type=REGULAR
    Rte_Write_SWC_VCF_PP_SWC_VCF_VCF_TrqDes: call-type=REGULAR
    Rte_Write_SWC_VCF_PP_SWC_VCF_VCF_stModeReq: call-type=REGULAR
    Rte_Write_SWC_VCF_PP_SWC_VCF_VCF_trqDesUnProc: call-type=REGULAR
    Rte_Write_SWC_VCF_PP_SWC_VCF_VCF_trqRamp: call-type=REGULAR
    Rte_memcpy: call-type=REGULAR
    SchM_Deinit: call-type=REGULAR
    SchM_IModeInit: call-type=REGULAR
    SchM_Init: call-type=REGULAR
    SchM_Mode_BswM_MDGR_BswM_MRP_BswM_MDG: call-type=REGULAR
    SchM_Mode_Dcm_R_DcmCommunicationControl_ComMChannel_Can_Network_0_Channel: call-type=REGULAR
    SchM_Mode_Dcm_R_DcmCommunicationControl_ComMChannel_Can_Network_1_Channel: call-type=REGULAR
    SchM_Switch_BswM_MDGP_AUTOSAR_BswM_ModeDeclarationGroups_MDG_ECUM_STATE: call-type=REGULAR
    SchM_Switch_Dcm_DcmDiagnosticSessionControl: call-type=REGULAR
    SchM_Switch_Dcm_DcmEcuReset: call-type=REGULAR
package /AUTOSAR_Rte/BswImplementations
  bsw implementation Rte: programming-language=C, sw-version=0.0.0, used-code-generator=ETAS RTEGen, ar-release-version=4.0.0, behavior=RteInternalBehavior
    generated-artifacts:
      157 x dependency on artifact:
        BswM_MemMap_h: artifact-descriptor={short-label=BswM_MemMap_h, category=SWHDR, domain=AUTOSAR}
        Com_h: artifact-descriptor={short-label=Com_h, category=SWHDR, domain=AUTOSAR}
        ComM_MemMap_h: artifact-descriptor={short-label=ComM_MemMap_h, category=SWHDR, domain=AUTOSAR}
        Dcm_MemMap_h: artifact-descriptor={short-label=Dcm_MemMap_h, category=SWHDR, domain=AUTOSAR}
        Dem_MemMap_h: artifact-descriptor={short-label=Dem_MemMap_h, category=SWHDR, domain=AUTOSAR}
        Det_MemMap_h: artifact-descriptor={short-label=Det_MemMap_h, category=SWHDR, domain=AUTOSAR}
        Diag_SWC_MemMap_h: artifact-descriptor={short-label=Diag_SWC_MemMap_h, category=SWHDR, domain=AUTOSAR}
        EcuM_MemMap_h: artifact-descriptor={short-label=EcuM_MemMap_h, category=SWHDR, domain=AUTOSAR}
        FiM_MemMap_h: artifact-descriptor={short-label=FiM_MemMap_h, category=SWHDR, domain=AUTOSAR}
        IoHwAbW_MemMap_h: artifact-descriptor={short-label=IoHwAbW_MemMap_h, category=SWHDR, domain=AUTOSAR}
        Ioc_h: artifact-descriptor={short-label=Ioc_h, category=SWHDR, domain=AUTOSAR}
        NvM_h: artifact-descriptor={short-label=NvM_h, category=SWHDR, domain=AUTOSAR}
        NvM_MemMap_h: artifact-descriptor={short-label=NvM_MemMap_h, category=SWHDR, domain=AUTOSAR}
        NvM_SWC_MemMap_h: artifact-descriptor={short-label=NvM_SWC_MemMap_h, category=SWHDR, domain=AUTOSAR}
        Os_h: artifact-descriptor={short-label=Os_h, category=SWHDR, domain=AUTOSAR}
        Rte_c: artifact-descriptor={short-label=Rte_c, category=SWSRC, domain=AUTOSAR}
        Rte_h: artifact-descriptor={short-label=Rte_h, category=SWHDR, domain=AUTOSAR}
        Rte_BswM_h: artifact-descriptor={short-label=Rte_BswM_h, category=SWHDR, domain=AUTOSAR}
        Rte_BswM_Type_h: artifact-descriptor={short-label=Rte_BswM_Type_h, category=SWHDR, domain=AUTOSAR}
        Rte_Cbk_h: artifact-descriptor={short-label=Rte_Cbk_h, category=SWHDR, domain=AUTOSAR}
        Rte_Cfg_h: artifact-descriptor={short-label=Rte_Cfg_h, category=SWHDR, domain=AUTOSAR}
        Rte_ComM_h: artifact-descriptor={short-label=Rte_ComM_h, category=SWHDR, domain=AUTOSAR}
        Rte_ComM_Type_h: artifact-descriptor={short-label=Rte_ComM_Type_h, category=SWHDR, domain=AUTOSAR}
        Rte_Const_h: artifact-descriptor={short-label=Rte_Const_h, category=SWHDR, domain=AUTOSAR}
        Rte_DataHandleType_h: artifact-descriptor={short-label=Rte_DataHandleType_h, category=SWHDR, domain=AUTOSAR}
        Rte_Dcm_h: artifact-descriptor={short-label=Rte_Dcm_h, category=SWHDR, domain=AUTOSAR}
        Rte_Dcm_Type_h: artifact-descriptor={short-label=Rte_Dcm_Type_h, category=SWHDR, domain=AUTOSAR}
        Rte_Dem_h: artifact-descriptor={short-label=Rte_Dem_h, category=SWHDR, domain=AUTOSAR}
        Rte_Dem_Type_h: artifact-descriptor={short-label=Rte_Dem_Type_h, category=SWHDR, domain=AUTOSAR}
        Rte_Det_h: artifact-descriptor={short-label=Rte_Det_h, category=SWHDR, domain=AUTOSAR}
        Rte_Det_Type_h: artifact-descriptor={short-label=Rte_Det_Type_h, category=SWHDR, domain=AUTOSAR}
        Rte_Diag_SWC_h: artifact-descriptor={short-label=Rte_Diag_SWC_h, category=SWHDR, domain=AUTOSAR}
        Rte_Diag_SWC_Type_h: artifact-descriptor={short-label=Rte_Diag_SWC_Type_h, category=SWHDR, domain=AUTOSAR}
        Rte_EcuM_h: artifact-descriptor={short-label=Rte_EcuM_h, category=SWHDR, domain=AUTOSAR}
        Rte_EcuM_Type_h: artifact-descriptor={short-label=Rte_EcuM_Type_h, category=SWHDR, domain=AUTOSAR}
        Rte_FiM_h: artifact-descriptor={short-label=Rte_FiM_h, category=SWHDR, domain=AUTOSAR}
        Rte_FiM_Type_h: artifact-descriptor={short-label=Rte_FiM_Type_h, category=SWHDR, domain=AUTOSAR}
        Rte_Hook_h: artifact-descriptor={short-label=Rte_Hook_h, category=SWHDR, domain=AUTOSAR}
        Rte_Intl_h: artifact-descriptor={short-label=Rte_Intl_h, category=SWHDR, domain=AUTOSAR}
        Rte_IoHwAbW_h: artifact-descriptor={short-label=Rte_IoHwAbW_h, category=SWHDR, domain=AUTOSAR}
        Rte_IoHwAbW_Type_h: artifact-descriptor={short-label=Rte_IoHwAbW_Type_h, category=SWHDR, domain=AUTOSAR}
        Rte_Lib_c: artifact-descriptor={short-label=Rte_Lib_c, category=SWSRC, domain=AUTOSAR}
        Rte_Main_h: artifact-descriptor={short-label=Rte_Main_h, category=SWHDR, domain=AUTOSAR}
        Rte_MemMap_h: artifact-descriptor={short-label=Rte_MemMap_h, category=SWHDR, domain=AUTOSAR}
        Rte_NvM_h: artifact-descriptor={short-label=Rte_NvM_h, category=SWHDR, domain=AUTOSAR}
        Rte_NvM_SWC_h: artifact-descriptor={short-label=Rte_NvM_SWC_h, category=SWHDR, domain=AUTOSAR}
        Rte_NvM_SWC_Type_h: artifact-descriptor={short-label=Rte_NvM_SWC_Type_h, category=SWHDR, domain=AUTOSAR}
        Rte_NvM_Type_h: artifact-descriptor={short-label=Rte_NvM_Type_h, category=SWHDR, domain=AUTOSAR}
        Rte_SWC_BCC_h: artifact-descriptor={short-label=Rte_SWC_BCC_h, category=SWHDR, domain=AUTOSAR}
        Rte_SWC_BCC_Type_h: artifact-descriptor={short-label=Rte_SWC_BCC_Type_h, category=SWHDR, domain=AUTOSAR}
        Rte_SWC_CSPF_h: artifact-descriptor={short-label=Rte_SWC_CSPF_h, category=SWHDR, domain=AUTOSAR}
        Rte_SWC_CSPF_Type_h: artifact-descriptor={short-label=Rte_SWC_CSPF_Type_h, category=SWHDR, domain=AUTOSAR}
        Rte_SWC_Cpld_h: artifact-descriptor={short-label=Rte_SWC_Cpld_h, category=SWHDR, domain=AUTOSAR}
        Rte_SWC_Cpld_Type_h: artifact-descriptor={short-label=Rte_SWC_Cpld_Type_h, category=SWHDR, domain=AUTOSAR}
        Rte_SWC_DiagCalib_h: artifact-descriptor={short-label=Rte_SWC_DiagCalib_h, category=SWHDR, domain=AUTOSAR}
        Rte_SWC_DiagCalib_Type_h: artifact-descriptor={short-label=Rte_SWC_DiagCalib_Type_h, category=SWHDR, domain=AUTOSAR}
        Rte_SWC_Epark_h: artifact-descriptor={short-label=Rte_SWC_Epark_h, category=SWHDR, domain=AUTOSAR}
        Rte_SWC_Epark_Type_h: artifact-descriptor={short-label=Rte_SWC_Epark_Type_h, category=SWHDR, domain=AUTOSAR}
        Rte_SWC_HSPF_h: artifact-descriptor={short-label=Rte_SWC_HSPF_h, category=SWHDR, domain=AUTOSAR}
        Rte_SWC_HSPF_Type_h: artifact-descriptor={short-label=Rte_SWC_HSPF_Type_h, category=SWHDR, domain=AUTOSAR}
        Rte_SWC_HvMcu_h: artifact-descriptor={short-label=Rte_SWC_HvMcu_h, category=SWHDR, domain=AUTOSAR}
        Rte_SWC_HvMcu_Type_h: artifact-descriptor={short-label=Rte_SWC_HvMcu_Type_h, category=SWHDR, domain=AUTOSAR}
        Rte_SWC_Igbt_h: artifact-descriptor={short-label=Rte_SWC_Igbt_h, category=SWHDR, domain=AUTOSAR}
        Rte_SWC_Igbt_Type_h: artifact-descriptor={short-label=Rte_SWC_Igbt_Type_h, category=SWHDR, domain=AUTOSAR}
        Rte_SWC_LvPower_h: artifact-descriptor={short-label=Rte_SWC_LvPower_h, category=SWHDR, domain=AUTOSAR}
        Rte_SWC_LvPower_Type_h: artifact-descriptor={short-label=Rte_SWC_LvPower_Type_h, category=SWHDR, domain=AUTOSAR}
        Rte_SWC_MCF_h: artifact-descriptor={short-label=Rte_SWC_MCF_h, category=SWHDR, domain=AUTOSAR}
        Rte_SWC_MCF_Type_h: artifact-descriptor={short-label=Rte_SWC_MCF_Type_h, category=SWHDR, domain=AUTOSAR}
        Rte_SWC_MDF_h: artifact-descriptor={short-label=Rte_SWC_MDF_h, category=SWHDR, domain=AUTOSAR}
        Rte_SWC_MDF_Type_h: artifact-descriptor={short-label=Rte_SWC_MDF_Type_h, category=SWHDR, domain=AUTOSAR}
        Rte_SWC_MPC_h: artifact-descriptor={short-label=Rte_SWC_MPC_h, category=SWHDR, domain=AUTOSAR}
        Rte_SWC_MPC_Type_h: artifact-descriptor={short-label=Rte_SWC_MPC_Type_h, category=SWHDR, domain=AUTOSAR}
        Rte_SWC_PCF_h: artifact-descriptor={short-label=Rte_SWC_PCF_h, category=SWHDR, domain=AUTOSAR}
        Rte_SWC_PCF_Type_h: artifact-descriptor={short-label=Rte_SWC_PCF_Type_h, category=SWHDR, domain=AUTOSAR}
        Rte_SWC_PhC_h: artifact-descriptor={short-label=Rte_SWC_PhC_h, category=SWHDR, domain=AUTOSAR}
        Rte_SWC_PhC_Type_h: artifact-descriptor={short-label=Rte_SWC_PhC_Type_h, category=SWHDR, domain=AUTOSAR}
        Rte_SWC_Pwm3ph_h: artifact-descriptor={short-label=Rte_SWC_Pwm3ph_h, category=SWHDR, domain=AUTOSAR}
        Rte_SWC_Pwm3ph_Type_h: artifact-descriptor={short-label=Rte_SWC_Pwm3ph_Type_h, category=SWHDR, domain=AUTOSAR}
        Rte_SWC_RCF_h: artifact-descriptor={short-label=Rte_SWC_RCF_h, category=SWHDR, domain=AUTOSAR}
        Rte_SWC_RCF_Type_h: artifact-descriptor={short-label=Rte_SWC_RCF_Type_h, category=SWHDR, domain=AUTOSAR}
        Rte_SWC_Rdc_h: artifact-descriptor={short-label=Rte_SWC_Rdc_h, category=SWHDR, domain=AUTOSAR}
        Rte_SWC_Rdc_Type_h: artifact-descriptor={short-label=Rte_SWC_Rdc_Type_h, category=SWHDR, domain=AUTOSAR}
        Rte_SWC_SCF_h: artifact-descriptor={short-label=Rte_SWC_SCF_h, category=SWHDR, domain=AUTOSAR}
        Rte_SWC_SCF_Type_h: artifact-descriptor={short-label=Rte_SWC_SCF_Type_h, category=SWHDR, domain=AUTOSAR}
        Rte_SWC_Snapshot_h: artifact-descriptor={short-label=Rte_SWC_Snapshot_h, category=SWHDR, domain=AUTOSAR}
        Rte_SWC_Snapshot_Type_h: artifact-descriptor={short-label=Rte_SWC_Snapshot_Type_h, category=SWHDR, domain=AUTOSAR}
        Rte_SWC_TDC_h: artifact-descriptor={short-label=Rte_SWC_TDC_h, category=SWHDR, domain=AUTOSAR}
        Rte_SWC_TDC_Type_h: artifact-descriptor={short-label=Rte_SWC_TDC_Type_h, category=SWHDR, domain=AUTOSAR}
        Rte_SWC_TPC_h: artifact-descriptor={short-label=Rte_SWC_TPC_h, category=SWHDR, domain=AUTOSAR}
        Rte_SWC_TPC_Type_h: artifact-descriptor={short-label=Rte_SWC_TPC_Type_h, category=SWHDR, domain=AUTOSAR}
        Rte_SWC_Task_Core0_h: artifact-descriptor={short-label=Rte_SWC_Task_Core0_h, category=SWHDR, domain=AUTOSAR}
        Rte_SWC_Task_Core0_Type_h: artifact-descriptor={short-label=Rte_SWC_Task_Core0_Type_h, category=SWHDR, domain=AUTOSAR}
        Rte_SWC_Task_Core1_h: artifact-descriptor={short-label=Rte_SWC_Task_Core1_h, category=SWHDR, domain=AUTOSAR}
        Rte_SWC_Task_Core1_Type_h: artifact-descriptor={short-label=Rte_SWC_Task_Core1_Type_h, category=SWHDR, domain=AUTOSAR}
        Rte_SWC_Task_Core2_h: artifact-descriptor={short-label=Rte_SWC_Task_Core2_h, category=SWHDR, domain=AUTOSAR}
        Rte_SWC_Task_Core2_Type_h: artifact-descriptor={short-label=Rte_SWC_Task_Core2_Type_h, category=SWHDR, domain=AUTOSAR}
        Rte_SWC_Tja1043_h: artifact-descriptor={short-label=Rte_SWC_Tja1043_h, category=SWHDR, domain=AUTOSAR}
        Rte_SWC_Tja1043_Type_h: artifact-descriptor={short-label=Rte_SWC_Tja1043_Type_h, category=SWHDR, domain=AUTOSAR}
        Rte_SWC_VCF_h: artifact-descriptor={short-label=Rte_SWC_VCF_h, category=SWHDR, domain=AUTOSAR}
        Rte_SWC_VCF_Type_h: artifact-descriptor={short-label=Rte_SWC_VCF_Type_h, category=SWHDR, domain=AUTOSAR}
        Rte_Type_h: artifact-descriptor={short-label=Rte_Type_h, category=SWHDR, domain=AUTOSAR}
        Rte_WdgM_SWC_h: artifact-descriptor={short-label=Rte_WdgM_SWC_h, category=SWHDR, domain=AUTOSAR}
        Rte_WdgM_SWC_Type_h: artifact-descriptor={short-label=Rte_WdgM_SWC_Type_h, category=SWHDR, domain=AUTOSAR}
        SWC_BCC_MemMap_h: artifact-descriptor={short-label=SWC_BCC_MemMap_h, category=SWHDR, domain=AUTOSAR}
        SWC_CSPF_MemMap_h: artifact-descriptor={short-label=SWC_CSPF_MemMap_h, category=SWHDR, domain=AUTOSAR}
        SWC_Cpld_MemMap_h: artifact-descriptor={short-label=SWC_Cpld_MemMap_h, category=SWHDR, domain=AUTOSAR}
        SWC_DiagCalib_MemMap_h: artifact-descriptor={short-label=SWC_DiagCalib_MemMap_h, category=SWHDR, domain=AUTOSAR}
        SWC_Epark_MemMap_h: artifact-descriptor={short-label=SWC_Epark_MemMap_h, category=SWHDR, domain=AUTOSAR}
        SWC_HSPF_MemMap_h: artifact-descriptor={short-label=SWC_HSPF_MemMap_h, category=SWHDR, domain=AUTOSAR}
        SWC_HvMcu_MemMap_h: artifact-descriptor={short-label=SWC_HvMcu_MemMap_h, category=SWHDR, domain=AUTOSAR}
        SWC_Igbt_MemMap_h: artifact-descriptor={short-label=SWC_Igbt_MemMap_h, category=SWHDR, domain=AUTOSAR}
        SWC_LvPower_MemMap_h: artifact-descriptor={short-label=SWC_LvPower_MemMap_h, category=SWHDR, domain=AUTOSAR}
        SWC_MCF_MemMap_h: artifact-descriptor={short-label=SWC_MCF_MemMap_h, category=SWHDR, domain=AUTOSAR}
        SWC_MDF_MemMap_h: artifact-descriptor={short-label=SWC_MDF_MemMap_h, category=SWHDR, domain=AUTOSAR}
        SWC_MPC_MemMap_h: artifact-descriptor={short-label=SWC_MPC_MemMap_h, category=SWHDR, domain=AUTOSAR}
        SWC_PCF_MemMap_h: artifact-descriptor={short-label=SWC_PCF_MemMap_h, category=SWHDR, domain=AUTOSAR}
        SWC_PhC_MemMap_h: artifact-descriptor={short-label=SWC_PhC_MemMap_h, category=SWHDR, domain=AUTOSAR}
        SWC_Pwm3ph_MemMap_h: artifact-descriptor={short-label=SWC_Pwm3ph_MemMap_h, category=SWHDR, domain=AUTOSAR}
        SWC_RCF_MemMap_h: artifact-descriptor={short-label=SWC_RCF_MemMap_h, category=SWHDR, domain=AUTOSAR}
        SWC_Rdc_MemMap_h: artifact-descriptor={short-label=SWC_Rdc_MemMap_h, category=SWHDR, domain=AUTOSAR}
        SWC_SCF_MemMap_h: artifact-descriptor={short-label=SWC_SCF_MemMap_h, category=SWHDR, domain=AUTOSAR}
        SWC_Snapshot_MemMap_h: artifact-descriptor={short-label=SWC_Snapshot_MemMap_h, category=SWHDR, domain=AUTOSAR}
        SWC_TDC_MemMap_h: artifact-descriptor={short-label=SWC_TDC_MemMap_h, category=SWHDR, domain=AUTOSAR}
        SWC_TPC_MemMap_h: artifact-descriptor={short-label=SWC_TPC_MemMap_h, category=SWHDR, domain=AUTOSAR}
        SWC_Task_Core{0..2}_MemMap_h: artifact-descriptor={short-label=SWC_Task_Core{0..2}_MemMap_h, category=SWHDR, domain=AUTOSAR}
        SWC_Tja1043_MemMap_h: artifact-descriptor={short-label=SWC_Tja1043_MemMap_h, category=SWHDR, domain=AUTOSAR}
        SWC_VCF_MemMap_h: artifact-descriptor={short-label=SWC_VCF_MemMap_h, category=SWHDR, domain=AUTOSAR}
        SchM_BswM_h: artifact-descriptor={short-label=SchM_BswM_h, category=SWHDR, domain=AUTOSAR}
        SchM_BswM_Type_h: artifact-descriptor={short-label=SchM_BswM_Type_h, category=SWHDR, domain=AUTOSAR}
        SchM_Can_h: artifact-descriptor={short-label=SchM_Can_h, category=SWHDR, domain=AUTOSAR}
        SchM_CanSM_h: artifact-descriptor={short-label=SchM_CanSM_h, category=SWHDR, domain=AUTOSAR}
        SchM_CanSM_Type_h: artifact-descriptor={short-label=SchM_CanSM_Type_h, category=SWHDR, domain=AUTOSAR}
        SchM_CanTp_h: artifact-descriptor={short-label=SchM_CanTp_h, category=SWHDR, domain=AUTOSAR}
        SchM_CanTp_Type_h: artifact-descriptor={short-label=SchM_CanTp_Type_h, category=SWHDR, domain=AUTOSAR}
        SchM_Can_Type_h: artifact-descriptor={short-label=SchM_Can_Type_h, category=SWHDR, domain=AUTOSAR}
        SchM_Com_h: artifact-descriptor={short-label=SchM_Com_h, category=SWHDR, domain=AUTOSAR}
        SchM_ComM_h: artifact-descriptor={short-label=SchM_ComM_h, category=SWHDR, domain=AUTOSAR}
        SchM_ComM_Type_h: artifact-descriptor={short-label=SchM_ComM_Type_h, category=SWHDR, domain=AUTOSAR}
        SchM_Com_Type_h: artifact-descriptor={short-label=SchM_Com_Type_h, category=SWHDR, domain=AUTOSAR}
        SchM_Dcm_h: artifact-descriptor={short-label=SchM_Dcm_h, category=SWHDR, domain=AUTOSAR}
        SchM_Dcm_Type_h: artifact-descriptor={short-label=SchM_Dcm_Type_h, category=SWHDR, domain=AUTOSAR}
        SchM_Dem_h: artifact-descriptor={short-label=SchM_Dem_h, category=SWHDR, domain=AUTOSAR}
        SchM_Dem_Type_h: artifact-descriptor={short-label=SchM_Dem_Type_h, category=SWHDR, domain=AUTOSAR}
        SchM_FiM_h: artifact-descriptor={short-label=SchM_FiM_h, category=SWHDR, domain=AUTOSAR}
        SchM_FiM_Type_h: artifact-descriptor={short-label=SchM_FiM_Type_h, category=SWHDR, domain=AUTOSAR}
        SchM_MemIf_h: artifact-descriptor={short-label=SchM_MemIf_h, category=SWHDR, domain=AUTOSAR}
        SchM_MemIf_Type_h: artifact-descriptor={short-label=SchM_MemIf_Type_h, category=SWHDR, domain=AUTOSAR}
        SchM_NvM_h: artifact-descriptor={short-label=SchM_NvM_h, category=SWHDR, domain=AUTOSAR}
        SchM_NvM_Type_h: artifact-descriptor={short-label=SchM_NvM_Type_h, category=SWHDR, domain=AUTOSAR}
        SchM_WdgM_h: artifact-descriptor={short-label=SchM_WdgM_h, category=SWHDR, domain=AUTOSAR}
        SchM_WdgM_Type_h: artifact-descriptor={short-label=SchM_WdgM_Type_h, category=SWHDR, domain=AUTOSAR}
        SchM_Xcp_h: artifact-descriptor={short-label=SchM_Xcp_h, category=SWHDR, domain=AUTOSAR}
        SchM_Xcp_Type_h: artifact-descriptor={short-label=SchM_Xcp_Type_h, category=SWHDR, domain=AUTOSAR}
        WdgM_SWC_MemMap_h: artifact-descriptor={short-label=WdgM_SWC_MemMap_h, category=SWHDR, domain=AUTOSAR}
        iocNeeds_h: artifact-descriptor={short-label=iocNeeds_h, category=SWHDR, domain=AUTOSAR}
    resource consumption ResConsumption
      96 x memory section:
        RTE_BSW_10MS_TASK_CORE0_CODE: prefix=RTE_BSW_10MS_TASK_CORE0, sw-addrmethod=CODE, symbol=CODE
        RTE_BSW_1MS_TASK_CORE0_CODE: prefix=RTE_BSW_1MS_TASK_CORE0, sw-addrmethod=CODE, symbol=CODE
        RTE_BSW_2MS_TASK_CORE0_CODE: prefix=RTE_BSW_2MS_TASK_CORE0, sw-addrmethod=CODE, symbol=CODE
        RTE_BSWM_CODE: executable-entity=[Rte_Read_BswM_RP_BswMArbitration_BswM_MRP_SWC_RequestAfterRun_SCF_stSysCtl, Rte_Read_BswM_RP_BswMArbitration_BswM_MRP_SWC_RequestShutDown_SCF_stSysCtl, SchM_Mode_BswM_MDGR_BswM_MRP_BswM_MDG, SchM_Switch_BswM_MDGP_AUTOSAR_BswM_ModeDeclarationGroups_MDG_ECUM_STATE], prefix=RTE_BSWM, sw-addrmethod=CODE, symbol=CODE
        RTE_DCM_CODE:
          executable-entity=[Rte_Call_Dcm_RoutineServices_DcmDspRoutine_CheckPgmPreCond_RequestResults, Rte_Call_Dcm_RoutineServices_DcmDspRoutine_CheckPgmPreCond_Start, Rte_Call_Dcm_RoutineServices_DcmDspRoutine_CheckPgmPreCond_Stop, Rte_Call_Dcm_RoutineServices_DcmDspRoutine_Test_RequestResults, Rte_Call_Dcm_RoutineServices_DcmDspRoutine_Test_Start, Rte_Call_Dcm_RoutineServices_DcmDspRoutine_Test_Stop, Rte_Call_Dcm_SecurityAccess_DSP_SEC_LEV_L1_CompareKey, Rte_Call_Dcm_SecurityAccess_DSP_SEC_LEV_L1_GetSeed, Rte_Call_Dcm_SecurityAccess_DSP_SEC_LEV_L2_CompareKey, Rte_Call_Dcm_SecurityAccess_DSP_SEC_LEV_L2_GetSeed, Rte_Call_Dcm_SecurityAccess_DSP_SEC_LEV_L3_CompareKey, Rte_Call_Dcm_SecurityAccess_DSP_SEC_LEV_L3_GetSeed, Rte_Call_Dcm_SecurityAccess_DSP_SEC_LEV_L4_CompareKey, Rte_Call_Dcm_SecurityAccess_DSP_SEC_LEV_L4_GetSeed, Rte_Mode_Dcm_Rp_Mdg2_MDGP_Mdg2, Rte_Read_Dcm_R_DataServices_DspData_ASW_VER_F189_Data, Rte_Read_Dcm_R_DataServices_DspData_MANU_DATE_F18B_Data, Rte_Read_Dcm_R_DataServices_DspData_SYS_SUP_ID_F18A_Data, Rte_Switch_Dcm_Pp_DcmCommunicationControl_ComMChannel_Can_Network_0_Channel_MDGP_DcmCommunicationControl_ComMChannel_Can_Network_0_Channel, Rte_Switch_Dcm_Pp_DcmCommunicationControl_ComMChannel_Can_Network_1_Channel_MDGP_DcmCommunicationControl_ComMChannel_Can_Network_1_Channel, Rte_Switch_Dcm_Pp_DcmControlDTCSetting_MDGP_DcmControlDTCSetting, Rte_Switch_Dcm_Pp_DcmDiagnosticSessionControl_MDGP_DcmDiagnosticSessionControl, Rte_Switch_Dcm_Pp_DcmEcuReset_MDGP_DcmEcuReset, Rte_Write_Dcm_P_DataServices_DspData_ASW_VER_F189_Data, Rte_Write_Dcm_P_DataServices_DspData_SYS_SUP_ID_F18A_Data, SchM_Mode_Dcm_R_DcmCommunicationControl_ComMChannel_Can_Network_0_Channel, SchM_Mode_Dcm_R_DcmCommunicationControl_ComMChannel_Can_Network_1_Channel, SchM_Switch_Dcm_DcmDiagnosticSessionControl, SchM_Switch_Dcm_DcmEcuReset]
          prefix=RTE_DCM
          sw-addrmethod=CODE
          symbol=CODE
        RTE_DEM_CODE:
          executable-entity=[Rte_Call_Dem_CBStatusComp_DemComponent_BusOff1_ComponentStatusChanged, Rte_Call_Dem_CBStatusComp_DemComponent_BusOff2_ComponentStatusChanged, Rte_Call_Dem_CBStatusComp_DemComponent_BusOff_ComponentStatusChanged, Rte_Call_Dem_CBStatusComp_DemComponent_MCAL_Status_ComponentStatusChanged, Rte_Call_Dem_CBStatusComp_DemComponent_MCU_Status_ComponentStatusChanged, Rte_Call_Dem_CBStatusComp_DemComponent_MPDU_CommStatus_ComponentStatusChanged, Rte_Call_Dem_CBStatusComp_DemComponent_NvM_ReadErr_ComponentStatusChanged, Rte_Call_Dem_CBStatusComp_DemComponent_NvM_WriteErr_ComponentStatusChanged, Rte_Call_Dem_CBStatusComp_DemComponent_SEN_1_CommStatus_ComponentStatusChanged, Rte_Call_Dem_CBStatusComp_DemComponent_SEN_CommStatus_ComponentStatusChanged, Rte_Call_Dem_CBStatusComp_DemComponent_VCU_DC01_AliveCounter_ComponentStatusChanged, Rte_Call_Dem_CBStatusComp_DemComponent_VCU_DC01_CheckSum_ComponentStatusChanged, Rte_Call_Dem_CBStatusComp_DemComponent_VCU_DC01_DLC_ComponentStatusChanged, Rte_Call_Dem_CBStatusComp_DemComponent_VCU_DC01_Tiout_ComponentStatusChanged]
          prefix=RTE_DEM
          sw-addrmethod=CODE
          symbol=CODE
        RTE_DIAG_SWC_CODE:
          executable-entity=[Rte_Call_Diag_SWC_RPort_ControlDTCSuppression_SetDTCSuppression, Rte_Call_Diag_SWC_RPort_DCMServices_GetActiveProtocol, Rte_Call_Diag_SWC_RPort_DCMServices_GetSecurityLevel, Rte_Call_Diag_SWC_RPort_DCMServices_GetSesCtrlType, Rte_Call_Diag_SWC_RPort_DCMServices_ResetToDefaultSession, Rte_Call_Diag_SWC_RPort_EcuMSelectResetTarget_SelectShutdownTarget, Rte_Call_Diag_SWC_RPort_Event_Event_LostComm_MPDU_ClearPrestoredFreezeFrame, Rte_Call_Diag_SWC_RPort_Event_Event_LostComm_MPDU_PrestoreFreezeFrame, Rte_Call_Diag_SWC_RPort_Event_Event_LostComm_MPDU_ResetEventStatus, Rte_Call_Diag_SWC_RPort_Event_Event_LostComm_MPDU_SetEventStatus, Rte_Call_Diag_SWC_RPort_Event_Event_LostComm_SEN_1_ClearPrestoredFreezeFrame, Rte_Call_Diag_SWC_RPort_Event_Event_LostComm_SEN_1_PrestoreFreezeFrame, Rte_Call_Diag_SWC_RPort_Event_Event_LostComm_SEN_1_ResetEventStatus, Rte_Call_Diag_SWC_RPort_Event_Event_LostComm_SEN_1_SetEventStatus, Rte_Call_Diag_SWC_RPort_Event_Event_LostComm_SEN_ClearPrestoredFreezeFrame, Rte_Call_Diag_SWC_RPort_Event_Event_LostComm_SEN_PrestoreFreezeFrame, Rte_Call_Diag_SWC_RPort_Event_Event_LostComm_SEN_ResetEventStatus, Rte_Call_Diag_SWC_RPort_Event_Event_LostComm_SEN_SetEventStatus, Rte_Call_Diag_SWC_RPort_EvtInfo_Event_LostComm_MPDU_GetDTCOfEvent, Rte_Call_Diag_SWC_RPort_EvtInfo_Event_LostComm_MPDU_GetEventFailed, Rte_Call_Diag_SWC_RPort_EvtInfo_Event_LostComm_MPDU_GetEventStatus, Rte_Call_Diag_SWC_RPort_EvtInfo_Event_LostComm_MPDU_GetEventTested, Rte_Call_Diag_SWC_RPort_EvtInfo_Event_LostComm_MPDU_GetFaultDetectionCounter, Rte_Call_Diag_SWC_RPort_EvtInfo_Event_LostComm_SEN_1_GetDTCOfEvent, Rte_Call_Diag_SWC_RPort_EvtInfo_Event_LostComm_SEN_1_GetEventFailed, Rte_Call_Diag_SWC_RPort_EvtInfo_Event_LostComm_SEN_1_GetEventStatus, Rte_Call_Diag_SWC_RPort_EvtInfo_Event_LostComm_SEN_1_GetEventTested, Rte_Call_Diag_SWC_RPort_EvtInfo_Event_LostComm_SEN_1_GetFaultDetectionCounter, Rte_Call_Diag_SWC_RPort_EvtInfo_Event_LostComm_SEN_GetDTCOfEvent, Rte_Call_Diag_SWC_RPort_EvtInfo_Event_LostComm_SEN_GetEventFailed, Rte_Call_Diag_SWC_RPort_EvtInfo_Event_LostComm_SEN_GetEventStatus, Rte_Call_Diag_SWC_RPort_EvtInfo_Event_LostComm_SEN_GetEventTested, Rte_Call_Diag_SWC_RPort_EvtInfo_Event_LostComm_SEN_GetFaultDetectionCounter, Rte_Call_Diag_SWC_RPort_FiMFID_0_GetFunctionPermission, Rte_Call_Diag_SWC_RPort_OpCycle_DemOperationCycle_0_SetOperationCycleState, Rte_Mode_Diag_SWC_RPort_DcmDiagnosticSessionControl_MDGP_DcmDiagnosticSessionControl, Rte_Mode_Diag_SWC_RPort_DcmEcuReset_MDGP_DcmEcuReset, Rte_Read_Diag_SWC_RPort_DataServices_DspData_SYS_SUP_ID_F18A_Data, Rte_Switch_Diag_SWC_PPort_Mdg2_MDGP_Mdg2, Rte_Write_Diag_SWC_PPort_DataServices_DspData_ASW_VER_F189_Data, Rte_Write_Diag_SWC_PPort_DataServices_DspData_MANU_DATE_F18B_Data, Rte_Write_Diag_SWC_PPort_DataServices_DspData_SYS_SUP_ID_F18A_Data, Rte_Write_Diag_SWC_PPort_Diag_Request_Shutdown_uint16, Rte_Write_Diag_SWC_PPort_TST_FimPermisison_TST_FimPermission]
          prefix=RTE_DIAG_SWC
          sw-addrmethod=CODE
          symbol=CODE
        RTE_EXT_CODE: executable-entity=[Rte_ActivateRE, Rte_SetEvent, Rte_WriteQueue], prefix=RTE_EXT, sw-addrmethod=CODE, symbol=CODE
        RTE_LIB_CODE: executable-entity=[Rte_GetCurrentTaskIndex, Rte_memcpy], prefix=RTE_LIB, sw-addrmethod=CODE, symbol=CODE
        RTE_MAIN_CODE: executable-entity=[Rte_MainFunction, Rte_Start, Rte_Stop, SchM_Deinit, SchM_Init], prefix=RTE_MAIN, sw-addrmethod=CODE, symbol=CODE
        RTE_NVM_SWC_CODE:
          executable-entity=[Rte_Call_NvM_SWC_RPort_NvM_SWC_BlockNative_1024_EraseBlock, Rte_Call_NvM_SWC_RPort_NvM_SWC_BlockNative_1024_GetDataIndex, Rte_Call_NvM_SWC_RPort_NvM_SWC_BlockNative_1024_GetErrorStatus, Rte_Call_NvM_SWC_RPort_NvM_SWC_BlockNative_1024_InvalidateNvBlock, Rte_Call_NvM_SWC_RPort_NvM_SWC_BlockNative_1024_ReadBlock, Rte_Call_NvM_SWC_RPort_NvM_SWC_BlockNative_1024_RestoreBlockDefaults, Rte_Call_NvM_SWC_RPort_NvM_SWC_BlockNative_1024_SetDataIndex, Rte_Call_NvM_SWC_RPort_NvM_SWC_BlockNative_1024_SetRamBlockStatus, Rte_Call_NvM_SWC_RPort_NvM_SWC_BlockNative_1024_WriteBlock, Rte_Call_NvM_SWC_RPort_NvM_SWC_BlockRedundant_1024_EraseBlock, Rte_Call_NvM_SWC_RPort_NvM_SWC_BlockRedundant_1024_GetDataIndex, Rte_Call_NvM_SWC_RPort_NvM_SWC_BlockRedundant_1024_GetErrorStatus, Rte_Call_NvM_SWC_RPort_NvM_SWC_BlockRedundant_1024_InvalidateNvBlock, Rte_Call_NvM_SWC_RPort_NvM_SWC_BlockRedundant_1024_ReadBlock, Rte_Call_NvM_SWC_RPort_NvM_SWC_BlockRedundant_1024_RestoreBlockDefaults, Rte_Call_NvM_SWC_RPort_NvM_SWC_BlockRedundant_1024_SetDataIndex, Rte_Call_NvM_SWC_RPort_NvM_SWC_BlockRedundant_1024_SetRamBlockStatus, Rte_Call_NvM_SWC_RPort_NvM_SWC_BlockRedundant_1024_WriteBlock, Rte_Call_NvM_SWC_RPort_ShutdownTarget_GetLastShutdownTarget, Rte_Call_NvM_SWC_RPort_ShutdownTarget_GetShutdownCause, Rte_Call_NvM_SWC_RPort_ShutdownTarget_GetShutdownTarget, Rte_Call_NvM_SWC_RPort_ShutdownTarget_SelectShutdownCause, Rte_Call_NvM_SWC_RPort_ShutdownTarget_SelectShutdownTarget, Rte_Read_NvM_SWC_RP_SWC_PCF_PCF_SLInPLimt, Rte_Read_NvM_SWC_RP_SWC_PCF_PCF_flgSLWD, Rte_Read_NvM_SWC_RP_SWC_RCF_RCF_AutoClbOffset, Rte_Read_NvM_SWC_RP_SWC_RCF_RCF_flgOfsClbSucToNVM, Rte_Write_NvM_SWC_PP_SWC_NvM_NvM_AngAutoClbOffset, Rte_Write_NvM_SWC_PP_SWC_NvM_NvM_SLFnh, Rte_Write_NvM_SWC_PP_SWC_NvM_NvM_SLInPLimt, Rte_Write_NvM_SWC_PP_SWC_NvM_NvM_flgAngAutoClbOffset, Rte_Write_NvM_SWC_PPort_NvM_Request_Shutdown_uint16]
          prefix=RTE_NVM_SWC
          sw-addrmethod=CODE
          symbol=CODE
        RTE_OS_COM_PWM3PH_EDGE_CORE2_ISR_CODE: prefix=RTE_OS_COM_PWM3PH_EDGE_CORE2_ISR, sw-addrmethod=CODE, symbol=CODE
        RTE_OS_GPDSADC_RES_CORE0_ISR_CODE: prefix=RTE_OS_GPDSADC_RES_CORE0_ISR, sw-addrmethod=CODE, symbol=CODE
        RTE_OS_GPT100US_CORE0_ISR_CODE: prefix=RTE_OS_GPT100US_CORE0_ISR, sw-addrmethod=CODE, symbol=CODE
        RTE_OS_INIT_TASK_CORE{0..2}_CODE: prefix=RTE_OS_INIT_TASK_CORE{0..2}, sw-addrmethod=CODE, symbol=CODE
        RTE_OS_U1_V2_CORE0_ISR_CODE: prefix=RTE_OS_U1_V2_CORE0_ISR, sw-addrmethod=CODE, symbol=CODE
        RTE_SIG_BMS01_BATTCURR_BMS_01_CODE: executable-entity=Rte_COMCbk_BMS01_BattCurr_BMS_01, prefix=RTE_SIG_BMS01_BATTCURR_BMS_01, sw-addrmethod=CODE, symbol=CODE
        RTE_SIG_BMS01_BATTVOLT_BMS_01_CODE: executable-entity=Rte_COMCbk_BMS01_BattVolt_BMS_01, prefix=RTE_SIG_BMS01_BATTVOLT_BMS_01, sw-addrmethod=CODE, symbol=CODE
        RTE_SIG_BMS01_STMAINRELAY_BMS_01_CODE: executable-entity=Rte_COMCbk_BMS01_stMainRelay_BMS_01, prefix=RTE_SIG_BMS01_STMAINRELAY_BMS_01, sw-addrmethod=CODE, symbol=CODE
        RTE_SIG_VCU01_IDCMAX_VCU_01_CODE: executable-entity=Rte_COMCbk_VCU01_IdcMax_VCU_01, prefix=RTE_SIG_VCU01_IDCMAX_VCU_01, sw-addrmethod=CODE, symbol=CODE
        RTE_SIG_VCU01_IDCMIN_VCU_01_CODE: executable-entity=Rte_COMCbk_VCU01_IdcMin_VCU_01, prefix=RTE_SIG_VCU01_IDCMIN_VCU_01, sw-addrmethod=CODE, symbol=CODE
        RTE_SIG_VCU01_UDCMAX_VCU_01_CODE: executable-entity=Rte_COMCbk_VCU01_UdcMax_VCU_01, prefix=RTE_SIG_VCU01_UDCMAX_VCU_01, sw-addrmethod=CODE, symbol=CODE
        RTE_SIG_VCU01_UDCMIN_VCU_01_CODE: executable-entity=Rte_COMCbk_VCU01_UdcMin_VCU_01, prefix=RTE_SIG_VCU01_UDCMIN_VCU_01, sw-addrmethod=CODE, symbol=CODE
        RTE_SIG_VCU01_STHVBMAIRLY_VCU_01_CODE: executable-entity=Rte_COMCbk_VCU01_stHvbMaiRly_VCU_01, prefix=RTE_SIG_VCU01_STHVBMAIRLY_VCU_01, sw-addrmethod=CODE, symbol=CODE
        RTE_SIG_VCU02_KPHIGHNCTL_VCU_02_CODE: executable-entity=Rte_COMCbk_VCU02_KpHighNCtl_VCU_02, prefix=RTE_SIG_VCU02_KPHIGHNCTL_VCU_02, sw-addrmethod=CODE, symbol=CODE
        RTE_SIG_VCU02_KPLOWNCTL_VCU_02_CODE: executable-entity=Rte_COMCbk_VCU02_KpLowNCtl_VCU_02, prefix=RTE_SIG_VCU02_KPLOWNCTL_VCU_02, sw-addrmethod=CODE, symbol=CODE
        RTE_SIG_VCU02_NDIFFMAX_VCU_02_CODE: executable-entity=Rte_COMCbk_VCU02_NDiffMax_VCU_02, prefix=RTE_SIG_VCU02_NDIFFMAX_VCU_02, sw-addrmethod=CODE, symbol=CODE
        RTE_SIG_VCU02_TRQMAXNCTL_VCU_02_CODE: executable-entity=Rte_COMCbk_VCU02_TrqMaxNCtl_VCU_02, prefix=RTE_SIG_VCU02_TRQMAXNCTL_VCU_02, sw-addrmethod=CODE, symbol=CODE
        RTE_SIG_VCU02_TRQMINNCTL_VCU_02_CODE: executable-entity=Rte_COMCbk_VCU02_TrqMinNCtl_VCU_02, prefix=RTE_SIG_VCU02_TRQMINNCTL_VCU_02, sw-addrmethod=CODE, symbol=CODE
        RTE_SIG_VCU03_TRQMAX_VCU_03_CODE: executable-entity=Rte_COMCbk_VCU03_TrqMax_VCU_03, prefix=RTE_SIG_VCU03_TRQMAX_VCU_03, sw-addrmethod=CODE, symbol=CODE
        RTE_SIG_VCU03_TRQMIN_VCU_03_CODE: executable-entity=Rte_COMCbk_VCU03_TrqMin_VCU_03, prefix=RTE_SIG_VCU03_TRQMIN_VCU_03, sw-addrmethod=CODE, symbol=CODE
        RTE_SIG_VCU03_CTRQSLOPEMAX_VCU_03_CODE: executable-entity=Rte_COMCbk_VCU03_cTrqSlopeMax_VCU_03, prefix=RTE_SIG_VCU03_CTRQSLOPEMAX_VCU_03, sw-addrmethod=CODE, symbol=CODE
        RTE_SIG_VCU04_MOTDIR_VCU_04_CODE: executable-entity=Rte_COMCbk_VCU04_MotDir_VCU_04, prefix=RTE_SIG_VCU04_MOTDIR_VCU_04, sw-addrmethod=CODE, symbol=CODE
        RTE_SIG_VCU04_NSETP_VCU_04_CODE: executable-entity=Rte_COMCbk_VCU04_NSetP_VCU_04, prefix=RTE_SIG_VCU04_NSETP_VCU_04, sw-addrmethod=CODE, symbol=CODE
        RTE_SIG_VCU04_TRQSETP_VCU_04_CODE: executable-entity=Rte_COMCbk_VCU04_TrqSetP_VCU_04, prefix=RTE_SIG_VCU04_TRQSETP_VCU_04, sw-addrmethod=CODE, symbol=CODE
        RTE_SIG_VCU04_BKL15_VCU_04_CODE: executable-entity=Rte_COMCbk_VCU04_bKL15_VCU_04, prefix=RTE_SIG_VCU04_BKL15_VCU_04, sw-addrmethod=CODE, symbol=CODE
        RTE_SIG_VCU04_STMODEREQ_VCU_04_CODE: executable-entity=Rte_COMCbk_VCU04_stModeReq_VCU_04, prefix=RTE_SIG_VCU04_STMODEREQ_VCU_04, sw-addrmethod=CODE, symbol=CODE
        RTE_SIG_VCU05_OFSAL_VCU_05_CODE: executable-entity=Rte_COMCbk_VCU05_OfsAl_VCU_05, prefix=RTE_SIG_VCU05_OFSAL_VCU_05, sw-addrmethod=CODE, symbol=CODE
        RTE_SIG_VCU05_TRQDMPLIM_VCU_05_CODE: executable-entity=Rte_COMCbk_VCU05_TrqDmpLim_VCU_05, prefix=RTE_SIG_VCU05_TRQDMPLIM_VCU_05, sw-addrmethod=CODE, symbol=CODE
        RTE_SIG_VCU05_TRQDMPMAX_VCU_05_CODE: executable-entity=Rte_COMCbk_VCU05_TrqDmpMax_VCU_05, prefix=RTE_SIG_VCU05_TRQDMPMAX_VCU_05, sw-addrmethod=CODE, symbol=CODE
        RTE_SIG_VCU05_BSETOFSAL_VCU_05_CODE: executable-entity=Rte_COMCbk_VCU05_bSetOfsAl_VCU_05, prefix=RTE_SIG_VCU05_BSETOFSAL_VCU_05, sw-addrmethod=CODE, symbol=CODE
        RTE_SIG_VCU05_KDMP_VCU_05_CODE: executable-entity=Rte_COMCbk_VCU05_kDmp_VCU_05, prefix=RTE_SIG_VCU05_KDMP_VCU_05, sw-addrmethod=CODE, symbol=CODE
        RTE_SIG_VCU05_STDMPCTLREQ_VCU_05_CODE: executable-entity=Rte_COMCbk_VCU05_stDmpCtlReq_VCU_05, prefix=RTE_SIG_VCU05_STDMPCTLREQ_VCU_05, sw-addrmethod=CODE, symbol=CODE
        RTE_SIG_VCU06_PARK_VCU_06_CODE: executable-entity=Rte_COMCbk_VCU06_Park_VCU_06, prefix=RTE_SIG_VCU06_PARK_VCU_06, sw-addrmethod=CODE, symbol=CODE
        RTE_SIG_VCU06_VEHGRAD_VCU_06_CODE: executable-entity=Rte_COMCbk_VCU06_VehGrad_VCU_06, prefix=RTE_SIG_VCU06_VEHGRAD_VCU_06, sw-addrmethod=CODE, symbol=CODE
        RTE_SIG_VCU06_STBELT_VCU_06_CODE: executable-entity=Rte_COMCbk_VCU06_stBelt_VCU_06, prefix=RTE_SIG_VCU06_STBELT_VCU_06, sw-addrmethod=CODE, symbol=CODE
        RTE_SIG_VCU06_STBREAK_VCU_06_CODE: executable-entity=Rte_COMCbk_VCU06_stBreak_VCU_06, prefix=RTE_SIG_VCU06_STBREAK_VCU_06, sw-addrmethod=CODE, symbol=CODE
        RTE_SIG_VCU06_STDOOR_VCU_06_CODE: executable-entity=Rte_COMCbk_VCU06_stDoor_VCU_06, prefix=RTE_SIG_VCU06_STDOOR_VCU_06, sw-addrmethod=CODE, symbol=CODE
        RTE_SWC_1000MS_TASK_CORE0_CODE: prefix=RTE_SWC_1000MS_TASK_CORE0, sw-addrmethod=CODE, symbol=CODE
        RTE_SWC_100MS_TASK_CORE0_CODE: prefix=RTE_SWC_100MS_TASK_CORE0, sw-addrmethod=CODE, symbol=CODE
        RTE_SWC_10MS_TASK_CORE0_CODE: prefix=RTE_SWC_10MS_TASK_CORE0, sw-addrmethod=CODE, symbol=CODE
        RTE_SWC_20MS_TASK_CORE0_CODE: prefix=RTE_SWC_20MS_TASK_CORE0, sw-addrmethod=CODE, symbol=CODE
        RTE_SWC_BCC_CODE:
          executable-entity=[Rte_Read_SWC_BCC_RP_SWC_HSPF_HSPF_tCoolantTempFlt, Rte_Read_SWC_BCC_RP_SWC_HSPF_HSPF_tDBCTempUFlt, Rte_Read_SWC_BCC_RP_SWC_HSPF_HSPF_tDBCTempVFlt, Rte_Read_SWC_BCC_RP_SWC_HSPF_HSPF_tDBCTempWFlt, Rte_Read_SWC_BCC_RP_SWC_HSPF_HSPF_uDcLnkSlowFlt, Rte_Read_SWC_BCC_RP_SWC_MCF_MCF_DycU, Rte_Read_SWC_BCC_RP_SWC_MCF_MCF_DycV, Rte_Read_SWC_BCC_RP_SWC_MCF_MCF_DycW, Rte_Read_SWC_BCC_RP_SWC_MCF_MCF_Is, Rte_Read_SWC_BCC_RP_SWC_MCF_MCF_frqPwm, Rte_Read_SWC_BCC_RP_SWC_MCF_MCF_iU, Rte_Read_SWC_BCC_RP_SWC_MCF_MCF_iV, Rte_Read_SWC_BCC_RP_SWC_MCF_MCF_iW, Rte_Read_SWC_BCC_RP_SWC_MCF_MCF_secVolt, Rte_Read_SWC_BCC_RP_SWC_MCF_MCF_tiLock, Rte_Read_SWC_BCC_RP_SWC_MPC_MPC_dtCorFac, Rte_Read_SWC_BCC_RP_SWC_Rdc_Rdc_nWoFlt, Rte_Read_SWC_BCC_RP_SWC_SCF_SCF_stGateDrv, Rte_Read_SWC_BCC_RP_SWC_TPC_TPC_stMotorMod, Rte_Write_SWC_BCC_PP_SWC_BCC_BCC_iDcLnkEstFlt, Rte_Write_SWC_BCC_PP_SWC_BCC_BCC_tCoolantTj, Rte_Write_SWC_BCC_PP_SWC_BCC_BCC_tIgbtTj]
          prefix=RTE_SWC_BCC
          sw-addrmethod=CODE
          symbol=CODE
        RTE_SWC_CSPF_CODE:
          executable-entity=[Rte_Call_SWC_CSPF_RP_SWC_IoHwAb_ADC_BSW_HwVer_IoHwAb_ADC_GetPhyVoltage, Rte_Read_SWC_CSPF_RP_SWC_BCC_BCC_iDcLnkEstFlt, Rte_Read_SWC_CSPF_RP_SWC_Com_Com_BMS01_BattCurr, Rte_Read_SWC_CSPF_RP_SWC_Com_Com_BMS01_BattVoLt, Rte_Read_SWC_CSPF_RP_SWC_Com_Com_BMS01_stMainReLay, Rte_Read_SWC_CSPF_RP_SWC_Com_Com_RecflgDchaReq, Rte_Read_SWC_CSPF_RP_SWC_Com_Com_VCU01_UdcMax, Rte_Read_SWC_CSPF_RP_SWC_Com_Com_VCU01_UdcMin, Rte_Read_SWC_CSPF_RP_SWC_Com_Com_VCU01_idcMax, Rte_Read_SWC_CSPF_RP_SWC_Com_Com_VCU01_idcMin, Rte_Read_SWC_CSPF_RP_SWC_Com_Com_VCU01_stHvbMaiRly, Rte_Read_SWC_CSPF_RP_SWC_Com_Com_VCU02_KpHighNCtL, Rte_Read_SWC_CSPF_RP_SWC_Com_Com_VCU02_KpLowNCtL, Rte_Read_SWC_CSPF_RP_SWC_Com_Com_VCU02_NDiffMax, Rte_Read_SWC_CSPF_RP_SWC_Com_Com_VCU02_TrqMaxNCtL, Rte_Read_SWC_CSPF_RP_SWC_Com_Com_VCU02_TrqMinNCtL, Rte_Read_SWC_CSPF_RP_SWC_Com_Com_VCU03_TrqMax, Rte_Read_SWC_CSPF_RP_SWC_Com_Com_VCU03_TrqMin, Rte_Read_SWC_CSPF_RP_SWC_Com_Com_VCU03_cTrqSlopeMax, Rte_Read_SWC_CSPF_RP_SWC_Com_Com_VCU04_MotDir, Rte_Read_SWC_CSPF_RP_SWC_Com_Com_VCU04_NSetP, Rte_Read_SWC_CSPF_RP_SWC_Com_Com_VCU04_TrqSetP, Rte_Read_SWC_CSPF_RP_SWC_Com_Com_VCU04_bKL15, Rte_Read_SWC_CSPF_RP_SWC_Com_Com_VCU04_stModeReq, Rte_Read_SWC_CSPF_RP_SWC_Com_Com_VCU05_OfsAL, Rte_Read_SWC_CSPF_RP_SWC_Com_Com_VCU05_TrqDmpMax, Rte_Read_SWC_CSPF_RP_SWC_Com_Com_VCU05_TrqDmpMin, Rte_Read_SWC_CSPF_RP_SWC_Com_Com_VCU05_bSetOfsAL, Rte_Read_SWC_CSPF_RP_SWC_Com_Com_VCU05_kDmp, Rte_Read_SWC_CSPF_RP_SWC_Com_Com_VCU05_stDmpCtLReq, Rte_Read_SWC_CSPF_RP_SWC_Com_Com_VCU_flgCrash, Rte_Read_SWC_CSPF_RP_SWC_Cpld_Cpld_CpldSwVer, Rte_Read_SWC_CSPF_RP_SWC_Cpld_Cpld_IgbtState, Rte_Read_SWC_CSPF_RP_SWC_DiagCalib_DiagCalib_FailCode1, Rte_Read_SWC_CSPF_RP_SWC_DiagCalib_DiagCalib_FailCode2, Rte_Read_SWC_CSPF_RP_SWC_DiagCalib_DiagCalib_FailCode3, Rte_Read_SWC_CSPF_RP_SWC_DiagCalib_DiagCalib_FailCode4, Rte_Read_SWC_CSPF_RP_SWC_DiagCalib_DiagCalib_FailCode5, Rte_Read_SWC_CSPF_RP_SWC_DiagCalib_DiagCalib_FailCode6, Rte_Read_SWC_CSPF_RP_SWC_DiagCalib_DiagCalib_FailCode7, Rte_Read_SWC_CSPF_RP_SWC_DiagCalib_DiagCalib_FailCode8, Rte_Read_SWC_CSPF_RP_SWC_HSPF_HSPF_nSlowFlt, Rte_Read_SWC_CSPF_RP_SWC_HSPF_HSPF_tCoolantTempFlt, Rte_Read_SWC_CSPF_RP_SWC_HSPF_HSPF_tDBCTempUFlt, Rte_Read_SWC_CSPF_RP_SWC_HSPF_HSPF_tDBCTempVFlt, Rte_Read_SWC_CSPF_RP_SWC_HSPF_HSPF_tDBCTempWFlt, Rte_Read_SWC_CSPF_RP_SWC_HSPF_HSPF_tStrrTemp1Flt, Rte_Read_SWC_CSPF_RP_SWC_HSPF_HSPF_tStrrTemp2Flt, Rte_Read_SWC_CSPF_RP_SWC_HSPF_HSPF_uDcLnkSlowFlt, Rte_Read_SWC_CSPF_RP_SWC_HSPF_HSPF_uKl30Flt, Rte_Read_SWC_CSPF_RP_SWC_HvMcu_HvMcu_HvMcuVer, Rte_Read_SWC_CSPF_RP_SWC_MPC_MPC_IsFlt, Rte_Read_SWC_CSPF_RP_SWC_MPC_MPC_TrqMechFlt, Rte_Read_SWC_CSPF_RP_SWC_MPC_MPC_isdFlt, Rte_Read_SWC_CSPF_RP_SWC_MPC_MPC_isqFlt, Rte_Read_SWC_CSPF_RP_SWC_RCF_RCF_AutoClbOffset, Rte_Read_SWC_CSPF_RP_SWC_RCF_RCF_flgOfsClbSuc, Rte_Read_SWC_CSPF_RP_SWC_Rdc_Rdc_ArctanAgRtr, Rte_Read_SWC_CSPF_RP_SWC_SCF_SCF_bHvReady, Rte_Read_SWC_CSPF_RP_SWC_SCF_SCF_stDisChg, Rte_Read_SWC_CSPF_RP_SWC_SCF_SCF_stDrvCtl, Rte_Read_SWC_CSPF_RP_SWC_SCF_SCF_stGateDrv, Rte_Read_SWC_CSPF_RP_SWC_SCF_SCF_stSysCtl, Rte_Read_SWC_CSPF_RP_SWC_TDC_TDC_TrqDes, Rte_Read_SWC_CSPF_RP_SWC_TDC_TDC_flgTrqLmtActv, Rte_Read_SWC_CSPF_RP_SWC_TPC_TPC_TrqMax, Rte_Read_SWC_CSPF_RP_SWC_TPC_TPC_TrqMin, Rte_Read_SWC_CSPF_RP_SWC_TPC_TPC_bDernCAN, Rte_Read_SWC_CSPF_RP_SWC_TPC_TPC_bDernCoolantTemp, Rte_Read_SWC_CSPF_RP_SWC_TPC_TPC_bDernDbcTemp, Rte_Read_SWC_CSPF_RP_SWC_TPC_TPC_bDernDrvBoardTemp, Rte_Read_SWC_CSPF_RP_SWC_TPC_TPC_bDernExcMax, Rte_Read_SWC_CSPF_RP_SWC_TPC_TPC_bDernExcMin, Rte_Read_SWC_CSPF_RP_SWC_TPC_TPC_bDernMtrSpd, Rte_Read_SWC_CSPF_RP_SWC_TPC_TPC_bDernOvrIdc, Rte_Read_SWC_CSPF_RP_SWC_TPC_TPC_bDernOvrUdc, Rte_Read_SWC_CSPF_RP_SWC_TPC_TPC_bDernStrTemp, Rte_Read_SWC_CSPF_RP_SWC_TPC_TPC_bDernUndrUdc, Rte_Read_SWC_CSPF_RP_SWC_TPC_TPC_stTrqEmMax, Rte_Read_SWC_CSPF_RP_SWC_TPC_TPC_stTrqEmMin, Rte_Write_SWC_CSPF_PP_SWC_CSPF_CSPF_RecKpDmp, Rte_Write_SWC_CSPF_PP_SWC_CSPF_CSPF_RecKpHighNCtL, Rte_Write_SWC_CSPF_PP_SWC_CSPF_CSPF_RecKpLowNCtL, Rte_Write_SWC_CSPF_PP_SWC_CSPF_CSPF_RecNDiffMax, Rte_Write_SWC_CSPF_PP_SWC_CSPF_CSPF_RecNSetP, Rte_Write_SWC_CSPF_PP_SWC_CSPF_CSPF_RecTrqDmpMax, Rte_Write_SWC_CSPF_PP_SWC_CSPF_CSPF_RecTrqDmpMin, Rte_Write_SWC_CSPF_PP_SWC_CSPF_CSPF_RecTrqMax, Rte_Write_SWC_CSPF_PP_SWC_CSPF_CSPF_RecTrqMaxNCtL, Rte_Write_SWC_CSPF_PP_SWC_CSPF_CSPF_RecTrqMin, Rte_Write_SWC_CSPF_PP_SWC_CSPF_CSPF_RecTrqMinNCtL, Rte_Write_SWC_CSPF_PP_SWC_CSPF_CSPF_RecTrqSLope, Rte_Write_SWC_CSPF_PP_SWC_CSPF_CSPF_RecTrqSetP, Rte_Write_SWC_CSPF_PP_SWC_CSPF_CSPF_RecUdcMax, Rte_Write_SWC_CSPF_PP_SWC_CSPF_CSPF_RecUdcMin, Rte_Write_SWC_CSPF_PP_SWC_CSPF_CSPF_RecflgCrash, Rte_Write_SWC_CSPF_PP_SWC_CSPF_CSPF_RecflgDchaReq, Rte_Write_SWC_CSPF_PP_SWC_CSPF_CSPF_RecidcMax, Rte_Write_SWC_CSPF_PP_SWC_CSPF_CSPF_RecidcMin, Rte_Write_SWC_CSPF_PP_SWC_CSPF_CSPF_RecstDmpCtLReq, Rte_Write_SWC_CSPF_PP_SWC_CSPF_CSPF_RecstMainReLay, Rte_Write_SWC_CSPF_PP_SWC_CSPF_CSPF_RecstModeReq, Rte_Write_SWC_CSPF_PP_SWC_CSPF_CSPF_TraCodeVer, Rte_Write_SWC_CSPF_PP_SWC_CSPF_CSPF_TraCpldVer, Rte_Write_SWC_CSPF_PP_SWC_CSPF_CSPF_TraDataVer, Rte_Write_SWC_CSPF_PP_SWC_CSPF_CSPF_TraFailCode1, Rte_Write_SWC_CSPF_PP_SWC_CSPF_CSPF_TraFailCode2, Rte_Write_SWC_CSPF_PP_SWC_CSPF_CSPF_TraFailCode3, Rte_Write_SWC_CSPF_PP_SWC_CSPF_CSPF_TraFailCode4, Rte_Write_SWC_CSPF_PP_SWC_CSPF_CSPF_TraFailCode5, Rte_Write_SWC_CSPF_PP_SWC_CSPF_CSPF_TraFailCode6, Rte_Write_SWC_CSPF_PP_SWC_CSPF_CSPF_TraFailCode7, Rte_Write_SWC_CSPF_PP_SWC_CSPF_CSPF_TraFailCode8, Rte_Write_SWC_CSPF_PP_SWC_CSPF_CSPF_TraHvMcuVer, Rte_Write_SWC_CSPF_PP_SWC_CSPF_CSPF_TraHwVer, Rte_Write_SWC_CSPF_PP_SWC_CSPF_CSPF_TraNCurr, Rte_Write_SWC_CSPF_PP_SWC_CSPF_CSPF_TraOfsAL, Rte_Write_SWC_CSPF_PP_SWC_CSPF_CSPF_TraTempCurrCooL, Rte_Write_SWC_CSPF_PP_SWC_CSPF_CSPF_TraTempCurrStr1, Rte_Write_SWC_CSPF_PP_SWC_CSPF_CSPF_TraTempCurrStr2, Rte_Write_SWC_CSPF_PP_SWC_CSPF_CSPF_TraTrqAbsMax, Rte_Write_SWC_CSPF_PP_SWC_CSPF_CSPF_TraTrqAbsMin, Rte_Write_SWC_CSPF_PP_SWC_CSPF_CSPF_TraTrqCurr, Rte_Write_SWC_CSPF_PP_SWC_CSPF_CSPF_TraTrqCurrWoDmpC, Rte_Write_SWC_CSPF_PP_SWC_CSPF_CSPF_TraUT30Curr, Rte_Write_SWC_CSPF_PP_SWC_CSPF_CSPF_TraUdcCurr, Rte_Write_SWC_CSPF_PP_SWC_CSPF_CSPF_TraagRtrELecSnsr, Rte_Write_SWC_CSPF_PP_SWC_CSPF_CSPF_TrabDernCAN, Rte_Write_SWC_CSPF_PP_SWC_CSPF_CSPF_TrabDernDrvBoardTemp, Rte_Write_SWC_CSPF_PP_SWC_CSPF_CSPF_TrabDernN, Rte_Write_SWC_CSPF_PP_SWC_CSPF_CSPF_TrabDernOvrUdc, Rte_Write_SWC_CSPF_PP_SWC_CSPF_CSPF_TrabDernOvridc, Rte_Write_SWC_CSPF_PP_SWC_CSPF_CSPF_TrabDernStrTemp, Rte_Write_SWC_CSPF_PP_SWC_CSPF_CSPF_TrabDernTempCooL, Rte_Write_SWC_CSPF_PP_SWC_CSPF_CSPF_TrabDernTempiGBT, Rte_Write_SWC_CSPF_PP_SWC_CSPF_CSPF_TrabDernTrqMax, Rte_Write_SWC_CSPF_PP_SWC_CSPF_CSPF_TrabDernTrqMin, Rte_Write_SWC_CSPF_PP_SWC_CSPF_CSPF_TrabDernUndrUdc, Rte_Write_SWC_CSPF_PP_SWC_CSPF_CSPF_TrabDmpCActv, Rte_Write_SWC_CSPF_PP_SWC_CSPF_CSPF_TrabReadyHv, Rte_Write_SWC_CSPF_PP_SWC_CSPF_CSPF_TraiGBTTempU, Rte_Write_SWC_CSPF_PP_SWC_CSPF_CSPF_TraiGBTTempV, Rte_Write_SWC_CSPF_PP_SWC_CSPF_CSPF_TraiGBTTempW, Rte_Write_SWC_CSPF_PP_SWC_CSPF_CSPF_TraidcCurr, Rte_Write_SWC_CSPF_PP_SWC_CSPF_CSPF_TraisCurr, Rte_Write_SWC_CSPF_PP_SWC_CSPF_CSPF_Traisd, Rte_Write_SWC_CSPF_PP_SWC_CSPF_CSPF_Traisq, Rte_Write_SWC_CSPF_PP_SWC_CSPF_CSPF_TrastDischg, Rte_Write_SWC_CSPF_PP_SWC_CSPF_CSPF_TrastGateDrv, Rte_Write_SWC_CSPF_PP_SWC_CSPF_CSPF_TrastMode, Rte_Write_SWC_CSPF_PP_SWC_CSPF_CSPF_TrastTrqEmMax, Rte_Write_SWC_CSPF_PP_SWC_CSPF_CSPF_TrastTrqEmMin]
          prefix=RTE_SWC_CSPF
          sw-addrmethod=CODE
          symbol=CODE
        RTE_SWC_CPLD_CODE: executable-entity=[Rte_Write_SWC_Cpld_PP_SWC_Cpld_Cpld_CpldSwVer, Rte_Write_SWC_Cpld_PP_SWC_Cpld_Cpld_IgbtState, Rte_Write_SWC_Cpld_PP_SWC_Cpld_Cpld_ProjectNum], prefix=RTE_SWC_CPLD, sw-addrmethod=CODE, symbol=CODE
        RTE_SWC_DIAGCALIB_CODE:
          executable-entity=[Rte_Write_SWC_DiagCalib_PP_SWC_DiagCalib_DiagCalib_FailCode1, Rte_Write_SWC_DiagCalib_PP_SWC_DiagCalib_DiagCalib_FailCode2, Rte_Write_SWC_DiagCalib_PP_SWC_DiagCalib_DiagCalib_FailCode3, Rte_Write_SWC_DiagCalib_PP_SWC_DiagCalib_DiagCalib_FailCode4, Rte_Write_SWC_DiagCalib_PP_SWC_DiagCalib_DiagCalib_FailCode5, Rte_Write_SWC_DiagCalib_PP_SWC_DiagCalib_DiagCalib_FailCode6, Rte_Write_SWC_DiagCalib_PP_SWC_DiagCalib_DiagCalib_FailCode7, Rte_Write_SWC_DiagCalib_PP_SWC_DiagCalib_DiagCalib_FailCode8]
          prefix=RTE_SWC_DIAGCALIB
          sw-addrmethod=CODE
          symbol=CODE
        RTE_SWC_EPARK_CODE: executable-entity=[Rte_Read_SWC_Epark_RP_SWC_PCF_PCF_MotDir, Rte_Read_SWC_Epark_RP_SWC_PCF_PCF_dycPWM, Rte_Write_SWC_Epark_PP_SWC_Epark_Epark_iPcf, Rte_Write_SWC_Epark_PP_SWC_Epark_Epark_posPcf, Rte_Write_SWC_Epark_PP_SWC_Epark_Epark_posPcfMon], prefix=RTE_SWC_EPARK, sw-addrmethod=CODE, symbol=CODE
        RTE_SWC_HSPF_CODE:
          executable-entity=[Rte_Call_SWC_HSPF_RP_SWC_DEM_HSPF_VerMatchFailureFail_SetEventStatus, Rte_Call_SWC_HSPF_RP_SWC_Dem_HSPF_InvOpenFail_SetEventStatus, Rte_Call_SWC_HSPF_RP_SWC_Dem_HSPF_IphaOffCalFail_SetEventStatus, Rte_Call_SWC_HSPF_RP_SWC_Dem_HSPF_MotorOpenFail_SetEventStatus, Rte_Call_SWC_HSPF_RP_SWC_Dem_HSPF_tDBCTempCmpFail_SetEventStatus, Rte_Call_SWC_HSPF_RP_SWC_FIM_HSPF_Sttr1Err_GetFunctionPermission, Rte_Call_SWC_HSPF_RP_SWC_FIM_HSPF_Sttr2Err_GetFunctionPermission, Rte_Call_SWC_HSPF_RP_SWC_FIM_HSPF_tDBCTempCmpErr_GetFunctionPermission, Rte_Call_SWC_HSPF_RP_SWC_IoHwAb_ADC_BSW_HwVer_IoHwAb_ADC_GetPhyVoltage, Rte_Call_SWC_HSPF_RP_SWC_IoHwAb_ADC_BSW_tCoolantTemp_IoHwAb_ADC_GetPhyVoltage, Rte_Call_SWC_HSPF_RP_SWC_IoHwAb_ADC_BSW_tStrrTemp1_IoHwAb_ADC_GetPhyVoltage, Rte_Call_SWC_HSPF_RP_SWC_IoHwAb_ADC_BSW_tStrrTemp2_IoHwAb_ADC_GetPhyVoltage, Rte_Call_SWC_HSPF_RP_SWC_IoHwAb_ADC_BSW_uKl30_IoHwAb_ADC_GetPhyVoltage, Rte_Call_SWC_HSPF_RP_SWC_IoHwAb_DIO_Get_BSW_Wake_IoHwAb_DIO_Get, Rte_Call_SWC_HSPF_RP_SWC_IoHwAb_DIO_Get_BSW_bt15_IoHwAb_DIO_Get, Rte_Call_SWC_HSPF_RP_SWC_IoHwAb_DIO_Get_BSW_flgCrash_IoHwAb_DIO_Get, Rte_Call_SWC_HSPF_RP_SWC_IoHwAb_DIO_Get_BSW_flgMcuOpen_IoHwAb_DIO_Get, Rte_Call_SWC_HSPF_RP_SWC_IoHwAb_DIO_Get_BSW_flgMotorOpen_IoHwAb_DIO_Get, Rte_Call_SWC_HSPF_RP_SWC_IoHwAb_DIO_Set_HSPF_flgSwtTSttr1_IoHwAb_DIO_Set, Rte_Call_SWC_HSPF_RP_SWC_IoHwAb_DIO_Set_HSPF_flgSwtTSttr2_IoHwAb_DIO_Set, Rte_Read_SWC_HSPF_RP_SWC_BCC_BCC_iDcLnkEstFlt, Rte_Read_SWC_HSPF_RP_SWC_BCC_BCC_tCoolantTj, Rte_Read_SWC_HSPF_RP_SWC_BCC_BCC_tIgbtTj, Rte_Read_SWC_HSPF_RP_SWC_Cpld_Cpld_CpldSwVer, Rte_Read_SWC_HSPF_RP_SWC_Cpld_Cpld_ProjectNum, Rte_Read_SWC_HSPF_RP_SWC_HvMcu_HvMcu_HvMcuVer, Rte_Read_SWC_HSPF_RP_SWC_HvMcu_HvMcu_tDBCTempU, Rte_Read_SWC_HSPF_RP_SWC_HvMcu_HvMcu_tDBCTempV, Rte_Read_SWC_HSPF_RP_SWC_HvMcu_HvMcu_tDBCTempW, Rte_Read_SWC_HSPF_RP_SWC_HvMcu_HvMcu_tDrvBoardTemp, Rte_Read_SWC_HSPF_RP_SWC_MCF_MCF_uDcLnk, Rte_Read_SWC_HSPF_RP_SWC_MDF_MDF_bFaultEMBlkWarnSt, Rte_Read_SWC_HSPF_RP_SWC_PhC_PhC_iUNoOff, Rte_Read_SWC_HSPF_RP_SWC_PhC_PhC_iVNoOff, Rte_Read_SWC_HSPF_RP_SWC_PhC_PhC_iWNoOff, Rte_Read_SWC_HSPF_RP_SWC_Rdc_Rdc_nWoFlt, Rte_Read_SWC_HSPF_RP_SWC_SCF_SCF_stPreDrvCtl, Rte_Write_SWC_HSPF_PP_SWC_HSPF_HSPF_INV_Open, Rte_Write_SWC_HSPF_PP_SWC_HSPF_HSPF_Motor_Open, Rte_Write_SWC_HSPF_PP_SWC_HSPF_HSPF_PwrDcLnk, Rte_Write_SWC_HSPF_PP_SWC_HSPF_HSPF_Wake, Rte_Write_SWC_HSPF_PP_SWC_HSPF_HSPF_bt15, Rte_Write_SWC_HSPF_PP_SWC_HSPF_HSPF_flgCrash, Rte_Write_SWC_HSPF_PP_SWC_HSPF_HSPF_iDcLnkEstFlt, Rte_Write_SWC_HSPF_PP_SWC_HSPF_HSPF_iPhaUOffset, Rte_Write_SWC_HSPF_PP_SWC_HSPF_HSPF_iPhaVOffset, Rte_Write_SWC_HSPF_PP_SWC_HSPF_HSPF_iPhaWOffset, Rte_Write_SWC_HSPF_PP_SWC_HSPF_HSPF_nSlowFlt, Rte_Write_SWC_HSPF_PP_SWC_HSPF_HSPF_stIphaOffCal, Rte_Write_SWC_HSPF_PP_SWC_HSPF_HSPF_tCoolantTempFlt, Rte_Write_SWC_HSPF_PP_SWC_HSPF_HSPF_tCoolantTjFlt, Rte_Write_SWC_HSPF_PP_SWC_HSPF_HSPF_tDBCTempUFlt, Rte_Write_SWC_HSPF_PP_SWC_HSPF_HSPF_tDBCTempVFlt, Rte_Write_SWC_HSPF_PP_SWC_HSPF_HSPF_tDBCTempWFlt, Rte_Write_SWC_HSPF_PP_SWC_HSPF_HSPF_tDrvBoardTempFlt, Rte_Write_SWC_HSPF_PP_SWC_HSPF_HSPF_tIgbtTjFlt, Rte_Write_SWC_HSPF_PP_SWC_HSPF_HSPF_tStrrTemp1Flt, Rte_Write_SWC_HSPF_PP_SWC_HSPF_HSPF_tStrrTemp2Flt, Rte_Write_SWC_HSPF_PP_SWC_HSPF_HSPF_tStrrTempFlt, Rte_Write_SWC_HSPF_PP_SWC_HSPF_HSPF_uDcLnkSlowFlt, Rte_Write_SWC_HSPF_PP_SWC_HSPF_HSPF_uKl30Flt]
          prefix=RTE_SWC_HSPF
          sw-addrmethod=CODE
          symbol=CODE
        RTE_SWC_HVMCU_CODE:
          executable-entity=[Rte_Read_SWC_HvMcu_RP_SWC_RCF_RCF_stAgRtrOfsCal, Rte_Read_SWC_HvMcu_RP_SWC_SCF_SCF_flgEmgReqInvDcha, Rte_Write_SWC_HvMcu_PP_SWC_HvMcu_HvMcu_AlOfsClb_TimeStamp, Rte_Write_SWC_HvMcu_PP_SWC_HvMcu_HvMcu_HvMcuVer, Rte_Write_SWC_HvMcu_PP_SWC_HvMcu_HvMcu_VDD15L_Vol, Rte_Write_SWC_HvMcu_PP_SWC_HvMcu_HvMcu_flgUphaEdgeRiseCo, Rte_Write_SWC_HvMcu_PP_SWC_HvMcu_HvMcu_tDBCTempU, Rte_Write_SWC_HvMcu_PP_SWC_HvMcu_HvMcu_tDBCTempV, Rte_Write_SWC_HvMcu_PP_SWC_HvMcu_HvMcu_tDBCTempW, Rte_Write_SWC_HvMcu_PP_SWC_HvMcu_HvMcu_tDrvBoardTemp, Rte_Write_SWC_HvMcu_PP_SWC_HvMcu_HvMcu_uBackEMF_U, Rte_Write_SWC_HvMcu_PP_SWC_HvMcu_HvMcu_uBackEMF_V, Rte_Write_SWC_HvMcu_PP_SWC_HvMcu_HvMcu_uBackEMF_W, Rte_Write_SWC_HvMcu_PP_SWC_HvMcu_HvMcu_uDcLnkHvMcu]
          prefix=RTE_SWC_HVMCU
          sw-addrmethod=CODE
          symbol=CODE
        RTE_SWC_IGBT_CODE: executable-entity=[Rte_Write_SWC_Igbt_PP_SWC_Igbt_Igbt_flgGateDrvRdyHs, Rte_Write_SWC_Igbt_PP_SWC_Igbt_Igbt_flgGateDrvRdyLs], prefix=RTE_SWC_IGBT, sw-addrmethod=CODE, symbol=CODE
        RTE_SWC_LVPOWER_CODE: executable-entity=Rte_Write_SWC_LvPower_PP_SWC_LvPower_LvPower_stLowpowerUp, prefix=RTE_SWC_LVPOWER, sw-addrmethod=CODE, symbol=CODE
        RTE_SWC_MCF_CODE:
          executable-entity=[Rte_Read_SWC_MCF_RP_SWC_BCC_BCC_iDcLnkEstFlt, Rte_Read_SWC_MCF_RP_SWC_HSPF_HSPF_iPhaUOffset, Rte_Read_SWC_MCF_RP_SWC_HSPF_HSPF_iPhaVOffset, Rte_Read_SWC_MCF_RP_SWC_HSPF_HSPF_iPhaWOffset, Rte_Read_SWC_MCF_RP_SWC_HSPF_HSPF_stIphaOffCal, Rte_Read_SWC_MCF_RP_SWC_HSPF_HSPF_tStrrTempFlt, Rte_Read_SWC_MCF_RP_SWC_HvMcu_HvMcu_uDcLnkHvMcu, Rte_Read_SWC_MCF_RP_SWC_MDF_MDF_bFaultEMBlkWarnSt, Rte_Read_SWC_MCF_RP_SWC_MPC_MPC_CofRandomPwm, Rte_Read_SWC_MCF_RP_SWC_MPC_MPC_Ld, Rte_Read_SWC_MCF_RP_SWC_MPC_MPC_LdSubLq, Rte_Read_SWC_MCF_RP_SWC_MPC_MPC_Lq, Rte_Read_SWC_MCF_RP_SWC_MPC_MPC_OmBw, Rte_Read_SWC_MCF_RP_SWC_MPC_MPC_Psi, Rte_Read_SWC_MCF_RP_SWC_MPC_MPC_Rs, Rte_Read_SWC_MCF_RP_SWC_MPC_MPC_Rv, Rte_Read_SWC_MCF_RP_SWC_MPC_MPC_TrqMechFlt, Rte_Read_SWC_MCF_RP_SWC_MPC_MPC_frqPwmVF, Rte_Read_SWC_MCF_RP_SWC_MPC_MPC_isdFF, Rte_Read_SWC_MCF_RP_SWC_MPC_MPC_isdMTPA, Rte_Read_SWC_MCF_RP_SWC_MPC_MPC_isdMTPV, Rte_Read_SWC_MCF_RP_SWC_NvM_NvM_AngAutoClbOffset, Rte_Read_SWC_MCF_RP_SWC_NvM_NvM_flgAngAutoClbOffset, Rte_Read_SWC_MCF_RP_SWC_PhC_PhC_iUNoOff, Rte_Read_SWC_MCF_RP_SWC_PhC_PhC_iVNoOff, Rte_Read_SWC_MCF_RP_SWC_PhC_PhC_iWNoOff, Rte_Read_SWC_MCF_RP_SWC_PhC_PhC_uDcLnkLowMcu, Rte_Read_SWC_MCF_RP_SWC_RCF_RCF_UsAlfaScalSet, Rte_Read_SWC_MCF_RP_SWC_RCF_RCF_UsBetaScalSet, Rte_Read_SWC_MCF_RP_SWC_RCF_RCF_agRtrOffsEstimd, Rte_Read_SWC_MCF_RP_SWC_RCF_RCF_flgUseUsSet, Rte_Read_SWC_MCF_RP_SWC_Rdc_Rdc_ArctanAgRtr, Rte_Read_SWC_MCF_RP_SWC_Rdc_Rdc_nWoFlt, Rte_Read_SWC_MCF_RP_SWC_SCF_SCF_FIM_ReqFailrMod, Rte_Read_SWC_MCF_RP_SWC_SCF_SCF_flgEnDchaToMc, Rte_Read_SWC_MCF_RP_SWC_SCF_SCF_flginitPI, Rte_Read_SWC_MCF_RP_SWC_SCF_SCF_stGateDrv, Rte_Read_SWC_MCF_RP_SWC_SCF_SCF_stPwmMode, Rte_Read_SWC_MCF_RP_SWC_TDC_TDC_TrqDes, Rte_Read_SWC_MCF_RP_SWC_TPC_TPC_TDbcTrqMax, Rte_Write_SWC_MCF_PP_SWC_MCF_MCF_DycU, Rte_Write_SWC_MCF_PP_SWC_MCF_MCF_DycV, Rte_Write_SWC_MCF_PP_SWC_MCF_MCF_DycW, Rte_Write_SWC_MCF_PP_SWC_MCF_MCF_Is, Rte_Write_SWC_MCF_PP_SWC_MCF_MCF_VoltModuRate, Rte_Write_SWC_MCF_PP_SWC_MCF_MCF_cofFrqPwm, Rte_Write_SWC_MCF_PP_SWC_MCF_MCF_dtPwm, Rte_Write_SWC_MCF_PP_SWC_MCF_MCF_frqPwm, Rte_Write_SWC_MCF_PP_SWC_MCF_MCF_iU, Rte_Write_SWC_MCF_PP_SWC_MCF_MCF_iV, Rte_Write_SWC_MCF_PP_SWC_MCF_MCF_iW, Rte_Write_SWC_MCF_PP_SWC_MCF_MCF_idDes, Rte_Write_SWC_MCF_PP_SWC_MCF_MCF_iqDes, Rte_Write_SWC_MCF_PP_SWC_MCF_MCF_isd, Rte_Write_SWC_MCF_PP_SWC_MCF_MCF_isq, Rte_Write_SWC_MCF_PP_SWC_MCF_MCF_secVolt, Rte_Write_SWC_MCF_PP_SWC_MCF_MCF_stPwmMode, Rte_Write_SWC_MCF_PP_SWC_MCF_MCF_tiLock, Rte_Write_SWC_MCF_PP_SWC_MCF_MCF_uDcLnk, Rte_Write_SWC_MCF_PP_SWC_MCF_MCF_udDes, Rte_Write_SWC_MCF_PP_SWC_MCF_MCF_uqDes]
          prefix=RTE_SWC_MCF
          sw-addrmethod=CODE
          symbol=CODE
        RTE_SWC_MDF_CODE:
          executable-entity=[Rte_Call_SWC_MDF_RP_SWC_Dem_MDF_AlOfsNoPlausFail_SetEventStatus, Rte_Call_SWC_MDF_RP_SWC_Dem_MDF_DiashCirNoPsblFail_SetEventStatus, Rte_Call_SWC_MDF_RP_SWC_Dem_MDF_EmacBlkdFail_SetEventStatus, Rte_Call_SWC_MDF_RP_SWC_Dem_MDF_EmacBlkdWarn_SetEventStatus, Rte_Call_SWC_MDF_RP_SWC_Dem_MDF_ICtlRatFail_SetEventStatus, Rte_Call_SWC_MDF_RP_SWC_Dem_MDF_IsOvHiFail_SetEventStatus, Rte_Call_SWC_MDF_RP_SWC_Dem_MDF_OpenCirNoPsblFail_SetEventStatus, Rte_Call_SWC_MDF_RP_SWC_Dem_MDF_OperOutdRngFail_SetEventStatus, Rte_Call_SWC_MDF_RP_SWC_Dem_MDF_PhaseLossFaultFail_SetEventStatus, Rte_Call_SWC_MDF_RP_SWC_Dem_MDF_PrfElDrvFail_SetEventStatus, Rte_Call_SWC_MDF_RP_SWC_FIM_MDFIsOvHiErr_GetFunctionPermission, Rte_Call_SWC_MDF_RP_SWC_FIM_MDF_AlOfsNoPlausErr_GetFunctionPermission, Rte_Call_SWC_MDF_RP_SWC_FIM_MDF_DiagPrfChkElecDt_GetFunctionPermission, Rte_Call_SWC_MDF_RP_SWC_FIM_MDF_DiashCirNoPsblErr_GetFunctionPermission, Rte_Call_SWC_MDF_RP_SWC_FIM_MDF_EmacBlkdWarn_GetFunctionPermission, Rte_Call_SWC_MDF_RP_SWC_FIM_MDF_IctlRat_GetFunctionPermission, Rte_Call_SWC_MDF_RP_SWC_FIM_MDF_OpenCirNoPsblErr_GetFunctionPermission, Rte_Call_SWC_MDF_RP_SWC_FIM_MDF_OperOutdRngErr_GetFunctionPermission, Rte_Call_SWC_MDF_RP_SWC_FIM_MDF_PhaseLossFaultErr_GetFunctionPermission, Rte_Read_SWC_MDF_RP_SWC_HSPF_HSPF_PwrDcLnk, Rte_Read_SWC_MDF_RP_SWC_HSPF_HSPF_nSlowFlt, Rte_Read_SWC_MDF_RP_SWC_HSPF_HSPF_tCoolantTempFlt, Rte_Read_SWC_MDF_RP_SWC_HSPF_HSPF_tDBCTempUFlt, Rte_Read_SWC_MDF_RP_SWC_HSPF_HSPF_tDBCTempVFlt, Rte_Read_SWC_MDF_RP_SWC_HSPF_HSPF_tDBCTempWFlt, Rte_Read_SWC_MDF_RP_SWC_HSPF_HSPF_tStrrTempFlt, Rte_Read_SWC_MDF_RP_SWC_HSPF_HSPF_uDcLnkSlowFlt, Rte_Read_SWC_MDF_RP_SWC_MCF_MCF_dtPwm, Rte_Read_SWC_MDF_RP_SWC_MCF_MCF_iU, Rte_Read_SWC_MDF_RP_SWC_MCF_MCF_iV, Rte_Read_SWC_MDF_RP_SWC_MCF_MCF_iW, Rte_Read_SWC_MDF_RP_SWC_MCF_MCF_idDes, Rte_Read_SWC_MDF_RP_SWC_MCF_MCF_iqDes, Rte_Read_SWC_MDF_RP_SWC_MCF_MCF_udDes, Rte_Read_SWC_MDF_RP_SWC_MCF_MCF_uqDes, Rte_Read_SWC_MDF_RP_SWC_MPC_MPC_IsFlt, Rte_Read_SWC_MDF_RP_SWC_MPC_MPC_Ld, Rte_Read_SWC_MDF_RP_SWC_MPC_MPC_Lq, Rte_Read_SWC_MDF_RP_SWC_MPC_MPC_Psi, Rte_Read_SWC_MDF_RP_SWC_MPC_MPC_Rs, Rte_Read_SWC_MDF_RP_SWC_MPC_MPC_TrqMech, Rte_Read_SWC_MDF_RP_SWC_MPC_MPC_isdFlt, Rte_Read_SWC_MDF_RP_SWC_MPC_MPC_isqFlt, Rte_Read_SWC_MDF_RP_SWC_RCF_RCF_stAgRtrOfsCal, Rte_Read_SWC_MDF_RP_SWC_Rdc_Rdc_nWoFlt, Rte_Read_SWC_MDF_RP_SWC_SCF_SCF_stDrvCtl, Rte_Read_SWC_MDF_RP_SWC_SCF_SCF_stGateDrv, Rte_Read_SWC_MDF_RP_SWC_SCF_SCF_stSysCtl, Rte_Read_SWC_MDF_RP_SWC_VCF_VCF_TrqDes, Rte_Write_SWC_MDF_PP_SWC_MDF_MDF_bFaultEMBlkWarnSt, Rte_Write_SWC_MDF_PP_SWC_MDF_MDF_stFrwhl]
          prefix=RTE_SWC_MDF
          sw-addrmethod=CODE
          symbol=CODE
        RTE_SWC_MPC_CODE:
          executable-entity=[Rte_Read_SWC_MPC_RP_SWC_HSPF_HSPF_nSlowFlt, Rte_Read_SWC_MPC_RP_SWC_HSPF_HSPF_tStrrTempFlt, Rte_Read_SWC_MPC_RP_SWC_MCF_MCF_Is, Rte_Read_SWC_MPC_RP_SWC_MCF_MCF_VoltModuRate, Rte_Read_SWC_MPC_RP_SWC_MCF_MCF_idDes, Rte_Read_SWC_MPC_RP_SWC_MCF_MCF_iqDes, Rte_Read_SWC_MPC_RP_SWC_MCF_MCF_isd, Rte_Read_SWC_MPC_RP_SWC_MCF_MCF_isq, Rte_Read_SWC_MPC_RP_SWC_MCF_MCF_uDcLnk, Rte_Read_SWC_MPC_RP_SWC_MCF_MCF_udDes, Rte_Read_SWC_MPC_RP_SWC_MCF_MCF_uqDes, Rte_Read_SWC_MPC_RP_SWC_TDC_TDC_TrqDes, Rte_Read_SWC_MPC_RP_SWC_TPC_TPC_stMotorMod, Rte_Write_SWC_MPC_PP_SWC_MPC_MPC_CofRandomPwm, Rte_Write_SWC_MPC_PP_SWC_MPC_MPC_IsFlt, Rte_Write_SWC_MPC_PP_SWC_MPC_MPC_Ld, Rte_Write_SWC_MPC_PP_SWC_MPC_MPC_LdSubLq, Rte_Write_SWC_MPC_PP_SWC_MPC_MPC_Lq, Rte_Write_SWC_MPC_PP_SWC_MPC_MPC_OmBw, Rte_Write_SWC_MPC_PP_SWC_MPC_MPC_Psi, Rte_Write_SWC_MPC_PP_SWC_MPC_MPC_Rs, Rte_Write_SWC_MPC_PP_SWC_MPC_MPC_Rv, Rte_Write_SWC_MPC_PP_SWC_MPC_MPC_TrqMech, Rte_Write_SWC_MPC_PP_SWC_MPC_MPC_TrqMechFlt, Rte_Write_SWC_MPC_PP_SWC_MPC_MPC_dtCorFac, Rte_Write_SWC_MPC_PP_SWC_MPC_MPC_frqPwmVF, Rte_Write_SWC_MPC_PP_SWC_MPC_MPC_isdFF, Rte_Write_SWC_MPC_PP_SWC_MPC_MPC_isdFlt, Rte_Write_SWC_MPC_PP_SWC_MPC_MPC_isdMTPA, Rte_Write_SWC_MPC_PP_SWC_MPC_MPC_isdMTPV, Rte_Write_SWC_MPC_PP_SWC_MPC_MPC_isqFlt]
          prefix=RTE_SWC_MPC
          sw-addrmethod=CODE
          symbol=CODE
        RTE_SWC_PCF_CODE:
          executable-entity=[Rte_Call_SWC_PCF_RP_SWC_Dem_PCF_ActOvTiErr_SetEventStatus, Rte_Call_SWC_PCF_RP_SWC_Dem_PCF_IdcOvErr_SetEventStatus, Rte_Call_SWC_PCF_RP_SWC_Dem_PCF_SelfcheckErr_SetEventStatus, Rte_Call_SWC_PCF_RP_SWC_Dem_PCF_SenClbErr_SetEventStatus, Rte_Call_SWC_PCF_RP_SWC_Dem_PCF_SenOvErr_SetEventStatus, Rte_Call_SWC_PCF_RP_SWC_Dem_PCF_StallRetryErr_SetEventStatus, Rte_Call_SWC_PCF_RP_SWC_Dem_PCF_StallWarn_SetEventStatus, Rte_Call_SWC_PCF_RP_SWC_Dem_PCF_UnexpPosErr_SetEventStatus, Rte_Call_SWC_PCF_RP_SWC_IoHwAb_ADC_BSW_IUBPCF_IoHwAb_ADC_GetPhyVoltage, Rte_Call_SWC_PCF_RP_SWC_IoHwAb_ADC_BSW_UBRPCF_IoHwAb_ADC_GetPhyVoltage, Rte_Call_SWC_PCF_RP_SWC_IoHwAb_ADC_BSW_VDD5PCF_IoHwAb_ADC_GetPhyVoltage, Rte_Call_SWC_PCF_RP_SWC_IoHwAb_ADC_BSW_tEpc_IoHwAb_ADC_GetPhyVoltage, Rte_Call_SWC_PCF_RP_SWC_IoHwAb_DIO_Get_BSW_EnPcfEFUSE_IoHwAb_DIO_Get, Rte_Call_SWC_PCF_RP_SWC_IoHwAb_DIO_Get_BSW_ParkHard_IoHwAb_DIO_Get, Rte_Call_SWC_PCF_RP_SWC_IoHwAb_DIO_Get_BSW_bt15_IoHwAb_DIO_Get, Rte_Call_SWC_PCF_RP_SWC_IoHwAb_DIO_Get_BSW_flgPcfOc_IoHwAb_DIO_Get, Rte_Call_SWC_PCF_RP_SWC_IoHwAb_DIO_Set_PCF_enMos_IoHwAb_DIO_Set, Rte_Read_SWC_PCF_RP_SWC_Com_Com_VCU06_Park, Rte_Read_SWC_PCF_RP_SWC_Com_Com_VCU06_VehGrad, Rte_Read_SWC_PCF_RP_SWC_Com_Com_VCU06_stBelt, Rte_Read_SWC_PCF_RP_SWC_Com_Com_VCU06_stBreak, Rte_Read_SWC_PCF_RP_SWC_Com_Com_VCU06_stDoor, Rte_Read_SWC_PCF_RP_SWC_Epark_Epark_iPcf, Rte_Read_SWC_PCF_RP_SWC_Epark_Epark_posPcf, Rte_Read_SWC_PCF_RP_SWC_Epark_Epark_posPcfMon, Rte_Read_SWC_PCF_RP_SWC_HSPF_HSPF_nSlowFlt, Rte_Read_SWC_PCF_RP_SWC_NvM_NvM_SLFnh, Rte_Read_SWC_PCF_RP_SWC_NvM_NvM_SLInPLimt, Rte_Write_SWC_PCF_PP_SWC_PCF_PCF_MotDir, Rte_Write_SWC_PCF_PP_SWC_PCF_PCF_Pos1, Rte_Write_SWC_PCF_PP_SWC_PCF_PCF_SLEnMotorAcc, Rte_Write_SWC_PCF_PP_SWC_PCF_PCF_SLInPLimt, Rte_Write_SWC_PCF_PP_SWC_PCF_PCF_SLInPLimtPos, Rte_Write_SWC_PCF_PP_SWC_PCF_PCF_SLtrqDes, Rte_Write_SWC_PCF_PP_SWC_PCF_PCF_Status, Rte_Write_SWC_PCF_PP_SWC_PCF_PCF_dycPWM, Rte_Write_SWC_PCF_PP_SWC_PCF_PCF_enMos, Rte_Write_SWC_PCF_PP_SWC_PCF_PCF_flgAllowPwmRun, Rte_Write_SWC_PCF_PP_SWC_PCF_PCF_flgSLWD, Rte_Write_SWC_PCF_PP_SWC_PCF_PCF_flgShtDwnReq, Rte_Write_SWC_PCF_PP_SWC_PCF_PCF_iPcf, Rte_Write_SWC_PCF_PP_SWC_PCF_PCF_stParkCtl]
          prefix=RTE_SWC_PCF
          sw-addrmethod=CODE
          symbol=CODE
        RTE_SWC_PHC_CODE: executable-entity=[Rte_Write_SWC_PhC_PP_SWC_PhC_PhC_iUNoOff, Rte_Write_SWC_PhC_PP_SWC_PhC_PhC_iVNoOff, Rte_Write_SWC_PhC_PP_SWC_PhC_PhC_iWNoOff, Rte_Write_SWC_PhC_PP_SWC_PhC_PhC_uDcLnkLowMcu], prefix=RTE_SWC_PHC, sw-addrmethod=CODE, symbol=CODE
        RTE_SWC_PWM3PH_CODE: executable-entity=[Rte_Read_SWC_Pwm3ph_RP_SWC_MCF_MCF_DycU, Rte_Read_SWC_Pwm3ph_RP_SWC_MCF_MCF_DycV, Rte_Read_SWC_Pwm3ph_RP_SWC_MCF_MCF_DycW, Rte_Read_SWC_Pwm3ph_RP_SWC_MCF_MCF_frqPwm, Rte_Read_SWC_Pwm3ph_RP_SWC_MCF_MCF_stPwmMode], prefix=RTE_SWC_PWM3PH, sw-addrmethod=CODE, symbol=CODE
        RTE_SWC_RCF_CODE:
          executable-entity=[Rte_Call_SWC_RCF_RP_SWC_DEM_RCF_AccOvTiErr_SetEventStatus, Rte_Call_SWC_RCF_RP_SWC_DEM_RCF_EstOfsErr_SetEventStatus, Rte_Call_SWC_RCF_RP_SWC_DEM_RCF_FwlBwdOvTiErr_SetEventStatus, Rte_Call_SWC_RCF_RP_SWC_DEM_RCF_FwlFwdOvTiErr_SetEventStatus, Rte_Call_SWC_RCF_RP_SWC_DEM_RCF_OfsClbFailErr_SetEventStatus, Rte_Call_SWC_RCF_RP_SWC_DEM_RCF_PsiOvErr_SetEventStatus, Rte_Read_SWC_RCF_RP_SWC_CSPF_CSPF_RecstModeReq, Rte_Read_SWC_RCF_RP_SWC_HSPF_HSPF_nSlowFlt, Rte_Read_SWC_RCF_RP_SWC_HvMcu_HvMcu_AlOfsClb_TimeStamp, Rte_Read_SWC_RCF_RP_SWC_HvMcu_HvMcu_flgUphaEdgeRiseCo, Rte_Read_SWC_RCF_RP_SWC_MDF_MDF_stFrwhl, Rte_Read_SWC_RCF_RP_SWC_NvM_NvM_flgAngAutoClbOffset, Rte_Read_SWC_RCF_RP_SWC_Rdc_Rdc_ArctanAgRtr, Rte_Read_SWC_RCF_RP_SWC_Rdc_Rdc_nWoFlt, Rte_Read_SWC_RCF_RP_SWC_SCF_SCF_stDrvCtl, Rte_Write_SWC_RCF_PP_SWC_RCF_RCF_AutoClbOffset, Rte_Write_SWC_RCF_PP_SWC_RCF_RCF_TrqEmDesOfsClb, Rte_Write_SWC_RCF_PP_SWC_RCF_RCF_UsAlfaScalSet, Rte_Write_SWC_RCF_PP_SWC_RCF_RCF_UsBetaScalSet, Rte_Write_SWC_RCF_PP_SWC_RCF_RCF_agRtrOffsEstimd, Rte_Write_SWC_RCF_PP_SWC_RCF_RCF_cTrqSlpOfsClb, Rte_Write_SWC_RCF_PP_SWC_RCF_RCF_flgOfsClbSuc, Rte_Write_SWC_RCF_PP_SWC_RCF_RCF_flgOfsClbSucToNVM, Rte_Write_SWC_RCF_PP_SWC_RCF_RCF_flgUseUsSet, Rte_Write_SWC_RCF_PP_SWC_RCF_RCF_stAgRtrOfsCal, Rte_Write_SWC_RCF_PP_SWC_RCF_RCF_stEstAlRtrOfs]
          prefix=RTE_SWC_RCF
          sw-addrmethod=CODE
          symbol=CODE
        RTE_SWC_RDC_CODE: executable-entity=[Rte_Read_SWC_Rdc_PP_SWC_MCF_MCF_cofFrqPwm, Rte_Write_SWC_Rdc_PP_SWC_Rdc_Rdc_ArctanAgRtr, Rte_Write_SWC_Rdc_PP_SWC_Rdc_Rdc_nWoFlt], prefix=RTE_SWC_RDC, sw-addrmethod=CODE, symbol=CODE
        RTE_SWC_SCF_CODE:
          executable-entity=[Rte_Call_SWC_SCF_RP_SWC_DEM_SCF_DisChgOvTiFail_SetEventStatus, Rte_Call_SWC_SCF_RP_SWC_DEM_SCF_LowPwrShtDwnOvTiFail_SetEventStatus, Rte_Call_SWC_SCF_RP_SWC_DEM_SCF_RunToDisChaFail_SetEventStatus, Rte_Call_SWC_SCF_RP_SWC_FIM_FiM_FlagforFR_GetFunctionPermission, Rte_Call_SWC_SCF_RP_SWC_FIM_ReqFailrMod_GetFunctionPermission, Rte_Call_SWC_SCF_RP_SWC_FIM_VCUComTimeOut_GetFunctionPermission, Rte_Call_SWC_SCF_RP_SWC_FIM_flgDchaFailr_GetFunctionPermission, Rte_Call_SWC_SCF_RP_SWC_FIM_flgFaultLvFive_GetFunctionPermission, Rte_Call_SWC_SCF_RP_SWC_FIM_flgFaultLvFour_GetFunctionPermission, Rte_Read_SWC_SCF_RP_SWC_CSPF_CSPF_RecflgCrash, Rte_Read_SWC_SCF_RP_SWC_CSPF_CSPF_RecflgDchaReq, Rte_Read_SWC_SCF_RP_SWC_CSPF_CSPF_RecstMainReLay, Rte_Read_SWC_SCF_RP_SWC_HSPF_HSPF_Wake, Rte_Read_SWC_SCF_RP_SWC_HSPF_HSPF_bt15, Rte_Read_SWC_SCF_RP_SWC_HSPF_HSPF_flgCrash, Rte_Read_SWC_SCF_RP_SWC_HSPF_HSPF_nSlowFlt, Rte_Read_SWC_SCF_RP_SWC_HSPF_HSPF_stIphaOffCal, Rte_Read_SWC_SCF_RP_SWC_HSPF_HSPF_uDcLnkSlowFlt, Rte_Read_SWC_SCF_RP_SWC_Igbt_Igbt_flgGateDrvRdyHs, Rte_Read_SWC_SCF_RP_SWC_Igbt_Igbt_flgGateDrvRdyLs, Rte_Read_SWC_SCF_RP_SWC_LvPower_LvPower_stLowpowerUp, Rte_Read_SWC_SCF_RP_SWC_MDF_MDF_stFrwhl, Rte_Read_SWC_SCF_RP_SWC_MPC_MPC_IsFlt, Rte_Read_SWC_SCF_RP_SWC_NvM_NvM_flgAngAutoClbOffset, Rte_Read_SWC_SCF_RP_SWC_PCF_PCF_SLEnMotorAcc, Rte_Read_SWC_SCF_RP_SWC_PCF_PCF_Status, Rte_Read_SWC_SCF_RP_SWC_PCF_PCF_flgAllowPwmRun, Rte_Read_SWC_SCF_RP_SWC_PCF_PCF_flgShtDwnReq, Rte_Read_SWC_SCF_RP_SWC_PCF_PCF_stParkCtl, Rte_Read_SWC_SCF_RP_SWC_RCF_RCF_stAgRtrOfsCal, Rte_Read_SWC_SCF_RP_SWC_RCF_RCF_stEstAlRtrOfs, Rte_Read_SWC_SCF_RP_SWC_Snapshot_Snapshot_flgPostDrvDone, Rte_Read_SWC_SCF_RP_SWC_Tja1043_Tja1043_flgCAN_WakeUp, Rte_Read_SWC_SCF_RP_SWC_VCF_VCF_stModeReq, Rte_Write_SWC_SCF_PP_SWC_SCF_SCF_FIM_ReqFailrMod, Rte_Write_SWC_SCF_PP_SWC_SCF_SCF_bHvReady, Rte_Write_SWC_SCF_PP_SWC_SCF_SCF_flgActvDcha, Rte_Write_SWC_SCF_PP_SWC_SCF_SCF_flgDataStrgBgnToBsw, Rte_Write_SWC_SCF_PP_SWC_SCF_SCF_flgEmgReqInvDcha, Rte_Write_SWC_SCF_PP_SWC_SCF_SCF_flgEnDchaToMc, Rte_Write_SWC_SCF_PP_SWC_SCF_SCF_flgUdcLowToTpc, Rte_Write_SWC_SCF_PP_SWC_SCF_SCF_flginitPI, Rte_Write_SWC_SCF_PP_SWC_SCF_SCF_stDisChg, Rte_Write_SWC_SCF_PP_SWC_SCF_SCF_stDrvCtl, Rte_Write_SWC_SCF_PP_SWC_SCF_SCF_stFFAction, Rte_Write_SWC_SCF_PP_SWC_SCF_SCF_stGateDrv, Rte_Write_SWC_SCF_PP_SWC_SCF_SCF_stModeReqToTdc, Rte_Write_SWC_SCF_PP_SWC_SCF_SCF_stPreDrvCtl, Rte_Write_SWC_SCF_PP_SWC_SCF_SCF_stPwmMode, Rte_Write_SWC_SCF_PP_SWC_SCF_SCF_stSysCtl]
          prefix=RTE_SWC_SCF
          sw-addrmethod=CODE
          symbol=CODE
        RTE_SWC_SNAPSHOT_CODE:
          executable-entity=[Rte_Call_SWC_Snapshot_RP_SWC_IoHwAb_ADC_BSW_UBR_Vol_IoHwAb_ADC_GetPhyVoltage, Rte_Call_SWC_Snapshot_RP_SWC_IoHwAb_ADC_BSW_VDD18L_Vol_IoHwAb_ADC_GetPhyVoltage, Rte_Call_SWC_Snapshot_RP_SWC_IoHwAb_ADC_BSW_VDD5T1_Vol_IoHwAb_ADC_GetPhyVoltage, Rte_Call_SWC_Snapshot_RP_SWC_IoHwAb_ADC_BSW_VDD5T2_Vol_IoHwAb_ADC_GetPhyVoltage, Rte_Read_SWC_Snapshot_RP_SWC_HvMcu_HvMcu_VDD15L_Vol, Rte_Read_SWC_Snapshot_RP_SWC_HvMcu_HvMcu_uDcLnkHvMcu, Rte_Read_SWC_Snapshot_RP_SWC_PhC_PhC_iUNoOff, Rte_Read_SWC_Snapshot_RP_SWC_PhC_PhC_iVNoOff, Rte_Read_SWC_Snapshot_RP_SWC_PhC_PhC_iWNoOff, Rte_Read_SWC_Snapshot_RP_SWC_Rdc_Rdc_ArctanAgRtr, Rte_Read_SWC_Snapshot_RP_SWC_SCF_SCF_stFFAction, Rte_Write_SWC_Snapshot_PP_SWC_Snapshot_Snapshot_flgPostDrvDone]
          prefix=RTE_SWC_SNAPSHOT
          sw-addrmethod=CODE
          symbol=CODE
        RTE_SWC_TDC_CODE:
          executable-entity=[Rte_Read_SWC_TDC_RP_SWC_Rdc_Rdc_nWoFlt, Rte_Read_SWC_TDC_RP_SWC_SCF_SCF_stModeReqToTdc, Rte_Read_SWC_TDC_RP_SWC_TPC_TPC_TrqMax, Rte_Read_SWC_TDC_RP_SWC_TPC_TPC_TrqMin, Rte_Read_SWC_TDC_RP_SWC_VCF_VCF_HoldStartTrq, Rte_Read_SWC_TDC_RP_SWC_VCF_VCF_KpNCtl, Rte_Read_SWC_TDC_RP_SWC_VCF_VCF_NsetPReq, Rte_Read_SWC_TDC_RP_SWC_VCF_VCF_TrqDes, Rte_Read_SWC_TDC_RP_SWC_VCF_VCF_stModeReq, Rte_Read_SWC_TDC_RP_SWC_VCF_VCF_trqRamp, Rte_Write_SWC_TDC_PP_SWC_TDC_TDC_TrqDes, Rte_Write_SWC_TDC_PP_SWC_TDC_TDC_flgTrqLmtActv]
          prefix=RTE_SWC_TDC
          sw-addrmethod=CODE
          symbol=CODE
        RTE_SWC_TPC_CODE:
          executable-entity=[Rte_Call_SWC_TPC_RP_SWC_Dem_TPC_SpdOvHiLimFail_SetEventStatus, Rte_Call_SWC_TPC_RP_SWC_Dem_TPC_SpdOvHiWarn_SetEventStatus, Rte_Call_SWC_TPC_RP_SWC_Dem_TPC_TCoolantOvHiWarn_SetEventStatus, Rte_Call_SWC_TPC_RP_SWC_Dem_TPC_TDbcOvHiWarn_SetEventStatus, Rte_Call_SWC_TPC_RP_SWC_Dem_TPC_TDbcOvLoWarn_SetEventStatus, Rte_Call_SWC_TPC_RP_SWC_Dem_TPC_TDbcUHiLimFail_SetEventStatus, Rte_Call_SWC_TPC_RP_SWC_Dem_TPC_TDbcULoLimFail_SetEventStatus, Rte_Call_SWC_TPC_RP_SWC_Dem_TPC_TDbcVHiLimFail_SetEventStatus, Rte_Call_SWC_TPC_RP_SWC_Dem_TPC_TDbcVLoLimFail_SetEventStatus, Rte_Call_SWC_TPC_RP_SWC_Dem_TPC_TDbcWHiLimFail_SetEventStatus, Rte_Call_SWC_TPC_RP_SWC_Dem_TPC_TDbcWLoLimFail_SetEventStatus, Rte_Call_SWC_TPC_RP_SWC_Dem_TPC_TDrvBoardOvHiWarn_SetEventStatus, Rte_Call_SWC_TPC_RP_SWC_Dem_TPC_TIGBTOvHiLimFail_SetEventStatus, Rte_Call_SWC_TPC_RP_SWC_Dem_TPC_TIGBTOvHiWarn_SetEventStatus, Rte_Call_SWC_TPC_RP_SWC_Dem_TPC_TIGBTOvLoWarn_SetEventStatus, Rte_Call_SWC_TPC_RP_SWC_Dem_TPC_TSttrOvHiLimFail_SetEventStatus, Rte_Call_SWC_TPC_RP_SWC_Dem_TPC_TSttrOvHiWarn_SetEventStatus, Rte_Call_SWC_TPC_RP_SWC_Dem_TPC_TSttrOvLoWarn_SetEventStatus, Rte_Call_SWC_TPC_RP_SWC_Dem_TPC_iDcLnkOvCLimFail_SetEventStatus, Rte_Call_SWC_TPC_RP_SWC_Dem_TPC_iDcLnkOvcWarn_SetEventStatus, Rte_Call_SWC_TPC_RP_SWC_Dem_TPC_uDcLnkOvVLimFail_SetEventStatus, Rte_Call_SWC_TPC_RP_SWC_Dem_TPC_uDcLnkOvWarn_SetEventStatus, Rte_Call_SWC_TPC_RP_SWC_Dem_TPC_uDcLnkUnVLimFail_SetEventStatus, Rte_Call_SWC_TPC_RP_SWC_Dem_TPC_uDcLnkUnvWarn_SetEventStatus, Rte_Call_SWC_TPC_RP_SWC_FIM_PwrLimLvFour_GetFunctionPermission, Rte_Call_SWC_TPC_RP_SWC_FIM_PwrLimLvOne_GetFunctionPermission, Rte_Call_SWC_TPC_RP_SWC_FIM_PwrLimLvThree_GetFunctionPermission, Rte_Call_SWC_TPC_RP_SWC_FIM_PwrLimLvTwo_GetFunctionPermission, Rte_Call_SWC_TPC_RP_SWC_FIM_TrqLimLvFour_GetFunctionPermission, Rte_Call_SWC_TPC_RP_SWC_FIM_TrqLimLvOne_GetFunctionPermission, Rte_Call_SWC_TPC_RP_SWC_FIM_TrqLimLvThree_GetFunctionPermission, Rte_Call_SWC_TPC_RP_SWC_FIM_TrqLimLvTwo_GetFunctionPermission, Rte_Read_SWC_TPC_RP_SWC_CSPF_CSPF_RecTrqMax, Rte_Read_SWC_TPC_RP_SWC_CSPF_CSPF_RecTrqMaxNCtL, Rte_Read_SWC_TPC_RP_SWC_CSPF_CSPF_RecTrqMin, Rte_Read_SWC_TPC_RP_SWC_CSPF_CSPF_RecTrqMinNCtL, Rte_Read_SWC_TPC_RP_SWC_CSPF_CSPF_RecUdcMax, Rte_Read_SWC_TPC_RP_SWC_CSPF_CSPF_RecUdcMin, Rte_Read_SWC_TPC_RP_SWC_CSPF_CSPF_RecidcMax, Rte_Read_SWC_TPC_RP_SWC_CSPF_CSPF_RecidcMin, Rte_Read_SWC_TPC_RP_SWC_HSPF_HSPF_iDcLnkEstFlt, Rte_Read_SWC_TPC_RP_SWC_HSPF_HSPF_nSlowFlt, Rte_Read_SWC_TPC_RP_SWC_HSPF_HSPF_tCoolantTempFlt, Rte_Read_SWC_TPC_RP_SWC_HSPF_HSPF_tCoolantTjFlt, Rte_Read_SWC_TPC_RP_SWC_HSPF_HSPF_tDBCTempUFlt, Rte_Read_SWC_TPC_RP_SWC_HSPF_HSPF_tDBCTempVFlt, Rte_Read_SWC_TPC_RP_SWC_HSPF_HSPF_tDBCTempWFlt, Rte_Read_SWC_TPC_RP_SWC_HSPF_HSPF_tDrvBoardTempFlt, Rte_Read_SWC_TPC_RP_SWC_HSPF_HSPF_tIgbtTjFlt, Rte_Read_SWC_TPC_RP_SWC_HSPF_HSPF_tStrrTempFlt, Rte_Read_SWC_TPC_RP_SWC_HSPF_HSPF_uDcLnkSlowFlt, Rte_Read_SWC_TPC_RP_SWC_MCF_MCF_Is, Rte_Read_SWC_TPC_RP_SWC_MPC_MPC_TrqMech, Rte_Read_SWC_TPC_RP_SWC_MPC_MPC_TrqMechFlt, Rte_Read_SWC_TPC_RP_SWC_SCF_SCF_flgUdcLowToTpc, Rte_Read_SWC_TPC_RP_SWC_VCF_VCF_TrqDes, Rte_Read_SWC_TPC_RP_SWC_VCF_VCF_stModeReq, Rte_Write_SWC_TPC_PP_SWC_TPC_TPC_SgnRotDir, Rte_Write_SWC_TPC_PP_SWC_TPC_TPC_SgnTrqMechDir, Rte_Write_SWC_TPC_PP_SWC_TPC_TPC_TDbcTrqMax, Rte_Write_SWC_TPC_PP_SWC_TPC_TPC_TrqMax, Rte_Write_SWC_TPC_PP_SWC_TPC_TPC_TrqMaxTrans, Rte_Write_SWC_TPC_PP_SWC_TPC_TPC_TrqMin, Rte_Write_SWC_TPC_PP_SWC_TPC_TPC_TrqMinTrans, Rte_Write_SWC_TPC_PP_SWC_TPC_TPC_bDernCAN, Rte_Write_SWC_TPC_PP_SWC_TPC_TPC_bDernCoolantTemp, Rte_Write_SWC_TPC_PP_SWC_TPC_TPC_bDernDbcTemp, Rte_Write_SWC_TPC_PP_SWC_TPC_TPC_bDernDrvBoardTemp, Rte_Write_SWC_TPC_PP_SWC_TPC_TPC_bDernElecOvrIdc, Rte_Write_SWC_TPC_PP_SWC_TPC_TPC_bDernExcMax, Rte_Write_SWC_TPC_PP_SWC_TPC_TPC_bDernExcMin, Rte_Write_SWC_TPC_PP_SWC_TPC_TPC_bDernGenOvrIdc, Rte_Write_SWC_TPC_PP_SWC_TPC_TPC_bDernIGBTTemp, Rte_Write_SWC_TPC_PP_SWC_TPC_TPC_bDernMtrSpd, Rte_Write_SWC_TPC_PP_SWC_TPC_TPC_bDernOvrIdc, Rte_Write_SWC_TPC_PP_SWC_TPC_TPC_bDernOvrUdc, Rte_Write_SWC_TPC_PP_SWC_TPC_TPC_bDernStrTemp, Rte_Write_SWC_TPC_PP_SWC_TPC_TPC_bDernUndrUdc, Rte_Write_SWC_TPC_PP_SWC_TPC_TPC_stMotorMod, Rte_Write_SWC_TPC_PP_SWC_TPC_TPC_stTrqEmMax, Rte_Write_SWC_TPC_PP_SWC_TPC_TPC_stTrqEmMin]
          prefix=RTE_SWC_TPC
          sw-addrmethod=CODE
          symbol=CODE
        RTE_SWC_TJA1043_CODE: executable-entity=Rte_Write_SWC_Tja1043_PP_SWC_Tja1043_Tja1043_flgCAN_WakeUp, prefix=RTE_SWC_TJA1043, sw-addrmethod=CODE, symbol=CODE
        RTE_SWC_VCF_CODE:
          executable-entity=[Rte_Call_SWC_VCF_RP_SWC_FIM_IGBTOvTempWarn_GetFunctionPermission, Rte_Call_SWC_VCF_RP_SWC_FIM_MtrOvTempWarn_GetFunctionPermission, Rte_Call_SWC_VCF_RP_SWC_FIM_ReqFailrMod_GetFunctionPermission, Rte_Read_SWC_VCF_RP_SWC_CSPF_CSPF_RecKpDmp, Rte_Read_SWC_VCF_RP_SWC_CSPF_CSPF_RecKpHighNCtL, Rte_Read_SWC_VCF_RP_SWC_CSPF_CSPF_RecKpLowNCtL, Rte_Read_SWC_VCF_RP_SWC_CSPF_CSPF_RecNDiffMax, Rte_Read_SWC_VCF_RP_SWC_CSPF_CSPF_RecNSetP, Rte_Read_SWC_VCF_RP_SWC_CSPF_CSPF_RecTrqDmpMax, Rte_Read_SWC_VCF_RP_SWC_CSPF_CSPF_RecTrqDmpMin, Rte_Read_SWC_VCF_RP_SWC_CSPF_CSPF_RecTrqSLope, Rte_Read_SWC_VCF_RP_SWC_CSPF_CSPF_RecTrqSetP, Rte_Read_SWC_VCF_RP_SWC_CSPF_CSPF_RecstDmpCtLReq, Rte_Read_SWC_VCF_RP_SWC_CSPF_CSPF_RecstModeReq, Rte_Read_SWC_VCF_RP_SWC_HSPF_HSPF_nSlowFlt, Rte_Read_SWC_VCF_RP_SWC_MPC_MPC_TrqMechFlt, Rte_Read_SWC_VCF_RP_SWC_PCF_PCF_SLtrqDes, Rte_Read_SWC_VCF_RP_SWC_PCF_PCF_stParkCtl, Rte_Read_SWC_VCF_RP_SWC_RCF_RCF_TrqEmDesOfsClb, Rte_Read_SWC_VCF_RP_SWC_RCF_RCF_cTrqSlpOfsClb, Rte_Read_SWC_VCF_RP_SWC_Rdc_Rdc_nWoFlt, Rte_Read_SWC_VCF_RP_SWC_SCF_SCF_stDrvCtl, Rte_Read_SWC_VCF_RP_SWC_TDC_TDC_TrqDes, Rte_Read_SWC_VCF_RP_SWC_TPC_TPC_SgnRotDir, Rte_Read_SWC_VCF_RP_SWC_TPC_TPC_SgnTrqMechDir, Rte_Write_SWC_VCF_PP_SWC_VCF_VCF_HoldStartTrq, Rte_Write_SWC_VCF_PP_SWC_VCF_VCF_KpNCtl, Rte_Write_SWC_VCF_PP_SWC_VCF_VCF_NsetPReq, Rte_Write_SWC_VCF_PP_SWC_VCF_VCF_TrqDes, Rte_Write_SWC_VCF_PP_SWC_VCF_VCF_stModeReq, Rte_Write_SWC_VCF_PP_SWC_VCF_VCF_trqDesUnProc, Rte_Write_SWC_VCF_PP_SWC_VCF_VCF_trqRamp]
          prefix=RTE_SWC_VCF
          sw-addrmethod=CODE
          symbol=CODE
        RTE_SYS_CODE: executable-entity=[Rte_DecrementWaitingCount, Rte_ReadQueue, Rte_WaitWithTimeout, SchM_IModeInit], prefix=RTE_SYS, sw-addrmethod=CODE, symbol=CODE
        CONST_UNSPECIFIED: alignment=UNSPECIFIED, sw-addrmethod=CONST
        Partition_Core0_CONST_8: alignment=8, sw-addrmethod=Partition_Core0_CONST
        Partition_Core0_CONST_BOOLEAN: alignment=BOOLEAN, sw-addrmethod=Partition_Core0_CONST
        Partition_Core0_CONST_UNSPECIFIED: alignment=UNSPECIFIED, sw-addrmethod=Partition_Core0_CONST
        Partition_Core0_VAR_CLEARED_16: alignment=16, sw-addrmethod=Partition_Core0_VAR_CLEARED
        Partition_Core0_VAR_CLEARED_32: alignment=32, sw-addrmethod=Partition_Core0_VAR_CLEARED
        Partition_Core0_VAR_CLEARED_8: alignment=8, sw-addrmethod=Partition_Core0_VAR_CLEARED
        Partition_Core0_VAR_CLEARED_BOOLEAN: alignment=BOOLEAN, sw-addrmethod=Partition_Core0_VAR_CLEARED
        Partition_Core0_VAR_CLEARED_UNSPECIFIED: alignment=UNSPECIFIED, sw-addrmethod=Partition_Core0_VAR_CLEARED
        Partition_Core1_CONST_UNSPECIFIED: alignment=UNSPECIFIED, sw-addrmethod=Partition_Core1_CONST
        Partition_Core2_CONST_UNSPECIFIED: alignment=UNSPECIFIED, sw-addrmethod=Partition_Core2_CONST
        Partition_Core2_VAR_CLEARED_32: alignment=32, sw-addrmethod=Partition_Core2_VAR_CLEARED
        Partition_Core2_VAR_CLEARED_8: alignment=8, sw-addrmethod=Partition_Core2_VAR_CLEARED
        VAR_CLEARED_16: alignment=16, sw-addrmethod=VAR_CLEARED
        VAR_CLEARED_8: alignment=8, sw-addrmethod=VAR_CLEARED
        VAR_CLEARED_BOOLEAN: alignment=BOOLEAN, sw-addrmethod=VAR_CLEARED
        VAR_INIT_8: alignment=8, sw-addrmethod=VAR_INIT
        RTE_PARTITION_CORE0_VAR_INIT_8: alignment=8, prefix=RTE_PARTITION_CORE0, sw-addrmethod=VAR_INIT, symbol=VAR_INIT_8
      79 x section name prefix:
        RTE_BSWM
        RTE_BSW_10MS_TASK_CORE0
        RTE_BSW_1MS_TASK_CORE0
        RTE_BSW_2MS_TASK_CORE0
        RTE_DCM
        RTE_DEM
        RTE_DIAG_SWC
        RTE_EXT
        RTE_LIB
        RTE_MAIN
        RTE_NVM_SWC
        RTE_OS_COM_PWM3PH_EDGE_CORE2_ISR
        RTE_OS_GPDSADC_RES_CORE0_ISR
        RTE_OS_GPT100US_CORE0_ISR
        RTE_OS_INIT_TASK_CORE{0..2}
        RTE_OS_U1_V2_CORE0_ISR
        RTE_PARTITION_CORE0
        RTE_SIG_BMS01_BATTCURR_BMS_01
        RTE_SIG_BMS01_BATTVOLT_BMS_01
        RTE_SIG_BMS01_STMAINRELAY_BMS_01
        RTE_SIG_VCU01_IDCMAX_VCU_01
        RTE_SIG_VCU01_IDCMIN_VCU_01
        RTE_SIG_VCU01_STHVBMAIRLY_VCU_01
        RTE_SIG_VCU01_UDCMAX_VCU_01
        RTE_SIG_VCU01_UDCMIN_VCU_01
        RTE_SIG_VCU02_KPHIGHNCTL_VCU_02
        RTE_SIG_VCU02_KPLOWNCTL_VCU_02
        RTE_SIG_VCU02_NDIFFMAX_VCU_02
        RTE_SIG_VCU02_TRQMAXNCTL_VCU_02
        RTE_SIG_VCU02_TRQMINNCTL_VCU_02
        RTE_SIG_VCU03_CTRQSLOPEMAX_VCU_03
        RTE_SIG_VCU03_TRQMAX_VCU_03
        RTE_SIG_VCU03_TRQMIN_VCU_03
        RTE_SIG_VCU04_BKL15_VCU_04
        RTE_SIG_VCU04_MOTDIR_VCU_04
        RTE_SIG_VCU04_NSETP_VCU_04
        RTE_SIG_VCU04_STMODEREQ_VCU_04
        RTE_SIG_VCU04_TRQSETP_VCU_04
        RTE_SIG_VCU05_BSETOFSAL_VCU_05
        RTE_SIG_VCU05_KDMP_VCU_05
        RTE_SIG_VCU05_OFSAL_VCU_05
        RTE_SIG_VCU05_STDMPCTLREQ_VCU_05
        RTE_SIG_VCU05_TRQDMPLIM_VCU_05
        RTE_SIG_VCU05_TRQDMPMAX_VCU_05
        RTE_SIG_VCU06_PARK_VCU_06
        RTE_SIG_VCU06_STBELT_VCU_06
        RTE_SIG_VCU06_STBREAK_VCU_06
        RTE_SIG_VCU06_STDOOR_VCU_06
        RTE_SIG_VCU06_VEHGRAD_VCU_06
        RTE_SWC_1000MS_TASK_CORE0
        RTE_SWC_100MS_TASK_CORE0
        RTE_SWC_10MS_TASK_CORE0
        RTE_SWC_20MS_TASK_CORE0
        RTE_SWC_BCC
        RTE_SWC_CPLD
        RTE_SWC_CSPF
        RTE_SWC_DIAGCALIB
        RTE_SWC_EPARK
        RTE_SWC_HSPF
        RTE_SWC_HVMCU
        RTE_SWC_IGBT
        RTE_SWC_LVPOWER
        RTE_SWC_MCF
        RTE_SWC_MDF
        RTE_SWC_MPC
        RTE_SWC_PCF
        RTE_SWC_PHC
        RTE_SWC_PWM3PH
        RTE_SWC_RCF
        RTE_SWC_RDC
        RTE_SWC_SCF
        RTE_SWC_SNAPSHOT
        RTE_SWC_TDC
        RTE_SWC_TJA1043
        RTE_SWC_TPC
        RTE_SWC_VCF
        RTE_SYS
package /AUTOSAR_Rte/CompuMethods
  compu method CompuMethods_boolean: 0=FALSE, 1=TRUE
  compu method Methods_boolean: 0=FALSE, 1=TRUE
package /AUTOSAR_Rte/ImplementationDataTypes
  88 x impl type:
    Rte_REActCounterType: category=VALUE  # This is an external type, i.e. it is declared in the Rte Library and not in the XML. RTEGen does not have any information about this type apart from its name.
    Rte_PimType_NvM_SWC_NvM_SWC_BlockNative_1024_Type: category=TYPE_REFERENCE
    Rte_PimType_NvM_SWC_NvM_SWC_BlockRedundant_1024_Type: category=TYPE_REFERENCE
    Rte_DE_uint8: category=STRUCTURE
      element value: implementation-data-type=uint8
    Rte_TDB_SWC_1000ms_Task_Core0: category=STRUCTURE
      element rbuf0: implementation-data-type=Rte_DE_uint8
    Rte_ISA_18: category=UNION
      element Rte_SWC_1000ms_Task_Core0: implementation-data-type=Rte_TDB_SWC_1000ms_Task_Core0
    Rte_ImplicitBufsType: category=STRUCTURE
      element isa_18: implementation-data-type=Rte_ISA_18
    Rte_CDS_BswM: category=STRUCTURE
      element Rte_Dummy: implementation-data-type=uint8
    Rte_CDS_ComM: category=STRUCTURE
      element Rte_Dummy: implementation-data-type=uint8
    Rte_CDS_Dcm: category=STRUCTURE
      element Rte_Dummy: implementation-data-type=uint8
    Rte_CDS_Dem: category=STRUCTURE
      element Rte_Dummy: implementation-data-type=uint8
    Rte_CDS_Det: category=STRUCTURE
      element Rte_Dummy: implementation-data-type=uint8
    Rte_CDS_Diag_SWC: category=STRUCTURE
      element Runnable_Dcm_Swc_RPort_TST_Diag_TestNumber_uint8: implementation-data-type=Rte_DE_uint8
    Rte_CDS_EcuM: category=STRUCTURE
      element Rte_Dummy: implementation-data-type=uint8
    Rte_CDS_FiM: category=STRUCTURE
      element Rte_Dummy: implementation-data-type=uint8
    Rte_CDS_IoHwAbW: category=STRUCTURE
      element Rte_Dummy: implementation-data-type=uint8
    Rte_CDS_NvM: category=STRUCTURE
      element Rte_Dummy: implementation-data-type=uint8
    Rte_CDS_NvM_SWC: category=STRUCTURE
      element Pim_NvM_SWC_BlockNative_1024: implementation-data-type=Rte_PimType_NvM_SWC_NvM_SWC_BlockNative_1024_Type
      element Pim_NvM_SWC_BlockRedundant_1024: implementation-data-type=Rte_PimType_NvM_SWC_NvM_SWC_BlockRedundant_1024_Type
    Rte_CDS_SWC_BCC: category=STRUCTURE
      element Rte_Dummy: implementation-data-type=uint8
    Rte_CDS_SWC_CSPF: category=STRUCTURE
      element Rte_Dummy: implementation-data-type=uint8
    Rte_CDS_SWC_Cpld: category=STRUCTURE
      element Rte_Dummy: implementation-data-type=uint8
    Rte_CDS_SWC_DiagCalib: category=STRUCTURE
      element Rte_Dummy: implementation-data-type=uint8
    Rte_CDS_SWC_Epark: category=STRUCTURE
      element Rte_Dummy: implementation-data-type=uint8
    Rte_CDS_SWC_HSPF: category=STRUCTURE
      element Rte_Dummy: implementation-data-type=uint8
    Rte_CDS_SWC_HvMcu: category=STRUCTURE
      element Rte_Dummy: implementation-data-type=uint8
    Rte_CDS_SWC_Igbt: category=STRUCTURE
      element Rte_Dummy: implementation-data-type=uint8
    Rte_CDS_SWC_LvPower: category=STRUCTURE
      element Rte_Dummy: implementation-data-type=uint8
    Rte_CDS_SWC_MCF: category=STRUCTURE
      element Rte_Dummy: implementation-data-type=uint8
    Rte_CDS_SWC_MDF: category=STRUCTURE
      element Rte_Dummy: implementation-data-type=uint8
    Rte_CDS_SWC_MPC: category=STRUCTURE
      element Rte_Dummy: implementation-data-type=uint8
    Rte_CDS_SWC_PCF: category=STRUCTURE
      element Rte_Dummy: implementation-data-type=uint8
    Rte_CDS_SWC_PhC: category=STRUCTURE
      element Rte_Dummy: implementation-data-type=uint8
    Rte_CDS_SWC_Pwm3ph: category=STRUCTURE
      element Rte_Dummy: implementation-data-type=uint8
    Rte_CDS_SWC_RCF: category=STRUCTURE
      21 x element, all with category=TYPE_REFERENCE:
        Irv_RE_SWC_RCF_100us_IVDP_RCF_flgEnblEstAlRtrOfs: implementation-data-type=boolean
        Irv_RE_SWC_RCF_100us_IVDP_RCF_flgEnblOfsClbFrwhl: implementation-data-type=boolean
        Irv_RE_SWC_RCF_100us_IVDP_RCF_flgEnblOfsClbFrwhlBwd: implementation-data-type=boolean
        Irv_RE_SWC_RCF_100us_IVDP_RCF_flgEnblOfsClbFrwhlFwd: implementation-data-type=boolean
        Irv_RE_SWC_RCF_100us_IVDP_RCF_stAgRtrOfsCal: implementation-data-type=uint8
        Irv_RE_SWC_RCF_100us_IVDP_RCF_stEstAlRtrOfs: implementation-data-type=uint8
        Irv_RE_SWC_RCF_100us_IVDP_RCF_stOfsClbFrwhl: implementation-data-type=uint8
        Irv_RE_SWC_RCF_100us_IVDP_RCF_stOfsFrwhlFwd: implementation-data-type=uint8
        Irv_RE_SWC_RCF_10ms_IVDP_RCF_flgEnblEstAlRtrOfs: implementation-data-type=boolean
        Irv_RE_SWC_RCF_10ms_IVDP_RCF_flgEnblOfsClbFrwhl: implementation-data-type=boolean
        Irv_RE_SWC_RCF_10ms_IVDP_RCF_flgEnblOfsClbFrwhlBwd: implementation-data-type=boolean
        Irv_RE_SWC_RCF_10ms_IVDP_RCF_flgEnblOfsClbFrwhlFwd: implementation-data-type=boolean
        Irv_RE_SWC_RCF_10ms_IVDP_RCF_stAgRtrOfsCal: implementation-data-type=uint8
        Irv_RE_SWC_RCF_10ms_IVDP_RCF_stEstAlRtrOfs: implementation-data-type=uint8
        Irv_RE_SWC_RCF_10ms_IVDP_RCF_stOfsClbFrwhl: implementation-data-type=uint8
        Irv_RE_SWC_RCF_10ms_IVDP_RCF_stOfsFrwhlFwd: implementation-data-type=uint8
        Irv_RE_SWC_RCF_Init_IVDP_RCF_flgEnblEstAlRtrOfs: implementation-data-type=boolean
        Irv_RE_SWC_RCF_Init_IVDP_RCF_flgEnblOfsClbFrwhl: implementation-data-type=boolean
        Irv_RE_SWC_RCF_Init_IVDP_RCF_flgEnblOfsClbFrwhlBwd: implementation-data-type=boolean
        Irv_RE_SWC_RCF_Init_IVDP_RCF_flgEnblOfsClbFrwhlFwd: implementation-data-type=boolean
        Irv_RE_SWC_RCF_Init_IVDP_RCF_stAgRtrOfsCal: implementation-data-type=uint8
    Rte_CDS_SWC_Rdc: category=STRUCTURE
      element Rte_Dummy: implementation-data-type=uint8
    Rte_CDS_SWC_SCF: category=STRUCTURE
      element Rte_Dummy: implementation-data-type=uint8
    Rte_CDS_SWC_Snapshot: category=STRUCTURE
      element Rte_Dummy: implementation-data-type=uint8
    Rte_CDS_SWC_TDC: category=STRUCTURE
      element Rte_Dummy: implementation-data-type=uint8
    Rte_CDS_SWC_TPC: category=STRUCTURE
      element Rte_Dummy: implementation-data-type=uint8
    Rte_CDS_SWC_Task_Core0: category=STRUCTURE
      element Rte_Dummy: implementation-data-type=uint8
    Rte_CDS_SWC_Task_Core1: category=STRUCTURE
      element Rte_Dummy: implementation-data-type=uint8
    Rte_CDS_SWC_Task_Core2: category=STRUCTURE
      element Rte_Dummy: implementation-data-type=uint8
    Rte_CDS_SWC_Tja1043: category=STRUCTURE
      element Rte_Dummy: implementation-data-type=uint8
    Rte_CDS_SWC_VCF: category=STRUCTURE
      15 x element, all with category=TYPE_REFERENCE:
        Irv_RE_SWC_VCF_10ms_IVDP_VCF_CrawlFlg: implementation-data-type=boolean
        Irv_RE_SWC_VCF_10ms_IVDP_VCF_CrawlModeReq: implementation-data-type=uint8
        Irv_RE_SWC_VCF_10ms_IVDP_VCF_RecCrawlNSetP: implementation-data-type=float32
        Irv_RE_SWC_VCF_10ms_IVDP_VCF_RecCrawlTrqSetP: implementation-data-type=float32
        Irv_RE_SWC_VCF_10ms_IVDP_VCF_flgHoldModeReq: implementation-data-type=boolean
        Irv_RE_SWC_VCF_2ms_IVDP_VCF_CrawlFlg: implementation-data-type=boolean
        Irv_RE_SWC_VCF_2ms_IVDP_VCF_CrawlModeReq: implementation-data-type=uint8
        Irv_RE_SWC_VCF_2ms_IVDP_VCF_RecCrawlNSetP: implementation-data-type=float32
        Irv_RE_SWC_VCF_2ms_IVDP_VCF_RecCrawlTrqSetP: implementation-data-type=float32
        Irv_RE_SWC_VCF_2ms_IVDP_VCF_flgHoldModeReq: implementation-data-type=boolean
        Irv_RE_SWC_VCF_Init_IVDP_VCF_CrawlFlg: implementation-data-type=boolean
        Irv_RE_SWC_VCF_Init_IVDP_VCF_CrawlModeReq: implementation-data-type=uint8
        Irv_RE_SWC_VCF_Init_IVDP_VCF_RecCrawlNSetP: implementation-data-type=float32
        Irv_RE_SWC_VCF_Init_IVDP_VCF_RecCrawlTrqSetP: implementation-data-type=float32
        Irv_RE_SWC_VCF_Init_IVDP_VCF_flgHoldModeReq: implementation-data-type=boolean
    Rte_CDS_WdgM_SWC: category=STRUCTURE
      element Rte_Dummy: implementation-data-type=uint8
    Rte_REContainerType: category=VALUE  # This is an external type, i.e. it is declared in the Rte Library and not in the XML. RTEGen does not have any information about this type apart from its name.
    Dcm_DataArrayTypeUint8_DspData_SYS_SUP_ID_F18AType: category=ARRAY
      element Dcm_DataArrayTypeUint8_DspData_SYS_SUP_ID_F18ATypeElement: array-size=8, array-size-semantics=FIXED-SIZE, implementation-data-type=uint8
    Dcm_DataArrayTypeUint8_DspData_ASW_VER_F189Type: category=ARRAY
      element Dcm_DataArrayTypeUint8_DspData_ASW_VER_F189TypeElement: array-size=2, array-size-semantics=FIXED-SIZE, implementation-data-type=uint8
    Dcm_DataArrayTypeUint8_DspData_MANU_DATE_F18BType: category=ARRAY
      element Dcm_DataArrayTypeUint8_DspData_MANU_DATE_F18BTypeElement: array-size=8, array-size-semantics=FIXED-SIZE, implementation-data-type=uint8
    Rte_SelfType_BswM: implementation-data-type=Rte_CDS_BswM
    Rte_SelfType_ComM: implementation-data-type=Rte_CDS_ComM
    Rte_SelfType_Dcm: implementation-data-type=Rte_CDS_Dcm
    Rte_SelfType_Dem: implementation-data-type=Rte_CDS_Dem
    Rte_SelfType_Det: implementation-data-type=Rte_CDS_Det
    Rte_SelfType_Diag_SWC: implementation-data-type=Rte_CDS_Diag_SWC
    Rte_SelfType_EcuM: implementation-data-type=Rte_CDS_EcuM
    Rte_SelfType_SWC_Epark: implementation-data-type=Rte_CDS_SWC_Epark
    Rte_SelfType_FiM: implementation-data-type=Rte_CDS_FiM
    Rte_SelfType_SWC_HSPF: implementation-data-type=Rte_CDS_SWC_HSPF
    Rte_SelfType_SWC_HvMcu: implementation-data-type=Rte_CDS_SWC_HvMcu
    Rte_SelfType_SWC_Igbt: implementation-data-type=Rte_CDS_SWC_Igbt
    Rte_SelfType_IoHwAbW: implementation-data-type=Rte_CDS_IoHwAbW
    Rte_SelfType_SWC_LvPower: implementation-data-type=Rte_CDS_SWC_LvPower
    Rte_SelfType_SWC_MCF: implementation-data-type=Rte_CDS_SWC_MCF
    Rte_SelfType_SWC_MDF: implementation-data-type=Rte_CDS_SWC_MDF
    Rte_SelfType_SWC_MPC: implementation-data-type=Rte_CDS_SWC_MPC
    Rte_SelfType_NvM: implementation-data-type=Rte_CDS_NvM
    Rte_SelfType_NvM_SWC: implementation-data-type=Rte_CDS_NvM_SWC
    Rte_SelfType_SWC_PCF: implementation-data-type=Rte_CDS_SWC_PCF
    Rte_SelfType_SWC_PhC: implementation-data-type=Rte_CDS_SWC_PhC
    Rte_SelfType_SWC_Pwm3ph: implementation-data-type=Rte_CDS_SWC_Pwm3ph
    Rte_SelfType_SWC_RCF: implementation-data-type=Rte_CDS_SWC_RCF
    Rte_SelfType_SWC_Rdc: implementation-data-type=Rte_CDS_SWC_Rdc
    Rte_SelfType_SWC_SCF: implementation-data-type=Rte_CDS_SWC_SCF
    Rte_SelfType_SWC_BCC: implementation-data-type=Rte_CDS_SWC_BCC
    Rte_SelfType_SWC_CSPF: implementation-data-type=Rte_CDS_SWC_CSPF
    Rte_SelfType_SWC_Cpld: implementation-data-type=Rte_CDS_SWC_Cpld
    Rte_SelfType_SWC_DiagCalib: implementation-data-type=Rte_CDS_SWC_DiagCalib
    Rte_SelfType_SWC_Task_Core{0..2}: implementation-data-type=Rte_CDS_SWC_Task_Core{0..2}
    Rte_SelfType_SWC_Snapshot: implementation-data-type=Rte_CDS_SWC_Snapshot
    Rte_SelfType_SWC_TDC: implementation-data-type=Rte_CDS_SWC_TDC
    Rte_SelfType_SWC_TPC: implementation-data-type=Rte_CDS_SWC_TPC
    Rte_SelfType_SWC_Tja1043: implementation-data-type=Rte_CDS_SWC_Tja1043
    Rte_SelfType_SWC_VCF: implementation-data-type=Rte_CDS_SWC_VCF
    Rte_SelfType_WdgM_SWC: implementation-data-type=Rte_CDS_WdgM_SWC
    Rte_TaskInfo: category=VALUE  # This is an external type, i.e. it is declared in the Rte Library and not in the XML. RTEGen does not have any information about this type apart from its name.
package /AUTOSAR_Rte/SwAddrMethods
  9 x sw addr method:
    CODE: memory-allocation-keyword-policy=ADDR-METHOD-SHORT-NAME, section-type=CODE
    CONST: memory-allocation-keyword-policy=ADDR-METHOD-SHORT-NAME-AND-ALIGNMENT, section-type=CONST
    Partition_Core0_CONST: memory-allocation-keyword-policy=ADDR-METHOD-SHORT-NAME-AND-ALIGNMENT, section-type=CONST
    Partition_Core0_VAR_CLEARED: memory-allocation-keyword-policy=ADDR-METHOD-SHORT-NAME-AND-ALIGNMENT, section-initialization-policy=CLEARED, section-type=VAR
    Partition_Core1_CONST: memory-allocation-keyword-policy=ADDR-METHOD-SHORT-NAME-AND-ALIGNMENT, section-type=CONST
    Partition_Core2_CONST: memory-allocation-keyword-policy=ADDR-METHOD-SHORT-NAME-AND-ALIGNMENT, section-type=CONST
    Partition_Core2_VAR_CLEARED: memory-allocation-keyword-policy=ADDR-METHOD-SHORT-NAME-AND-ALIGNMENT, section-initialization-policy=CLEARED, section-type=VAR
    VAR_CLEARED: memory-allocation-keyword-policy=ADDR-METHOD-SHORT-NAME-AND-ALIGNMENT, section-initialization-policy=CLEARED, section-type=VAR
    VAR_INIT: memory-allocation-keyword-policy=ADDR-METHOD-SHORT-NAME-AND-ALIGNMENT, section-initialization-policy=INIT, section-type=VAR
