[part 1 of 2: package /AUTOSAR_Rte/BswModuleDescriptions]
AUTOSAR XML (schema 4-2-2)
standard types defined: uint8, boolean, float32, uint16
package /AUTOSAR_Rte/BswModuleDescriptions
  bsw module description Rte: outgoing-callbacks=[Rte_StartHook_Return, Rte_StartHook_Start, Rte_StopHook_Return, Rte_StopHook_Start, Rte_Task_Activate]
    provided-entrys:
      Rte_ActivateRE
      Rte_Call_Dcm_RoutineServices_DcmDspRoutine_CheckPgmPreCond_RequestResults
      Rte_Call_Dcm_RoutineServices_DcmDspRoutine_CheckPgmPreCond_Start
      Rte_Call_Dcm_RoutineServices_DcmDspRoutine_CheckPgmPreCond_Stop
      Rte_Call_Dcm_RoutineServices_DcmDspRoutine_Test_RequestResults
      Rte_Call_Dcm_RoutineServices_DcmDspRoutine_Test_Start
      Rte_Call_Dcm_RoutineServices_DcmDspRoutine_Test_Stop
      Rte_Call_Dcm_SecurityAccess_DSP_SEC_LEV_L1_CompareKey
      Rte_Call_Dcm_SecurityAccess_DSP_SEC_LEV_L1_GetSeed
      Rte_Call_Dcm_SecurityAccess_DSP_SEC_LEV_L2_CompareKey
      Rte_Call_Dcm_SecurityAccess_DSP_SEC_LEV_L2_GetSeed
      Rte_Call_Dcm_SecurityAccess_DSP_SEC_LEV_L3_CompareKey
      Rte_Call_Dcm_SecurityAccess_DSP_SEC_LEV_L3_GetSeed
      Rte_Call_Dcm_SecurityAccess_DSP_SEC_LEV_L4_CompareKey
      Rte_Call_Dcm_SecurityAccess_DSP_SEC_LEV_L4_GetSeed
      Rte_Call_Dem_CBStatusComp_DemComponent_BusOff1_ComponentStatusChanged
      Rte_Call_Dem_CBStatusComp_DemComponent_BusOff2_ComponentStatusChanged
      Rte_Call_Dem_CBStatusComp_DemComponent_BusOff_ComponentStatusChanged
      Rte_Call_Dem_CBStatusComp_DemComponent_MCAL_Status_ComponentStatusChanged
      Rte_Call_Dem_CBStatusComp_DemComponent_MCU_Status_ComponentStatusChanged
      Rte_Call_Dem_CBStatusComp_DemComponent_MPDU_CommStatus_ComponentStatusChanged
      Rte_Call_Dem_CBStatusComp_DemComponent_NvM_ReadErr_ComponentStatusChanged
      Rte_Call_Dem_CBStatusComp_DemComponent_NvM_WriteErr_ComponentStatusChanged
      Rte_Call_Dem_CBStatusComp_DemComponent_SEN_1_CommStatus_ComponentStatusChanged
      Rte_Call_Dem_CBStatusComp_DemComponent_SEN_CommStatus_ComponentStatusChanged
      Rte_Call_Dem_CBStatusComp_DemComponent_VCU_DC01_AliveCounter_ComponentStatusChanged
      Rte_Call_Dem_CBStatusComp_DemComponent_VCU_DC01_CheckSum_ComponentStatusChanged
      Rte_Call_Dem_CBStatusComp_DemComponent_VCU_DC01_DLC_ComponentStatusChanged
      Rte_Call_Dem_CBStatusComp_DemComponent_VCU_DC01_Tiout_ComponentStatusChanged
      Rte_Call_Diag_SWC_RPort_ControlDTCSuppression_SetDTCSuppression
      Rte_Call_Diag_SWC_RPort_DCMServices_GetActiveProtocol
      Rte_Call_Diag_SWC_RPort_DCMServices_GetSecurityLevel
      Rte_Call_Diag_SWC_RPort_DCMServices_GetSesCtrlType
      Rte_Call_Diag_SWC_RPort_DCMServices_ResetToDefaultSession
      Rte_Call_Diag_SWC_RPort_EcuMSelectResetTarget_SelectShutdownTarget
      Rte_Call_Diag_SWC_RPort_Event_Event_LostComm_MPDU_ClearPrestoredFreezeFrame
      Rte_Call_Diag_SWC_RPort_Event_Event_LostComm_MPDU_PrestoreFreezeFrame
      Rte_Call_Diag_SWC_RPort_Event_Event_LostComm_MPDU_ResetEventStatus
      Rte_Call_Diag_SWC_RPort_Event_Event_LostComm_MPDU_SetEventStatus
      Rte_Call_Diag_SWC_RPort_Event_Event_LostComm_SEN_1_ClearPrestoredFreezeFrame
      Rte_Call_Diag_SWC_RPort_Event_Event_LostComm_SEN_1_PrestoreFreezeFrame
      Rte_Call_Diag_SWC_RPort_Event_Event_LostComm_SEN_1_ResetEventStatus
      Rte_Call_Diag_SWC_RPort_Event_Event_LostComm_SEN_1_SetEventStatus
      Rte_Call_Diag_SWC_RPort_Event_Event_LostComm_SEN_ClearPrestoredFreezeFrame
      Rte_Call_Diag_SWC_RPort_Event_Event_LostComm_SEN_PrestoreFreezeFrame
      Rte_Call_Diag_SWC_RPort_Event_Event_LostComm_SEN_ResetEventStatus
      Rte_Call_Diag_SWC_RPort_Event_Event_LostComm_SEN_SetEventStatus
      Rte_Call_Diag_SWC_RPort_EvtInfo_Event_LostComm_MPDU_GetDTCOfEvent
      Rte_Call_Diag_SWC_RPort_EvtInfo_Event_LostComm_MPDU_GetEventFailed
      Rte_Call_Diag_SWC_RPort_EvtInfo_Event_LostComm_MPDU_GetEventStatus
      Rte_Call_Diag_SWC_RPort_EvtInfo_Event_LostComm_MPDU_GetEventTested
      Rte_Call_Diag_SWC_RPort_EvtInfo_Event_LostComm_MPDU_GetFaultDetectionCounter
      Rte_Call_Diag_SWC_RPort_EvtInfo_Event_LostComm_SEN_1_GetDTCOfEvent
      Rte_Call_Diag_SWC_RPort_EvtInfo_Event_LostComm_SEN_1_GetEventFailed
      Rte_Call_Diag_SWC_RPort_EvtInfo_Event_LostComm_SEN_1_GetEventStatus
      Rte_Call_Diag_SWC_RPort_EvtInfo_Event_LostComm_SEN_1_GetEventTested
      Rte_Call_Diag_SWC_RPort_EvtInfo_Event_LostComm_SEN_1_GetFaultDetectionCounter
      Rte_Call_Diag_SWC_RPort_EvtInfo_Event_LostComm_SEN_GetDTCOfEvent
      Rte_Call_Diag_SWC_RPort_EvtInfo_Event_LostComm_SEN_GetEventFailed
      Rte_Call_Diag_SWC_RPort_EvtInfo_Event_LostComm_SEN_GetEventStatus
      Rte_Call_Diag_SWC_RPort_EvtInfo_Event_LostComm_SEN_GetEventTested
      Rte_Call_Diag_SWC_RPort_EvtInfo_Event_LostComm_SEN_GetFaultDetectionCounter
      Rte_Call_Diag_SWC_RPort_FiMFID_0_GetFunctionPermission
      Rte_Call_Diag_SWC_RPort_OpCycle_DemOperationCycle_0_SetOperationCycleState
      Rte_Call_NvM_SWC_RPort_NvM_SWC_BlockNative_1024_EraseBlock
      Rte_Call_NvM_SWC_RPort_NvM_SWC_BlockNative_1024_GetDataIndex
      Rte_Call_NvM_SWC_RPort_NvM_SWC_BlockNative_1024_GetErrorStatus
      Rte_Call_NvM_SWC_RPort_NvM_SWC_BlockNative_1024_InvalidateNvBlock
      Rte_Call_NvM_SWC_RPort_NvM_SWC_BlockNative_1024_ReadBlock
      Rte_Call_NvM_SWC_RPort_NvM_SWC_BlockNative_1024_RestoreBlockDefaults
      Rte_Call_NvM_SWC_RPort_NvM_SWC_BlockNative_1024_SetDataIndex
      Rte_Call_NvM_SWC_RPort_NvM_SWC_BlockNative_1024_SetRamBlockStatus
      Rte_Call_NvM_SWC_RPort_NvM_SWC_BlockNative_1024_WriteBlock
      Rte_Call_NvM_SWC_RPort_NvM_SWC_BlockRedundant_1024_EraseBlock
      Rte_Call_NvM_SWC_RPort_NvM_SWC_BlockRedundant_1024_GetDataIndex
      Rte_Call_NvM_SWC_RPort_NvM_SWC_BlockRedundant_1024_GetErrorStatus
      Rte_Call_NvM_SWC_RPort_NvM_SWC_BlockRedundant_1024_InvalidateNvBlock
      Rte_Call_NvM_SWC_RPort_NvM_SWC_BlockRedundant_1024_ReadBlock
      Rte_Call_NvM_SWC_RPort_NvM_SWC_BlockRedundant_1024_RestoreBlockDefaults
      Rte_Call_NvM_SWC_RPort_NvM_SWC_BlockRedundant_1024_SetDataIndex
      Rte_Call_NvM_SWC_RPort_NvM_SWC_BlockRedundant_1024_SetRamBlockStatus
      Rte_Call_NvM_SWC_RPort_NvM_SWC_BlockRedundant_1024_WriteBlock
      Rte_Call_NvM_SWC_RPort_ShutdownTarget_GetLastShutdownTarget
      Rte_Call_NvM_SWC_RPort_ShutdownTarget_GetShutdownCause
      Rte_Call_NvM_SWC_RPort_ShutdownTarget_GetShutdownTarget
      Rte_Call_NvM_SWC_RPort_ShutdownTarget_SelectShutdownCause
      Rte_Call_NvM_SWC_RPort_ShutdownTarget_SelectShutdownTarget
      Rte_Call_SWC_CSPF_RP_SWC_IoHwAb_ADC_BSW_HwVer_IoHwAb_ADC_GetPhyVoltage
      Rte_Call_SWC_HSPF_RP_SWC_DEM_HSPF_VerMatchFailureFail_SetEventStatus
      Rte_Call_SWC_HSPF_RP_SWC_Dem_HSPF_InvOpenFail_SetEventStatus
      Rte_Call_SWC_HSPF_RP_SWC_Dem_HSPF_IphaOffCalFail_SetEventStatus
      Rte_Call_SWC_HSPF_RP_SWC_Dem_HSPF_MotorOpenFail_SetEventStatus
      Rte_Call_SWC_HSPF_RP_SWC_Dem_HSPF_tDBCTempCmpFail_SetEventStatus
      Rte_Call_SWC_HSPF_RP_SWC_FIM_HSPF_Sttr1Err_GetFunctionPermission
      Rte_Call_SWC_HSPF_RP_SWC_FIM_HSPF_Sttr2Err_GetFunctionPermission
      Rte_Call_SWC_HSPF_RP_SWC_FIM_HSPF_tDBCTempCmpErr_GetFunctionPermission
      Rte_Call_SWC_HSPF_RP_SWC_IoHwAb_ADC_BSW_HwVer_IoHwAb_ADC_GetPhyVoltage
      Rte_Call_SWC_HSPF_RP_SWC_IoHwAb_ADC_BSW_tCoolantTemp_IoHwAb_ADC_GetPhyVoltage
      Rte_Call_SWC_HSPF_RP_SWC_IoHwAb_ADC_BSW_tStrrTemp1_IoHwAb_ADC_GetPhyVoltage
      Rte_Call_SWC_HSPF_RP_SWC_IoHwAb_ADC_BSW_tStrrTemp2_IoHwAb_ADC_GetPhyVoltage
      Rte_Call_SWC_HSPF_RP_SWC_IoHwAb_ADC_BSW_uKl30_IoHwAb_ADC_GetPhyVoltage
      Rte_Call_SWC_HSPF_RP_SWC_IoHwAb_DIO_Get_BSW_Wake_IoHwAb_DIO_Get
      Rte_Call_SWC_HSPF_RP_SWC_IoHwAb_DIO_Get_BSW_bt15_IoHwAb_DIO_Get
      Rte_Call_SWC_HSPF_RP_SWC_IoHwAb_DIO_Get_BSW_flgCrash_IoHwAb_DIO_Get
      Rte_Call_SWC_HSPF_RP_SWC_IoHwAb_DIO_Get_BSW_flgMcuOpen_IoHwAb_DIO_Get
      Rte_Call_SWC_HSPF_RP_SWC_IoHwAb_DIO_Get_BSW_flgMotorOpen_IoHwAb_DIO_Get
      Rte_Call_SWC_HSPF_RP_SWC_IoHwAb_DIO_Set_HSPF_flgSwtTSttr1_IoHwAb_DIO_Set
      Rte_Call_SWC_HSPF_RP_SWC_IoHwAb_DIO_Set_HSPF_flgSwtTSttr2_IoHwAb_DIO_Set
      Rte_Call_SWC_MDF_RP_SWC_Dem_MDF_AlOfsNoPlausFail_SetEventStatus
      Rte_Call_SWC_MDF_RP_SWC_Dem_MDF_DiashCirNoPsblFail_SetEventStatus
      Rte_Call_SWC_MDF_RP_SWC_Dem_MDF_EmacBlkdFail_SetEventStatus
      Rte_Call_SWC_MDF_RP_SWC_Dem_MDF_EmacBlkdWarn_SetEventStatus
      Rte_Call_SWC_MDF_RP_SWC_Dem_MDF_ICtlRatFail_SetEventStatus
      Rte_Call_SWC_MDF_RP_SWC_Dem_MDF_IsOvHiFail_SetEventStatus
      Rte_Call_SWC_MDF_RP_SWC_Dem_MDF_OpenCirNoPsblFail_SetEventStatus
      Rte_Call_SWC_MDF_RP_SWC_Dem_MDF_OperOutdRngFail_SetEventStatus
      Rte_Call_SWC_MDF_RP_SWC_Dem_MDF_PhaseLossFaultFail_SetEventStatus
      Rte_Call_SWC_MDF_RP_SWC_Dem_MDF_PrfElDrvFail_SetEventStatus
      Rte_Call_SWC_MDF_RP_SWC_FIM_MDFIsOvHiErr_GetFunctionPermission
      Rte_Call_SWC_MDF_RP_SWC_FIM_MDF_AlOfsNoPlausErr_GetFunctionPermission
      Rte_Call_SWC_MDF_RP_SWC_FIM_MDF_DiagPrfChkElecDt_GetFunctionPermission
      Rte_Call_SWC_MDF_RP_SWC_FIM_MDF_DiashCirNoPsblErr_GetFunctionPermission
      Rte_Call_SWC_MDF_RP_SWC_FIM_MDF_EmacBlkdWarn_GetFunctionPermission
      Rte_Call_SWC_MDF_RP_SWC_FIM_MDF_IctlRat_GetFunctionPermission
      Rte_Call_SWC_MDF_RP_SWC_FIM_MDF_OpenCirNoPsblErr_GetFunctionPermission
      Rte_Call_SWC_MDF_RP_SWC_FIM_MDF_OperOutdRngErr_GetFunctionPermission
      Rte_Call_SWC_MDF_RP_SWC_FIM_MDF_PhaseLossFaultErr_GetFunctionPermission
      Rte_Call_SWC_PCF_RP_SWC_Dem_PCF_ActOvTiErr_SetEventStatus
      Rte_Call_SWC_PCF_RP_SWC_Dem_PCF_IdcOvErr_SetEventStatus
      Rte_Call_SWC_PCF_RP_SWC_Dem_PCF_SelfcheckErr_SetEventStatus
      Rte_Call_SWC_PCF_RP_SWC_Dem_PCF_SenClbErr_SetEventStatus
      Rte_Call_SWC_PCF_RP_SWC_Dem_PCF_SenOvErr_SetEventStatus
      Rte_Call_SWC_PCF_RP_SWC_Dem_PCF_StallRetryErr_SetEventStatus
      Rte_Call_SWC_PCF_RP_SWC_Dem_PCF_StallWarn_SetEventStatus
      Rte_Call_SWC_PCF_RP_SWC_Dem_PCF_UnexpPosErr_SetEventStatus
      Rte_Call_SWC_PCF_RP_SWC_IoHwAb_ADC_BSW_IUBPCF_IoHwAb_ADC_GetPhyVoltage
      Rte_Call_SWC_PCF_RP_SWC_IoHwAb_ADC_BSW_UBRPCF_IoHwAb_ADC_GetPhyVoltage
      Rte_Call_SWC_PCF_RP_SWC_IoHwAb_ADC_BSW_VDD5PCF_IoHwAb_ADC_GetPhyVoltage
      Rte_Call_SWC_PCF_RP_SWC_IoHwAb_ADC_BSW_tEpc_IoHwAb_ADC_GetPhyVoltage
      Rte_Call_SWC_PCF_RP_SWC_IoHwAb_DIO_Get_BSW_EnPcfEFUSE_IoHwAb_DIO_Get
      Rte_Call_SWC_PCF_RP_SWC_IoHwAb_DIO_Get_BSW_ParkHard_IoHwAb_DIO_Get
      Rte_Call_SWC_PCF_RP_SWC_IoHwAb_DIO_Get_BSW_bt15_IoHwAb_DIO_Get
      Rte_Call_SWC_PCF_RP_SWC_IoHwAb_DIO_Get_BSW_flgPcfOc_IoHwAb_DIO_Get
      Rte_Call_SWC_PCF_RP_SWC_IoHwAb_DIO_Set_PCF_enMos_IoHwAb_DIO_Set
      Rte_Call_SWC_RCF_RP_SWC_DEM_RCF_AccOvTiErr_SetEventStatus
      Rte_Call_SWC_RCF_RP_SWC_DEM_RCF_EstOfsErr_SetEventStatus
      Rte_Call_SWC_RCF_RP_SWC_DEM_RCF_FwlBwdOvTiErr_SetEventStatus
      Rte_Call_SWC_RCF_RP_SWC_DEM_RCF_FwlFwdOvTiErr_SetEventStatus
      Rte_Call_SWC_RCF_RP_SWC_DEM_RCF_OfsClbFailErr_SetEventStatus
      Rte_Call_SWC_RCF_RP_SWC_DEM_RCF_PsiOvErr_SetEventStatus
      Rte_Call_SWC_SCF_RP_SWC_DEM_SCF_DisChgOvTiFail_SetEventStatus
      Rte_Call_SWC_SCF_RP_SWC_DEM_SCF_LowPwrShtDwnOvTiFail_SetEventStatus
      Rte_Call_SWC_SCF_RP_SWC_DEM_SCF_RunToDisChaFail_SetEventStatus
      Rte_Call_SWC_SCF_RP_SWC_FIM_FiM_FlagforFR_GetFunctionPermission
      Rte_Call_SWC_SCF_RP_SWC_FIM_ReqFailrMod_GetFunctionPermission
      Rte_Call_SWC_SCF_RP_SWC_FIM_VCUComTimeOut_GetFunctionPermission
      Rte_Call_SWC_SCF_RP_SWC_FIM_flgDchaFailr_GetFunctionPermission
      Rte_Call_SWC_SCF_RP_SWC_FIM_flgFaultLvFive_GetFunctionPermission
      Rte_Call_SWC_SCF_RP_SWC_FIM_flgFaultLvFour_GetFunctionPermission
      Rte_Call_SWC_Snapshot_RP_SWC_IoHwAb_ADC_BSW_UBR_Vol_IoHwAb_ADC_GetPhyVoltage
      Rte_Call_SWC_Snapshot_RP_SWC_IoHwAb_ADC_BSW_VDD18L_Vol_IoHwAb_ADC_GetPhyVoltage
      Rte_Call_SWC_Snapshot_RP_SWC_IoHwAb_ADC_BSW_VDD5T1_Vol_IoHwAb_ADC_GetPhyVoltage
      Rte_Call_SWC_Snapshot_RP_SWC_IoHwAb_ADC_BSW_VDD5T2_Vol_IoHwAb_ADC_GetPhyVoltage
      Rte_Call_SWC_TPC_RP_SWC_Dem_TPC_SpdOvHiLimFail_SetEventStatus
      Rte_Call_SWC_TPC_RP_SWC_Dem_TPC_SpdOvHiWarn_SetEventStatus
      Rte_Call_SWC_TPC_RP_SWC_Dem_TPC_TCoolantOvHiWarn_SetEventStatus
      Rte_Call_SWC_TPC_RP_SWC_Dem_TPC_TDbcOvHiWarn_SetEventStatus
      Rte_Call_SWC_TPC_RP_SWC_Dem_TPC_TDbcOvLoWarn_SetEventStatus
      Rte_Call_SWC_TPC_RP_SWC_Dem_TPC_TDbcUHiLimFail_SetEventStatus
      Rte_Call_SWC_TPC_RP_SWC_Dem_TPC_TDbcULoLimFail_SetEventStatus
      Rte_Call_SWC_TPC_RP_SWC_Dem_TPC_TDbcVHiLimFail_SetEventStatus
      Rte_Call_SWC_TPC_RP_SWC_Dem_TPC_TDbcVLoLimFail_SetEventStatus
      Rte_Call_SWC_TPC_RP_SWC_Dem_TPC_TDbcWHiLimFail_SetEventStatus
      Rte_Call_SWC_TPC_RP_SWC_Dem_TPC_TDbcWLoLimFail_SetEventStatus
      Rte_Call_SWC_TPC_RP_SWC_Dem_TPC_TDrvBoardOvHiWarn_SetEventStatus
      Rte_Call_SWC_TPC_RP_SWC_Dem_TPC_TIGBTOvHiLimFail_SetEventStatus
      Rte_Call_SWC_TPC_RP_SWC_Dem_TPC_TIGBTOvHiWarn_SetEventStatus
      Rte_Call_SWC_TPC_RP_SWC_Dem_TPC_TIGBTOvLoWarn_SetEventStatus
      Rte_Call_SWC_TPC_RP_SWC_Dem_TPC_TSttrOvHiLimFail_SetEventStatus
      Rte_Call_SWC_TPC_RP_SWC_Dem_TPC_TSttrOvHiWarn_SetEventStatus
      Rte_Call_SWC_TPC_RP_SWC_Dem_TPC_TSttrOvLoWarn_SetEventStatus
      Rte_Call_SWC_TPC_RP_SWC_Dem_TPC_iDcLnkOvCLimFail_SetEventStatus
      Rte_Call_SWC_TPC_RP_SWC_Dem_TPC_iDcLnkOvcWarn_SetEventStatus
      Rte_Call_SWC_TPC_RP_SWC_Dem_TPC_uDcLnkOvVLimFail_SetEventStatus
      Rte_Call_SWC_TPC_RP_SWC_Dem_TPC_uDcLnkOvWarn_SetEventStatus
      Rte_Call_SWC_TPC_RP_SWC_Dem_TPC_uDcLnkUnVLimFail_SetEventStatus
      Rte_Call_SWC_TPC_RP_SWC_Dem_TPC_uDcLnkUnvWarn_SetEventStatus
      Rte_Call_SWC_TPC_RP_SWC_FIM_PwrLimLvFour_GetFunctionPermission
      Rte_Call_SWC_TPC_RP_SWC_FIM_PwrLimLvOne_GetFunctionPermission
      Rte_Call_SWC_TPC_RP_SWC_FIM_PwrLimLvThree_GetFunctionPermission
      Rte_Call_SWC_TPC_RP_SWC_FIM_PwrLimLvTwo_GetFunctionPermission
      Rte_Call_SWC_TPC_RP_SWC_FIM_TrqLimLvFour_GetFunctionPermission
      Rte_Call_SWC_TPC_RP_SWC_FIM_TrqLimLvOne_GetFunctionPermission
      Rte_Call_SWC_TPC_RP_SWC_FIM_TrqLimLvThree_GetFunctionPermission
      Rte_Call_SWC_TPC_RP_SWC_FIM_TrqLimLvTwo_GetFunctionPermission
      Rte_Call_SWC_VCF_RP_SWC_FIM_IGBTOvTempWarn_GetFunctionPermission
      Rte_Call_SWC_VCF_RP_SWC_FIM_MtrOvTempWarn_GetFunctionPermission
      Rte_Call_SWC_VCF_RP_SWC_FIM_ReqFailrMod_GetFunctionPermission
      Rte_DecrementWaitingCount
      Rte_GetCurrentTaskIndex
      Rte_MainFunction
      Rte_Mode_Dcm_Rp_Mdg2_MDGP_Mdg2
      Rte_Mode_Diag_SWC_RPort_DcmDiagnosticSessionControl_MDGP_DcmDiagnosticSessionControl
      Rte_Mode_Diag_SWC_RPort_DcmEcuReset_MDGP_DcmEcuReset
      Rte_ReadQueue
      Rte_Read_BswM_RP_BswMArbitration_BswM_MRP_SWC_RequestAfterRun_SCF_stSysCtl
      Rte_Read_BswM_RP_BswMArbitration_BswM_MRP_SWC_RequestShutDown_SCF_stSysCtl
      Rte_Read_Dcm_R_DataServices_DspData_ASW_VER_F189_Data
      Rte_Read_Dcm_R_DataServices_DspData_MANU_DATE_F18B_Data
      Rte_Read_Dcm_R_DataServices_DspData_SYS_SUP_ID_F18A_Data
      Rte_Read_Diag_SWC_RPort_DataServices_DspData_SYS_SUP_ID_F18A_Data
      Rte_Read_NvM_SWC_RP_SWC_PCF_PCF_SLInPLimt
      Rte_Read_NvM_SWC_RP_SWC_PCF_PCF_flgSLWD
      Rte_Read_NvM_SWC_RP_SWC_RCF_RCF_AutoClbOffset
      Rte_Read_NvM_SWC_RP_SWC_RCF_RCF_flgOfsClbSucToNVM
      Rte_Read_SWC_BCC_RP_SWC_HSPF_HSPF_tCoolantTempFlt
      Rte_Read_SWC_BCC_RP_SWC_HSPF_HSPF_tDBCTempUFlt
      Rte_Read_SWC_BCC_RP_SWC_HSPF_HSPF_tDBCTempVFlt
      Rte_Read_SWC_BCC_RP_SWC_HSPF_HSPF_tDBCTempWFlt
      Rte_Read_SWC_BCC_RP_SWC_HSPF_HSPF_uDcLnkSlowFlt
      Rte_Read_SWC_BCC_RP_SWC_MCF_MCF_DycU
      Rte_Read_SWC_BCC_RP_SWC_MCF_MCF_DycV
      Rte_Read_SWC_BCC_RP_SWC_MCF_MCF_DycW
      Rte_Read_SWC_BCC_RP_SWC_MCF_MCF_Is
      Rte_Read_SWC_BCC_RP_SWC_MCF_MCF_frqPwm
      Rte_Read_SWC_BCC_RP_SWC_MCF_MCF_iU
      Rte_Read_SWC_BCC_RP_SWC_MCF_MCF_iV
      Rte_Read_SWC_BCC_RP_SWC_MCF_MCF_iW
      Rte_Read_SWC_BCC_RP_SWC_MCF_MCF_secVolt
      Rte_Read_SWC_BCC_RP_SWC_MCF_MCF_tiLock
      Rte_Read_SWC_BCC_RP_SWC_MPC_MPC_dtCorFac
      Rte_Read_SWC_BCC_RP_SWC_Rdc_Rdc_nWoFlt
      Rte_Read_SWC_BCC_RP_SWC_SCF_SCF_stGateDrv
      Rte_Read_SWC_BCC_RP_SWC_TPC_TPC_stMotorMod
      Rte_Read_SWC_CSPF_RP_SWC_BCC_BCC_iDcLnkEstFlt
      Rte_Read_SWC_CSPF_RP_SWC_Com_Com_BMS01_BattCurr
      Rte_Read_SWC_CSPF_RP_SWC_Com_Com_BMS01_BattVoLt
      Rte_Read_SWC_CSPF_RP_SWC_Com_Com_BMS01_stMainReLay
      Rte_Read_SWC_CSPF_RP_SWC_Com_Com_RecflgDchaReq
      Rte_Read_SWC_CSPF_RP_SWC_Com_Com_VCU01_UdcMax
      Rte_Read_SWC_CSPF_RP_SWC_Com_Com_VCU01_UdcMin
      Rte_Read_SWC_CSPF_RP_SWC_Com_Com_VCU01_idcMax
      Rte_Read_SWC_CSPF_RP_SWC_Com_Com_VCU01_idcMin
      Rte_Read_SWC_CSPF_RP_SWC_Com_Com_VCU01_stHvbMaiRly
      Rte_Read_SWC_CSPF_RP_SWC_Com_Com_VCU02_KpHighNCtL
      Rte_Read_SWC_CSPF_RP_SWC_Com_Com_VCU02_KpLowNCtL
      Rte_Read_SWC_CSPF_RP_SWC_Com_Com_VCU02_NDiffMax
      Rte_Read_SWC_CSPF_RP_SWC_Com_Com_VCU02_TrqMaxNCtL
      Rte_Read_SWC_CSPF_RP_SWC_Com_Com_VCU02_TrqMinNCtL
      Rte_Read_SWC_CSPF_RP_SWC_Com_Com_VCU03_TrqMax
      Rte_Read_SWC_CSPF_RP_SWC_Com_Com_VCU03_TrqMin
      Rte_Read_SWC_CSPF_RP_SWC_Com_Com_VCU03_cTrqSlopeMax
      Rte_Read_SWC_CSPF_RP_SWC_Com_Com_VCU04_MotDir
      Rte_Read_SWC_CSPF_RP_SWC_Com_Com_VCU04_NSetP
      Rte_Read_SWC_CSPF_RP_SWC_Com_Com_VCU04_TrqSetP
      Rte_Read_SWC_CSPF_RP_SWC_Com_Com_VCU04_bKL15
      Rte_Read_SWC_CSPF_RP_SWC_Com_Com_VCU04_stModeReq
      Rte_Read_SWC_CSPF_RP_SWC_Com_Com_VCU05_OfsAL
      Rte_Read_SWC_CSPF_RP_SWC_Com_Com_VCU05_TrqDmpMax
      Rte_Read_SWC_CSPF_RP_SWC_Com_Com_VCU05_TrqDmpMin
      Rte_Read_SWC_CSPF_RP_SWC_Com_Com_VCU05_bSetOfsAL
      Rte_Read_SWC_CSPF_RP_SWC_Com_Com_VCU05_kDmp
      Rte_Read_SWC_CSPF_RP_SWC_Com_Com_VCU05_stDmpCtLReq
      Rte_Read_SWC_CSPF_RP_SWC_Com_Com_VCU_flgCrash
      Rte_Read_SWC_CSPF_RP_SWC_Cpld_Cpld_CpldSwVer
      Rte_Read_SWC_CSPF_RP_SWC_Cpld_Cpld_IgbtState
      Rte_Read_SWC_CSPF_RP_SWC_DiagCalib_DiagCalib_FailCode{1..8}
      Rte_Read_SWC_CSPF_RP_SWC_HSPF_HSPF_nSlowFlt
      Rte_Read_SWC_CSPF_RP_SWC_HSPF_HSPF_tCoolantTempFlt
      Rte_Read_SWC_CSPF_RP_SWC_HSPF_HSPF_tDBCTempUFlt
      Rte_Read_SWC_CSPF_RP_SWC_HSPF_HSPF_tDBCTempVFlt
      Rte_Read_SWC_CSPF_RP_SWC_HSPF_HSPF_tDBCTempWFlt
      Rte_Read_SWC_CSPF_RP_SWC_HSPF_HSPF_tStrrTemp1Flt
      Rte_Read_SWC_CSPF_RP_SWC_HSPF_HSPF_tStrrTemp2Flt
      Rte_Read_SWC_CSPF_RP_SWC_HSPF_HSPF_uDcLnkSlowFlt
      Rte_Read_SWC_CSPF_RP_SWC_HSPF_HSPF_uKl30Flt
      Rte_Read_SWC_CSPF_RP_SWC_HvMcu_HvMcu_HvMcuVer
      Rte_Read_SWC_CSPF_RP_SWC_MPC_MPC_IsFlt
      Rte_Read_SWC_CSPF_RP_SWC_MPC_MPC_TrqMechFlt
      Rte_Read_SWC_CSPF_RP_SWC_MPC_MPC_isdFlt
      Rte_Read_SWC_CSPF_RP_SWC_MPC_MPC_isqFlt
      Rte_Read_SWC_CSPF_RP_SWC_RCF_RCF_AutoClbOffset
      Rte_Read_SWC_CSPF_RP_SWC_RCF_RCF_flgOfsClbSuc
      Rte_Read_SWC_CSPF_RP_SWC_Rdc_Rdc_ArctanAgRtr
      Rte_Read_SWC_CSPF_RP_SWC_SCF_SCF_bHvReady
      Rte_Read_SWC_CSPF_RP_SWC_SCF_SCF_stDisChg
      Rte_Read_SWC_CSPF_RP_SWC_SCF_SCF_stDrvCtl
      Rte_Read_SWC_CSPF_RP_SWC_SCF_SCF_stGateDrv
      Rte_Read_SWC_CSPF_RP_SWC_SCF_SCF_stSysCtl
      Rte_Read_SWC_CSPF_RP_SWC_TDC_TDC_TrqDes
      Rte_Read_SWC_CSPF_RP_SWC_TDC_TDC_flgTrqLmtActv
      Rte_Read_SWC_CSPF_RP_SWC_TPC_TPC_TrqMax
      Rte_Read_SWC_CSPF_RP_SWC_TPC_TPC_TrqMin
      Rte_Read_SWC_CSPF_RP_SWC_TPC_TPC_bDernCAN
      Rte_Read_SWC_CSPF_RP_SWC_TPC_TPC_bDernCoolantTemp
      Rte_Read_SWC_CSPF_RP_SWC_TPC_TPC_bDernDbcTemp
      Rte_Read_SWC_CSPF_RP_SWC_TPC_TPC_bDernDrvBoardTemp
      Rte_Read_SWC_CSPF_RP_SWC_TPC_TPC_bDernExcMax
      Rte_Read_SWC_CSPF_RP_SWC_TPC_TPC_bDernExcMin
      Rte_Read_SWC_CSPF_RP_SWC_TPC_TPC_bDernMtrSpd
      Rte_Read_SWC_CSPF_RP_SWC_TPC_TPC_bDernOvrIdc
      Rte_Read_SWC_CSPF_RP_SWC_TPC_TPC_bDernOvrUdc
      Rte_Read_SWC_CSPF_RP_SWC_TPC_TPC_bDernStrTemp
      Rte_Read_SWC_CSPF_RP_SWC_TPC_TPC_bDernUndrUdc
      Rte_Read_SWC_CSPF_RP_SWC_TPC_TPC_stTrqEmMax
      Rte_Read_SWC_CSPF_RP_SWC_TPC_TPC_stTrqEmMin
      Rte_Read_SWC_Epark_RP_SWC_PCF_PCF_MotDir
      Rte_Read_SWC_Epark_RP_SWC_PCF_PCF_dycPWM
      Rte_Read_SWC_HSPF_RP_SWC_BCC_BCC_iDcLnkEstFlt
      Rte_Read_SWC_HSPF_RP_SWC_BCC_BCC_tCoolantTj
      Rte_Read_SWC_HSPF_RP_SWC_BCC_BCC_tIgbtTj
      Rte_Read_SWC_HSPF_RP_SWC_Cpld_Cpld_CpldSwVer
      Rte_Read_SWC_HSPF_RP_SWC_Cpld_Cpld_ProjectNum
      Rte_Read_SWC_HSPF_RP_SWC_HvMcu_HvMcu_HvMcuVer
      Rte_Read_SWC_HSPF_RP_SWC_HvMcu_HvMcu_tDBCTempU
      Rte_Read_SWC_HSPF_RP_SWC_HvMcu_HvMcu_tDBCTempV
      Rte_Read_SWC_HSPF_RP_SWC_HvMcu_HvMcu_tDBCTempW
      Rte_Read_SWC_HSPF_RP_SWC_HvMcu_HvMcu_tDrvBoardTemp
      Rte_Read_SWC_HSPF_RP_SWC_MCF_MCF_uDcLnk
      Rte_Read_SWC_HSPF_RP_SWC_MDF_MDF_bFaultEMBlkWarnSt
      Rte_Read_SWC_HSPF_RP_SWC_PhC_PhC_iUNoOff
      Rte_Read_SWC_HSPF_RP_SWC_PhC_PhC_iVNoOff
      Rte_Read_SWC_HSPF_RP_SWC_PhC_PhC_iWNoOff
      Rte_Read_SWC_HSPF_RP_SWC_Rdc_Rdc_nWoFlt
      Rte_Read_SWC_HSPF_RP_SWC_SCF_SCF_stPreDrvCtl
      Rte_Read_SWC_HvMcu_RP_SWC_RCF_RCF_stAgRtrOfsCal
      Rte_Read_SWC_HvMcu_RP_SWC_SCF_SCF_flgEmgReqInvDcha
      Rte_Read_SWC_MCF_RP_SWC_BCC_BCC_iDcLnkEstFlt
      Rte_Read_SWC_MCF_RP_SWC_HSPF_HSPF_iPhaUOffset
      Rte_Read_SWC_MCF_RP_SWC_HSPF_HSPF_iPhaVOffset
      Rte_Read_SWC_MCF_RP_SWC_HSPF_HSPF_iPhaWOffset
      Rte_Read_SWC_MCF_RP_SWC_HSPF_HSPF_stIphaOffCal
      Rte_Read_SWC_MCF_RP_SWC_HSPF_HSPF_tStrrTempFlt
      Rte_Read_SWC_MCF_RP_SWC_HvMcu_HvMcu_uDcLnkHvMcu
      Rte_Read_SWC_MCF_RP_SWC_MDF_MDF_bFaultEMBlkWarnSt
      Rte_Read_SWC_MCF_RP_SWC_MPC_MPC_CofRandomPwm
      Rte_Read_SWC_MCF_RP_SWC_MPC_MPC_Ld
      Rte_Read_SWC_MCF_RP_SWC_MPC_MPC_LdSubLq
      Rte_Read_SWC_MCF_RP_SWC_MPC_MPC_Lq
      Rte_Read_SWC_MCF_RP_SWC_MPC_MPC_OmBw
      Rte_Read_SWC_MCF_RP_SWC_MPC_MPC_Psi
      Rte_Read_SWC_MCF_RP_SWC_MPC_MPC_Rs
      Rte_Read_SWC_MCF_RP_SWC_MPC_MPC_Rv
      Rte_Read_SWC_MCF_RP_SWC_MPC_MPC_TrqMechFlt
      Rte_Read_SWC_MCF_RP_SWC_MPC_MPC_frqPwmVF
      Rte_Read_SWC_MCF_RP_SWC_MPC_MPC_isdFF
      Rte_Read_SWC_MCF_RP_SWC_MPC_MPC_isdMTPA
      Rte_Read_SWC_MCF_RP_SWC_MPC_MPC_isdMTPV
      Rte_Read_SWC_MCF_RP_SWC_NvM_NvM_AngAutoClbOffset
      Rte_Read_SWC_MCF_RP_SWC_NvM_NvM_flgAngAutoClbOffset
      Rte_Read_SWC_MCF_RP_SWC_PhC_PhC_iUNoOff
      Rte_Read_SWC_MCF_RP_SWC_PhC_PhC_iVNoOff
      Rte_Read_SWC_MCF_RP_SWC_PhC_PhC_iWNoOff
      Rte_Read_SWC_MCF_RP_SWC_PhC_PhC_uDcLnkLowMcu
      Rte_Read_SWC_MCF_RP_SWC_RCF_RCF_UsAlfaScalSet
      Rte_Read_SWC_MCF_RP_SWC_RCF_RCF_UsBetaScalSet
      Rte_Read_SWC_MCF_RP_SWC_RCF_RCF_agRtrOffsEstimd
      Rte_Read_SWC_MCF_RP_SWC_RCF_RCF_flgUseUsSet
      Rte_Read_SWC_MCF_RP_SWC_Rdc_Rdc_ArctanAgRtr
      Rte_Read_SWC_MCF_RP_SWC_Rdc_Rdc_nWoFlt
      Rte_Read_SWC_MCF_RP_SWC_SCF_SCF_FIM_ReqFailrMod
      Rte_Read_SWC_MCF_RP_SWC_SCF_SCF_flgEnDchaToMc
      Rte_Read_SWC_MCF_RP_SWC_SCF_SCF_flginitPI
      Rte_Read_SWC_MCF_RP_SWC_SCF_SCF_stGateDrv
      Rte_Read_SWC_MCF_RP_SWC_SCF_SCF_stPwmMode
      Rte_Read_SWC_MCF_RP_SWC_TDC_TDC_TrqDes
      Rte_Read_SWC_MCF_RP_SWC_TPC_TPC_TDbcTrqMax
      Rte_Read_SWC_MDF_RP_SWC_HSPF_HSPF_PwrDcLnk
      Rte_Read_SWC_MDF_RP_SWC_HSPF_HSPF_nSlowFlt
      Rte_Read_SWC_MDF_RP_SWC_HSPF_HSPF_tCoolantTempFlt
      Rte_Read_SWC_MDF_RP_SWC_HSPF_HSPF_tDBCTempUFlt
      Rte_Read_SWC_MDF_RP_SWC_HSPF_HSPF_tDBCTempVFlt
      Rte_Read_SWC_MDF_RP_SWC_HSPF_HSPF_tDBCTempWFlt
      Rte_Read_SWC_MDF_RP_SWC_HSPF_HSPF_tStrrTempFlt
      Rte_Read_SWC_MDF_RP_SWC_HSPF_HSPF_uDcLnkSlowFlt
      Rte_Read_SWC_MDF_RP_SWC_MCF_MCF_dtPwm
      Rte_Read_SWC_MDF_RP_SWC_MCF_MCF_iU
      Rte_Read_SWC_MDF_RP_SWC_MCF_MCF_iV
      Rte_Read_SWC_MDF_RP_SWC_MCF_MCF_iW
      Rte_Read_SWC_MDF_RP_SWC_MCF_MCF_idDes
      Rte_Read_SWC_MDF_RP_SWC_MCF_MCF_iqDes
      Rte_Read_SWC_MDF_RP_SWC_MCF_MCF_udDes
      Rte_Read_SWC_MDF_RP_SWC_MCF_MCF_uqDes
      Rte_Read_SWC_MDF_RP_SWC_MPC_MPC_IsFlt
      Rte_Read_SWC_MDF_RP_SWC_MPC_MPC_Ld
      Rte_Read_SWC_MDF_RP_SWC_MPC_MPC_Lq
      Rte_Read_SWC_MDF_RP_SWC_MPC_MPC_Psi
      Rte_Read_SWC_MDF_RP_SWC_MPC_MPC_Rs
      Rte_Read_SWC_MDF_RP_SWC_MPC_MPC_TrqMech
      Rte_Read_SWC_MDF_RP_SWC_MPC_MPC_isdFlt
      Rte_Read_SWC_MDF_RP_SWC_MPC_MPC_isqFlt
      Rte_Read_SWC_MDF_RP_SWC_RCF_RCF_stAgRtrOfsCal
      Rte_Read_SWC_MDF_RP_SWC_Rdc_Rdc_nWoFlt
      Rte_Read_SWC_MDF_RP_SWC_SCF_SCF_stDrvCtl
      Rte_Read_SWC_MDF_RP_SWC_SCF_SCF_stGateDrv
      Rte_Read_SWC_MDF_RP_SWC_SCF_SCF_stSysCtl
      Rte_Read_SWC_MDF_RP_SWC_VCF_VCF_TrqDes
      Rte_Read_SWC_MPC_RP_SWC_HSPF_HSPF_nSlowFlt
      Rte_Read_SWC_MPC_RP_SWC_HSPF_HSPF_tStrrTempFlt
      Rte_Read_SWC_MPC_RP_SWC_MCF_MCF_Is
      Rte_Read_SWC_MPC_RP_SWC_MCF_MCF_VoltModuRate
      Rte_Read_SWC_MPC_RP_SWC_MCF_MCF_idDes
      Rte_Read_SWC_MPC_RP_SWC_MCF_MCF_iqDes
      Rte_Read_SWC_MPC_RP_SWC_MCF_MCF_isd
      Rte_Read_SWC_MPC_RP_SWC_MCF_MCF_isq
      Rte_Read_SWC_MPC_RP_SWC_MCF_MCF_uDcLnk
      Rte_Read_SWC_MPC_RP_SWC_MCF_MCF_udDes
      Rte_Read_SWC_MPC_RP_SWC_MCF_MCF_uqDes
      Rte_Read_SWC_MPC_RP_SWC_TDC_TDC_TrqDes
      Rte_Read_SWC_MPC_RP_SWC_TPC_TPC_stMotorMod
      Rte_Read_SWC_PCF_RP_SWC_Com_Com_VCU06_Park
      Rte_Read_SWC_PCF_RP_SWC_Com_Com_VCU06_VehGrad
      Rte_Read_SWC_PCF_RP_SWC_Com_Com_VCU06_stBelt
      Rte_Read_SWC_PCF_RP_SWC_Com_Com_VCU06_stBreak
      Rte_Read_SWC_PCF_RP_SWC_Com_Com_VCU06_stDoor
      Rte_Read_SWC_PCF_RP_SWC_Epark_Epark_iPcf
      Rte_Read_SWC_PCF_RP_SWC_Epark_Epark_posPcf
      Rte_Read_SWC_PCF_RP_SWC_Epark_Epark_posPcfMon
      Rte_Read_SWC_PCF_RP_SWC_HSPF_HSPF_nSlowFlt
      Rte_Read_SWC_PCF_RP_SWC_NvM_NvM_SLFnh
      Rte_Read_SWC_PCF_RP_SWC_NvM_NvM_SLInPLimt
      Rte_Read_SWC_Pwm3ph_RP_SWC_MCF_MCF_DycU
      Rte_Read_SWC_Pwm3ph_RP_SWC_MCF_MCF_DycV
      Rte_Read_SWC_Pwm3ph_RP_SWC_MCF_MCF_DycW
      Rte_Read_SWC_Pwm3ph_RP_SWC_MCF_MCF_frqPwm
      Rte_Read_SWC_Pwm3ph_RP_SWC_MCF_MCF_stPwmMode
      Rte_Read_SWC_RCF_RP_SWC_CSPF_CSPF_RecstModeReq
      Rte_Read_SWC_RCF_RP_SWC_HSPF_HSPF_nSlowFlt
      Rte_Read_SWC_RCF_RP_SWC_HvMcu_HvMcu_AlOfsClb_TimeStamp
      Rte_Read_SWC_RCF_RP_SWC_HvMcu_HvMcu_flgUphaEdgeRiseCo
      Rte_Read_SWC_RCF_RP_SWC_MDF_MDF_stFrwhl
      Rte_Read_SWC_RCF_RP_SWC_NvM_NvM_flgAngAutoClbOffset
      Rte_Read_SWC_RCF_RP_SWC_Rdc_Rdc_ArctanAgRtr
      Rte_Read_SWC_RCF_RP_SWC_Rdc_Rdc_nWoFlt
      Rte_Read_SWC_RCF_RP_SWC_SCF_SCF_stDrvCtl
      Rte_Read_SWC_Rdc_PP_SWC_MCF_MCF_cofFrqPwm
      Rte_Read_SWC_SCF_RP_SWC_CSPF_CSPF_RecflgCrash
      Rte_Read_SWC_SCF_RP_SWC_CSPF_CSPF_RecflgDchaReq
      Rte_Read_SWC_SCF_RP_SWC_CSPF_CSPF_RecstMainReLay
      Rte_Read_SWC_SCF_RP_SWC_HSPF_HSPF_Wake
      Rte_Read_SWC_SCF_RP_SWC_HSPF_HSPF_bt15
      Rte_Read_SWC_SCF_RP_SWC_HSPF_HSPF_flgCrash
      Rte_Read_SWC_SCF_RP_SWC_HSPF_HSPF_nSlowFlt
      Rte_Read_SWC_SCF_RP_SWC_HSPF_HSPF_stIphaOffCal
      Rte_Read_SWC_SCF_RP_SWC_HSPF_HSPF_uDcLnkSlowFlt
      Rte_Read_SWC_SCF_RP_SWC_Igbt_Igbt_flgGateDrvRdyHs
      Rte_Read_SWC_SCF_RP_SWC_Igbt_Igbt_flgGateDrvRdyLs
      Rte_Read_SWC_SCF_RP_SWC_LvPower_LvPower_stLowpowerUp
      Rte_Read_SWC_SCF_RP_SWC_MDF_MDF_stFrwhl
      Rte_Read_SWC_SCF_RP_SWC_MPC_MPC_IsFlt
      Rte_Read_SWC_SCF_RP_SWC_NvM_NvM_flgAngAutoClbOffset
      Rte_Read_SWC_SCF_RP_SWC_PCF_PCF_SLEnMotorAcc
      Rte_Read_SWC_SCF_RP_SWC_PCF_PCF_Status
      Rte_Read_SWC_SCF_RP_SWC_PCF_PCF_flgAllowPwmRun
      Rte_Read_SWC_SCF_RP_SWC_PCF_PCF_flgShtDwnReq
      Rte_Read_SWC_SCF_RP_SWC_PCF_PCF_stParkCtl
      Rte_Read_SWC_SCF_RP_SWC_RCF_RCF_stAgRtrOfsCal
      Rte_Read_SWC_SCF_RP_SWC_RCF_RCF_stEstAlRtrOfs
      Rte_Read_SWC_SCF_RP_SWC_Snapshot_Snapshot_flgPostDrvDone
      Rte_Read_SWC_SCF_RP_SWC_Tja1043_Tja1043_flgCAN_WakeUp
      Rte_Read_SWC_SCF_RP_SWC_VCF_VCF_stModeReq
      Rte_Read_SWC_Snapshot_RP_SWC_HvMcu_HvMcu_VDD15L_Vol
      Rte_Read_SWC_Snapshot_RP_SWC_HvMcu_HvMcu_uDcLnkHvMcu
      Rte_Read_SWC_Snapshot_RP_SWC_PhC_PhC_iUNoOff
      Rte_Read_SWC_Snapshot_RP_SWC_PhC_PhC_iVNoOff
      Rte_Read_SWC_Snapshot_RP_SWC_PhC_PhC_iWNoOff
      Rte_Read_SWC_Snapshot_RP_SWC_Rdc_Rdc_ArctanAgRtr
      Rte_Read_SWC_Snapshot_RP_SWC_SCF_SCF_stFFAction
      Rte_Read_SWC_TDC_RP_SWC_Rdc_Rdc_nWoFlt
      Rte_Read_SWC_TDC_RP_SWC_SCF_SCF_stModeReqToTdc
      Rte_Read_SWC_TDC_RP_SWC_TPC_TPC_TrqMax
      Rte_Read_SWC_TDC_RP_SWC_TPC_TPC_TrqMin
      Rte_Read_SWC_TDC_RP_SWC_VCF_VCF_HoldStartTrq
      Rte_Read_SWC_TDC_RP_SWC_VCF_VCF_KpNCtl
      Rte_Read_SWC_TDC_RP_SWC_VCF_VCF_NsetPReq
      Rte_Read_SWC_TDC_RP_SWC_VCF_VCF_TrqDes
      Rte_Read_SWC_TDC_RP_SWC_VCF_VCF_stModeReq
      Rte_Read_SWC_TDC_RP_SWC_VCF_VCF_trqRamp
      Rte_Read_SWC_TPC_RP_SWC_CSPF_CSPF_RecTrqMax
      Rte_Read_SWC_TPC_RP_SWC_CSPF_CSPF_RecTrqMaxNCtL
      Rte_Read_SWC_TPC_RP_SWC_CSPF_CSPF_RecTrqMin
      Rte_Read_SWC_TPC_RP_SWC_CSPF_CSPF_RecTrqMinNCtL
      Rte_Read_SWC_TPC_RP_SWC_CSPF_CSPF_RecUdcMax
      Rte_Read_SWC_TPC_RP_SWC_CSPF_CSPF_RecUdcMin
      Rte_Read_SWC_TPC_RP_SWC_CSPF_CSPF_RecidcMax
      Rte_Read_SWC_TPC_RP_SWC_CSPF_CSPF_RecidcMin
      Rte_Read_SWC_TPC_RP_SWC_HSPF_HSPF_iDcLnkEstFlt
      Rte_Read_SWC_TPC_RP_SWC_HSPF_HSPF_nSlowFlt
      Rte_Read_SWC_TPC_RP_SWC_HSPF_HSPF_tCoolantTempFlt
      Rte_Read_SWC_TPC_RP_SWC_HSPF_HSPF_tCoolantTjFlt
      Rte_Read_SWC_TPC_RP_SWC_HSPF_HSPF_tDBCTempUFlt
      Rte_Read_SWC_TPC_RP_SWC_HSPF_HSPF_tDBCTempVFlt
      Rte_Read_SWC_TPC_RP_SWC_HSPF_HSPF_tDBCTempWFlt
      Rte_Read_SWC_TPC_RP_SWC_HSPF_HSPF_tDrvBoardTempFlt
      Rte_Read_SWC_TPC_RP_SWC_HSPF_HSPF_tIgbtTjFlt
      Rte_Read_SWC_TPC_RP_SWC_HSPF_HSPF_tStrrTempFlt
      Rte_Read_SWC_TPC_RP_SWC_HSPF_HSPF_uDcLnkSlowFlt
      Rte_Read_SWC_TPC_RP_SWC_MCF_MCF_Is
      Rte_Read_SWC_TPC_RP_SWC_MPC_MPC_TrqMech
      Rte_Read_SWC_TPC_RP_SWC_MPC_MPC_TrqMechFlt
      Rte_Read_SWC_TPC_RP_SWC_SCF_SCF_flgUdcLowToTpc
      Rte_Read_SWC_TPC_RP_SWC_VCF_VCF_TrqDes
      Rte_Read_SWC_TPC_RP_SWC_VCF_VCF_stModeReq
      Rte_Read_SWC_VCF_RP_SWC_CSPF_CSPF_RecKpDmp
      Rte_Read_SWC_VCF_RP_SWC_CSPF_CSPF_RecKpHighNCtL
      Rte_Read_SWC_VCF_RP_SWC_CSPF_CSPF_RecKpLowNCtL
      Rte_Read_SWC_VCF_RP_SWC_CSPF_CSPF_RecNDiffMax
      Rte_Read_SWC_VCF_RP_SWC_CSPF_CSPF_RecNSetP
      Rte_Read_SWC_VCF_RP_SWC_CSPF_CSPF_RecTrqDmpMax
      Rte_Read_SWC_VCF_RP_SWC_CSPF_CSPF_RecTrqDmpMin
      Rte_Read_SWC_VCF_RP_SWC_CSPF_CSPF_RecTrqSLope
      Rte_Read_SWC_VCF_RP_SWC_CSPF_CSPF_RecTrqSetP
      Rte_Read_SWC_VCF_RP_SWC_CSPF_CSPF_RecstDmpCtLReq
      Rte_Read_SWC_VCF_RP_SWC_CSPF_CSPF_RecstModeReq
      Rte_Read_SWC_VCF_RP_SWC_HSPF_HSPF_nSlowFlt
      Rte_Read_SWC_VCF_RP_SWC_MPC_MPC_TrqMechFlt
      Rte_Read_SWC_VCF_RP_SWC_PCF_PCF_SLtrqDes
      Rte_Read_SWC_VCF_RP_SWC_PCF_PCF_stParkCtl
      Rte_Read_SWC_VCF_RP_SWC_RCF_RCF_TrqEmDesOfsClb
      Rte_Read_SWC_VCF_RP_SWC_RCF_RCF_cTrqSlpOfsClb
      Rte_Read_SWC_VCF_RP_SWC_Rdc_Rdc_nWoFlt
      Rte_Read_SWC_VCF_RP_SWC_SCF_SCF_stDrvCtl
      Rte_Read_SWC_VCF_RP_SWC_TDC_TDC_TrqDes
      Rte_Read_SWC_VCF_RP_SWC_TPC_TPC_SgnRotDir
      Rte_Read_SWC_VCF_RP_SWC_TPC_TPC_SgnTrqMechDir
      Rte_SetEvent
      Rte_Start
      Rte_Stop
      Rte_Switch_Dcm_Pp_DcmCommunicationControl_ComMChannel_Can_Network_0_Channel_MDGP_DcmCommunicationControl_ComMChannel_Can_Network_0_Channel
      Rte_Switch_Dcm_Pp_DcmCommunicationControl_ComMChannel_Can_Network_1_Channel_MDGP_DcmCommunicationControl_ComMChannel_Can_Network_1_Channel
      Rte_Switch_Dcm_Pp_DcmControlDTCSetting_MDGP_DcmControlDTCSetting
      Rte_Switch_Dcm_Pp_DcmDiagnosticSessionControl_MDGP_DcmDiagnosticSessionControl
      Rte_Switch_Dcm_Pp_DcmEcuReset_MDGP_DcmEcuReset
      Rte_Switch_Diag_SWC_PPort_Mdg2_MDGP_Mdg2
      Rte_WaitWithTimeout
      Rte_WriteQueue
      Rte_Write_Dcm_P_DataServices_DspData_ASW_VER_F189_Data
      Rte_Write_Dcm_P_DataServices_DspData_SYS_SUP_ID_F18A_Data
      Rte_Write_Diag_SWC_PPort_DataServices_DspData_ASW_VER_F189_Data
      Rte_Write_Diag_SWC_PPort_DataServices_DspData_MANU_DATE_F18B_Data
      Rte_Write_Diag_SWC_PPort_DataServices_DspData_SYS_SUP_ID_F18A_Data
      Rte_Write_Diag_SWC_PPort_Diag_Request_Shutdown_uint16
      Rte_Write_Diag_SWC_PPort_TST_FimPermisison_TST_FimPermission
      Rte_Write_NvM_SWC_PP_SWC_NvM_NvM_AngAutoClbOffset
      Rte_Write_NvM_SWC_PP_SWC_NvM_NvM_SLFnh
      Rte_Write_NvM_SWC_PP_SWC_NvM_NvM_SLInPLimt
      Rte_Write_NvM_SWC_PP_SWC_NvM_NvM_flgAngAutoClbOffset
      Rte_Write_NvM_SWC_PPort_NvM_Request_Shutdown_uint16
      Rte_Write_SWC_BCC_PP_SWC_BCC_BCC_iDcLnkEstFlt
      Rte_Write_SWC_BCC_PP_SWC_BCC_BCC_tCoolantTj
      Rte_Write_SWC_BCC_PP_SWC_BCC_BCC_tIgbtTj
      Rte_Write_SWC_CSPF_PP_SWC_CSPF_CSPF_RecKpDmp
      Rte_Write_SWC_CSPF_PP_SWC_CSPF_CSPF_RecKpHighNCtL
      Rte_Write_SWC_CSPF_PP_SWC_CSPF_CSPF_RecKpLowNCtL
      Rte_Write_SWC_CSPF_PP_SWC_CSPF_CSPF_RecNDiffMax
      Rte_Write_SWC_CSPF_PP_SWC_CSPF_CSPF_RecNSetP
      Rte_Write_SWC_CSPF_PP_SWC_CSPF_CSPF_RecTrqDmpMax
      Rte_Write_SWC_CSPF_PP_SWC_CSPF_CSPF_RecTrqDmpMin
      Rte_Write_SWC_CSPF_PP_SWC_CSPF_CSPF_RecTrqMax
      Rte_Write_SWC_CSPF_PP_SWC_CSPF_CSPF_RecTrqMaxNCtL
      Rte_Write_SWC_CSPF_PP_SWC_CSPF_CSPF_RecTrqMin
      Rte_Write_SWC_CSPF_PP_SWC_CSPF_CSPF_RecTrqMinNCtL
      Rte_Write_SWC_CSPF_PP_SWC_CSPF_CSPF_RecTrqSLope
      Rte_Write_SWC_CSPF_PP_SWC_CSPF_CSPF_RecTrqSetP
      Rte_Write_SWC_CSPF_PP_SWC_CSPF_CSPF_RecUdcMax
      Rte_Write_SWC_CSPF_PP_SWC_CSPF_CSPF_RecUdcMin
      Rte_Write_SWC_CSPF_PP_SWC_CSPF_CSPF_RecflgCrash
      Rte_Write_SWC_CSPF_PP_SWC_CSPF_CSPF_RecflgDchaReq
      Rte_Write_SWC_CSPF_PP_SWC_CSPF_CSPF_RecidcMax
      Rte_Write_SWC_CSPF_PP_SWC_CSPF_CSPF_RecidcMin
      Rte_Write_SWC_CSPF_PP_SWC_CSPF_CSPF_RecstDmpCtLReq
      Rte_Write_SWC_CSPF_PP_SWC_CSPF_CSPF_RecstMainReLay
      Rte_Write_SWC_CSPF_PP_SWC_CSPF_CSPF_RecstModeReq
      Rte_Write_SWC_CSPF_PP_SWC_CSPF_CSPF_TraCodeVer
      Rte_Write_SWC_CSPF_PP_SWC_CSPF_CSPF_TraCpldVer
      Rte_Write_SWC_CSPF_PP_SWC_CSPF_CSPF_TraDataVer
      Rte_Write_SWC_CSPF_PP_SWC_CSPF_CSPF_TraFailCode{1..8}
      Rte_Write_SWC_CSPF_PP_SWC_CSPF_CSPF_TraHvMcuVer
      Rte_Write_SWC_CSPF_PP_SWC_CSPF_CSPF_TraHwVer
      Rte_Write_SWC_CSPF_PP_SWC_CSPF_CSPF_TraNCurr
      Rte_Write_SWC_CSPF_PP_SWC_CSPF_CSPF_TraOfsAL
      Rte_Write_SWC_CSPF_PP_SWC_CSPF_CSPF_TraTempCurrCooL
      Rte_Write_SWC_CSPF_PP_SWC_CSPF_CSPF_TraTempCurrStr1
      Rte_Write_SWC_CSPF_PP_SWC_CSPF_CSPF_TraTempCurrStr2
      Rte_Write_SWC_CSPF_PP_SWC_CSPF_CSPF_TraTrqAbsMax
      Rte_Write_SWC_CSPF_PP_SWC_CSPF_CSPF_TraTrqAbsMin
      Rte_Write_SWC_CSPF_PP_SWC_CSPF_CSPF_TraTrqCurr
      Rte_Write_SWC_CSPF_PP_SWC_CSPF_CSPF_TraTrqCurrWoDmpC
      Rte_Write_SWC_CSPF_PP_SWC_CSPF_CSPF_TraUT30Curr
      Rte_Write_SWC_CSPF_PP_SWC_CSPF_CSPF_TraUdcCurr
      Rte_Write_SWC_CSPF_PP_SWC_CSPF_CSPF_TraagRtrELecSnsr
      Rte_Write_SWC_CSPF_PP_SWC_CSPF_CSPF_TrabDernCAN
      Rte_Write_SWC_CSPF_PP_SWC_CSPF_CSPF_TrabDernDrvBoardTemp
      Rte_Write_SWC_CSPF_PP_SWC_CSPF_CSPF_TrabDernN
      Rte_Write_SWC_CSPF_PP_SWC_CSPF_CSPF_TrabDernOvrUdc
      Rte_Write_SWC_CSPF_PP_SWC_CSPF_CSPF_TrabDernOvridc
      Rte_Write_SWC_CSPF_PP_SWC_CSPF_CSPF_TrabDernStrTemp
      Rte_Write_SWC_CSPF_PP_SWC_CSPF_CSPF_TrabDernTempCooL
      Rte_Write_SWC_CSPF_PP_SWC_CSPF_CSPF_TrabDernTempiGBT
      Rte_Write_SWC_CSPF_PP_SWC_CSPF_CSPF_TrabDernTrqMax
      Rte_Write_SWC_CSPF_PP_SWC_CSPF_CSPF_TrabDernTrqMin
      Rte_Write_SWC_CSPF_PP_SWC_CSPF_CSPF_TrabDernUndrUdc
      Rte_Write_SWC_CSPF_PP_SWC_CSPF_CSPF_TrabDmpCActv
      Rte_Write_SWC_CSPF_PP_SWC_CSPF_CSPF_TrabReadyHv
      Rte_Write_SWC_CSPF_PP_SWC_CSPF_CSPF_TraiGBTTempU
      Rte_Write_SWC_CSPF_PP_SWC_CSPF_CSPF_TraiGBTTempV
      Rte_Write_SWC_CSPF_PP_SWC_CSPF_CSPF_TraiGBTTempW
      Rte_Write_SWC_CSPF_PP_SWC_CSPF_CSPF_TraidcCurr
      Rte_Write_SWC_CSPF_PP_SWC_CSPF_CSPF_TraisCurr
      Rte_Write_SWC_CSPF_PP_SWC_CSPF_CSPF_Traisd
      Rte_Write_SWC_CSPF_PP_SWC_CSPF_CSPF_Traisq
      Rte_Write_SWC_CSPF_PP_SWC_CSPF_CSPF_TrastDischg
      Rte_Write_SWC_CSPF_PP_SWC_CSPF_CSPF_TrastGateDrv
      Rte_Write_SWC_CSPF_PP_SWC_CSPF_CSPF_TrastMode
      Rte_Write_SWC_CSPF_PP_SWC_CSPF_CSPF_TrastTrqEmMax
      Rte_Write_SWC_CSPF_PP_SWC_CSPF_CSPF_TrastTrqEmMin
      Rte_Write_SWC_Cpld_PP_SWC_Cpld_Cpld_CpldSwVer
      Rte_Write_SWC_Cpld_PP_SWC_Cpld_Cpld_IgbtState
      Rte_Write_SWC_Cpld_PP_SWC_Cpld_Cpld_ProjectNum
      Rte_Write_SWC_DiagCalib_PP_SWC_DiagCalib_DiagCalib_FailCode{1..8}
      Rte_Write_SWC_Epark_PP_SWC_Epark_Epark_iPcf
      Rte_Write_SWC_Epark_PP_SWC_Epark_Epark_posPcf
      Rte_Write_SWC_Epark_PP_SWC_Epark_Epark_posPcfMon
      Rte_Write_SWC_HSPF_PP_SWC_HSPF_HSPF_INV_Open
      Rte_Write_SWC_HSPF_PP_SWC_HSPF_HSPF_Motor_Open
      Rte_Write_SWC_HSPF_PP_SWC_HSPF_HSPF_PwrDcLnk
      Rte_Write_SWC_HSPF_PP_SWC_HSPF_HSPF_Wake
      Rte_Write_SWC_HSPF_PP_SWC_HSPF_HSPF_bt15
      Rte_Write_SWC_HSPF_PP_SWC_HSPF_HSPF_flgCrash
      Rte_Write_SWC_HSPF_PP_SWC_HSPF_HSPF_iDcLnkEstFlt
      Rte_Write_SWC_HSPF_PP_SWC_HSPF_HSPF_iPhaUOffset
      Rte_Write_SWC_HSPF_PP_SWC_HSPF_HSPF_iPhaVOffset
      Rte_Write_SWC_HSPF_PP_SWC_HSPF_HSPF_iPhaWOffset
      Rte_Write_SWC_HSPF_PP_SWC_HSPF_HSPF_nSlowFlt
      Rte_Write_SWC_HSPF_PP_SWC_HSPF_HSPF_stIphaOffCal
      Rte_Write_SWC_HSPF_PP_SWC_HSPF_HSPF_tCoolantTempFlt
      Rte_Write_SWC_HSPF_PP_SWC_HSPF_HSPF_tCoolantTjFlt
      Rte_Write_SWC_HSPF_PP_SWC_HSPF_HSPF_tDBCTempUFlt
      Rte_Write_SWC_HSPF_PP_SWC_HSPF_HSPF_tDBCTempVFlt
      Rte_Write_SWC_HSPF_PP_SWC_HSPF_HSPF_tDBCTempWFlt
      Rte_Write_SWC_HSPF_PP_SWC_HSPF_HSPF_tDrvBoardTempFlt
      Rte_Write_SWC_HSPF_PP_SWC_HSPF_HSPF_tIgbtTjFlt
      Rte_Write_SWC_HSPF_PP_SWC_HSPF_HSPF_tStrrTemp1Flt
      Rte_Write_SWC_HSPF_PP_SWC_HSPF_HSPF_tStrrTemp2Flt
      Rte_Write_SWC_HSPF_PP_SWC_HSPF_HSPF_tStrrTempFlt
      Rte_Write_SWC_HSPF_PP_SWC_HSPF_HSPF_uDcLnkSlowFlt
      Rte_Write_SWC_HSPF_PP_SWC_HSPF_HSPF_uKl30Flt
      Rte_Write_SWC_HvMcu_PP_SWC_HvMcu_HvMcu_AlOfsClb_TimeStamp
      Rte_Write_SWC_HvMcu_PP_SWC_HvMcu_HvMcu_HvMcuVer
      Rte_Write_SWC_HvMcu_PP_SWC_HvMcu_HvMcu_VDD15L_Vol
      Rte_Write_SWC_HvMcu_PP_SWC_HvMcu_HvMcu_flgUphaEdgeRiseCo
      Rte_Write_SWC_HvMcu_PP_SWC_HvMcu_HvMcu_tDBCTempU
      Rte_Write_SWC_HvMcu_PP_SWC_HvMcu_HvMcu_tDBCTempV
      Rte_Write_SWC_HvMcu_PP_SWC_HvMcu_HvMcu_tDBCTempW
      Rte_Write_SWC_HvMcu_PP_SWC_HvMcu_HvMcu_tDrvBoardTemp
      Rte_Write_SWC_HvMcu_PP_SWC_HvMcu_HvMcu_uBackEMF_U
      Rte_Write_SWC_HvMcu_PP_SWC_HvMcu_HvMcu_uBackEMF_V
      Rte_Write_SWC_HvMcu_PP_SWC_HvMcu_HvMcu_uBackEMF_W
      Rte_Write_SWC_HvMcu_PP_SWC_HvMcu_HvMcu_uDcLnkHvMcu
      Rte_Write_SWC_Igbt_PP_SWC_Igbt_Igbt_flgGateDrvRdyHs
      Rte_Write_SWC_Igbt_PP_SWC_Igbt_Igbt_flgGateDrvRdyLs
      Rte_Write_SWC_LvPower_PP_SWC_LvPower_LvPower_stLowpowerUp
      Rte_Write_SWC_MCF_PP_SWC_MCF_MCF_DycU
      Rte_Write_SWC_MCF_PP_SWC_MCF_MCF_DycV
      Rte_Write_SWC_MCF_PP_SWC_MCF_MCF_DycW
      Rte_Write_SWC_MCF_PP_SWC_MCF_MCF_Is
      Rte_Write_SWC_MCF_PP_SWC_MCF_MCF_VoltModuRate
      Rte_Write_SWC_MCF_PP_SWC_MCF_MCF_cofFrqPwm
      Rte_Write_SWC_MCF_PP_SWC_MCF_MCF_dtPwm
      Rte_Write_SWC_MCF_PP_SWC_MCF_MCF_frqPwm
      Rte_Write_SWC_MCF_PP_SWC_MCF_MCF_iU
      Rte_Write_SWC_MCF_PP_SWC_MCF_MCF_iV
      Rte_Write_SWC_MCF_PP_SWC_MCF_MCF_iW
      Rte_Write_SWC_MCF_PP_SWC_MCF_MCF_idDes
      Rte_Write_SWC_MCF_PP_SWC_MCF_MCF_iqDes
      Rte_Write_SWC_MCF_PP_SWC_MCF_MCF_isd
      Rte_Write_SWC_MCF_PP_SWC_MCF_MCF_isq
      Rte_Write_SWC_MCF_PP_SWC_MCF_MCF_secVolt
      Rte_Write_SWC_MCF_PP_SWC_MCF_MCF_stPwmMode
      Rte_Write_SWC_MCF_PP_SWC_MCF_MCF_tiLock
      Rte_Write_SWC_MCF_PP_SWC_MCF_MCF_uDcLnk
      Rte_Write_SWC_MCF_PP_SWC_MCF_MCF_udDes
      Rte_Write_SWC_MCF_PP_SWC_MCF_MCF_uqDes
      Rte_Write_SWC_MDF_PP_SWC_MDF_MDF_bFaultEMBlkWarnSt
      Rte_Write_SWC_MDF_PP_SWC_MDF_MDF_stFrwhl
      Rte_Write_SWC_MPC_PP_SWC_MPC_MPC_CofRandomPwm
      Rte_Write_SWC_MPC_PP_SWC_MPC_MPC_IsFlt
      Rte_Write_SWC_MPC_PP_SWC_MPC_MPC_Ld
      Rte_Write_SWC_MPC_PP_SWC_MPC_MPC_LdSubLq
      Rte_Write_SWC_MPC_PP_SWC_MPC_MPC_Lq
      Rte_Write_SWC_MPC_PP_SWC_MPC_MPC_OmBw
      Rte_Write_SWC_MPC_PP_SWC_MPC_MPC_Psi
      Rte_Write_SWC_MPC_PP_SWC_MPC_MPC_Rs
      Rte_Write_SWC_MPC_PP_SWC_MPC_MPC_Rv
      Rte_Write_SWC_MPC_PP_SWC_MPC_MPC_TrqMech
      Rte_Write_SWC_MPC_PP_SWC_MPC_MPC_TrqMechFlt
      Rte_Write_SWC_MPC_PP_SWC_MPC_MPC_dtCorFac
      Rte_Write_SWC_MPC_PP_SWC_MPC_MPC_frqPwmVF
      Rte_Write_SWC_MPC_PP_SWC_MPC_MPC_isdFF
      Rte_Write_SWC_MPC_PP_SWC_MPC_MPC_isdFlt
      Rte_Write_SWC_MPC_PP_SWC_MPC_MPC_isdMTPA
      Rte_Write_SWC_MPC_PP_SWC_MPC_MPC_isdMTPV
      Rte_Write_SWC_MPC_PP_SWC_MPC_MPC_isqFlt
      Rte_Write_SWC_PCF_PP_SWC_PCF_PCF_MotDir
      Rte_Write_SWC_PCF_PP_SWC_PCF_PCF_Pos1
      Rte_Write_SWC_PCF_PP_SWC_PCF_PCF_SLEnMotorAcc
      Rte_Write_SWC_PCF_PP_SWC_PCF_PCF_SLInPLimt
      Rte_Write_SWC_PCF_PP_SWC_PCF_PCF_SLInPLimtPos
      Rte_Write_SWC_PCF_PP_SWC_PCF_PCF_SLtrqDes
      Rte_Write_SWC_PCF_PP_SWC_PCF_PCF_Status
      Rte_Write_SWC_PCF_PP_SWC_PCF_PCF_dycPWM
      Rte_Write_SWC_PCF_PP_SWC_PCF_PCF_enMos
      Rte_Write_SWC_PCF_PP_SWC_PCF_PCF_flgAllowPwmRun
      Rte_Write_SWC_PCF_PP_SWC_PCF_PCF_flgSLWD
      Rte_Write_SWC_PCF_PP_SWC_PCF_PCF_flgShtDwnReq
      Rte_Write_SWC_PCF_PP_SWC_PCF_PCF_iPcf
      Rte_Write_SWC_PCF_PP_SWC_PCF_PCF_stParkCtl
      Rte_Write_SWC_PhC_PP_SWC_PhC_PhC_iUNoOff
      Rte_Write_SWC_PhC_PP_SWC_PhC_PhC_iVNoOff
      Rte_Write_SWC_PhC_PP_SWC_PhC_PhC_iWNoOff
      Rte_Write_SWC_PhC_PP_SWC_PhC_PhC_uDcLnkLowMcu
      Rte_Write_SWC_RCF_PP_SWC_RCF_RCF_AutoClbOffset
      Rte_Write_SWC_RCF_PP_SWC_RCF_RCF_TrqEmDesOfsClb
      Rte_Write_SWC_RCF_PP_SWC_RCF_RCF_UsAlfaScalSet
      Rte_Write_SWC_RCF_PP_SWC_RCF_RCF_UsBetaScalSet
      Rte_Write_SWC_RCF_PP_SWC_RCF_RCF_agRtrOffsEstimd
      Rte_Write_SWC_RCF_PP_SWC_RCF_RCF_cTrqSlpOfsClb
      Rte_Write_SWC_RCF_PP_SWC_RCF_RCF_flgOfsClbSuc
      Rte_Write_SWC_RCF_PP_SWC_RCF_RCF_flgOfsClbSucToNVM
      Rte_Write_SWC_RCF_PP_SWC_RCF_RCF_flgUseUsSet
      Rte_Write_SWC_RCF_PP_SWC_RCF_RCF_stAgRtrOfsCal
      Rte_Write_SWC_RCF_PP_SWC_RCF_RCF_stEstAlRtrOfs
      Rte_Write_SWC_Rdc_PP_SWC_Rdc_Rdc_ArctanAgRtr
      Rte_Write_SWC_Rdc_PP_SWC_Rdc_Rdc_nWoFlt
      Rte_Write_SWC_SCF_PP_SWC_SCF_SCF_FIM_ReqFailrMod
      Rte_Write_SWC_SCF_PP_SWC_SCF_SCF_bHvReady
      Rte_Write_SWC_SCF_PP_SWC_SCF_SCF_flgActvDcha
      Rte_Write_SWC_SCF_PP_SWC_SCF_SCF_flgDataStrgBgnToBsw
      Rte_Write_SWC_SCF_PP_SWC_SCF_SCF_flgEmgReqInvDcha
      Rte_Write_SWC_SCF_PP_SWC_SCF_SCF_flgEnDchaToMc
      Rte_Write_SWC_SCF_PP_SWC_SCF_SCF_flgUdcLowToTpc
      Rte_Write_SWC_SCF_PP_SWC_SCF_SCF_flginitPI
      Rte_Write_SWC_SCF_PP_SWC_SCF_SCF_stDisChg
      Rte_Write_SWC_SCF_PP_SWC_SCF_SCF_stDrvCtl
      Rte_Write_SWC_SCF_PP_SWC_SCF_SCF_stFFAction
      Rte_Write_SWC_SCF_PP_SWC_SCF_SCF_stGateDrv
      Rte_Write_SWC_SCF_PP_SWC_SCF_SCF_stModeReqToTdc
      Rte_Write_SWC_SCF_PP_SWC_SCF_SCF_stPreDrvCtl
      Rte_Write_SWC_SCF_PP_SWC_SCF_SCF_stPwmMode
      Rte_Write_SWC_SCF_PP_SWC_SCF_SCF_stSysCtl
      Rte_Write_SWC_Snapshot_PP_SWC_Snapshot_Snapshot_flgPostDrvDone
      Rte_Write_SWC_TDC_PP_SWC_TDC_TDC_TrqDes
      Rte_Write_SWC_TDC_PP_SWC_TDC_TDC_flgTrqLmtActv
      Rte_Write_SWC_TPC_PP_SWC_TPC_TPC_SgnRotDir
      Rte_Write_SWC_TPC_PP_SWC_TPC_TPC_SgnTrqMechDir
      Rte_Write_SWC_TPC_PP_SWC_TPC_TPC_TDbcTrqMax
      Rte_Write_SWC_TPC_PP_SWC_TPC_TPC_TrqMax
      Rte_Write_SWC_TPC_PP_SWC_TPC_TPC_TrqMaxTrans
      Rte_Write_SWC_TPC_PP_SWC_TPC_TPC_TrqMin
      Rte_Write_SWC_TPC_PP_SWC_TPC_TPC_TrqMinTrans
      Rte_Write_SWC_TPC_PP_SWC_TPC_TPC_bDernCAN
      Rte_Write_SWC_TPC_PP_SWC_TPC_TPC_bDernCoolantTemp
      Rte_Write_SWC_TPC_PP_SWC_TPC_TPC_bDernDbcTemp
      Rte_Write_SWC_TPC_PP_SWC_TPC_TPC_bDernDrvBoardTemp
      Rte_Write_SWC_TPC_PP_SWC_TPC_TPC_bDernElecOvrIdc
      Rte_Write_SWC_TPC_PP_SWC_TPC_TPC_bDernExcMax
      Rte_Write_SWC_TPC_PP_SWC_TPC_TPC_bDernExcMin
      Rte_Write_SWC_TPC_PP_SWC_TPC_TPC_bDernGenOvrIdc
      Rte_Write_SWC_TPC_PP_SWC_TPC_TPC_bDernIGBTTemp
      Rte_Write_SWC_TPC_PP_SWC_TPC_TPC_bDernMtrSpd
      Rte_Write_SWC_TPC_PP_SWC_TPC_TPC_bDernOvrIdc
      Rte_Write_SWC_TPC_PP_SWC_TPC_TPC_bDernOvrUdc
      Rte_Write_SWC_TPC_PP_SWC_TPC_TPC_bDernStrTemp
      Rte_Write_SWC_TPC_PP_SWC_TPC_TPC_bDernUndrUdc
      Rte_Write_SWC_TPC_PP_SWC_TPC_TPC_stMotorMod
      Rte_Write_SWC_TPC_PP_SWC_TPC_TPC_stTrqEmMax
      Rte_Write_SWC_TPC_PP_SWC_TPC_TPC_stTrqEmMin
      Rte_Write_SWC_Tja1043_PP_SWC_Tja1043_Tja1043_flgCAN_WakeUp
      Rte_Write_SWC_VCF_PP_SWC_VCF_VCF_HoldStartTrq
      Rte_Write_SWC_VCF_PP_SWC_VCF_VCF_KpNCtl
      Rte_Write_SWC_VCF_PP_SWC_VCF_VCF_NsetPReq
      Rte_Write_SWC_VCF_PP_SWC_VCF_VCF_TrqDes
      Rte_Write_SWC_VCF_PP_SWC_VCF_VCF_stModeReq
      Rte_Write_SWC_VCF_PP_SWC_VCF_VCF_trqDesUnProc
      Rte_Write_SWC_VCF_PP_SWC_VCF_VCF_trqRamp
      Rte_memcpy
      SchM_Deinit
      SchM_IModeInit
      SchM_Init
      SchM_Mode_BswM_MDGR_BswM_MRP_BswM_MDG
      SchM_Mode_Dcm_R_DcmCommunicationControl_ComMChannel_Can_Network_0_Channel
      SchM_Mode_Dcm_R_DcmCommunicationControl_ComMChannel_Can_Network_1_Channel
      SchM_Switch_BswM_MDGP_AUTOSAR_BswM_ModeDeclarationGroups_MDG_ECUM_STATE
      SchM_Switch_Dcm_DcmDiagnosticSessionControl
      SchM_Switch_Dcm_DcmEcuReset
    bsw module dependency AUTOSAR_Os: target-module-id=1
      required-entrys:
        ActivateTask
        GetResource
        IocRead_Rte_Rx_000045_HSPF_iPhaUOffset
        IocRead_Rte_Rx_000046_HSPF_iPhaVOffset
        IocRead_Rte_Rx_000047_HSPF_iPhaWOffset
        IocRead_Rte_Rx_000049_HSPF_stIphaOffCal
        IocRead_Rte_Rx_000052_HSPF_tCoolantTempFlt
        IocRead_Rte_Rx_000055_HSPF_tDBCTempUFlt
        IocRead_Rte_Rx_000057_HSPF_tDBCTempVFlt
        IocRead_Rte_Rx_000059_HSPF_tDBCTempWFlt
        IocRead_Rte_Rx_000064_HSPF_tStrrTempFlt
        IocRead_Rte_Rx_000067_HSPF_uDcLnkSlowFlt
        IocRead_Rte_Rx_000077_HvMcu_uDcLnkHvMcu
        IocRead_Rte_Rx_000085_MCF_Is
        IocRead_Rte_Rx_000087_MCF_VoltModuRate
        IocRead_Rte_Rx_000088_MCF_cofFrqPwm
        IocRead_Rte_Rx_000089_MCF_dtPwm
        IocRead_Rte_Rx_000091_MCF_iU
        IocRead_Rte_Rx_000093_MCF_iV
        IocRead_Rte_Rx_000095_MCF_iW
        IocRead_Rte_Rx_000097_MCF_idDes
        IocRead_Rte_Rx_000098_MCF_iqDes
        IocRead_Rte_Rx_000099_MCF_isd
        IocRead_Rte_Rx_000100_MCF_isq
        IocRead_Rte_Rx_000104_MCF_uDcLnk
        IocRead_Rte_Rx_000105_MCF_udDes
        IocRead_Rte_Rx_000106_MCF_uqDes
        IocRead_Rte_Rx_000108_MDF_bFaultEMBlkWarnSt
        IocRead_Rte_Rx_000110_MPC_CofRandomPwm
        IocRead_Rte_Rx_000112_MPC_Ld
        IocRead_Rte_Rx_000114_MPC_LdSubLq
        IocRead_Rte_Rx_000115_MPC_Lq
        IocRead_Rte_Rx_000117_MPC_OmBw
        IocRead_Rte_Rx_000118_MPC_Psi
        IocRead_Rte_Rx_000120_MPC_Rs
        IocRead_Rte_Rx_000122_MPC_Rv
        IocRead_Rte_Rx_000124_MPC_TrqMechFlt
        IocRead_Rte_Rx_000126_MPC_dtCorFac
        IocRead_Rte_Rx_000127_MPC_frqPwmVF
        IocRead_Rte_Rx_000128_MPC_isdFF
        IocRead_Rte_Rx_000130_MPC_isdMTPA
        IocRead_Rte_Rx_000131_MPC_isdMTPV
        IocRead_Rte_Rx_000133_NvM_AngAutoClbOffset
        IocRead_Rte_Rx_000136_NvM_flgAngAutoClbOffset
        IocRead_Rte_Rx_000149_PhC_iUNoOff
        IocRead_Rte_Rx_000151_PhC_iVNoOff
        IocRead_Rte_Rx_000153_PhC_iWNoOff
        IocRead_Rte_Rx_000154_PhC_uDcLnkLowMcu
        IocRead_Rte_Rx_000157_RCF_UsAlfaScalSet
        IocRead_Rte_Rx_000158_RCF_UsBetaScalSet
        IocRead_Rte_Rx_000159_RCF_agRtrOffsEstimd
        IocRead_Rte_Rx_000163_RCF_flgUseUsSet
        IocRead_Rte_Rx_000166_Rdc_ArctanAgRtr
        IocRead_Rte_Rx_000169_Rdc_nWoFlt
        IocRead_Rte_Rx_000170_SCF_FIM_ReqFailrMod
        IocRead_Rte_Rx_000173_SCF_flgEnDchaToMc
        IocRead_Rte_Rx_000175_SCF_flginitPI
        IocRead_Rte_Rx_000179_SCF_stGateDrv
        IocRead_Rte_Rx_000183_SCF_stPwmMode
        IocRead_Rte_Rx_000185_BCC_iDcLnkEstFlt
        IocRead_Rte_Rx_000187_BCC_tCoolantTj
        IocRead_Rte_Rx_000188_BCC_tIgbtTj
        IocRead_Rte_Rx_000225_TDC_TrqDes
        IocRead_Rte_Rx_000230_TPC_TDbcTrqMax
        IocRead_Rte_Rx_000245_TPC_stMotorMod
        IocWrite_Rte_Rx_000045_HSPF_iPhaUOffset
        IocWrite_Rte_Rx_000046_HSPF_iPhaVOffset
        IocWrite_Rte_Rx_000047_HSPF_iPhaWOffset
        IocWrite_Rte_Rx_000049_HSPF_stIphaOffCal
        IocWrite_Rte_Rx_000052_HSPF_tCoolantTempFlt
        IocWrite_Rte_Rx_000055_HSPF_tDBCTempUFlt
        IocWrite_Rte_Rx_000057_HSPF_tDBCTempVFlt
        IocWrite_Rte_Rx_000059_HSPF_tDBCTempWFlt
        IocWrite_Rte_Rx_000064_HSPF_tStrrTempFlt
        IocWrite_Rte_Rx_000067_HSPF_uDcLnkSlowFlt
        IocWrite_Rte_Rx_000077_HvMcu_uDcLnkHvMcu
        IocWrite_Rte_Rx_000085_MCF_Is
        IocWrite_Rte_Rx_000087_MCF_VoltModuRate
        IocWrite_Rte_Rx_000088_MCF_cofFrqPwm
        IocWrite_Rte_Rx_000089_MCF_dtPwm
        IocWrite_Rte_Rx_000091_MCF_iU
        IocWrite_Rte_Rx_000093_MCF_iV
        IocWrite_Rte_Rx_000095_MCF_iW
        IocWrite_Rte_Rx_000097_MCF_idDes
        IocWrite_Rte_Rx_000098_MCF_iqDes
        IocWrite_Rte_Rx_000099_MCF_isd
        IocWrite_Rte_Rx_000100_MCF_isq
        IocWrite_Rte_Rx_000104_MCF_uDcLnk
        IocWrite_Rte_Rx_000105_MCF_udDes
        IocWrite_Rte_Rx_000106_MCF_uqDes
        IocWrite_Rte_Rx_000108_MDF_bFaultEMBlkWarnSt
        IocWrite_Rte_Rx_000110_MPC_CofRandomPwm
        IocWrite_Rte_Rx_000112_MPC_Ld
        IocWrite_Rte_Rx_000114_MPC_LdSubLq
        IocWrite_Rte_Rx_000115_MPC_Lq
        IocWrite_Rte_Rx_000117_MPC_OmBw
        IocWrite_Rte_Rx_000118_MPC_Psi
        IocWrite_Rte_Rx_000120_MPC_Rs
        IocWrite_Rte_Rx_000122_MPC_Rv
        IocWrite_Rte_Rx_000124_MPC_TrqMechFlt
        IocWrite_Rte_Rx_000126_MPC_dtCorFac
        IocWrite_Rte_Rx_000127_MPC_frqPwmVF
        IocWrite_Rte_Rx_000128_MPC_isdFF
        IocWrite_Rte_Rx_000130_MPC_isdMTPA
        IocWrite_Rte_Rx_000131_MPC_isdMTPV
        IocWrite_Rte_Rx_000133_NvM_AngAutoClbOffset
        IocWrite_Rte_Rx_000136_NvM_flgAngAutoClbOffset
        IocWrite_Rte_Rx_000149_PhC_iUNoOff
        IocWrite_Rte_Rx_000151_PhC_iVNoOff
        IocWrite_Rte_Rx_000153_PhC_iWNoOff
        IocWrite_Rte_Rx_000154_PhC_uDcLnkLowMcu
        IocWrite_Rte_Rx_000157_RCF_UsAlfaScalSet
        IocWrite_Rte_Rx_000158_RCF_UsBetaScalSet
        IocWrite_Rte_Rx_000159_RCF_agRtrOffsEstimd
        IocWrite_Rte_Rx_000163_RCF_flgUseUsSet
        IocWrite_Rte_Rx_000166_Rdc_ArctanAgRtr
        IocWrite_Rte_Rx_000169_Rdc_nWoFlt
        IocWrite_Rte_Rx_000170_SCF_FIM_ReqFailrMod
        IocWrite_Rte_Rx_000173_SCF_flgEnDchaToMc
        IocWrite_Rte_Rx_000175_SCF_flginitPI
        IocWrite_Rte_Rx_000179_SCF_stGateDrv
        IocWrite_Rte_Rx_000183_SCF_stPwmMode
        IocWrite_Rte_Rx_000185_BCC_iDcLnkEstFlt
        IocWrite_Rte_Rx_000187_BCC_tCoolantTj
        IocWrite_Rte_Rx_000188_BCC_tIgbtTj
        IocWrite_Rte_Rx_000225_TDC_TrqDes
        IocWrite_Rte_Rx_000230_TPC_TDbcTrqMax
        IocWrite_Rte_Rx_000245_TPC_stMotorMod
        ReleaseResource
        ResumeOSInterrupts
        Rte_ResumeOSInterrupts
        Rte_SuspendOSInterrupts
        SuspendOSInterrupts
        TerminateTask
    bsw module dependency AUTOSAR_Com: target-module-id=50, required-entrys=[Com_ReceiveSignal, Com_SendSignal]
      expected-callbacks:
        Rte_COMCbk_BMS01_BattCurr_BMS_01
        Rte_COMCbk_BMS01_BattVolt_BMS_01
        Rte_COMCbk_BMS01_stMainRelay_BMS_01
        Rte_COMCbk_VCU01_IdcMax_VCU_01
        Rte_COMCbk_VCU01_IdcMin_VCU_01
        Rte_COMCbk_VCU01_UdcMax_VCU_01
        Rte_COMCbk_VCU01_UdcMin_VCU_01
        Rte_COMCbk_VCU01_stHvbMaiRly_VCU_01
        Rte_COMCbk_VCU02_KpHighNCtl_VCU_02
        Rte_COMCbk_VCU02_KpLowNCtl_VCU_02
        Rte_COMCbk_VCU02_NDiffMax_VCU_02
        Rte_COMCbk_VCU02_TrqMaxNCtl_VCU_02
        Rte_COMCbk_VCU02_TrqMinNCtl_VCU_02
        Rte_COMCbk_VCU03_TrqMax_VCU_03
        Rte_COMCbk_VCU03_TrqMin_VCU_03
        Rte_COMCbk_VCU03_cTrqSlopeMax_VCU_03
        Rte_COMCbk_VCU04_MotDir_VCU_04
        Rte_COMCbk_VCU04_NSetP_VCU_04
        Rte_COMCbk_VCU04_TrqSetP_VCU_04
        Rte_COMCbk_VCU04_bKL15_VCU_04
        Rte_COMCbk_VCU04_stModeReq_VCU_04
        Rte_COMCbk_VCU05_OfsAl_VCU_05
        Rte_COMCbk_VCU05_TrqDmpLim_VCU_05
        Rte_COMCbk_VCU05_TrqDmpMax_VCU_05
        Rte_COMCbk_VCU05_bSetOfsAl_VCU_05
        Rte_COMCbk_VCU05_kDmp_VCU_05
        Rte_COMCbk_VCU05_stDmpCtlReq_VCU_05
        Rte_COMCbk_VCU06_Park_VCU_06
        Rte_COMCbk_VCU06_VehGrad_VCU_06
        Rte_COMCbk_VCU06_stBelt_VCU_06
        Rte_COMCbk_VCU06_stBreak_VCU_06
        Rte_COMCbk_VCU06_stDoor_VCU_06
    bsw internal behavior RteInternalBehavior
      constant-memorys:
        82 x parameter data prototype:
          Rte_Inst_BswM: type=Rte_CDS_BswM
          Rte_Inst_ComM: type=Rte_CDS_ComM
          Rte_Inst_Dcm: type=Rte_CDS_Dcm
          Rte_Inst_Dem: type=Rte_CDS_Dem
          Rte_Inst_Det: type=Rte_CDS_Det
          Rte_Inst_Diag_SWC: type=Rte_CDS_Diag_SWC
          Rte_Inst_EcuM: type=Rte_CDS_EcuM
          Rte_Inst_FiM: type=Rte_CDS_FiM
          Rte_Inst_IoHwAbW: type=Rte_CDS_IoHwAbW
          Rte_Inst_NvM: type=Rte_CDS_NvM
          Rte_Inst_NvM_SWC: type=Rte_CDS_NvM_SWC
          Rte_Inst_SWC_BCC: type=Rte_CDS_SWC_BCC
          Rte_Inst_SWC_CSPF: type=Rte_CDS_SWC_CSPF
          Rte_Inst_SWC_Cpld: type=Rte_CDS_SWC_Cpld
          Rte_Inst_SWC_DiagCalib: type=Rte_CDS_SWC_DiagCalib
          Rte_Inst_SWC_Epark: type=Rte_CDS_SWC_Epark
          Rte_Inst_SWC_HSPF: type=Rte_CDS_SWC_HSPF
          Rte_Inst_SWC_HvMcu: type=Rte_CDS_SWC_HvMcu
          Rte_Inst_SWC_Igbt: type=Rte_CDS_SWC_Igbt
          Rte_Inst_SWC_LvPower: type=Rte_CDS_SWC_LvPower
          Rte_Inst_SWC_MCF: type=Rte_CDS_SWC_MCF
          Rte_Inst_SWC_MDF: type=Rte_CDS_SWC_MDF
          Rte_Inst_SWC_MPC: type=Rte_CDS_SWC_MPC
          Rte_Inst_SWC_PCF: type=Rte_CDS_SWC_PCF
          Rte_Inst_SWC_PhC: type=Rte_CDS_SWC_PhC
          Rte_Inst_SWC_Pwm3ph: type=Rte_CDS_SWC_Pwm3ph
          Rte_Inst_SWC_RCF: type=Rte_CDS_SWC_RCF
          Rte_Inst_SWC_Rdc: type=Rte_CDS_SWC_Rdc
          Rte_Inst_SWC_SCF: type=Rte_CDS_SWC_SCF
          Rte_Inst_SWC_Snapshot: type=Rte_CDS_SWC_Snapshot
          Rte_Inst_SWC_TDC: type=Rte_CDS_SWC_TDC
          Rte_Inst_SWC_TPC: type=Rte_CDS_SWC_TPC
          Rte_Inst_SWC_Task_Core{0..2}: type=Rte_CDS_SWC_Task_Core{0..2}
          Rte_Inst_SWC_Tja1043: type=Rte_CDS_SWC_Tja1043
          Rte_Inst_SWC_VCF: type=Rte_CDS_SWC_VCF
          Rte_Inst_WdgM_SWC: type=Rte_CDS_WdgM_SWC
          Rte_RE_CONTAINER_CPT_BswM_DRE_BswM_Cfg_DfrdSwcReqst_BswM_MRP_SWC_RequestShutDown: type=Rte_REContainerType
          Rte_RE_CONTAINER_CPT_BswM_DRE_BswM_Cfg_ImdtSwcReqst_BswM_MRP_SWC_RequestAfterRun: type=Rte_REContainerType
          Rte_Rx_000036_uint8: type=uint8
          Rte_Rx_000211_Com_RecflgDchaReq: type=boolean
          Rte_Rx_000212_Com_VCU_flgCrash: type=boolean
          Rte_Self_CPT_BswM: type=Rte_SelfType_BswM
          Rte_Self_CPT_ComM: type=Rte_SelfType_ComM
          Rte_Self_CPT_Dcm: type=Rte_SelfType_Dcm
          Rte_Self_CPT_Dem: type=Rte_SelfType_Dem
          Rte_Self_CPT_Det: type=Rte_SelfType_Det
          Rte_Self_CPT_Diag_SWC: type=Rte_SelfType_Diag_SWC
          Rte_Self_CPT_EcuM: type=Rte_SelfType_EcuM
          Rte_Self_CPT_Epark: type=Rte_SelfType_SWC_Epark
          Rte_Self_CPT_FIM: type=Rte_SelfType_FiM
          Rte_Self_CPT_HSPF: type=Rte_SelfType_SWC_HSPF
          Rte_Self_CPT_HvMCu: type=Rte_SelfType_SWC_HvMcu
          Rte_Self_CPT_Igbt: type=Rte_SelfType_SWC_Igbt
          Rte_Self_CPT_IoHwAbw: type=Rte_SelfType_IoHwAbW
          Rte_Self_CPT_LvPower: type=Rte_SelfType_SWC_LvPower
          Rte_Self_CPT_MCF: type=Rte_SelfType_SWC_MCF
          Rte_Self_CPT_MDF: type=Rte_SelfType_SWC_MDF
          Rte_Self_CPT_MPC: type=Rte_SelfType_SWC_MPC
          Rte_Self_CPT_NvM: type=Rte_SelfType_NvM
          Rte_Self_CPT_Nvm_SWC: type=Rte_SelfType_NvM_SWC
          Rte_Self_CPT_PCF: type=Rte_SelfType_SWC_PCF
          Rte_Self_CPT_PhC: type=Rte_SelfType_SWC_PhC
          Rte_Self_CPT_Pwm3ph: type=Rte_SelfType_SWC_Pwm3ph
          Rte_Self_CPT_RCF: type=Rte_SelfType_SWC_RCF
          Rte_Self_CPT_Rdc: type=Rte_SelfType_SWC_Rdc
          Rte_Self_CPT_SCF: type=Rte_SelfType_SWC_SCF
          Rte_Self_CPT_SWC_BCC: type=Rte_SelfType_SWC_BCC
          Rte_Self_CPT_SWC_CSPF: type=Rte_SelfType_SWC_CSPF
          Rte_Self_CPT_SWC_Cpld: type=Rte_SelfType_SWC_Cpld
          Rte_Self_CPT_SWC_DiagCalib: type=Rte_SelfType_SWC_DiagCalib
          Rte_Self_CPT_SWC_Task_Core{0..2}: type=Rte_SelfType_SWC_Task_Core{0..2}
          Rte_Self_CPT_Snapshot: type=Rte_SelfType_SWC_Snapshot
          Rte_Self_CPT_TDC: type=Rte_SelfType_SWC_TDC
          Rte_Self_CPT_TPC: type=Rte_SelfType_SWC_TPC
          Rte_Self_CPT_Tja1043: type=Rte_SelfType_SWC_Tja1043
          Rte_Self_CPT_VCF: type=Rte_SelfType_SWC_VCF
          Rte_Self_CPT_WdgM_SWC: type=Rte_SelfType_WdgM_SWC
          Rte_Tasks: type=Rte_TaskInfo
      static-memorys:
        243 x data:
          Rte_ActCount_CPT_BswM_DRE_BswM_Cfg_DfrdSwcReqst_BswM_MRP_SWC_RequestShutDown: type=Rte_REActCounterType
          Rte_ActCount_CPT_BswM_DRE_BswM_Cfg_ImdtSwcReqst_BswM_MRP_SWC_RequestAfterRun: type=Rte_REActCounterType
          Rte_CPim_NvM_SWC_NvM_SWC_BlockNative_1024: type=Rte_PimType_NvM_SWC_NvM_SWC_BlockNative_1024_Type
          Rte_CPim_NvM_SWC_NvM_SWC_BlockRedundant_1024: type=Rte_PimType_NvM_SWC_NvM_SWC_BlockRedundant_1024_Type
          Rte_ImplicitBufs: type=Rte_ImplicitBufsType
          Rte_Irv_SWC_RCF_IVDP_RCF_flgEnblEstAlRtrOfs: type=boolean
          Rte_Irv_SWC_RCF_IVDP_RCF_flgEnblOfsClbFrwhl: type=boolean
          Rte_Irv_SWC_RCF_IVDP_RCF_flgEnblOfsClbFrwhlBwd: type=boolean
          Rte_Irv_SWC_RCF_IVDP_RCF_flgEnblOfsClbFrwhlFwd: type=boolean
          Rte_Irv_SWC_RCF_IVDP_RCF_stAgRtrOfsCal: type=uint8
          Rte_Irv_SWC_RCF_IVDP_RCF_stEstAlRtrOfs: type=uint8
          Rte_Irv_SWC_RCF_IVDP_RCF_stOfsClbFrwhl: type=uint8
          Rte_Irv_SWC_RCF_IVDP_RCF_stOfsFrwhlFwd: type=uint8
          Rte_Irv_SWC_VCF_IVDP_VCF_CrawlFlg: type=boolean
          Rte_Irv_SWC_VCF_IVDP_VCF_CrawlModeReq: type=uint8
          Rte_Irv_SWC_VCF_IVDP_VCF_RecCrawlNSetP: type=float32
          Rte_Irv_SWC_VCF_IVDP_VCF_RecCrawlTrqSetP: type=float32
          Rte_Irv_SWC_VCF_IVDP_VCF_flgHoldModeReq: type=boolean
          Rte_ModeCurrent_0: type=uint8
          Rte_ModeCurrent_1: type=uint8
          Rte_ModeCurrent_10: type=uint8
          Rte_ModeCurrent_11: type=uint8
          Rte_ModeCurrent_{2..9}: type=uint8
          Rte_ModeSchMNext_0: type=uint8
          Rte_Rx_000000_Com_BMS01_BattCurr: type=float32
          Rte_Rx_000001_Com_BMS01_BattVoLt: type=uint16
          Rte_Rx_000002_Com_BMS01_stMainReLay: type=uint8
          Rte_Rx_000003_Com_VCU01_idcMax: type=float32
          Rte_Rx_000004_Com_VCU01_idcMin: type=float32
          Rte_Rx_000005_Com_VCU01_UdcMax: type=float32
          Rte_Rx_000006_Com_VCU01_UdcMin: type=float32
          Rte_Rx_000007_Com_VCU01_stHvbMaiRly: type=uint8
          Rte_Rx_000008_Com_VCU02_KpHighNCtL: type=float32
          Rte_Rx_000009_Com_VCU02_KpLowNCtL: type=float32
          Rte_Rx_000010_Com_VCU02_NDiffMax: type=float32
          Rte_Rx_000011_Com_VCU02_TrqMaxNCtL: type=float32
          Rte_Rx_000012_Com_VCU02_TrqMinNCtL: type=float32
          Rte_Rx_000013_Com_VCU03_TrqMax: type=float32
          Rte_Rx_000014_Com_VCU03_TrqMin: type=float32
          Rte_Rx_000015_Com_VCU03_cTrqSlopeMax: type=float32
          Rte_Rx_000016_Com_VCU04_MotDir: type=uint8
          Rte_Rx_000017_Com_VCU04_NSetP: type=float32
          Rte_Rx_000018_Com_VCU04_TrqSetP: type=float32
          Rte_Rx_000019_Com_VCU04_bKL15: type=boolean
          Rte_Rx_000020_Com_VCU04_stModeReq: type=uint8
          Rte_Rx_000021_Com_VCU05_OfsAL: type=float32
          Rte_Rx_000022_Com_VCU05_TrqDmpMin: type=float32
          Rte_Rx_000023_Com_VCU05_TrqDmpMax: type=float32
          Rte_Rx_000024_Com_VCU05_bSetOfsAL: type=uint8
          Rte_Rx_000025_Com_VCU05_kDmp: type=float32
          Rte_Rx_000026_Com_VCU05_stDmpCtLReq: type=uint8
          Rte_Rx_000027_Com_VCU06_Park: type=boolean
          Rte_Rx_000028_Com_VCU06_VehGrad: type=float32
          Rte_Rx_000029_Com_VCU06_stBelt: type=uint8
          Rte_Rx_000030_Com_VCU06_stBreak: type=uint8
          Rte_Rx_000031_Com_VCU06_stDoor: type=uint8
          Rte_Rx_000032_Data: type=Dcm_DataArrayTypeUint8_DspData_SYS_SUP_ID_F18AType
          Rte_Rx_000033_Data: type=Dcm_DataArrayTypeUint8_DspData_ASW_VER_F189Type
          Rte_Rx_000034_Data: type=Dcm_DataArrayTypeUint8_DspData_MANU_DATE_F18BType
          Rte_Rx_000035_Data: type=Dcm_DataArrayTypeUint8_DspData_SYS_SUP_ID_F18AType
          Rte_Rx_000037_Epark_iPcf: type=float32
          Rte_Rx_000038_Epark_posPcf: type=float32
          Rte_Rx_000039_Epark_posPcfMon: type=float32
          Rte_Rx_000040_HSPF_PwrDcLnk: type=float32
          Rte_Rx_000041_HSPF_Wake: type=boolean
          Rte_Rx_000042_HSPF_bt15: type=boolean
          Rte_Rx_000043_HSPF_flgCrash: type=boolean
          Rte_Rx_000044_HSPF_iDcLnkEstFlt: type=float32
          Rte_Rx_000048_HSPF_nSlowFlt: type=float32
          Rte_Rx_000050_HSPF_stIphaOffCal: type=uint8
          Rte_Rx_000051_HSPF_tCoolantTempFlt: type=float32
          Rte_Rx_000053_HSPF_tCoolantTjFlt: type=float32
          Rte_Rx_000054_HSPF_tDBCTempUFlt: type=float32
          Rte_Rx_000056_HSPF_tDBCTempVFlt: type=float32
          Rte_Rx_000058_HSPF_tDBCTempWFlt: type=float32
          Rte_Rx_000060_HSPF_tDrvBoardTempFlt: type=float32
          Rte_Rx_000061_HSPF_tIgbtTjFlt: type=float32
          Rte_Rx_000062_HSPF_tStrrTemp1Flt: type=float32
          Rte_Rx_000063_HSPF_tStrrTemp2Flt: type=float32
          Rte_Rx_000065_HSPF_tStrrTempFlt: type=float32
          Rte_Rx_000066_HSPF_uDcLnkSlowFlt: type=float32
          Rte_Rx_000068_HSPF_uKl30Flt: type=float32
          Rte_Rx_000069_HvMcu_AlOfsClb_TimeStamp: type=float32
          Rte_Rx_000070_HvMcu_HvMcuVer: type=uint16
          Rte_Rx_000071_HvMcu_VDD15L_Vol: type=uint16
          Rte_Rx_000072_HvMcu_flgUphaEdgeRiseCo: type=boolean
          Rte_Rx_000073_HvMcu_tDBCTempU: type=uint16
          Rte_Rx_000074_HvMcu_tDBCTempV: type=uint16
          Rte_Rx_000075_HvMcu_tDBCTempW: type=uint16
          Rte_Rx_000076_HvMcu_tDrvBoardTemp: type=uint16
          Rte_Rx_000078_HvMcu_uDcLnkHvMcu: type=float32
          Rte_Rx_000079_Igbt_flgGateDrvRdyHs: type=boolean
          Rte_Rx_000080_Igbt_flgGateDrvRdyLs: type=boolean
          Rte_Rx_000081_LvPower_stLowpowerUp: type=uint8
          Rte_Rx_000082_MCF_DycU: type=float32
          Rte_Rx_000083_MCF_DycV: type=float32
          Rte_Rx_000084_MCF_DycW: type=float32
          Rte_Rx_000086_MCF_Is: type=float32
          Rte_Rx_000090_MCF_frqPwm: type=float32
          Rte_Rx_000092_MCF_iU: type=float32
          Rte_Rx_000094_MCF_iV: type=float32
          Rte_Rx_000096_MCF_iW: type=float32
          Rte_Rx_000101_MCF_secVolt: type=uint8
          Rte_Rx_000102_MCF_stPwmMode: type=uint8
          Rte_Rx_000103_MCF_tiLock: type=float32
          Rte_Rx_000107_MDF_bFaultEMBlkWarnSt: type=uint8
          Rte_Rx_000109_MDF_stFrwhl: type=uint8
          Rte_Rx_000111_MPC_IsFlt: type=float32
          Rte_Rx_000113_MPC_Ld: type=float32
          Rte_Rx_000116_MPC_Lq: type=float32
          Rte_Rx_000119_MPC_Psi: type=float32
          Rte_Rx_000121_MPC_Rs: type=float32
          Rte_Rx_000123_MPC_TrqMech: type=float32
          Rte_Rx_000125_MPC_TrqMechFlt: type=float32
          Rte_Rx_000129_MPC_isdFlt: type=float32
          Rte_Rx_000132_MPC_isqFlt: type=float32
          Rte_Rx_000134_NvM_SLFnh: type=boolean
          Rte_Rx_000135_NvM_SLInPLimt: type=float32
          Rte_Rx_000137_NvM_flgAngAutoClbOffset: type=boolean
          Rte_Rx_000138_PCF_MotDir: type=boolean
          Rte_Rx_000139_PCF_SLEnMotorAcc: type=boolean
          Rte_Rx_000140_PCF_SLInPLimt: type=float32
          Rte_Rx_000141_PCF_SLtrqDes: type=float32
          Rte_Rx_000142_PCF_Status: type=uint16
          Rte_Rx_000143_PCF_dycPWM: type=float32
          Rte_Rx_000144_PCF_flgAllowPwmRun: type=boolean
          Rte_Rx_000145_PCF_flgSLWD: type=boolean
          Rte_Rx_000146_PCF_flgShtDwnReq: type=boolean
          Rte_Rx_000147_PCF_stParkCtl: type=uint8
          Rte_Rx_000148_PhC_iUNoOff: type=uint16
          Rte_Rx_000150_PhC_iVNoOff: type=uint16
          Rte_Rx_000152_PhC_iWNoOff: type=uint16
          Rte_Rx_000155_RCF_AutoClbOffset: type=float32
          Rte_Rx_000156_RCF_TrqEmDesOfsClb: type=float32
          Rte_Rx_000160_RCF_cTrqSlpOfsClb: type=float32
          Rte_Rx_000161_RCF_flgOfsClbSuc: type=boolean
          Rte_Rx_000162_RCF_flgOfsClbSucToNVM: type=boolean
          Rte_Rx_000164_RCF_stAgRtrOfsCal: type=uint8
          Rte_Rx_000165_RCF_stEstAlRtrOfs: type=uint8
          Rte_Rx_000167_Rdc_ArctanAgRtr: type=float32
          Rte_Rx_000168_Rdc_nWoFlt: type=float32
          Rte_Rx_000171_SCF_bHvReady: type=boolean
          Rte_Rx_000172_SCF_flgEmgReqInvDcha: type=boolean
          Rte_Rx_000174_SCF_flgUdcLowToTpc: type=boolean
          Rte_Rx_000176_SCF_stDisChg: type=uint8
          Rte_Rx_000177_SCF_stDrvCtl: type=uint8
          Rte_Rx_000178_SCF_stFFAction: type=uint8
          Rte_Rx_000180_SCF_stGateDrv: type=uint8
          Rte_Rx_000181_SCF_stModeReqToTdc: type=uint8
          Rte_Rx_000182_SCF_stPreDrvCtl: type=uint8
          Rte_Rx_000184_SCF_stSysCtl: type=uint8
          Rte_Rx_000186_BCC_iDcLnkEstFlt: type=float32
          Rte_Rx_000189_CSPF_RecKpDmp: type=float32
          Rte_Rx_000190_CSPF_RecKpHighNCtL: type=float32
          Rte_Rx_000191_CSPF_RecKpLowNCtL: type=float32
          Rte_Rx_000192_CSPF_RecNDiffMax: type=float32
          Rte_Rx_000193_CSPF_RecNSetP: type=float32
          Rte_Rx_000194_CSPF_RecTrqDmpMax: type=float32
          Rte_Rx_000195_CSPF_RecTrqDmpMin: type=float32
          Rte_Rx_000196_CSPF_RecTrqMax: type=float32
          Rte_Rx_000197_CSPF_RecTrqMaxNCtL: type=float32
          Rte_Rx_000198_CSPF_RecTrqMin: type=float32
          Rte_Rx_000199_CSPF_RecTrqMinNCtL: type=float32
          Rte_Rx_000200_CSPF_RecTrqSLope: type=float32
          Rte_Rx_000201_CSPF_RecTrqSetP: type=float32
          Rte_Rx_000202_CSPF_RecUdcMax: type=float32
          Rte_Rx_000203_CSPF_RecUdcMin: type=float32
          Rte_Rx_000204_CSPF_RecflgCrash: type=boolean
          Rte_Rx_000205_CSPF_RecflgDchaReq: type=boolean
          Rte_Rx_000206_CSPF_RecidcMax: type=float32
          Rte_Rx_000207_CSPF_RecidcMin: type=float32
          Rte_Rx_000208_CSPF_RecstDmpCtLReq: type=uint8
          Rte_Rx_000209_CSPF_RecstMainReLay: type=uint8
          Rte_Rx_000210_CSPF_RecstModeReq: type=uint8
          Rte_Rx_000213_Cpld_CpldSwVer: type=uint8
          Rte_Rx_000214_Cpld_IgbtState: type=uint8
          Rte_Rx_000215_Cpld_ProjectNum: type=uint8
          Rte_Rx_000216_DiagCalib_FailCode1: type=uint8
          Rte_Rx_000217_DiagCalib_FailCode2: type=uint8
          Rte_Rx_000218_DiagCalib_FailCode3: type=uint8
          Rte_Rx_000219_DiagCalib_FailCode4: type=uint8
          Rte_Rx_000220_DiagCalib_FailCode5: type=uint8
          Rte_Rx_000221_DiagCalib_FailCode6: type=uint8
          Rte_Rx_000222_DiagCalib_FailCode7: type=uint8
          Rte_Rx_000223_DiagCalib_FailCode8: type=uint8
          Rte_Rx_000224_Snapshot_flgPostDrvDone: type=boolean
          Rte_Rx_000226_TDC_TrqDes: type=float32
          Rte_Rx_000227_TDC_flgTrqLmtActv: type=boolean
          Rte_Rx_000228_TPC_SgnRotDir: type=uint8
          Rte_Rx_000229_TPC_SgnTrqMechDir: type=uint8
          Rte_Rx_000231_TPC_TrqMax: type=float32
          Rte_Rx_000232_TPC_TrqMin: type=float32
          Rte_Rx_000233_TPC_bDernCAN: type=boolean
          Rte_Rx_000234_TPC_bDernCoolantTemp: type=boolean
          Rte_Rx_000235_TPC_bDernDbcTemp: type=boolean
          Rte_Rx_000236_TPC_bDernDrvBoardTemp: type=boolean
          Rte_Rx_000237_TPC_bDernExcMax: type=boolean
          Rte_Rx_000238_TPC_bDernExcMin: type=boolean
          Rte_Rx_000239_TPC_bDernMtrSpd: type=boolean
          Rte_Rx_000240_TPC_bDernOvrIdc: type=boolean
          Rte_Rx_000241_TPC_bDernOvrUdc: type=boolean
          Rte_Rx_000242_TPC_bDernStrTemp: type=boolean
          Rte_Rx_000243_TPC_bDernUndrUdc: type=boolean
          Rte_Rx_000244_TPC_stMotorMod: type=uint8
          Rte_Rx_000246_TPC_stTrqEmMax: type=uint8
          Rte_Rx_000247_TPC_stTrqEmMin: type=uint8
          Rte_Rx_000248_Tja1043_flgCAN_WakeUp: type=boolean
          Rte_Rx_000249_VCF_HoldStartTrq: type=float32
          Rte_Rx_000250_VCF_KpNCtl: type=float32
          Rte_Rx_000251_VCF_NsetPReq: type=float32
          Rte_Rx_000252_VCF_TrqDes: type=float32
          Rte_Rx_000253_VCF_stModeReq: type=uint8
          Rte_Rx_000254_VCF_trqRamp: type=float32
          Rte_Var_CPT_RCF_IE_SWC_RCF_Init_IVDP_RCF_flgEnblEstAlRtrOfs: type=boolean
          Rte_Var_CPT_RCF_IE_SWC_RCF_Init_IVDP_RCF_flgEnblOfsClbFrwhl: type=boolean
          Rte_Var_CPT_RCF_IE_SWC_RCF_Init_IVDP_RCF_flgEnblOfsClbFrwhlBwd: type=boolean
          Rte_Var_CPT_RCF_IE_SWC_RCF_Init_IVDP_RCF_flgEnblOfsClbFrwhlFwd: type=boolean
          Rte_Var_CPT_RCF_IE_SWC_RCF_Init_IVDP_RCF_stAgRtrOfsCal: type=uint8
          Rte_Var_CPT_RCF_TE_SWC_RCF_10ms_IVDP_RCF_flgEnblEstAlRtrOfs: type=boolean
          Rte_Var_CPT_RCF_TE_SWC_RCF_10ms_IVDP_RCF_flgEnblOfsClbFrwhl: type=boolean
          Rte_Var_CPT_RCF_TE_SWC_RCF_10ms_IVDP_RCF_flgEnblOfsClbFrwhlBwd: type=boolean
          Rte_Var_CPT_RCF_TE_SWC_RCF_10ms_IVDP_RCF_flgEnblOfsClbFrwhlFwd: type=boolean
          Rte_Var_CPT_RCF_TE_SWC_RCF_10ms_IVDP_RCF_stAgRtrOfsCal: type=uint8
          Rte_Var_CPT_RCF_TE_SWC_RCF_10ms_IVDP_RCF_stEstAlRtrOfs: type=uint8
          Rte_Var_CPT_RCF_TE_SWC_RCF_10ms_IVDP_RCF_stOfsClbFrwhl: type=uint8
          Rte_Var_CPT_RCF_TE_SWC_RCF_10ms_IVDP_RCF_stOfsFrwhlFwd: type=uint8
          Rte_Var_CPT_VCF_IE_SWC_VCF_Init_IVDP_VCF_CrawlFlg: type=boolean
          Rte_Var_CPT_VCF_IE_SWC_VCF_Init_IVDP_VCF_CrawlModeReq: type=uint8
          Rte_Var_CPT_VCF_IE_SWC_VCF_Init_IVDP_VCF_RecCrawlNSetP: type=float32
          Rte_Var_CPT_VCF_IE_SWC_VCF_Init_IVDP_VCF_RecCrawlTrqSetP: type=float32
          Rte_Var_CPT_VCF_IE_SWC_VCF_Init_IVDP_VCF_flgHoldModeReq: type=boolean
          Rte_Var_CPT_VCF_TE_SWC_VCF_10ms_IVDP_VCF_CrawlFlg: type=boolean
          Rte_Var_CPT_VCF_TE_SWC_VCF_10ms_IVDP_VCF_CrawlModeReq: type=uint8
          Rte_Var_CPT_VCF_TE_SWC_VCF_10ms_IVDP_VCF_RecCrawlNSetP: type=float32
          Rte_Var_CPT_VCF_TE_SWC_VCF_10ms_IVDP_VCF_RecCrawlTrqSetP: type=float32
          Rte_Var_CPT_VCF_TE_SWC_VCF_10ms_IVDP_VCF_flgHoldModeReq: type=boolean
      848 x bsw called entity, all with sw-addr-method=CODE:
        Rte_ActivateRE: implemented-entry=Rte_ActivateRE
        Rte_COMCbk_BMS01_BattCurr_BMS_01: implemented-entry=Rte_COMCbk_BMS01_BattCurr_BMS_01
        Rte_COMCbk_BMS01_BattVolt_BMS_01: implemented-entry=Rte_COMCbk_BMS01_BattVolt_BMS_01
        Rte_COMCbk_BMS01_stMainRelay_BMS_01: implemented-entry=Rte_COMCbk_BMS01_stMainRelay_BMS_01
        Rte_COMCbk_VCU01_IdcMax_VCU_01: implemented-entry=Rte_COMCbk_VCU01_IdcMax_VCU_01
        Rte_COMCbk_VCU01_IdcMin_VCU_01: implemented-entry=Rte_COMCbk_VCU01_IdcMin_VCU_01
        Rte_COMCbk_VCU01_UdcMax_VCU_01: implemented-entry=Rte_COMCbk_VCU01_UdcMax_VCU_01
        Rte_COMCbk_VCU01_UdcMin_VCU_01: implemented-entry=Rte_COMCbk_VCU01_UdcMin_VCU_01
        Rte_COMCbk_VCU01_stHvbMaiRly_VCU_01: implemented-entry=Rte_COMCbk_VCU01_stHvbMaiRly_VCU_01
        Rte_COMCbk_VCU02_KpHighNCtl_VCU_02: implemented-entry=Rte_COMCbk_VCU02_KpHighNCtl_VCU_02
        Rte_COMCbk_VCU02_KpLowNCtl_VCU_02: implemented-entry=Rte_COMCbk_VCU02_KpLowNCtl_VCU_02
        Rte_COMCbk_VCU02_NDiffMax_VCU_02: implemented-entry=Rte_COMCbk_VCU02_NDiffMax_VCU_02
        Rte_COMCbk_VCU02_TrqMaxNCtl_VCU_02: implemented-entry=Rte_COMCbk_VCU02_TrqMaxNCtl_VCU_02
        Rte_COMCbk_VCU02_TrqMinNCtl_VCU_02: implemented-entry=Rte_COMCbk_VCU02_TrqMinNCtl_VCU_02
        Rte_COMCbk_VCU03_TrqMax_VCU_03: implemented-entry=Rte_COMCbk_VCU03_TrqMax_VCU_03
        Rte_COMCbk_VCU03_TrqMin_VCU_03: implemented-entry=Rte_COMCbk_VCU03_TrqMin_VCU_03
        Rte_COMCbk_VCU03_cTrqSlopeMax_VCU_03: implemented-entry=Rte_COMCbk_VCU03_cTrqSlopeMax_VCU_03
        Rte_COMCbk_VCU04_MotDir_VCU_04: implemented-entry=Rte_COMCbk_VCU04_MotDir_VCU_04
        Rte_COMCbk_VCU04_NSetP_VCU_04: implemented-entry=Rte_COMCbk_VCU04_NSetP_VCU_04
        Rte_COMCbk_VCU04_TrqSetP_VCU_04: implemented-entry=Rte_COMCbk_VCU04_TrqSetP_VCU_04
        Rte_COMCbk_VCU04_bKL15_VCU_04: implemented-entry=Rte_COMCbk_VCU04_bKL15_VCU_04
        Rte_COMCbk_VCU04_stModeReq_VCU_04: implemented-entry=Rte_COMCbk_VCU04_stModeReq_VCU_04
        Rte_COMCbk_VCU05_OfsAl_VCU_05: implemented-entry=Rte_COMCbk_VCU05_OfsAl_VCU_05
        Rte_COMCbk_VCU05_TrqDmpLim_VCU_05: implemented-entry=Rte_COMCbk_VCU05_TrqDmpLim_VCU_05
        Rte_COMCbk_VCU05_TrqDmpMax_VCU_05: implemented-entry=Rte_COMCbk_VCU05_TrqDmpMax_VCU_05
        Rte_COMCbk_VCU05_bSetOfsAl_VCU_05: implemented-entry=Rte_COMCbk_VCU05_bSetOfsAl_VCU_05
        Rte_COMCbk_VCU05_kDmp_VCU_05: implemented-entry=Rte_COMCbk_VCU05_kDmp_VCU_05
        Rte_COMCbk_VCU05_stDmpCtlReq_VCU_05: implemented-entry=Rte_COMCbk_VCU05_stDmpCtlReq_VCU_05
        Rte_COMCbk_VCU06_Park_VCU_06: implemented-entry=Rte_COMCbk_VCU06_Park_VCU_06
        Rte_COMCbk_VCU06_VehGrad_VCU_06: implemented-entry=Rte_COMCbk_VCU06_VehGrad_VCU_06
        Rte_COMCbk_VCU06_stBelt_VCU_06: implemented-entry=Rte_COMCbk_VCU06_stBelt_VCU_06
        Rte_COMCbk_VCU06_stBreak_VCU_06: implemented-entry=Rte_COMCbk_VCU06_stBreak_VCU_06
        Rte_COMCbk_VCU06_stDoor_VCU_06: implemented-entry=Rte_COMCbk_VCU06_stDoor_VCU_06
        Rte_Call_Dcm_RoutineServices_DcmDspRoutine_CheckPgmPreCond_RequestResults: implemented-entry=Rte_Call_Dcm_RoutineServices_DcmDspRoutine_CheckPgmPreCond_RequestResults
        Rte_Call_Dcm_RoutineServices_DcmDspRoutine_CheckPgmPreCond_Start: implemented-entry=Rte_Call_Dcm_RoutineServices_DcmDspRoutine_CheckPgmPreCond_Start
        Rte_Call_Dcm_RoutineServices_DcmDspRoutine_CheckPgmPreCond_Stop: implemented-entry=Rte_Call_Dcm_RoutineServices_DcmDspRoutine_CheckPgmPreCond_Stop
        Rte_Call_Dcm_RoutineServices_DcmDspRoutine_Test_RequestResults: implemented-entry=Rte_Call_Dcm_RoutineServices_DcmDspRoutine_Test_RequestResults
        Rte_Call_Dcm_RoutineServices_DcmDspRoutine_Test_Start: implemented-entry=Rte_Call_Dcm_RoutineServices_DcmDspRoutine_Test_Start
        Rte_Call_Dcm_RoutineServices_DcmDspRoutine_Test_Stop: implemented-entry=Rte_Call_Dcm_RoutineServices_DcmDspRoutine_Test_Stop
        Rte_Call_Dcm_SecurityAccess_DSP_SEC_LEV_L1_CompareKey: implemented-entry=Rte_Call_Dcm_SecurityAccess_DSP_SEC_LEV_L1_CompareKey
        Rte_Call_Dcm_SecurityAccess_DSP_SEC_LEV_L1_GetSeed: implemented-entry=Rte_Call_Dcm_SecurityAccess_DSP_SEC_LEV_L1_GetSeed
        Rte_Call_Dcm_SecurityAccess_DSP_SEC_LEV_L2_CompareKey: implemented-entry=Rte_Call_Dcm_SecurityAccess_DSP_SEC_LEV_L2_CompareKey
        Rte_Call_Dcm_SecurityAccess_DSP_SEC_LEV_L2_GetSeed: implemented-entry=Rte_Call_Dcm_SecurityAccess_DSP_SEC_LEV_L2_GetSeed
        Rte_Call_Dcm_SecurityAccess_DSP_SEC_LEV_L3_CompareKey: implemented-entry=Rte_Call_Dcm_SecurityAccess_DSP_SEC_LEV_L3_CompareKey
        Rte_Call_Dcm_SecurityAccess_DSP_SEC_LEV_L3_GetSeed: implemented-entry=Rte_Call_Dcm_SecurityAccess_DSP_SEC_LEV_L3_GetSeed
        Rte_Call_Dcm_SecurityAccess_DSP_SEC_LEV_L4_CompareKey: implemented-entry=Rte_Call_Dcm_SecurityAccess_DSP_SEC_LEV_L4_CompareKey
        Rte_Call_Dcm_SecurityAccess_DSP_SEC_LEV_L4_GetSeed: implemented-entry=Rte_Call_Dcm_SecurityAccess_DSP_SEC_LEV_L4_GetSeed
        Rte_Call_Dem_CBStatusComp_DemComponent_BusOff1_ComponentStatusChanged: implemented-entry=Rte_Call_Dem_CBStatusComp_DemComponent_BusOff1_ComponentStatusChanged
        Rte_Call_Dem_CBStatusComp_DemComponent_BusOff2_ComponentStatusChanged: implemented-entry=Rte_Call_Dem_CBStatusComp_DemComponent_BusOff2_ComponentStatusChanged
        Rte_Call_Dem_CBStatusComp_DemComponent_BusOff_ComponentStatusChanged: implemented-entry=Rte_Call_Dem_CBStatusComp_DemComponent_BusOff_ComponentStatusChanged
        Rte_Call_Dem_CBStatusComp_DemComponent_MCAL_Status_ComponentStatusChanged: implemented-entry=Rte_Call_Dem_CBStatusComp_DemComponent_MCAL_Status_ComponentStatusChanged
        Rte_Call_Dem_CBStatusComp_DemComponent_MCU_Status_ComponentStatusChanged: implemented-entry=Rte_Call_Dem_CBStatusComp_DemComponent_MCU_Status_ComponentStatusChanged
        Rte_Call_Dem_CBStatusComp_DemComponent_MPDU_CommStatus_ComponentStatusChanged: implemented-entry=Rte_Call_Dem_CBStatusComp_DemComponent_MPDU_CommStatus_ComponentStatusChanged
        Rte_Call_Dem_CBStatusComp_DemComponent_NvM_ReadErr_ComponentStatusChanged: implemented-entry=Rte_Call_Dem_CBStatusComp_DemComponent_NvM_ReadErr_ComponentStatusChanged
        Rte_Call_Dem_CBStatusComp_DemComponent_NvM_WriteErr_ComponentStatusChanged: implemented-entry=Rte_Call_Dem_CBStatusComp_DemComponent_NvM_WriteErr_ComponentStatusChanged
        Rte_Call_Dem_CBStatusComp_DemComponent_SEN_1_CommStatus_ComponentStatusChanged: implemented-entry=Rte_Call_Dem_CBStatusComp_DemComponent_SEN_1_CommStatus_ComponentStatusChanged
        Rte_Call_Dem_CBStatusComp_DemComponent_SEN_CommStatus_ComponentStatusChanged: implemented-entry=Rte_Call_Dem_CBStatusComp_DemComponent_SEN_CommStatus_ComponentStatusChanged
        Rte_Call_Dem_CBStatusComp_DemComponent_VCU_DC01_AliveCounter_ComponentStatusChanged: implemented-entry=Rte_Call_Dem_CBStatusComp_DemComponent_VCU_DC01_AliveCounter_ComponentStatusChanged
        Rte_Call_Dem_CBStatusComp_DemComponent_VCU_DC01_CheckSum_ComponentStatusChanged: implemented-entry=Rte_Call_Dem_CBStatusComp_DemComponent_VCU_DC01_CheckSum_ComponentStatusChanged
        Rte_Call_Dem_CBStatusComp_DemComponent_VCU_DC01_DLC_ComponentStatusChanged: implemented-entry=Rte_Call_Dem_CBStatusComp_DemComponent_VCU_DC01_DLC_ComponentStatusChanged
        Rte_Call_Dem_CBStatusComp_DemComponent_VCU_DC01_Tiout_ComponentStatusChanged: implemented-entry=Rte_Call_Dem_CBStatusComp_DemComponent_VCU_DC01_Tiout_ComponentStatusChanged
        Rte_Call_Diag_SWC_RPort_ControlDTCSuppression_SetDTCSuppression: implemented-entry=Rte_Call_Diag_SWC_RPort_ControlDTCSuppression_SetDTCSuppression
        Rte_Call_Diag_SWC_RPort_DCMServices_GetActiveProtocol: implemented-entry=Rte_Call_Diag_SWC_RPort_DCMServices_GetActiveProtocol
        Rte_Call_Diag_SWC_RPort_DCMServices_GetSecurityLevel: implemented-entry=Rte_Call_Diag_SWC_RPort_DCMServices_GetSecurityLevel
        Rte_Call_Diag_SWC_RPort_DCMServices_GetSesCtrlType: implemented-entry=Rte_Call_Diag_SWC_RPort_DCMServices_GetSesCtrlType
        Rte_Call_Diag_SWC_RPort_DCMServices_ResetToDefaultSession: implemented-entry=Rte_Call_Diag_SWC_RPort_DCMServices_ResetToDefaultSession
        Rte_Call_Diag_SWC_RPort_EcuMSelectResetTarget_SelectShutdownTarget: implemented-entry=Rte_Call_Diag_SWC_RPort_EcuMSelectResetTarget_SelectShutdownTarget
        Rte_Call_Diag_SWC_RPort_Event_Event_LostComm_MPDU_ClearPrestoredFreezeFrame: implemented-entry=Rte_Call_Diag_SWC_RPort_Event_Event_LostComm_MPDU_ClearPrestoredFreezeFrame
        Rte_Call_Diag_SWC_RPort_Event_Event_LostComm_MPDU_PrestoreFreezeFrame: implemented-entry=Rte_Call_Diag_SWC_RPort_Event_Event_LostComm_MPDU_PrestoreFreezeFrame
        Rte_Call_Diag_SWC_RPort_Event_Event_LostComm_MPDU_ResetEventStatus: implemented-entry=Rte_Call_Diag_SWC_RPort_Event_Event_LostComm_MPDU_ResetEventStatus
        Rte_Call_Diag_SWC_RPort_Event_Event_LostComm_MPDU_SetEventStatus: implemented-entry=Rte_Call_Diag_SWC_RPort_Event_Event_LostComm_MPDU_SetEventStatus
        Rte_Call_Diag_SWC_RPort_Event_Event_LostComm_SEN_1_ClearPrestoredFreezeFrame: implemented-entry=Rte_Call_Diag_SWC_RPort_Event_Event_LostComm_SEN_1_ClearPrestoredFreezeFrame
        Rte_Call_Diag_SWC_RPort_Event_Event_LostComm_SEN_1_PrestoreFreezeFrame: implemented-entry=Rte_Call_Diag_SWC_RPort_Event_Event_LostComm_SEN_1_PrestoreFreezeFrame
        Rte_Call_Diag_SWC_RPort_Event_Event_LostComm_SEN_1_ResetEventStatus: implemented-entry=Rte_Call_Diag_SWC_RPort_Event_Event_LostComm_SEN_1_ResetEventStatus
        Rte_Call_Diag_SWC_RPort_Event_Event_LostComm_SEN_1_SetEventStatus: implemented-entry=Rte_Call_Diag_SWC_RPort_Event_Event_LostComm_SEN_1_SetEventStatus
        Rte_Call_Diag_SWC_RPort_Event_Event_LostComm_SEN_ClearPrestoredFreezeFrame: implemented-entry=Rte_Call_Diag_SWC_RPort_Event_Event_LostComm_SEN_ClearPrestoredFreezeFrame
        Rte_Call_Diag_SWC_RPort_Event_Event_LostComm_SEN_PrestoreFreezeFrame: implemented-entry=Rte_Call_Diag_SWC_RPort_Event_Event_LostComm_SEN_PrestoreFreezeFrame
        Rte_Call_Diag_SWC_RPort_Event_Event_LostComm_SEN_ResetEventStatus: implemented-entry=Rte_Call_Diag_SWC_RPort_Event_Event_LostComm_SEN_ResetEventStatus
        Rte_Call_Diag_SWC_RPort_Event_Event_LostComm_SEN_SetEventStatus: implemented-entry=Rte_Call_Diag_SWC_RPort_Event_Event_LostComm_SEN_SetEventStatus
        Rte_Call_Diag_SWC_RPort_EvtInfo_Event_LostComm_MPDU_GetDTCOfEvent: implemented-entry=Rte_Call_Diag_SWC_RPort_EvtInfo_Event_LostComm_MPDU_GetDTCOfEvent
        Rte_Call_Diag_SWC_RPort_EvtInfo_Event_LostComm_MPDU_GetEventFailed: implemented-entry=Rte_Call_Diag_SWC_RPort_EvtInfo_Event_LostComm_MPDU_GetEventFailed
        Rte_Call_Diag_SWC_RPort_EvtInfo_Event_LostComm_MPDU_GetEventStatus: implemented-entry=Rte_Call_Diag_SWC_RPort_EvtInfo_Event_LostComm_MPDU_GetEventStatus
        Rte_Call_Diag_SWC_RPort_EvtInfo_Event_LostComm_MPDU_GetEventTested: implemented-entry=Rte_Call_Diag_SWC_RPort_EvtInfo_Event_LostComm_MPDU_GetEventTested
        Rte_Call_Diag_SWC_RPort_EvtInfo_Event_LostComm_MPDU_GetFaultDetectionCounter: implemented-entry=Rte_Call_Diag_SWC_RPort_EvtInfo_Event_LostComm_MPDU_GetFaultDetectionCounter
        Rte_Call_Diag_SWC_RPort_EvtInfo_Event_LostComm_SEN_1_GetDTCOfEvent: implemented-entry=Rte_Call_Diag_SWC_RPort_EvtInfo_Event_LostComm_SEN_1_GetDTCOfEvent
        Rte_Call_Diag_SWC_RPort_EvtInfo_Event_LostComm_SEN_1_GetEventFailed: implemented-entry=Rte_Call_Diag_SWC_RPort_EvtInfo_Event_LostComm_SEN_1_GetEventFailed
        Rte_Call_Diag_SWC_RPort_EvtInfo_Event_LostComm_SEN_1_GetEventStatus: implemented-entry=Rte_Call_Diag_SWC_RPort_EvtInfo_Event_LostComm_SEN_1_GetEventStatus
        Rte_Call_Diag_SWC_RPort_EvtInfo_Event_LostComm_SEN_1_GetEventTested: implemented-entry=Rte_Call_Diag_SWC_RPort_EvtInfo_Event_LostComm_SEN_1_GetEventTested
        Rte_Call_Diag_SWC_RPort_EvtInfo_Event_LostComm_SEN_1_GetFaultDetectionCounter: implemented-entry=Rte_Call_Diag_SWC_RPort_EvtInfo_Event_LostComm_SEN_1_GetFaultDetectionCounter
        Rte_Call_Diag_SWC_RPort_EvtInfo_Event_LostComm_SEN_GetDTCOfEvent: implemented-entry=Rte_Call_Diag_SWC_RPort_EvtInfo_Event_LostComm_SEN_GetDTCOfEvent
        Rte_Call_Diag_SWC_RPort_EvtInfo_Event_LostComm_SEN_GetEventFailed: implemented-entry=Rte_Call_Diag_SWC_RPort_EvtInfo_Event_LostComm_SEN_GetEventFailed
        Rte_Call_Diag_SWC_RPort_EvtInfo_Event_LostComm_SEN_GetEventStatus: implemented-entry=Rte_Call_Diag_SWC_RPort_EvtInfo_Event_LostComm_SEN_GetEventStatus
        Rte_Call_Diag_SWC_RPort_EvtInfo_Event_LostComm_SEN_GetEventTested: implemented-entry=Rte_Call_Diag_SWC_RPort_EvtInfo_Event_LostComm_SEN_GetEventTested
        Rte_Call_Diag_SWC_RPort_EvtInfo_Event_LostComm_SEN_GetFaultDetectionCounter: implemented-entry=Rte_Call_Diag_SWC_RPort_EvtInfo_Event_LostComm_SEN_GetFaultDetectionCounter
        Rte_Call_Diag_SWC_RPort_FiMFID_0_GetFunctionPermission: implemented-entry=Rte_Call_Diag_SWC_RPort_FiMFID_0_GetFunctionPermission
        Rte_Call_Diag_SWC_RPort_OpCycle_DemOperationCycle_0_SetOperationCycleState: implemented-entry=Rte_Call_Diag_SWC_RPort_OpCycle_DemOperationCycle_0_SetOperationCycleState
        Rte_Call_NvM_SWC_RPort_NvM_SWC_BlockNative_1024_EraseBlock: implemented-entry=Rte_Call_NvM_SWC_RPort_NvM_SWC_BlockNative_1024_EraseBlock
        Rte_Call_NvM_SWC_RPort_NvM_SWC_BlockNative_1024_GetDataIndex: implemented-entry=Rte_Call_NvM_SWC_RPort_NvM_SWC_BlockNative_1024_GetDataIndex
        Rte_Call_NvM_SWC_RPort_NvM_SWC_BlockNative_1024_GetErrorStatus: implemented-entry=Rte_Call_NvM_SWC_RPort_NvM_SWC_BlockNative_1024_GetErrorStatus
        Rte_Call_NvM_SWC_RPort_NvM_SWC_BlockNative_1024_InvalidateNvBlock: implemented-entry=Rte_Call_NvM_SWC_RPort_NvM_SWC_BlockNative_1024_InvalidateNvBlock
        Rte_Call_NvM_SWC_RPort_NvM_SWC_BlockNative_1024_ReadBlock: implemented-entry=Rte_Call_NvM_SWC_RPort_NvM_SWC_BlockNative_1024_ReadBlock
        Rte_Call_NvM_SWC_RPort_NvM_SWC_BlockNative_1024_RestoreBlockDefaults: implemented-entry=Rte_Call_NvM_SWC_RPort_NvM_SWC_BlockNative_1024_RestoreBlockDefaults
        Rte_Call_NvM_SWC_RPort_NvM_SWC_BlockNative_1024_SetDataIndex: implemented-entry=Rte_Call_NvM_SWC_RPort_NvM_SWC_BlockNative_1024_SetDataIndex
        Rte_Call_NvM_SWC_RPort_NvM_SWC_BlockNative_1024_SetRamBlockStatus: implemented-entry=Rte_Call_NvM_SWC_RPort_NvM_SWC_BlockNative_1024_SetRamBlockStatus
        Rte_Call_NvM_SWC_RPort_NvM_SWC_BlockNative_1024_WriteBlock: implemented-entry=Rte_Call_NvM_SWC_RPort_NvM_SWC_BlockNative_1024_WriteBlock
        Rte_Call_NvM_SWC_RPort_NvM_SWC_BlockRedundant_1024_EraseBlock: implemented-entry=Rte_Call_NvM_SWC_RPort_NvM_SWC_BlockRedundant_1024_EraseBlock
        Rte_Call_NvM_SWC_RPort_NvM_SWC_BlockRedundant_1024_GetDataIndex: implemented-entry=Rte_Call_NvM_SWC_RPort_NvM_SWC_BlockRedundant_1024_GetDataIndex
        Rte_Call_NvM_SWC_RPort_NvM_SWC_BlockRedundant_1024_GetErrorStatus: implemented-entry=Rte_Call_NvM_SWC_RPort_NvM_SWC_BlockRedundant_1024_GetErrorStatus
        Rte_Call_NvM_SWC_RPort_NvM_SWC_BlockRedundant_1024_InvalidateNvBlock: implemented-entry=Rte_Call_NvM_SWC_RPort_NvM_SWC_BlockRedundant_1024_InvalidateNvBlock
        Rte_Call_NvM_SWC_RPort_NvM_SWC_BlockRedundant_1024_ReadBlock: implemented-entry=Rte_Call_NvM_SWC_RPort_NvM_SWC_BlockRedundant_1024_ReadBlock
        Rte_Call_NvM_SWC_RPort_NvM_SWC_BlockRedundant_1024_RestoreBlockDefaults: implemented-entry=Rte_Call_NvM_SWC_RPort_NvM_SWC_BlockRedundant_1024_RestoreBlockDefaults
        Rte_Call_NvM_SWC_RPort_NvM_SWC_BlockRedundant_1024_SetDataIndex: implemented-entry=Rte_Call_NvM_SWC_RPort_NvM_SWC_BlockRedundant_1024_SetDataIndex
        Rte_Call_NvM_SWC_RPort_NvM_SWC_BlockRedundant_1024_SetRamBlockStatus: implemented-entry=Rte_Call_NvM_SWC_RPort_NvM_SWC_BlockRedundant_1024_SetRamBlockStatus
        Rte_Call_NvM_SWC_RPort_NvM_SWC_BlockRedundant_1024_WriteBlock: implemented-entry=Rte_Call_NvM_SWC_RPort_NvM_SWC_BlockRedundant_1024_WriteBlock
        Rte_Call_NvM_SWC_RPort_ShutdownTarget_GetLastShutdownTarget: implemented-entry=Rte_Call_NvM_SWC_RPort_ShutdownTarget_GetLastShutdownTarget
        Rte_Call_NvM_SWC_RPort_ShutdownTarget_GetShutdownCause: implemented-entry=Rte_Call_NvM_SWC_RPort_ShutdownTarget_GetShutdownCause
        Rte_Call_NvM_SWC_RPort_ShutdownTarget_GetShutdownTarget: implemented-entry=Rte_Call_NvM_SWC_RPort_ShutdownTarget_GetShutdownTarget
        Rte_Call_NvM_SWC_RPort_ShutdownTarget_SelectShutdownCause: implemented-entry=Rte_Call_NvM_SWC_RPort_ShutdownTarget_SelectShutdownCause
        Rte_Call_NvM_SWC_RPort_ShutdownTarget_SelectShutdownTarget: implemented-entry=Rte_Call_NvM_SWC_RPort_ShutdownTarget_SelectShutdownTarget
        Rte_Call_SWC_CSPF_RP_SWC_IoHwAb_ADC_BSW_HwVer_IoHwAb_ADC_GetPhyVoltage: implemented-entry=Rte_Call_SWC_CSPF_RP_SWC_IoHwAb_ADC_BSW_HwVer_IoHwAb_ADC_GetPhyVoltage
        Rte_Call_SWC_HSPF_RP_SWC_DEM_HSPF_VerMatchFailureFail_SetEventStatus: implemented-entry=Rte_Call_SWC_HSPF_RP_SWC_DEM_HSPF_VerMatchFailureFail_SetEventStatus
        Rte_Call_SWC_HSPF_RP_SWC_Dem_HSPF_InvOpenFail_SetEventStatus: implemented-entry=Rte_Call_SWC_HSPF_RP_SWC_Dem_HSPF_InvOpenFail_SetEventStatus
        Rte_Call_SWC_HSPF_RP_SWC_Dem_HSPF_IphaOffCalFail_SetEventStatus: implemented-entry=Rte_Call_SWC_HSPF_RP_SWC_Dem_HSPF_IphaOffCalFail_SetEventStatus
        Rte_Call_SWC_HSPF_RP_SWC_Dem_HSPF_MotorOpenFail_SetEventStatus: implemented-entry=Rte_Call_SWC_HSPF_RP_SWC_Dem_HSPF_MotorOpenFail_SetEventStatus
        Rte_Call_SWC_HSPF_RP_SWC_Dem_HSPF_tDBCTempCmpFail_SetEventStatus: implemented-entry=Rte_Call_SWC_HSPF_RP_SWC_Dem_HSPF_tDBCTempCmpFail_SetEventStatus
        Rte_Call_SWC_HSPF_RP_SWC_FIM_HSPF_Sttr1Err_GetFunctionPermission: implemented-entry=Rte_Call_SWC_HSPF_RP_SWC_FIM_HSPF_Sttr1Err_GetFunctionPermission
        Rte_Call_SWC_HSPF_RP_SWC_FIM_HSPF_Sttr2Err_GetFunctionPermission: implemented-entry=Rte_Call_SWC_HSPF_RP_SWC_FIM_HSPF_Sttr2Err_GetFunctionPermission
        Rte_Call_SWC_HSPF_RP_SWC_FIM_HSPF_tDBCTempCmpErr_GetFunctionPermission: implemented-entry=Rte_Call_SWC_HSPF_RP_SWC_FIM_HSPF_tDBCTempCmpErr_GetFunctionPermission
        Rte_Call_SWC_HSPF_RP_SWC_IoHwAb_ADC_BSW_HwVer_IoHwAb_ADC_GetPhyVoltage: implemented-entry=Rte_Call_SWC_HSPF_RP_SWC_IoHwAb_ADC_BSW_HwVer_IoHwAb_ADC_GetPhyVoltage
        Rte_Call_SWC_HSPF_RP_SWC_IoHwAb_ADC_BSW_tCoolantTemp_IoHwAb_ADC_GetPhyVoltage: implemented-entry=Rte_Call_SWC_HSPF_RP_SWC_IoHwAb_ADC_BSW_tCoolantTemp_IoHwAb_ADC_GetPhyVoltage
        Rte_Call_SWC_HSPF_RP_SWC_IoHwAb_ADC_BSW_tStrrTemp1_IoHwAb_ADC_GetPhyVoltage: implemented-entry=Rte_Call_SWC_HSPF_RP_SWC_IoHwAb_ADC_BSW_tStrrTemp1_IoHwAb_ADC_GetPhyVoltage
        Rte_Call_SWC_HSPF_RP_SWC_IoHwAb_ADC_BSW_tStrrTemp2_IoHwAb_ADC_GetPhyVoltage: implemented-entry=Rte_Call_SWC_HSPF_RP_SWC_IoHwAb_ADC_BSW_tStrrTemp2_IoHwAb_ADC_GetPhyVoltage
        Rte_Call_SWC_HSPF_RP_SWC_IoHwAb_ADC_BSW_uKl30_IoHwAb_ADC_GetPhyVoltage: implemented-entry=Rte_Call_SWC_HSPF_RP_SWC_IoHwAb_ADC_BSW_uKl30_IoHwAb_ADC_GetPhyVoltage
        Rte_Call_SWC_HSPF_RP_SWC_IoHwAb_DIO_Get_BSW_Wake_IoHwAb_DIO_Get: implemented-entry=Rte_Call_SWC_HSPF_RP_SWC_IoHwAb_DIO_Get_BSW_Wake_IoHwAb_DIO_Get
        Rte_Call_SWC_HSPF_RP_SWC_IoHwAb_DIO_Get_BSW_bt15_IoHwAb_DIO_Get: implemented-entry=Rte_Call_SWC_HSPF_RP_SWC_IoHwAb_DIO_Get_BSW_bt15_IoHwAb_DIO_Get
        Rte_Call_SWC_HSPF_RP_SWC_IoHwAb_DIO_Get_BSW_flgCrash_IoHwAb_DIO_Get: implemented-entry=Rte_Call_SWC_HSPF_RP_SWC_IoHwAb_DIO_Get_BSW_flgCrash_IoHwAb_DIO_Get
        Rte_Call_SWC_HSPF_RP_SWC_IoHwAb_DIO_Get_BSW_flgMcuOpen_IoHwAb_DIO_Get: implemented-entry=Rte_Call_SWC_HSPF_RP_SWC_IoHwAb_DIO_Get_BSW_flgMcuOpen_IoHwAb_DIO_Get
        Rte_Call_SWC_HSPF_RP_SWC_IoHwAb_DIO_Get_BSW_flgMotorOpen_IoHwAb_DIO_Get: implemented-entry=Rte_Call_SWC_HSPF_RP_SWC_IoHwAb_DIO_Get_BSW_flgMotorOpen_IoHwAb_DIO_Get
        Rte_Call_SWC_HSPF_RP_SWC_IoHwAb_DIO_Set_HSPF_flgSwtTSttr1_IoHwAb_DIO_Set: implemented-entry=Rte_Call_SWC_HSPF_RP_SWC_IoHwAb_DIO_Set_HSPF_flgSwtTSttr1_IoHwAb_DIO_Set
        Rte_Call_SWC_HSPF_RP_SWC_IoHwAb_DIO_Set_HSPF_flgSwtTSttr2_IoHwAb_DIO_Set: implemented-entry=Rte_Call_SWC_HSPF_RP_SWC_IoHwAb_DIO_Set_HSPF_flgSwtTSttr2_IoHwAb_DIO_Set
        Rte_Call_SWC_MDF_RP_SWC_Dem_MDF_AlOfsNoPlausFail_SetEventStatus: implemented-entry=Rte_Call_SWC_MDF_RP_SWC_Dem_MDF_AlOfsNoPlausFail_SetEventStatus
        Rte_Call_SWC_MDF_RP_SWC_Dem_MDF_DiashCirNoPsblFail_SetEventStatus: implemented-entry=Rte_Call_SWC_MDF_RP_SWC_Dem_MDF_DiashCirNoPsblFail_SetEventStatus
        Rte_Call_SWC_MDF_RP_SWC_Dem_MDF_EmacBlkdFail_SetEventStatus: implemented-entry=Rte_Call_SWC_MDF_RP_SWC_Dem_MDF_EmacBlkdFail_SetEventStatus
        Rte_Call_SWC_MDF_RP_SWC_Dem_MDF_EmacBlkdWarn_SetEventStatus: implemented-entry=Rte_Call_SWC_MDF_RP_SWC_Dem_MDF_EmacBlkdWarn_SetEventStatus
        Rte_Call_SWC_MDF_RP_SWC_Dem_MDF_ICtlRatFail_SetEventStatus: implemented-entry=Rte_Call_SWC_MDF_RP_SWC_Dem_MDF_ICtlRatFail_SetEventStatus
        Rte_Call_SWC_MDF_RP_SWC_Dem_MDF_IsOvHiFail_SetEventStatus: implemented-entry=Rte_Call_SWC_MDF_RP_SWC_Dem_MDF_IsOvHiFail_SetEventStatus
        Rte_Call_SWC_MDF_RP_SWC_Dem_MDF_OpenCirNoPsblFail_SetEventStatus: implemented-entry=Rte_Call_SWC_MDF_RP_SWC_Dem_MDF_OpenCirNoPsblFail_SetEventStatus
        Rte_Call_SWC_MDF_RP_SWC_Dem_MDF_OperOutdRngFail_SetEventStatus: implemented-entry=Rte_Call_SWC_MDF_RP_SWC_Dem_MDF_OperOutdRngFail_SetEventStatus
        Rte_Call_SWC_MDF_RP_SWC_Dem_MDF_PhaseLossFaultFail_SetEventStatus: implemented-entry=Rte_Call_SWC_MDF_RP_SWC_Dem_MDF_PhaseLossFaultFail_SetEventStatus
        Rte_Call_SWC_MDF_RP_SWC_Dem_MDF_PrfElDrvFail_SetEventStatus: implemented-entry=Rte_Call_SWC_MDF_RP_SWC_Dem_MDF_PrfElDrvFail_SetEventStatus
        Rte_Call_SWC_MDF_RP_SWC_FIM_MDFIsOvHiErr_GetFunctionPermission: implemented-entry=Rte_Call_SWC_MDF_RP_SWC_FIM_MDFIsOvHiErr_GetFunctionPermission
        Rte_Call_SWC_MDF_RP_SWC_FIM_MDF_AlOfsNoPlausErr_GetFunctionPermission: implemented-entry=Rte_Call_SWC_MDF_RP_SWC_FIM_MDF_AlOfsNoPlausErr_GetFunctionPermission
        Rte_Call_SWC_MDF_RP_SWC_FIM_MDF_DiagPrfChkElecDt_GetFunctionPermission: implemented-entry=Rte_Call_SWC_MDF_RP_SWC_FIM_MDF_DiagPrfChkElecDt_GetFunctionPermission
        Rte_Call_SWC_MDF_RP_SWC_FIM_MDF_DiashCirNoPsblErr_GetFunctionPermission: implemented-entry=Rte_Call_SWC_MDF_RP_SWC_FIM_MDF_DiashCirNoPsblErr_GetFunctionPermission
        Rte_Call_SWC_MDF_RP_SWC_FIM_MDF_EmacBlkdWarn_GetFunctionPermission: implemented-entry=Rte_Call_SWC_MDF_RP_SWC_FIM_MDF_EmacBlkdWarn_GetFunctionPermission
        Rte_Call_SWC_MDF_RP_SWC_FIM_MDF_IctlRat_GetFunctionPermission: implemented-entry=Rte_Call_SWC_MDF_RP_SWC_FIM_MDF_IctlRat_GetFunctionPermission
        Rte_Call_SWC_MDF_RP_SWC_FIM_MDF_OpenCirNoPsblErr_GetFunctionPermission: implemented-entry=Rte_Call_SWC_MDF_RP_SWC_FIM_MDF_OpenCirNoPsblErr_GetFunctionPermission
        Rte_Call_SWC_MDF_RP_SWC_FIM_MDF_OperOutdRngErr_GetFunctionPermission: implemented-entry=Rte_Call_SWC_MDF_RP_SWC_FIM_MDF_OperOutdRngErr_GetFunctionPermission
        Rte_Call_SWC_MDF_RP_SWC_FIM_MDF_PhaseLossFaultErr_GetFunctionPermission: implemented-entry=Rte_Call_SWC_MDF_RP_SWC_FIM_MDF_PhaseLossFaultErr_GetFunctionPermission
        Rte_Call_SWC_PCF_RP_SWC_Dem_PCF_ActOvTiErr_SetEventStatus: implemented-entry=Rte_Call_SWC_PCF_RP_SWC_Dem_PCF_ActOvTiErr_SetEventStatus
        Rte_Call_SWC_PCF_RP_SWC_Dem_PCF_IdcOvErr_SetEventStatus: implemented-entry=Rte_Call_SWC_PCF_RP_SWC_Dem_PCF_IdcOvErr_SetEventStatus
        Rte_Call_SWC_PCF_RP_SWC_Dem_PCF_SelfcheckErr_SetEventStatus: implemented-entry=Rte_Call_SWC_PCF_RP_SWC_Dem_PCF_SelfcheckErr_SetEventStatus
        Rte_Call_SWC_PCF_RP_SWC_Dem_PCF_SenClbErr_SetEventStatus: implemented-entry=Rte_Call_SWC_PCF_RP_SWC_Dem_PCF_SenClbErr_SetEventStatus
        Rte_Call_SWC_PCF_RP_SWC_Dem_PCF_SenOvErr_SetEventStatus: implemented-entry=Rte_Call_SWC_PCF_RP_SWC_Dem_PCF_SenOvErr_SetEventStatus
        Rte_Call_SWC_PCF_RP_SWC_Dem_PCF_StallRetryErr_SetEventStatus: implemented-entry=Rte_Call_SWC_PCF_RP_SWC_Dem_PCF_StallRetryErr_SetEventStatus
        Rte_Call_SWC_PCF_RP_SWC_Dem_PCF_StallWarn_SetEventStatus: implemented-entry=Rte_Call_SWC_PCF_RP_SWC_Dem_PCF_StallWarn_SetEventStatus
        Rte_Call_SWC_PCF_RP_SWC_Dem_PCF_UnexpPosErr_SetEventStatus: implemented-entry=Rte_Call_SWC_PCF_RP_SWC_Dem_PCF_UnexpPosErr_SetEventStatus
        Rte_Call_SWC_PCF_RP_SWC_IoHwAb_ADC_BSW_IUBPCF_IoHwAb_ADC_GetPhyVoltage: implemented-entry=Rte_Call_SWC_PCF_RP_SWC_IoHwAb_ADC_BSW_IUBPCF_IoHwAb_ADC_GetPhyVoltage
        Rte_Call_SWC_PCF_RP_SWC_IoHwAb_ADC_BSW_UBRPCF_IoHwAb_ADC_GetPhyVoltage: implemented-entry=Rte_Call_SWC_PCF_RP_SWC_IoHwAb_ADC_BSW_UBRPCF_IoHwAb_ADC_GetPhyVoltage
        Rte_Call_SWC_PCF_RP_SWC_IoHwAb_ADC_BSW_VDD5PCF_IoHwAb_ADC_GetPhyVoltage: implemented-entry=Rte_Call_SWC_PCF_RP_SWC_IoHwAb_ADC_BSW_VDD5PCF_IoHwAb_ADC_GetPhyVoltage
        Rte_Call_SWC_PCF_RP_SWC_IoHwAb_ADC_BSW_tEpc_IoHwAb_ADC_GetPhyVoltage: implemented-entry=Rte_Call_SWC_PCF_RP_SWC_IoHwAb_ADC_BSW_tEpc_IoHwAb_ADC_GetPhyVoltage
        Rte_Call_SWC_PCF_RP_SWC_IoHwAb_DIO_Get_BSW_EnPcfEFUSE_IoHwAb_DIO_Get: implemented-entry=Rte_Call_SWC_PCF_RP_SWC_IoHwAb_DIO_Get_BSW_EnPcfEFUSE_IoHwAb_DIO_Get
        Rte_Call_SWC_PCF_RP_SWC_IoHwAb_DIO_Get_BSW_ParkHard_IoHwAb_DIO_Get: implemented-entry=Rte_Call_SWC_PCF_RP_SWC_IoHwAb_DIO_Get_BSW_ParkHard_IoHwAb_DIO_Get
        Rte_Call_SWC_PCF_RP_SWC_IoHwAb_DIO_Get_BSW_bt15_IoHwAb_DIO_Get: implemented-entry=Rte_Call_SWC_PCF_RP_SWC_IoHwAb_DIO_Get_BSW_bt15_IoHwAb_DIO_Get
        Rte_Call_SWC_PCF_RP_SWC_IoHwAb_DIO_Get_BSW_flgPcfOc_IoHwAb_DIO_Get: implemented-entry=Rte_Call_SWC_PCF_RP_SWC_IoHwAb_DIO_Get_BSW_flgPcfOc_IoHwAb_DIO_Get
        Rte_Call_SWC_PCF_RP_SWC_IoHwAb_DIO_Set_PCF_enMos_IoHwAb_DIO_Set: implemented-entry=Rte_Call_SWC_PCF_RP_SWC_IoHwAb_DIO_Set_PCF_enMos_IoHwAb_DIO_Set
        Rte_Call_SWC_RCF_RP_SWC_DEM_RCF_AccOvTiErr_SetEventStatus: implemented-entry=Rte_Call_SWC_RCF_RP_SWC_DEM_RCF_AccOvTiErr_SetEventStatus
        Rte_Call_SWC_RCF_RP_SWC_DEM_RCF_EstOfsErr_SetEventStatus: implemented-entry=Rte_Call_SWC_RCF_RP_SWC_DEM_RCF_EstOfsErr_SetEventStatus
        Rte_Call_SWC_RCF_RP_SWC_DEM_RCF_FwlBwdOvTiErr_SetEventStatus: implemented-entry=Rte_Call_SWC_RCF_RP_SWC_DEM_RCF_FwlBwdOvTiErr_SetEventStatus
        Rte_Call_SWC_RCF_RP_SWC_DEM_RCF_FwlFwdOvTiErr_SetEventStatus: implemented-entry=Rte_Call_SWC_RCF_RP_SWC_DEM_RCF_FwlFwdOvTiErr_SetEventStatus
        Rte_Call_SWC_RCF_RP_SWC_DEM_RCF_OfsClbFailErr_SetEventStatus: implemented-entry=Rte_Call_SWC_RCF_RP_SWC_DEM_RCF_OfsClbFailErr_SetEventStatus
        Rte_Call_SWC_RCF_RP_SWC_DEM_RCF_PsiOvErr_SetEventStatus: implemented-entry=Rte_Call_SWC_RCF_RP_SWC_DEM_RCF_PsiOvErr_SetEventStatus
        Rte_Call_SWC_SCF_RP_SWC_DEM_SCF_DisChgOvTiFail_SetEventStatus: implemented-entry=Rte_Call_SWC_SCF_RP_SWC_DEM_SCF_DisChgOvTiFail_SetEventStatus
        Rte_Call_SWC_SCF_RP_SWC_DEM_SCF_LowPwrShtDwnOvTiFail_SetEventStatus: implemented-entry=Rte_Call_SWC_SCF_RP_SWC_DEM_SCF_LowPwrShtDwnOvTiFail_SetEventStatus
        Rte_Call_SWC_SCF_RP_SWC_DEM_SCF_RunToDisChaFail_SetEventStatus: implemented-entry=Rte_Call_SWC_SCF_RP_SWC_DEM_SCF_RunToDisChaFail_SetEventStatus
        Rte_Call_SWC_SCF_RP_SWC_FIM_FiM_FlagforFR_GetFunctionPermission: implemented-entry=Rte_Call_SWC_SCF_RP_SWC_FIM_FiM_FlagforFR_GetFunctionPermission
        Rte_Call_SWC_SCF_RP_SWC_FIM_ReqFailrMod_GetFunctionPermission: implemented-entry=Rte_Call_SWC_SCF_RP_SWC_FIM_ReqFailrMod_GetFunctionPermission
        Rte_Call_SWC_SCF_RP_SWC_FIM_VCUComTimeOut_GetFunctionPermission: implemented-entry=Rte_Call_SWC_SCF_RP_SWC_FIM_VCUComTimeOut_GetFunctionPermission
        Rte_Call_SWC_SCF_RP_SWC_FIM_flgDchaFailr_GetFunctionPermission: implemented-entry=Rte_Call_SWC_SCF_RP_SWC_FIM_flgDchaFailr_GetFunctionPermission
        Rte_Call_SWC_SCF_RP_SWC_FIM_flgFaultLvFive_GetFunctionPermission: implemented-entry=Rte_Call_SWC_SCF_RP_SWC_FIM_flgFaultLvFive_GetFunctionPermission
        Rte_Call_SWC_SCF_RP_SWC_FIM_flgFaultLvFour_GetFunctionPermission: implemented-entry=Rte_Call_SWC_SCF_RP_SWC_FIM_flgFaultLvFour_GetFunctionPermission
        Rte_Call_SWC_Snapshot_RP_SWC_IoHwAb_ADC_BSW_UBR_Vol_IoHwAb_ADC_GetPhyVoltage: implemented-entry=Rte_Call_SWC_Snapshot_RP_SWC_IoHwAb_ADC_BSW_UBR_Vol_IoHwAb_ADC_GetPhyVoltage
        Rte_Call_SWC_Snapshot_RP_SWC_IoHwAb_ADC_BSW_VDD18L_Vol_IoHwAb_ADC_GetPhyVoltage: implemented-entry=Rte_Call_SWC_Snapshot_RP_SWC_IoHwAb_ADC_BSW_VDD18L_Vol_IoHwAb_ADC_GetPhyVoltage
        Rte_Call_SWC_Snapshot_RP_SWC_IoHwAb_ADC_BSW_VDD5T1_Vol_IoHwAb_ADC_GetPhyVoltage: implemented-entry=Rte_Call_SWC_Snapshot_RP_SWC_IoHwAb_ADC_BSW_VDD5T1_Vol_IoHwAb_ADC_GetPhyVoltage
        Rte_Call_SWC_Snapshot_RP_SWC_IoHwAb_ADC_BSW_VDD5T2_Vol_IoHwAb_ADC_GetPhyVoltage: implemented-entry=Rte_Call_SWC_Snapshot_RP_SWC_IoHwAb_ADC_BSW_VDD5T2_Vol_IoHwAb_ADC_GetPhyVoltage
        Rte_Call_SWC_TPC_RP_SWC_Dem_TPC_SpdOvHiLimFail_SetEventStatus: implemented-entry=Rte_Call_SWC_TPC_RP_SWC_Dem_TPC_SpdOvHiLimFail_SetEventStatus
        Rte_Call_SWC_TPC_RP_SWC_Dem_TPC_SpdOvHiWarn_SetEventStatus: implemented-entry=Rte_Call_SWC_TPC_RP_SWC_Dem_TPC_SpdOvHiWarn_SetEventStatus
        Rte_Call_SWC_TPC_RP_SWC_Dem_TPC_TCoolantOvHiWarn_SetEventStatus: implemented-entry=Rte_Call_SWC_TPC_RP_SWC_Dem_TPC_TCoolantOvHiWarn_SetEventStatus
        Rte_Call_SWC_TPC_RP_SWC_Dem_TPC_TDbcOvHiWarn_SetEventStatus: implemented-entry=Rte_Call_SWC_TPC_RP_SWC_Dem_TPC_TDbcOvHiWarn_SetEventStatus
        Rte_Call_SWC_TPC_RP_SWC_Dem_TPC_TDbcOvLoWarn_SetEventStatus: implemented-entry=Rte_Call_SWC_TPC_RP_SWC_Dem_TPC_TDbcOvLoWarn_SetEventStatus
        Rte_Call_SWC_TPC_RP_SWC_Dem_TPC_TDbcUHiLimFail_SetEventStatus: implemented-entry=Rte_Call_SWC_TPC_RP_SWC_Dem_TPC_TDbcUHiLimFail_SetEventStatus
        Rte_Call_SWC_TPC_RP_SWC_Dem_TPC_TDbcULoLimFail_SetEventStatus: implemented-entry=Rte_Call_SWC_TPC_RP_SWC_Dem_TPC_TDbcULoLimFail_SetEventStatus
        Rte_Call_SWC_TPC_RP_SWC_Dem_TPC_TDbcVHiLimFail_SetEventStatus: implemented-entry=Rte_Call_SWC_TPC_RP_SWC_Dem_TPC_TDbcVHiLimFail_SetEventStatus
        Rte_Call_SWC_TPC_RP_SWC_Dem_TPC_TDbcVLoLimFail_SetEventStatus: implemented-entry=Rte_Call_SWC_TPC_RP_SWC_Dem_TPC_TDbcVLoLimFail_SetEventStatus
        Rte_Call_SWC_TPC_RP_SWC_Dem_TPC_TDbcWHiLimFail_SetEventStatus: implemented-entry=Rte_Call_SWC_TPC_RP_SWC_Dem_TPC_TDbcWHiLimFail_SetEventStatus
        Rte_Call_SWC_TPC_RP_SWC_Dem_TPC_TDbcWLoLimFail_SetEventStatus: implemented-entry=Rte_Call_SWC_TPC_RP_SWC_Dem_TPC_TDbcWLoLimFail_SetEventStatus
        Rte_Call_SWC_TPC_RP_SWC_Dem_TPC_TDrvBoardOvHiWarn_SetEventStatus: implemented-entry=Rte_Call_SWC_TPC_RP_SWC_Dem_TPC_TDrvBoardOvHiWarn_SetEventStatus
        Rte_Call_SWC_TPC_RP_SWC_Dem_TPC_TIGBTOvHiLimFail_SetEventStatus: implemented-entry=Rte_Call_SWC_TPC_RP_SWC_Dem_TPC_TIGBTOvHiLimFail_SetEventStatus
        Rte_Call_SWC_TPC_RP_SWC_Dem_TPC_TIGBTOvHiWarn_SetEventStatus: implemented-entry=Rte_Call_SWC_TPC_RP_SWC_Dem_TPC_TIGBTOvHiWarn_SetEventStatus
        Rte_Call_SWC_TPC_RP_SWC_Dem_TPC_TIGBTOvLoWarn_SetEventStatus: implemented-entry=Rte_Call_SWC_TPC_RP_SWC_Dem_TPC_TIGBTOvLoWarn_SetEventStatus
        Rte_Call_SWC_TPC_RP_SWC_Dem_TPC_TSttrOvHiLimFail_SetEventStatus: implemented-entry=Rte_Call_SWC_TPC_RP_SWC_Dem_TPC_TSttrOvHiLimFail_SetEventStatus
        Rte_Call_SWC_TPC_RP_SWC_Dem_TPC_TSttrOvHiWarn_SetEventStatus: implemented-entry=Rte_Call_SWC_TPC_RP_SWC_Dem_TPC_TSttrOvHiWarn_SetEventStatus
        Rte_Call_SWC_TPC_RP_SWC_Dem_TPC_TSttrOvLoWarn_SetEventStatus: implemented-entry=Rte_Call_SWC_TPC_RP_SWC_Dem_TPC_TSttrOvLoWarn_SetEventStatus
        Rte_Call_SWC_TPC_RP_SWC_Dem_TPC_iDcLnkOvCLimFail_SetEventStatus: implemented-entry=Rte_Call_SWC_TPC_RP_SWC_Dem_TPC_iDcLnkOvCLimFail_SetEventStatus
        Rte_Call_SWC_TPC_RP_SWC_Dem_TPC_iDcLnkOvcWarn_SetEventStatus: implemented-entry=Rte_Call_SWC_TPC_RP_SWC_Dem_TPC_iDcLnkOvcWarn_SetEventStatus
        Rte_Call_SWC_TPC_RP_SWC_Dem_TPC_uDcLnkOvVLimFail_SetEventStatus: implemented-entry=Rte_Call_SWC_TPC_RP_SWC_Dem_TPC_uDcLnkOvVLimFail_SetEventStatus
        Rte_Call_SWC_TPC_RP_SWC_Dem_TPC_uDcLnkOvWarn_SetEventStatus: implemented-entry=Rte_Call_SWC_TPC_RP_SWC_Dem_TPC_uDcLnkOvWarn_SetEventStatus
        Rte_Call_SWC_TPC_RP_SWC_Dem_TPC_uDcLnkUnVLimFail_SetEventStatus: implemented-entry=Rte_Call_SWC_TPC_RP_SWC_Dem_TPC_uDcLnkUnVLimFail_SetEventStatus
        Rte_Call_SWC_TPC_RP_SWC_Dem_TPC_uDcLnkUnvWarn_SetEventStatus: implemented-entry=Rte_Call_SWC_TPC_RP_SWC_Dem_TPC_uDcLnkUnvWarn_SetEventStatus
        Rte_Call_SWC_TPC_RP_SWC_FIM_PwrLimLvFour_GetFunctionPermission: implemented-entry=Rte_Call_SWC_TPC_RP_SWC_FIM_PwrLimLvFour_GetFunctionPermission
        Rte_Call_SWC_TPC_RP_SWC_FIM_PwrLimLvOne_GetFunctionPermission: implemented-entry=Rte_Call_SWC_TPC_RP_SWC_FIM_PwrLimLvOne_GetFunctionPermission
        Rte_Call_SWC_TPC_RP_SWC_FIM_PwrLimLvThree_GetFunctionPermission: implemented-entry=Rte_Call_SWC_TPC_RP_SWC_FIM_PwrLimLvThree_GetFunctionPermission
        Rte_Call_SWC_TPC_RP_SWC_FIM_PwrLimLvTwo_GetFunctionPermission: implemented-entry=Rte_Call_SWC_TPC_RP_SWC_FIM_PwrLimLvTwo_GetFunctionPermission
        Rte_Call_SWC_TPC_RP_SWC_FIM_TrqLimLvFour_GetFunctionPermission: implemented-entry=Rte_Call_SWC_TPC_RP_SWC_FIM_TrqLimLvFour_GetFunctionPermission
        Rte_Call_SWC_TPC_RP_SWC_FIM_TrqLimLvOne_GetFunctionPermission: implemented-entry=Rte_Call_SWC_TPC_RP_SWC_FIM_TrqLimLvOne_GetFunctionPermission
        Rte_Call_SWC_TPC_RP_SWC_FIM_TrqLimLvThree_GetFunctionPermission: implemented-entry=Rte_Call_SWC_TPC_RP_SWC_FIM_TrqLimLvThree_GetFunctionPermission
        Rte_Call_SWC_TPC_RP_SWC_FIM_TrqLimLvTwo_GetFunctionPermission: implemented-entry=Rte_Call_SWC_TPC_RP_SWC_FIM_TrqLimLvTwo_GetFunctionPermission
        Rte_Call_SWC_VCF_RP_SWC_FIM_IGBTOvTempWarn_GetFunctionPermission: implemented-entry=Rte_Call_SWC_VCF_RP_SWC_FIM_IGBTOvTempWarn_GetFunctionPermission
        Rte_Call_SWC_VCF_RP_SWC_FIM_MtrOvTempWarn_GetFunctionPermission: implemented-entry=Rte_Call_SWC_VCF_RP_SWC_FIM_MtrOvTempWarn_GetFunctionPermission
        Rte_Call_SWC_VCF_RP_SWC_FIM_ReqFailrMod_GetFunctionPermission: implemented-entry=Rte_Call_SWC_VCF_RP_SWC_FIM_ReqFailrMod_GetFunctionPermission
        Rte_DecrementWaitingCount: implemented-entry=Rte_DecrementWaitingCount
        Rte_GetCurrentTaskIndex: implemented-entry=Rte_GetCurrentTaskIndex
        Rte_MainFunction: implemented-entry=Rte_MainFunction
        Rte_Mode_Dcm_Rp_Mdg2_MDGP_Mdg2: implemented-entry=Rte_Mode_Dcm_Rp_Mdg2_MDGP_Mdg2
        Rte_Mode_Diag_SWC_RPort_DcmDiagnosticSessionControl_MDGP_DcmDiagnosticSessionControl: implemented-entry=Rte_Mode_Diag_SWC_RPort_DcmDiagnosticSessionControl_MDGP_DcmDiagnosticSessionControl
        Rte_Mode_Diag_SWC_RPort_DcmEcuReset_MDGP_DcmEcuReset: implemented-entry=Rte_Mode_Diag_SWC_RPort_DcmEcuReset_MDGP_DcmEcuReset
        Rte_ReadQueue: implemented-entry=Rte_ReadQueue
        Rte_Read_BswM_RP_BswMArbitration_BswM_MRP_SWC_RequestAfterRun_SCF_stSysCtl: implemented-entry=Rte_Read_BswM_RP_BswMArbitration_BswM_MRP_SWC_RequestAfterRun_SCF_stSysCtl
        Rte_Read_BswM_RP_BswMArbitration_BswM_MRP_SWC_RequestShutDown_SCF_stSysCtl: implemented-entry=Rte_Read_BswM_RP_BswMArbitration_BswM_MRP_SWC_RequestShutDown_SCF_stSysCtl
        Rte_Read_Dcm_R_DataServices_DspData_ASW_VER_F189_Data: implemented-entry=Rte_Read_Dcm_R_DataServices_DspData_ASW_VER_F189_Data
        Rte_Read_Dcm_R_DataServices_DspData_MANU_DATE_F18B_Data: implemented-entry=Rte_Read_Dcm_R_DataServices_DspData_MANU_DATE_F18B_Data
        Rte_Read_Dcm_R_DataServices_DspData_SYS_SUP_ID_F18A_Data: implemented-entry=Rte_Read_Dcm_R_DataServices_DspData_SYS_SUP_ID_F18A_Data
        Rte_Read_Diag_SWC_RPort_DataServices_DspData_SYS_SUP_ID_F18A_Data: implemented-entry=Rte_Read_Diag_SWC_RPort_DataServices_DspData_SYS_SUP_ID_F18A_Data
        Rte_Read_NvM_SWC_RP_SWC_PCF_PCF_SLInPLimt: implemented-entry=Rte_Read_NvM_SWC_RP_SWC_PCF_PCF_SLInPLimt
        Rte_Read_NvM_SWC_RP_SWC_PCF_PCF_flgSLWD: implemented-entry=Rte_Read_NvM_SWC_RP_SWC_PCF_PCF_flgSLWD
        Rte_Read_NvM_SWC_RP_SWC_RCF_RCF_AutoClbOffset: implemented-entry=Rte_Read_NvM_SWC_RP_SWC_RCF_RCF_AutoClbOffset
        Rte_Read_NvM_SWC_RP_SWC_RCF_RCF_flgOfsClbSucToNVM: implemented-entry=Rte_Read_NvM_SWC_RP_SWC_RCF_RCF_flgOfsClbSucToNVM
        Rte_Read_SWC_BCC_RP_SWC_HSPF_HSPF_tCoolantTempFlt: implemented-entry=Rte_Read_SWC_BCC_RP_SWC_HSPF_HSPF_tCoolantTempFlt
        Rte_Read_SWC_BCC_RP_SWC_HSPF_HSPF_tDBCTempUFlt: implemented-entry=Rte_Read_SWC_BCC_RP_SWC_HSPF_HSPF_tDBCTempUFlt
        Rte_Read_SWC_BCC_RP_SWC_HSPF_HSPF_tDBCTempVFlt: implemented-entry=Rte_Read_SWC_BCC_RP_SWC_HSPF_HSPF_tDBCTempVFlt
        Rte_Read_SWC_BCC_RP_SWC_HSPF_HSPF_tDBCTempWFlt: implemented-entry=Rte_Read_SWC_BCC_RP_SWC_HSPF_HSPF_tDBCTempWFlt
        Rte_Read_SWC_BCC_RP_SWC_HSPF_HSPF_uDcLnkSlowFlt: implemented-entry=Rte_Read_SWC_BCC_RP_SWC_HSPF_HSPF_uDcLnkSlowFlt
        Rte_Read_SWC_BCC_RP_SWC_MCF_MCF_DycU: implemented-entry=Rte_Read_SWC_BCC_RP_SWC_MCF_MCF_DycU
        Rte_Read_SWC_BCC_RP_SWC_MCF_MCF_DycV: implemented-entry=Rte_Read_SWC_BCC_RP_SWC_MCF_MCF_DycV
        Rte_Read_SWC_BCC_RP_SWC_MCF_MCF_DycW: implemented-entry=Rte_Read_SWC_BCC_RP_SWC_MCF_MCF_DycW
        Rte_Read_SWC_BCC_RP_SWC_MCF_MCF_Is: implemented-entry=Rte_Read_SWC_BCC_RP_SWC_MCF_MCF_Is
        Rte_Read_SWC_BCC_RP_SWC_MCF_MCF_frqPwm: implemented-entry=Rte_Read_SWC_BCC_RP_SWC_MCF_MCF_frqPwm
        Rte_Read_SWC_BCC_RP_SWC_MCF_MCF_iU: implemented-entry=Rte_Read_SWC_BCC_RP_SWC_MCF_MCF_iU
        Rte_Read_SWC_BCC_RP_SWC_MCF_MCF_iV: implemented-entry=Rte_Read_SWC_BCC_RP_SWC_MCF_MCF_iV
        Rte_Read_SWC_BCC_RP_SWC_MCF_MCF_iW: implemented-entry=Rte_Read_SWC_BCC_RP_SWC_MCF_MCF_iW
        Rte_Read_SWC_BCC_RP_SWC_MCF_MCF_secVolt: implemented-entry=Rte_Read_SWC_BCC_RP_SWC_MCF_MCF_secVolt
        Rte_Read_SWC_BCC_RP_SWC_MCF_MCF_tiLock: implemented-entry=Rte_Read_SWC_BCC_RP_SWC_MCF_MCF_tiLock
        Rte_Read_SWC_BCC_RP_SWC_MPC_MPC_dtCorFac: implemented-entry=Rte_Read_SWC_BCC_RP_SWC_MPC_MPC_dtCorFac
        Rte_Read_SWC_BCC_RP_SWC_Rdc_Rdc_nWoFlt: implemented-entry=Rte_Read_SWC_BCC_RP_SWC_Rdc_Rdc_nWoFlt
        Rte_Read_SWC_BCC_RP_SWC_SCF_SCF_stGateDrv: implemented-entry=Rte_Read_SWC_BCC_RP_SWC_SCF_SCF_stGateDrv
        Rte_Read_SWC_BCC_RP_SWC_TPC_TPC_stMotorMod: implemented-entry=Rte_Read_SWC_BCC_RP_SWC_TPC_TPC_stMotorMod
        Rte_Read_SWC_CSPF_RP_SWC_BCC_BCC_iDcLnkEstFlt: implemented-entry=Rte_Read_SWC_CSPF_RP_SWC_BCC_BCC_iDcLnkEstFlt
        Rte_Read_SWC_CSPF_RP_SWC_Com_Com_BMS01_BattCurr: implemented-entry=Rte_Read_SWC_CSPF_RP_SWC_Com_Com_BMS01_BattCurr
        Rte_Read_SWC_CSPF_RP_SWC_Com_Com_BMS01_BattVoLt: implemented-entry=Rte_Read_SWC_CSPF_RP_SWC_Com_Com_BMS01_BattVoLt
        Rte_Read_SWC_CSPF_RP_SWC_Com_Com_BMS01_stMainReLay: implemented-entry=Rte_Read_SWC_CSPF_RP_SWC_Com_Com_BMS01_stMainReLay
        Rte_Read_SWC_CSPF_RP_SWC_Com_Com_RecflgDchaReq: implemented-entry=Rte_Read_SWC_CSPF_RP_SWC_Com_Com_RecflgDchaReq
        Rte_Read_SWC_CSPF_RP_SWC_Com_Com_VCU01_UdcMax: implemented-entry=Rte_Read_SWC_CSPF_RP_SWC_Com_Com_VCU01_UdcMax
        Rte_Read_SWC_CSPF_RP_SWC_Com_Com_VCU01_UdcMin: implemented-entry=Rte_Read_SWC_CSPF_RP_SWC_Com_Com_VCU01_UdcMin
        Rte_Read_SWC_CSPF_RP_SWC_Com_Com_VCU01_idcMax: implemented-entry=Rte_Read_SWC_CSPF_RP_SWC_Com_Com_VCU01_idcMax
        Rte_Read_SWC_CSPF_RP_SWC_Com_Com_VCU01_idcMin: implemented-entry=Rte_Read_SWC_CSPF_RP_SWC_Com_Com_VCU01_idcMin
        Rte_Read_SWC_CSPF_RP_SWC_Com_Com_VCU01_stHvbMaiRly: implemented-entry=Rte_Read_SWC_CSPF_RP_SWC_Com_Com_VCU01_stHvbMaiRly
        Rte_Read_SWC_CSPF_RP_SWC_Com_Com_VCU02_KpHighNCtL: implemented-entry=Rte_Read_SWC_CSPF_RP_SWC_Com_Com_VCU02_KpHighNCtL
        Rte_Read_SWC_CSPF_RP_SWC_Com_Com_VCU02_KpLowNCtL: implemented-entry=Rte_Read_SWC_CSPF_RP_SWC_Com_Com_VCU02_KpLowNCtL
        Rte_Read_SWC_CSPF_RP_SWC_Com_Com_VCU02_NDiffMax: implemented-entry=Rte_Read_SWC_CSPF_RP_SWC_Com_Com_VCU02_NDiffMax
        Rte_Read_SWC_CSPF_RP_SWC_Com_Com_VCU02_TrqMaxNCtL: implemented-entry=Rte_Read_SWC_CSPF_RP_SWC_Com_Com_VCU02_TrqMaxNCtL
        Rte_Read_SWC_CSPF_RP_SWC_Com_Com_VCU02_TrqMinNCtL: implemented-entry=Rte_Read_SWC_CSPF_RP_SWC_Com_Com_VCU02_TrqMinNCtL
        Rte_Read_SWC_CSPF_RP_SWC_Com_Com_VCU03_TrqMax: implemented-entry=Rte_Read_SWC_CSPF_RP_SWC_Com_Com_VCU03_TrqMax
        Rte_Read_SWC_CSPF_RP_SWC_Com_Com_VCU03_TrqMin: implemented-entry=Rte_Read_SWC_CSPF_RP_SWC_Com_Com_VCU03_TrqMin
        Rte_Read_SWC_CSPF_RP_SWC_Com_Com_VCU03_cTrqSlopeMax: implemented-entry=Rte_Read_SWC_CSPF_RP_SWC_Com_Com_VCU03_cTrqSlopeMax
        Rte_Read_SWC_CSPF_RP_SWC_Com_Com_VCU04_MotDir: implemented-entry=Rte_Read_SWC_CSPF_RP_SWC_Com_Com_VCU04_MotDir
        Rte_Read_SWC_CSPF_RP_SWC_Com_Com_VCU04_NSetP: implemented-entry=Rte_Read_SWC_CSPF_RP_SWC_Com_Com_VCU04_NSetP
        Rte_Read_SWC_CSPF_RP_SWC_Com_Com_VCU04_TrqSetP: implemented-entry=Rte_Read_SWC_CSPF_RP_SWC_Com_Com_VCU04_TrqSetP
        Rte_Read_SWC_CSPF_RP_SWC_Com_Com_VCU04_bKL15: implemented-entry=Rte_Read_SWC_CSPF_RP_SWC_Com_Com_VCU04_bKL15
        Rte_Read_SWC_CSPF_RP_SWC_Com_Com_VCU04_stModeReq: implemented-entry=Rte_Read_SWC_CSPF_RP_SWC_Com_Com_VCU04_stModeReq
        Rte_Read_SWC_CSPF_RP_SWC_Com_Com_VCU05_OfsAL: implemented-entry=Rte_Read_SWC_CSPF_RP_SWC_Com_Com_VCU05_OfsAL
        Rte_Read_SWC_CSPF_RP_SWC_Com_Com_VCU05_TrqDmpMax: implemented-entry=Rte_Read_SWC_CSPF_RP_SWC_Com_Com_VCU05_TrqDmpMax
        Rte_Read_SWC_CSPF_RP_SWC_Com_Com_VCU05_TrqDmpMin: implemented-entry=Rte_Read_SWC_CSPF_RP_SWC_Com_Com_VCU05_TrqDmpMin
        Rte_Read_SWC_CSPF_RP_SWC_Com_Com_VCU05_bSetOfsAL: implemented-entry=Rte_Read_SWC_CSPF_RP_SWC_Com_Com_VCU05_bSetOfsAL
        Rte_Read_SWC_CSPF_RP_SWC_Com_Com_VCU05_kDmp: implemented-entry=Rte_Read_SWC_CSPF_RP_SWC_Com_Com_VCU05_kDmp
        Rte_Read_SWC_CSPF_RP_SWC_Com_Com_VCU05_stDmpCtLReq: implemented-entry=Rte_Read_SWC_CSPF_RP_SWC_Com_Com_VCU05_stDmpCtLReq
        Rte_Read_SWC_CSPF_RP_SWC_Com_Com_VCU_flgCrash: implemented-entry=Rte_Read_SWC_CSPF_RP_SWC_Com_Com_VCU_flgCrash
        Rte_Read_SWC_CSPF_RP_SWC_Cpld_Cpld_CpldSwVer: implemented-entry=Rte_Read_SWC_CSPF_RP_SWC_Cpld_Cpld_CpldSwVer
        Rte_Read_SWC_CSPF_RP_SWC_Cpld_Cpld_IgbtState: implemented-entry=Rte_Read_SWC_CSPF_RP_SWC_Cpld_Cpld_IgbtState
        Rte_Read_SWC_CSPF_RP_SWC_DiagCalib_DiagCalib_FailCode{1..8}: implemented-entry=Rte_Read_SWC_CSPF_RP_SWC_DiagCalib_DiagCalib_FailCode{1..8}
        Rte_Read_SWC_CSPF_RP_SWC_HSPF_HSPF_nSlowFlt: implemented-entry=Rte_Read_SWC_CSPF_RP_SWC_HSPF_HSPF_nSlowFlt
        Rte_Read_SWC_CSPF_RP_SWC_HSPF_HSPF_tCoolantTempFlt: implemented-entry=Rte_Read_SWC_CSPF_RP_SWC_HSPF_HSPF_tCoolantTempFlt
        Rte_Read_SWC_CSPF_RP_SWC_HSPF_HSPF_tDBCTempUFlt: implemented-entry=Rte_Read_SWC_CSPF_RP_SWC_HSPF_HSPF_tDBCTempUFlt
        Rte_Read_SWC_CSPF_RP_SWC_HSPF_HSPF_tDBCTempVFlt: implemented-entry=Rte_Read_SWC_CSPF_RP_SWC_HSPF_HSPF_tDBCTempVFlt
        Rte_Read_SWC_CSPF_RP_SWC_HSPF_HSPF_tDBCTempWFlt: implemented-entry=Rte_Read_SWC_CSPF_RP_SWC_HSPF_HSPF_tDBCTempWFlt
        Rte_Read_SWC_CSPF_RP_SWC_HSPF_HSPF_tStrrTemp1Flt: implemented-entry=Rte_Read_SWC_CSPF_RP_SWC_HSPF_HSPF_tStrrTemp1Flt
        Rte_Read_SWC_CSPF_RP_SWC_HSPF_HSPF_tStrrTemp2Flt: implemented-entry=Rte_Read_SWC_CSPF_RP_SWC_HSPF_HSPF_tStrrTemp2Flt
        Rte_Read_SWC_CSPF_RP_SWC_HSPF_HSPF_uDcLnkSlowFlt: implemented-entry=Rte_Read_SWC_CSPF_RP_SWC_HSPF_HSPF_uDcLnkSlowFlt
        Rte_Read_SWC_CSPF_RP_SWC_HSPF_HSPF_uKl30Flt: implemented-entry=Rte_Read_SWC_CSPF_RP_SWC_HSPF_HSPF_uKl30Flt
        Rte_Read_SWC_CSPF_RP_SWC_HvMcu_HvMcu_HvMcuVer: implemented-entry=Rte_Read_SWC_CSPF_RP_SWC_HvMcu_HvMcu_HvMcuVer
        Rte_Read_SWC_CSPF_RP_SWC_MPC_MPC_IsFlt: implemented-entry=Rte_Read_SWC_CSPF_RP_SWC_MPC_MPC_IsFlt
        Rte_Read_SWC_CSPF_RP_SWC_MPC_MPC_TrqMechFlt: implemented-entry=Rte_Read_SWC_CSPF_RP_SWC_MPC_MPC_TrqMechFlt
        Rte_Read_SWC_CSPF_RP_SWC_MPC_MPC_isdFlt: implemented-entry=Rte_Read_SWC_CSPF_RP_SWC_MPC_MPC_isdFlt
        Rte_Read_SWC_CSPF_RP_SWC_MPC_MPC_isqFlt: implemented-entry=Rte_Read_SWC_CSPF_RP_SWC_MPC_MPC_isqFlt
        Rte_Read_SWC_CSPF_RP_SWC_RCF_RCF_AutoClbOffset: implemented-entry=Rte_Read_SWC_CSPF_RP_SWC_RCF_RCF_AutoClbOffset
        Rte_Read_SWC_CSPF_RP_SWC_RCF_RCF_flgOfsClbSuc: implemented-entry=Rte_Read_SWC_CSPF_RP_SWC_RCF_RCF_flgOfsClbSuc
        Rte_Read_SWC_CSPF_RP_SWC_Rdc_Rdc_ArctanAgRtr: implemented-entry=Rte_Read_SWC_CSPF_RP_SWC_Rdc_Rdc_ArctanAgRtr
        Rte_Read_SWC_CSPF_RP_SWC_SCF_SCF_bHvReady: implemented-entry=Rte_Read_SWC_CSPF_RP_SWC_SCF_SCF_bHvReady
        Rte_Read_SWC_CSPF_RP_SWC_SCF_SCF_stDisChg: implemented-entry=Rte_Read_SWC_CSPF_RP_SWC_SCF_SCF_stDisChg
        Rte_Read_SWC_CSPF_RP_SWC_SCF_SCF_stDrvCtl: implemented-entry=Rte_Read_SWC_CSPF_RP_SWC_SCF_SCF_stDrvCtl
        Rte_Read_SWC_CSPF_RP_SWC_SCF_SCF_stGateDrv: implemented-entry=Rte_Read_SWC_CSPF_RP_SWC_SCF_SCF_stGateDrv
        Rte_Read_SWC_CSPF_RP_SWC_SCF_SCF_stSysCtl: implemented-entry=Rte_Read_SWC_CSPF_RP_SWC_SCF_SCF_stSysCtl
        Rte_Read_SWC_CSPF_RP_SWC_TDC_TDC_TrqDes: implemented-entry=Rte_Read_SWC_CSPF_RP_SWC_TDC_TDC_TrqDes
        Rte_Read_SWC_CSPF_RP_SWC_TDC_TDC_flgTrqLmtActv: implemented-entry=Rte_Read_SWC_CSPF_RP_SWC_TDC_TDC_flgTrqLmtActv
        Rte_Read_SWC_CSPF_RP_SWC_TPC_TPC_TrqMax: implemented-entry=Rte_Read_SWC_CSPF_RP_SWC_TPC_TPC_TrqMax
        Rte_Read_SWC_CSPF_RP_SWC_TPC_TPC_TrqMin: implemented-entry=Rte_Read_SWC_CSPF_RP_SWC_TPC_TPC_TrqMin
        Rte_Read_SWC_CSPF_RP_SWC_TPC_TPC_bDernCAN: implemented-entry=Rte_Read_SWC_CSPF_RP_SWC_TPC_TPC_bDernCAN
        Rte_Read_SWC_CSPF_RP_SWC_TPC_TPC_bDernCoolantTemp: implemented-entry=Rte_Read_SWC_CSPF_RP_SWC_TPC_TPC_bDernCoolantTemp
        Rte_Read_SWC_CSPF_RP_SWC_TPC_TPC_bDernDbcTemp: implemented-entry=Rte_Read_SWC_CSPF_RP_SWC_TPC_TPC_bDernDbcTemp
        Rte_Read_SWC_CSPF_RP_SWC_TPC_TPC_bDernDrvBoardTemp: implemented-entry=Rte_Read_SWC_CSPF_RP_SWC_TPC_TPC_bDernDrvBoardTemp
        Rte_Read_SWC_CSPF_RP_SWC_TPC_TPC_bDernExcMax: implemented-entry=Rte_Read_SWC_CSPF_RP_SWC_TPC_TPC_bDernExcMax
        Rte_Read_SWC_CSPF_RP_SWC_TPC_TPC_bDernExcMin: implemented-entry=Rte_Read_SWC_CSPF_RP_SWC_TPC_TPC_bDernExcMin
        Rte_Read_SWC_CSPF_RP_SWC_TPC_TPC_bDernMtrSpd: implemented-entry=Rte_Read_SWC_CSPF_RP_SWC_TPC_TPC_bDernMtrSpd
        Rte_Read_SWC_CSPF_RP_SWC_TPC_TPC_bDernOvrIdc: implemented-entry=Rte_Read_SWC_CSPF_RP_SWC_TPC_TPC_bDernOvrIdc
        Rte_Read_SWC_CSPF_RP_SWC_TPC_TPC_bDernOvrUdc: implemented-entry=Rte_Read_SWC_CSPF_RP_SWC_TPC_TPC_bDernOvrUdc
        Rte_Read_SWC_CSPF_RP_SWC_TPC_TPC_bDernStrTemp: implemented-entry=Rte_Read_SWC_CSPF_RP_SWC_TPC_TPC_bDernStrTemp
        Rte_Read_SWC_CSPF_RP_SWC_TPC_TPC_bDernUndrUdc: implemented-entry=Rte_Read_SWC_CSPF_RP_SWC_TPC_TPC_bDernUndrUdc
        Rte_Read_SWC_CSPF_RP_SWC_TPC_TPC_stTrqEmMax: implemented-entry=Rte_Read_SWC_CSPF_RP_SWC_TPC_TPC_stTrqEmMax
        Rte_Read_SWC_CSPF_RP_SWC_TPC_TPC_stTrqEmMin: implemented-entry=Rte_Read_SWC_CSPF_RP_SWC_TPC_TPC_stTrqEmMin
        Rte_Read_SWC_Epark_RP_SWC_PCF_PCF_MotDir: implemented-entry=Rte_Read_SWC_Epark_RP_SWC_PCF_PCF_MotDir
        Rte_Read_SWC_Epark_RP_SWC_PCF_PCF_dycPWM: implemented-entry=Rte_Read_SWC_Epark_RP_SWC_PCF_PCF_dycPWM
        Rte_Read_SWC_HSPF_RP_SWC_BCC_BCC_iDcLnkEstFlt: implemented-entry=Rte_Read_SWC_HSPF_RP_SWC_BCC_BCC_iDcLnkEstFlt
        Rte_Read_SWC_HSPF_RP_SWC_BCC_BCC_tCoolantTj: implemented-entry=Rte_Read_SWC_HSPF_RP_SWC_BCC_BCC_tCoolantTj
        Rte_Read_SWC_HSPF_RP_SWC_BCC_BCC_tIgbtTj: implemented-entry=Rte_Read_SWC_HSPF_RP_SWC_BCC_BCC_tIgbtTj
        Rte_Read_SWC_HSPF_RP_SWC_Cpld_Cpld_CpldSwVer: implemented-entry=Rte_Read_SWC_HSPF_RP_SWC_Cpld_Cpld_CpldSwVer
        Rte_Read_SWC_HSPF_RP_SWC_Cpld_Cpld_ProjectNum: implemented-entry=Rte_Read_SWC_HSPF_RP_SWC_Cpld_Cpld_ProjectNum
        Rte_Read_SWC_HSPF_RP_SWC_HvMcu_HvMcu_HvMcuVer: implemented-entry=Rte_Read_SWC_HSPF_RP_SWC_HvMcu_HvMcu_HvMcuVer
        Rte_Read_SWC_HSPF_RP_SWC_HvMcu_HvMcu_tDBCTempU: implemented-entry=Rte_Read_SWC_HSPF_RP_SWC_HvMcu_HvMcu_tDBCTempU
        Rte_Read_SWC_HSPF_RP_SWC_HvMcu_HvMcu_tDBCTempV: implemented-entry=Rte_Read_SWC_HSPF_RP_SWC_HvMcu_HvMcu_tDBCTempV
        Rte_Read_SWC_HSPF_RP_SWC_HvMcu_HvMcu_tDBCTempW: implemented-entry=Rte_Read_SWC_HSPF_RP_SWC_HvMcu_HvMcu_tDBCTempW
        Rte_Read_SWC_HSPF_RP_SWC_HvMcu_HvMcu_tDrvBoardTemp: implemented-entry=Rte_Read_SWC_HSPF_RP_SWC_HvMcu_HvMcu_tDrvBoardTemp
        Rte_Read_SWC_HSPF_RP_SWC_MCF_MCF_uDcLnk: implemented-entry=Rte_Read_SWC_HSPF_RP_SWC_MCF_MCF_uDcLnk
        Rte_Read_SWC_HSPF_RP_SWC_MDF_MDF_bFaultEMBlkWarnSt: implemented-entry=Rte_Read_SWC_HSPF_RP_SWC_MDF_MDF_bFaultEMBlkWarnSt
        Rte_Read_SWC_HSPF_RP_SWC_PhC_PhC_iUNoOff: implemented-entry=Rte_Read_SWC_HSPF_RP_SWC_PhC_PhC_iUNoOff
        Rte_Read_SWC_HSPF_RP_SWC_PhC_PhC_iVNoOff: implemented-entry=Rte_Read_SWC_HSPF_RP_SWC_PhC_PhC_iVNoOff
        Rte_Read_SWC_HSPF_RP_SWC_PhC_PhC_iWNoOff: implemented-entry=Rte_Read_SWC_HSPF_RP_SWC_PhC_PhC_iWNoOff
        Rte_Read_SWC_HSPF_RP_SWC_Rdc_Rdc_nWoFlt: implemented-entry=Rte_Read_SWC_HSPF_RP_SWC_Rdc_Rdc_nWoFlt
        Rte_Read_SWC_HSPF_RP_SWC_SCF_SCF_stPreDrvCtl: implemented-entry=Rte_Read_SWC_HSPF_RP_SWC_SCF_SCF_stPreDrvCtl
        Rte_Read_SWC_HvMcu_RP_SWC_RCF_RCF_stAgRtrOfsCal: implemented-entry=Rte_Read_SWC_HvMcu_RP_SWC_RCF_RCF_stAgRtrOfsCal
        Rte_Read_SWC_HvMcu_RP_SWC_SCF_SCF_flgEmgReqInvDcha: implemented-entry=Rte_Read_SWC_HvMcu_RP_SWC_SCF_SCF_flgEmgReqInvDcha
        Rte_Read_SWC_MCF_RP_SWC_BCC_BCC_iDcLnkEstFlt: implemented-entry=Rte_Read_SWC_MCF_RP_SWC_BCC_BCC_iDcLnkEstFlt
        Rte_Read_SWC_MCF_RP_SWC_HSPF_HSPF_iPhaUOffset: implemented-entry=Rte_Read_SWC_MCF_RP_SWC_HSPF_HSPF_iPhaUOffset
        Rte_Read_SWC_MCF_RP_SWC_HSPF_HSPF_iPhaVOffset: implemented-entry=Rte_Read_SWC_MCF_RP_SWC_HSPF_HSPF_iPhaVOffset
        Rte_Read_SWC_MCF_RP_SWC_HSPF_HSPF_iPhaWOffset: implemented-entry=Rte_Read_SWC_MCF_RP_SWC_HSPF_HSPF_iPhaWOffset
        Rte_Read_SWC_MCF_RP_SWC_HSPF_HSPF_stIphaOffCal: implemented-entry=Rte_Read_SWC_MCF_RP_SWC_HSPF_HSPF_stIphaOffCal
        Rte_Read_SWC_MCF_RP_SWC_HSPF_HSPF_tStrrTempFlt: implemented-entry=Rte_Read_SWC_MCF_RP_SWC_HSPF_HSPF_tStrrTempFlt
        Rte_Read_SWC_MCF_RP_SWC_HvMcu_HvMcu_uDcLnkHvMcu: implemented-entry=Rte_Read_SWC_MCF_RP_SWC_HvMcu_HvMcu_uDcLnkHvMcu
        Rte_Read_SWC_MCF_RP_SWC_MDF_MDF_bFaultEMBlkWarnSt: implemented-entry=Rte_Read_SWC_MCF_RP_SWC_MDF_MDF_bFaultEMBlkWarnSt
        Rte_Read_SWC_MCF_RP_SWC_MPC_MPC_CofRandomPwm: implemented-entry=Rte_Read_SWC_MCF_RP_SWC_MPC_MPC_CofRandomPwm
        Rte_Read_SWC_MCF_RP_SWC_MPC_MPC_Ld: implemented-entry=Rte_Read_SWC_MCF_RP_SWC_MPC_MPC_Ld
        Rte_Read_SWC_MCF_RP_SWC_MPC_MPC_LdSubLq: implemented-entry=Rte_Read_SWC_MCF_RP_SWC_MPC_MPC_LdSubLq
        Rte_Read_SWC_MCF_RP_SWC_MPC_MPC_Lq: implemented-entry=Rte_Read_SWC_MCF_RP_SWC_MPC_MPC_Lq
        Rte_Read_SWC_MCF_RP_SWC_MPC_MPC_OmBw: implemented-entry=Rte_Read_SWC_MCF_RP_SWC_MPC_MPC_OmBw
        Rte_Read_SWC_MCF_RP_SWC_MPC_MPC_Psi: implemented-entry=Rte_Read_SWC_MCF_RP_SWC_MPC_MPC_Psi
        Rte_Read_SWC_MCF_RP_SWC_MPC_MPC_Rs: implemented-entry=Rte_Read_SWC_MCF_RP_SWC_MPC_MPC_Rs
        Rte_Read_SWC_MCF_RP_SWC_MPC_MPC_Rv: implemented-entry=Rte_Read_SWC_MCF_RP_SWC_MPC_MPC_Rv
        Rte_Read_SWC_MCF_RP_SWC_MPC_MPC_TrqMechFlt: implemented-entry=Rte_Read_SWC_MCF_RP_SWC_MPC_MPC_TrqMechFlt
        Rte_Read_SWC_MCF_RP_SWC_MPC_MPC_frqPwmVF: implemented-entry=Rte_Read_SWC_MCF_RP_SWC_MPC_MPC_frqPwmVF
        Rte_Read_SWC_MCF_RP_SWC_MPC_MPC_isdFF: implemented-entry=Rte_Read_SWC_MCF_RP_SWC_MPC_MPC_isdFF
        Rte_Read_SWC_MCF_RP_SWC_MPC_MPC_isdMTPA: implemented-entry=Rte_Read_SWC_MCF_RP_SWC_MPC_MPC_isdMTPA
        Rte_Read_SWC_MCF_RP_SWC_MPC_MPC_isdMTPV: implemented-entry=Rte_Read_SWC_MCF_RP_SWC_MPC_MPC_isdMTPV
        Rte_Read_SWC_MCF_RP_SWC_NvM_NvM_AngAutoClbOffset: implemented-entry=Rte_Read_SWC_MCF_RP_SWC_NvM_NvM_AngAutoClbOffset
        Rte_Read_SWC_MCF_RP_SWC_NvM_NvM_flgAngAutoClbOffset: implemented-entry=Rte_Read_SWC_MCF_RP_SWC_NvM_NvM_flgAngAutoClbOffset
        Rte_Read_SWC_MCF_RP_SWC_PhC_PhC_iUNoOff: implemented-entry=Rte_Read_SWC_MCF_RP_SWC_PhC_PhC_iUNoOff
        Rte_Read_SWC_MCF_RP_SWC_PhC_PhC_iVNoOff: implemented-entry=Rte_Read_SWC_MCF_RP_SWC_PhC_PhC_iVNoOff
        Rte_Read_SWC_MCF_RP_SWC_PhC_PhC_iWNoOff: implemented-entry=Rte_Read_SWC_MCF_RP_SWC_PhC_PhC_iWNoOff
        Rte_Read_SWC_MCF_RP_SWC_PhC_PhC_uDcLnkLowMcu: implemented-entry=Rte_Read_SWC_MCF_RP_SWC_PhC_PhC_uDcLnkLowMcu
        Rte_Read_SWC_MCF_RP_SWC_RCF_RCF_UsAlfaScalSet: implemented-entry=Rte_Read_SWC_MCF_RP_SWC_RCF_RCF_UsAlfaScalSet
        Rte_Read_SWC_MCF_RP_SWC_RCF_RCF_UsBetaScalSet: implemented-entry=Rte_Read_SWC_MCF_RP_SWC_RCF_RCF_UsBetaScalSet
        Rte_Read_SWC_MCF_RP_SWC_RCF_RCF_agRtrOffsEstimd: implemented-entry=Rte_Read_SWC_MCF_RP_SWC_RCF_RCF_agRtrOffsEstimd
        Rte_Read_SWC_MCF_RP_SWC_RCF_RCF_flgUseUsSet: implemented-entry=Rte_Read_SWC_MCF_RP_SWC_RCF_RCF_flgUseUsSet
        Rte_Read_SWC_MCF_RP_SWC_Rdc_Rdc_ArctanAgRtr: implemented-entry=Rte_Read_SWC_MCF_RP_SWC_Rdc_Rdc_ArctanAgRtr
        Rte_Read_SWC_MCF_RP_SWC_Rdc_Rdc_nWoFlt: implemented-entry=Rte_Read_SWC_MCF_RP_SWC_Rdc_Rdc_nWoFlt
        Rte_Read_SWC_MCF_RP_SWC_SCF_SCF_FIM_ReqFailrMod: implemented-entry=Rte_Read_SWC_MCF_RP_SWC_SCF_SCF_FIM_ReqFailrMod
        Rte_Read_SWC_MCF_RP_SWC_SCF_SCF_flgEnDchaToMc: implemented-entry=Rte_Read_SWC_MCF_RP_SWC_SCF_SCF_flgEnDchaToMc
        Rte_Read_SWC_MCF_RP_SWC_SCF_SCF_flginitPI: implemented-entry=Rte_Read_SWC_MCF_RP_SWC_SCF_SCF_flginitPI
        Rte_Read_SWC_MCF_RP_SWC_SCF_SCF_stGateDrv: implemented-entry=Rte_Read_SWC_MCF_RP_SWC_SCF_SCF_stGateDrv
        Rte_Read_SWC_MCF_RP_SWC_SCF_SCF_stPwmMode: implemented-entry=Rte_Read_SWC_MCF_RP_SWC_SCF_SCF_stPwmMode
        Rte_Read_SWC_MCF_RP_SWC_TDC_TDC_TrqDes: implemented-entry=Rte_Read_SWC_MCF_RP_SWC_TDC_TDC_TrqDes
        Rte_Read_SWC_MCF_RP_SWC_TPC_TPC_TDbcTrqMax: implemented-entry=Rte_Read_SWC_MCF_RP_SWC_TPC_TPC_TDbcTrqMax
        Rte_Read_SWC_MDF_RP_SWC_HSPF_HSPF_PwrDcLnk: implemented-entry=Rte_Read_SWC_MDF_RP_SWC_HSPF_HSPF_PwrDcLnk
        Rte_Read_SWC_MDF_RP_SWC_HSPF_HSPF_nSlowFlt: implemented-entry=Rte_Read_SWC_MDF_RP_SWC_HSPF_HSPF_nSlowFlt
        Rte_Read_SWC_MDF_RP_SWC_HSPF_HSPF_tCoolantTempFlt: implemented-entry=Rte_Read_SWC_MDF_RP_SWC_HSPF_HSPF_tCoolantTempFlt
        Rte_Read_SWC_MDF_RP_SWC_HSPF_HSPF_tDBCTempUFlt: implemented-entry=Rte_Read_SWC_MDF_RP_SWC_HSPF_HSPF_tDBCTempUFlt
        Rte_Read_SWC_MDF_RP_SWC_HSPF_HSPF_tDBCTempVFlt: implemented-entry=Rte_Read_SWC_MDF_RP_SWC_HSPF_HSPF_tDBCTempVFlt
        Rte_Read_SWC_MDF_RP_SWC_HSPF_HSPF_tDBCTempWFlt: implemented-entry=Rte_Read_SWC_MDF_RP_SWC_HSPF_HSPF_tDBCTempWFlt
        Rte_Read_SWC_MDF_RP_SWC_HSPF_HSPF_tStrrTempFlt: implemented-entry=Rte_Read_SWC_MDF_RP_SWC_HSPF_HSPF_tStrrTempFlt
        Rte_Read_SWC_MDF_RP_SWC_HSPF_HSPF_uDcLnkSlowFlt: implemented-entry=Rte_Read_SWC_MDF_RP_SWC_HSPF_HSPF_uDcLnkSlowFlt
        Rte_Read_SWC_MDF_RP_SWC_MCF_MCF_dtPwm: implemented-entry=Rte_Read_SWC_MDF_RP_SWC_MCF_MCF_dtPwm
        Rte_Read_SWC_MDF_RP_SWC_MCF_MCF_iU: implemented-entry=Rte_Read_SWC_MDF_RP_SWC_MCF_MCF_iU
        Rte_Read_SWC_MDF_RP_SWC_MCF_MCF_iV: implemented-entry=Rte_Read_SWC_MDF_RP_SWC_MCF_MCF_iV
        Rte_Read_SWC_MDF_RP_SWC_MCF_MCF_iW: implemented-entry=Rte_Read_SWC_MDF_RP_SWC_MCF_MCF_iW
        Rte_Read_SWC_MDF_RP_SWC_MCF_MCF_idDes: implemented-entry=Rte_Read_SWC_MDF_RP_SWC_MCF_MCF_idDes
        Rte_Read_SWC_MDF_RP_SWC_MCF_MCF_iqDes: implemented-entry=Rte_Read_SWC_MDF_RP_SWC_MCF_MCF_iqDes
        Rte_Read_SWC_MDF_RP_SWC_MCF_MCF_udDes: implemented-entry=Rte_Read_SWC_MDF_RP_SWC_MCF_MCF_udDes
        Rte_Read_SWC_MDF_RP_SWC_MCF_MCF_uqDes: implemented-entry=Rte_Read_SWC_MDF_RP_SWC_MCF_MCF_uqDes
        Rte_Read_SWC_MDF_RP_SWC_MPC_MPC_IsFlt: implemented-entry=Rte_Read_SWC_MDF_RP_SWC_MPC_MPC_IsFlt
        Rte_Read_SWC_MDF_RP_SWC_MPC_MPC_Ld: implemented-entry=Rte_Read_SWC_MDF_RP_SWC_MPC_MPC_Ld
        Rte_Read_SWC_MDF_RP_SWC_MPC_MPC_Lq: implemented-entry=Rte_Read_SWC_MDF_RP_SWC_MPC_MPC_Lq
        Rte_Read_SWC_MDF_RP_SWC_MPC_MPC_Psi: implemented-entry=Rte_Read_SWC_MDF_RP_SWC_MPC_MPC_Psi
        Rte_Read_SWC_MDF_RP_SWC_MPC_MPC_Rs: implemented-entry=Rte_Read_SWC_MDF_RP_SWC_MPC_MPC_Rs
        Rte_Read_SWC_MDF_RP_SWC_MPC_MPC_TrqMech: implemented-entry=Rte_Read_SWC_MDF_RP_SWC_MPC_MPC_TrqMech
        Rte_Read_SWC_MDF_RP_SWC_MPC_MPC_isdFlt: implemented-entry=Rte_Read_SWC_MDF_RP_SWC_MPC_MPC_isdFlt
        Rte_Read_SWC_MDF_RP_SWC_MPC_MPC_isqFlt: implemented-entry=Rte_Read_SWC_MDF_RP_SWC_MPC_MPC_isqFlt
        Rte_Read_SWC_MDF_RP_SWC_RCF_RCF_stAgRtrOfsCal: implemented-entry=Rte_Read_SWC_MDF_RP_SWC_RCF_RCF_stAgRtrOfsCal
        Rte_Read_SWC_MDF_RP_SWC_Rdc_Rdc_nWoFlt: implemented-entry=Rte_Read_SWC_MDF_RP_SWC_Rdc_Rdc_nWoFlt
        Rte_Read_SWC_MDF_RP_SWC_SCF_SCF_stDrvCtl: implemented-entry=Rte_Read_SWC_MDF_RP_SWC_SCF_SCF_stDrvCtl
        Rte_Read_SWC_MDF_RP_SWC_SCF_SCF_stGateDrv: implemented-entry=Rte_Read_SWC_MDF_RP_SWC_SCF_SCF_stGateDrv
        Rte_Read_SWC_MDF_RP_SWC_SCF_SCF_stSysCtl: implemented-entry=Rte_Read_SWC_MDF_RP_SWC_SCF_SCF_stSysCtl
        Rte_Read_SWC_MDF_RP_SWC_VCF_VCF_TrqDes: implemented-entry=Rte_Read_SWC_MDF_RP_SWC_VCF_VCF_TrqDes
        Rte_Read_SWC_MPC_RP_SWC_HSPF_HSPF_nSlowFlt: implemented-entry=Rte_Read_SWC_MPC_RP_SWC_HSPF_HSPF_nSlowFlt
        Rte_Read_SWC_MPC_RP_SWC_HSPF_HSPF_tStrrTempFlt: implemented-entry=Rte_Read_SWC_MPC_RP_SWC_HSPF_HSPF_tStrrTempFlt
        Rte_Read_SWC_MPC_RP_SWC_MCF_MCF_Is: implemented-entry=Rte_Read_SWC_MPC_RP_SWC_MCF_MCF_Is
        Rte_Read_SWC_MPC_RP_SWC_MCF_MCF_VoltModuRate: implemented-entry=Rte_Read_SWC_MPC_RP_SWC_MCF_MCF_VoltModuRate
        Rte_Read_SWC_MPC_RP_SWC_MCF_MCF_idDes: implemented-entry=Rte_Read_SWC_MPC_RP_SWC_MCF_MCF_idDes
        Rte_Read_SWC_MPC_RP_SWC_MCF_MCF_iqDes: implemented-entry=Rte_Read_SWC_MPC_RP_SWC_MCF_MCF_iqDes
        Rte_Read_SWC_MPC_RP_SWC_MCF_MCF_isd: implemented-entry=Rte_Read_SWC_MPC_RP_SWC_MCF_MCF_isd
        Rte_Read_SWC_MPC_RP_SWC_MCF_MCF_isq: implemented-entry=Rte_Read_SWC_MPC_RP_SWC_MCF_MCF_isq
        Rte_Read_SWC_MPC_RP_SWC_MCF_MCF_uDcLnk: implemented-entry=Rte_Read_SWC_MPC_RP_SWC_MCF_MCF_uDcLnk
        Rte_Read_SWC_MPC_RP_SWC_MCF_MCF_udDes: implemented-entry=Rte_Read_SWC_MPC_RP_SWC_MCF_MCF_udDes
        Rte_Read_SWC_MPC_RP_SWC_MCF_MCF_uqDes: implemented-entry=Rte_Read_SWC_MPC_RP_SWC_MCF_MCF_uqDes
        Rte_Read_SWC_MPC_RP_SWC_TDC_TDC_TrqDes: implemented-entry=Rte_Read_SWC_MPC_RP_SWC_TDC_TDC_TrqDes
        Rte_Read_SWC_MPC_RP_SWC_TPC_TPC_stMotorMod: implemented-entry=Rte_Read_SWC_MPC_RP_SWC_TPC_TPC_stMotorMod
        Rte_Read_SWC_PCF_RP_SWC_Com_Com_VCU06_Park: implemented-entry=Rte_Read_SWC_PCF_RP_SWC_Com_Com_VCU06_Park
        Rte_Read_SWC_PCF_RP_SWC_Com_Com_VCU06_VehGrad: implemented-entry=Rte_Read_SWC_PCF_RP_SWC_Com_Com_VCU06_VehGrad
        Rte_Read_SWC_PCF_RP_SWC_Com_Com_VCU06_stBelt: implemented-entry=Rte_Read_SWC_PCF_RP_SWC_Com_Com_VCU06_stBelt
        Rte_Read_SWC_PCF_RP_SWC_Com_Com_VCU06_stBreak: implemented-entry=Rte_Read_SWC_PCF_RP_SWC_Com_Com_VCU06_stBreak
        Rte_Read_SWC_PCF_RP_SWC_Com_Com_VCU06_stDoor: implemented-entry=Rte_Read_SWC_PCF_RP_SWC_Com_Com_VCU06_stDoor
        Rte_Read_SWC_PCF_RP_SWC_Epark_Epark_iPcf: implemented-entry=Rte_Read_SWC_PCF_RP_SWC_Epark_Epark_iPcf
        Rte_Read_SWC_PCF_RP_SWC_Epark_Epark_posPcf: implemented-entry=Rte_Read_SWC_PCF_RP_SWC_Epark_Epark_posPcf
        Rte_Read_SWC_PCF_RP_SWC_Epark_Epark_posPcfMon: implemented-entry=Rte_Read_SWC_PCF_RP_SWC_Epark_Epark_posPcfMon
        Rte_Read_SWC_PCF_RP_SWC_HSPF_HSPF_nSlowFlt: implemented-entry=Rte_Read_SWC_PCF_RP_SWC_HSPF_HSPF_nSlowFlt
        Rte_Read_SWC_PCF_RP_SWC_NvM_NvM_SLFnh: implemented-entry=Rte_Read_SWC_PCF_RP_SWC_NvM_NvM_SLFnh
        Rte_Read_SWC_PCF_RP_SWC_NvM_NvM_SLInPLimt: implemented-entry=Rte_Read_SWC_PCF_RP_SWC_NvM_NvM_SLInPLimt
        Rte_Read_SWC_Pwm3ph_RP_SWC_MCF_MCF_DycU: implemented-entry=Rte_Read_SWC_Pwm3ph_RP_SWC_MCF_MCF_DycU
        Rte_Read_SWC_Pwm3ph_RP_SWC_MCF_MCF_DycV: implemented-entry=Rte_Read_SWC_Pwm3ph_RP_SWC_MCF_MCF_DycV
        Rte_Read_SWC_Pwm3ph_RP_SWC_MCF_MCF_DycW: implemented-entry=Rte_Read_SWC_Pwm3ph_RP_SWC_MCF_MCF_DycW
        Rte_Read_SWC_Pwm3ph_RP_SWC_MCF_MCF_frqPwm: implemented-entry=Rte_Read_SWC_Pwm3ph_RP_SWC_MCF_MCF_frqPwm
        Rte_Read_SWC_Pwm3ph_RP_SWC_MCF_MCF_stPwmMode: implemented-entry=Rte_Read_SWC_Pwm3ph_RP_SWC_MCF_MCF_stPwmMode
        Rte_Read_SWC_RCF_RP_SWC_CSPF_CSPF_RecstModeReq: implemented-entry=Rte_Read_SWC_RCF_RP_SWC_CSPF_CSPF_RecstModeReq
        Rte_Read_SWC_RCF_RP_SWC_HSPF_HSPF_nSlowFlt: implemented-entry=Rte_Read_SWC_RCF_RP_SWC_HSPF_HSPF_nSlowFlt
        Rte_Read_SWC_RCF_RP_SWC_HvMcu_HvMcu_AlOfsClb_TimeStamp: implemented-entry=Rte_Read_SWC_RCF_RP_SWC_HvMcu_HvMcu_AlOfsClb_TimeStamp
        Rte_Read_SWC_RCF_RP_SWC_HvMcu_HvMcu_flgUphaEdgeRiseCo: implemented-entry=Rte_Read_SWC_RCF_RP_SWC_HvMcu_HvMcu_flgUphaEdgeRiseCo
        Rte_Read_SWC_RCF_RP_SWC_MDF_MDF_stFrwhl: implemented-entry=Rte_Read_SWC_RCF_RP_SWC_MDF_MDF_stFrwhl
        Rte_Read_SWC_RCF_RP_SWC_NvM_NvM_flgAngAutoClbOffset: implemented-entry=Rte_Read_SWC_RCF_RP_SWC_NvM_NvM_flgAngAutoClbOffset
        Rte_Read_SWC_RCF_RP_SWC_Rdc_Rdc_ArctanAgRtr: implemented-entry=Rte_Read_SWC_RCF_RP_SWC_Rdc_Rdc_ArctanAgRtr
        Rte_Read_SWC_RCF_RP_SWC_Rdc_Rdc_nWoFlt: implemented-entry=Rte_Read_SWC_RCF_RP_SWC_Rdc_Rdc_nWoFlt
        Rte_Read_SWC_RCF_RP_SWC_SCF_SCF_stDrvCtl: implemented-entry=Rte_Read_SWC_RCF_RP_SWC_SCF_SCF_stDrvCtl
        Rte_Read_SWC_Rdc_PP_SWC_MCF_MCF_cofFrqPwm: implemented-entry=Rte_Read_SWC_Rdc_PP_SWC_MCF_MCF_cofFrqPwm
        Rte_Read_SWC_SCF_RP_SWC_CSPF_CSPF_RecflgCrash: implemented-entry=Rte_Read_SWC_SCF_RP_SWC_CSPF_CSPF_RecflgCrash
        Rte_Read_SWC_SCF_RP_SWC_CSPF_CSPF_RecflgDchaReq: implemented-entry=Rte_Read_SWC_SCF_RP_SWC_CSPF_CSPF_RecflgDchaReq
        Rte_Read_SWC_SCF_RP_SWC_CSPF_CSPF_RecstMainReLay: implemented-entry=Rte_Read_SWC_SCF_RP_SWC_CSPF_CSPF_RecstMainReLay
        Rte_Read_SWC_SCF_RP_SWC_HSPF_HSPF_Wake: implemented-entry=Rte_Read_SWC_SCF_RP_SWC_HSPF_HSPF_Wake
        Rte_Read_SWC_SCF_RP_SWC_HSPF_HSPF_bt15: implemented-entry=Rte_Read_SWC_SCF_RP_SWC_HSPF_HSPF_bt15
        Rte_Read_SWC_SCF_RP_SWC_HSPF_HSPF_flgCrash: implemented-entry=Rte_Read_SWC_SCF_RP_SWC_HSPF_HSPF_flgCrash
        Rte_Read_SWC_SCF_RP_SWC_HSPF_HSPF_nSlowFlt: implemented-entry=Rte_Read_SWC_SCF_RP_SWC_HSPF_HSPF_nSlowFlt
        Rte_Read_SWC_SCF_RP_SWC_HSPF_HSPF_stIphaOffCal: implemented-entry=Rte_Read_SWC_SCF_RP_SWC_HSPF_HSPF_stIphaOffCal
        Rte_Read_SWC_SCF_RP_SWC_HSPF_HSPF_uDcLnkSlowFlt: implemented-entry=Rte_Read_SWC_SCF_RP_SWC_HSPF_HSPF_uDcLnkSlowFlt
        Rte_Read_SWC_SCF_RP_SWC_Igbt_Igbt_flgGateDrvRdyHs: implemented-entry=Rte_Read_SWC_SCF_RP_SWC_Igbt_Igbt_flgGateDrvRdyHs
        Rte_Read_SWC_SCF_RP_SWC_Igbt_Igbt_flgGateDrvRdyLs: implemented-entry=Rte_Read_SWC_SCF_RP_SWC_Igbt_Igbt_flgGateDrvRdyLs
        Rte_Read_SWC_SCF_RP_SWC_LvPower_LvPower_stLowpowerUp: implemented-entry=Rte_Read_SWC_SCF_RP_SWC_LvPower_LvPower_stLowpowerUp
        Rte_Read_SWC_SCF_RP_SWC_MDF_MDF_stFrwhl: implemented-entry=Rte_Read_SWC_SCF_RP_SWC_MDF_MDF_stFrwhl
        Rte_Read_SWC_SCF_RP_SWC_MPC_MPC_IsFlt: implemented-entry=Rte_Read_SWC_SCF_RP_SWC_MPC_MPC_IsFlt
        Rte_Read_SWC_SCF_RP_SWC_NvM_NvM_flgAngAutoClbOffset: implemented-entry=Rte_Read_SWC_SCF_RP_SWC_NvM_NvM_flgAngAutoClbOffset
        Rte_Read_SWC_SCF_RP_SWC_PCF_PCF_SLEnMotorAcc: implemented-entry=Rte_Read_SWC_SCF_RP_SWC_PCF_PCF_SLEnMotorAcc
        Rte_Read_SWC_SCF_RP_SWC_PCF_PCF_Status: implemented-entry=Rte_Read_SWC_SCF_RP_SWC_PCF_PCF_Status
        Rte_Read_SWC_SCF_RP_SWC_PCF_PCF_flgAllowPwmRun: implemented-entry=Rte_Read_SWC_SCF_RP_SWC_PCF_PCF_flgAllowPwmRun
        Rte_Read_SWC_SCF_RP_SWC_PCF_PCF_flgShtDwnReq: implemented-entry=Rte_Read_SWC_SCF_RP_SWC_PCF_PCF_flgShtDwnReq
        Rte_Read_SWC_SCF_RP_SWC_PCF_PCF_stParkCtl: implemented-entry=Rte_Read_SWC_SCF_RP_SWC_PCF_PCF_stParkCtl
        Rte_Read_SWC_SCF_RP_SWC_RCF_RCF_stAgRtrOfsCal: implemented-entry=Rte_Read_SWC_SCF_RP_SWC_RCF_RCF_stAgRtrOfsCal
        Rte_Read_SWC_SCF_RP_SWC_RCF_RCF_stEstAlRtrOfs: implemented-entry=Rte_Read_SWC_SCF_RP_SWC_RCF_RCF_stEstAlRtrOfs
        Rte_Read_SWC_SCF_RP_SWC_Snapshot_Snapshot_flgPostDrvDone: implemented-entry=Rte_Read_SWC_SCF_RP_SWC_Snapshot_Snapshot_flgPostDrvDone
        Rte_Read_SWC_SCF_RP_SWC_Tja1043_Tja1043_flgCAN_WakeUp: implemented-entry=Rte_Read_SWC_SCF_RP_SWC_Tja1043_Tja1043_flgCAN_WakeUp
        Rte_Read_SWC_SCF_RP_SWC_VCF_VCF_stModeReq: implemented-entry=Rte_Read_SWC_SCF_RP_SWC_VCF_VCF_stModeReq
        Rte_Read_SWC_Snapshot_RP_SWC_HvMcu_HvMcu_VDD15L_Vol: implemented-entry=Rte_Read_SWC_Snapshot_RP_SWC_HvMcu_HvMcu_VDD15L_Vol
        Rte_Read_SWC_Snapshot_RP_SWC_HvMcu_HvMcu_uDcLnkHvMcu: implemented-entry=Rte_Read_SWC_Snapshot_RP_SWC_HvMcu_HvMcu_uDcLnkHvMcu
        Rte_Read_SWC_Snapshot_RP_SWC_PhC_PhC_iUNoOff: implemented-entry=Rte_Read_SWC_Snapshot_RP_SWC_PhC_PhC_iUNoOff
        Rte_Read_SWC_Snapshot_RP_SWC_PhC_PhC_iVNoOff: implemented-entry=Rte_Read_SWC_Snapshot_RP_SWC_PhC_PhC_iVNoOff
        Rte_Read_SWC_Snapshot_RP_SWC_PhC_PhC_iWNoOff: implemented-entry=Rte_Read_SWC_Snapshot_RP_SWC_PhC_PhC_iWNoOff
        Rte_Read_SWC_Snapshot_RP_SWC_Rdc_Rdc_ArctanAgRtr: implemented-entry=Rte_Read_SWC_Snapshot_RP_SWC_Rdc_Rdc_ArctanAgRtr
        Rte_Read_SWC_Snapshot_RP_SWC_SCF_SCF_stFFAction: implemented-entry=Rte_Read_SWC_Snapshot_RP_SWC_SCF_SCF_stFFAction
        Rte_Read_SWC_TDC_RP_SWC_Rdc_Rdc_nWoFlt: implemented-entry=Rte_Read_SWC_TDC_RP_SWC_Rdc_Rdc_nWoFlt
        Rte_Read_SWC_TDC_RP_SWC_SCF_SCF_stModeReqToTdc: implemented-entry=Rte_Read_SWC_TDC_RP_SWC_SCF_SCF_stModeReqToTdc
        Rte_Read_SWC_TDC_RP_SWC_TPC_TPC_TrqMax: implemented-entry=Rte_Read_SWC_TDC_RP_SWC_TPC_TPC_TrqMax
        Rte_Read_SWC_TDC_RP_SWC_TPC_TPC_TrqMin: implemented-entry=Rte_Read_SWC_TDC_RP_SWC_TPC_TPC_TrqMin
        Rte_Read_SWC_TDC_RP_SWC_VCF_VCF_HoldStartTrq: implemented-entry=Rte_Read_SWC_TDC_RP_SWC_VCF_VCF_HoldStartTrq
        Rte_Read_SWC_TDC_RP_SWC_VCF_VCF_KpNCtl: implemented-entry=Rte_Read_SWC_TDC_RP_SWC_VCF_VCF_KpNCtl
        Rte_Read_SWC_TDC_RP_SWC_VCF_VCF_NsetPReq: implemented-entry=Rte_Read_SWC_TDC_RP_SWC_VCF_VCF_NsetPReq
        Rte_Read_SWC_TDC_RP_SWC_VCF_VCF_TrqDes: implemented-entry=Rte_Read_SWC_TDC_RP_SWC_VCF_VCF_TrqDes
        Rte_Read_SWC_TDC_RP_SWC_VCF_VCF_stModeReq: implemented-entry=Rte_Read_SWC_TDC_RP_SWC_VCF_VCF_stModeReq
        Rte_Read_SWC_TDC_RP_SWC_VCF_VCF_trqRamp: implemented-entry=Rte_Read_SWC_TDC_RP_SWC_VCF_VCF_trqRamp
        Rte_Read_SWC_TPC_RP_SWC_CSPF_CSPF_RecTrqMax: implemented-entry=Rte_Read_SWC_TPC_RP_SWC_CSPF_CSPF_RecTrqMax
        Rte_Read_SWC_TPC_RP_SWC_CSPF_CSPF_RecTrqMaxNCtL: implemented-entry=Rte_Read_SWC_TPC_RP_SWC_CSPF_CSPF_RecTrqMaxNCtL
        Rte_Read_SWC_TPC_RP_SWC_CSPF_CSPF_RecTrqMin: implemented-entry=Rte_Read_SWC_TPC_RP_SWC_CSPF_CSPF_RecTrqMin
        Rte_Read_SWC_TPC_RP_SWC_CSPF_CSPF_RecTrqMinNCtL: implemented-entry=Rte_Read_SWC_TPC_RP_SWC_CSPF_CSPF_RecTrqMinNCtL
        Rte_Read_SWC_TPC_RP_SWC_CSPF_CSPF_RecUdcMax: implemented-entry=Rte_Read_SWC_TPC_RP_SWC_CSPF_CSPF_RecUdcMax
        Rte_Read_SWC_TPC_RP_SWC_CSPF_CSPF_RecUdcMin: implemented-entry=Rte_Read_SWC_TPC_RP_SWC_CSPF_CSPF_RecUdcMin
        Rte_Read_SWC_TPC_RP_SWC_CSPF_CSPF_RecidcMax: implemented-entry=Rte_Read_SWC_TPC_RP_SWC_CSPF_CSPF_RecidcMax
        Rte_Read_SWC_TPC_RP_SWC_CSPF_CSPF_RecidcMin: implemented-entry=Rte_Read_SWC_TPC_RP_SWC_CSPF_CSPF_RecidcMin
        Rte_Read_SWC_TPC_RP_SWC_HSPF_HSPF_iDcLnkEstFlt: implemented-entry=Rte_Read_SWC_TPC_RP_SWC_HSPF_HSPF_iDcLnkEstFlt
        Rte_Read_SWC_TPC_RP_SWC_HSPF_HSPF_nSlowFlt: implemented-entry=Rte_Read_SWC_TPC_RP_SWC_HSPF_HSPF_nSlowFlt
        Rte_Read_SWC_TPC_RP_SWC_HSPF_HSPF_tCoolantTempFlt: implemented-entry=Rte_Read_SWC_TPC_RP_SWC_HSPF_HSPF_tCoolantTempFlt
        Rte_Read_SWC_TPC_RP_SWC_HSPF_HSPF_tCoolantTjFlt: implemented-entry=Rte_Read_SWC_TPC_RP_SWC_HSPF_HSPF_tCoolantTjFlt
        Rte_Read_SWC_TPC_RP_SWC_HSPF_HSPF_tDBCTempUFlt: implemented-entry=Rte_Read_SWC_TPC_RP_SWC_HSPF_HSPF_tDBCTempUFlt
        Rte_Read_SWC_TPC_RP_SWC_HSPF_HSPF_tDBCTempVFlt: implemented-entry=Rte_Read_SWC_TPC_RP_SWC_HSPF_HSPF_tDBCTempVFlt
        Rte_Read_SWC_TPC_RP_SWC_HSPF_HSPF_tDBCTempWFlt: implemented-entry=Rte_Read_SWC_TPC_RP_SWC_HSPF_HSPF_tDBCTempWFlt
        Rte_Read_SWC_TPC_RP_SWC_HSPF_HSPF_tDrvBoardTempFlt: implemented-entry=Rte_Read_SWC_TPC_RP_SWC_HSPF_HSPF_tDrvBoardTempFlt
        Rte_Read_SWC_TPC_RP_SWC_HSPF_HSPF_tIgbtTjFlt: implemented-entry=Rte_Read_SWC_TPC_RP_SWC_HSPF_HSPF_tIgbtTjFlt
        Rte_Read_SWC_TPC_RP_SWC_HSPF_HSPF_tStrrTempFlt: implemented-entry=Rte_Read_SWC_TPC_RP_SWC_HSPF_HSPF_tStrrTempFlt
        Rte_Read_SWC_TPC_RP_SWC_HSPF_HSPF_uDcLnkSlowFlt: implemented-entry=Rte_Read_SWC_TPC_RP_SWC_HSPF_HSPF_uDcLnkSlowFlt
        Rte_Read_SWC_TPC_RP_SWC_MCF_MCF_Is: implemented-entry=Rte_Read_SWC_TPC_RP_SWC_MCF_MCF_Is
        Rte_Read_SWC_TPC_RP_SWC_MPC_MPC_TrqMech: implemented-entry=Rte_Read_SWC_TPC_RP_SWC_MPC_MPC_TrqMech
        Rte_Read_SWC_TPC_RP_SWC_MPC_MPC_TrqMechFlt: implemented-entry=Rte_Read_SWC_TPC_RP_SWC_MPC_MPC_TrqMechFlt
        Rte_Read_SWC_TPC_RP_SWC_SCF_SCF_flgUdcLowToTpc: implemented-entry=Rte_Read_SWC_TPC_RP_SWC_SCF_SCF_flgUdcLowToTpc
        Rte_Read_SWC_TPC_RP_SWC_VCF_VCF_TrqDes: implemented-entry=Rte_Read_SWC_TPC_RP_SWC_VCF_VCF_TrqDes
        Rte_Read_SWC_TPC_RP_SWC_VCF_VCF_stModeReq: implemented-entry=Rte_Read_SWC_TPC_RP_SWC_VCF_VCF_stModeReq
        Rte_Read_SWC_VCF_RP_SWC_CSPF_CSPF_RecKpDmp: implemented-entry=Rte_Read_SWC_VCF_RP_SWC_CSPF_CSPF_RecKpDmp
        Rte_Read_SWC_VCF_RP_SWC_CSPF_CSPF_RecKpHighNCtL: implemented-entry=Rte_Read_SWC_VCF_RP_SWC_CSPF_CSPF_RecKpHighNCtL
        Rte_Read_SWC_VCF_RP_SWC_CSPF_CSPF_RecKpLowNCtL: implemented-entry=Rte_Read_SWC_VCF_RP_SWC_CSPF_CSPF_RecKpLowNCtL
        Rte_Read_SWC_VCF_RP_SWC_CSPF_CSPF_RecNDiffMax: implemented-entry=Rte_Read_SWC_VCF_RP_SWC_CSPF_CSPF_RecNDiffMax
        Rte_Read_SWC_VCF_RP_SWC_CSPF_CSPF_RecNSetP: implemented-entry=Rte_Read_SWC_VCF_RP_SWC_CSPF_CSPF_RecNSetP
        Rte_Read_SWC_VCF_RP_SWC_CSPF_CSPF_RecTrqDmpMax: implemented-entry=Rte_Read_SWC_VCF_RP_SWC_CSPF_CSPF_RecTrqDmpMax
        Rte_Read_SWC_VCF_RP_SWC_CSPF_CSPF_RecTrqDmpMin: implemented-entry=Rte_Read_SWC_VCF_RP_SWC_CSPF_CSPF_RecTrqDmpMin
        Rte_Read_SWC_VCF_RP_SWC_CSPF_CSPF_RecTrqSLope: implemented-entry=Rte_Read_SWC_VCF_RP_SWC_CSPF_CSPF_RecTrqSLope
        Rte_Read_SWC_VCF_RP_SWC_CSPF_CSPF_RecTrqSetP: implemented-entry=Rte_Read_SWC_VCF_RP_SWC_CSPF_CSPF_RecTrqSetP
        Rte_Read_SWC_VCF_RP_SWC_CSPF_CSPF_RecstDmpCtLReq: implemented-entry=Rte_Read_SWC_VCF_RP_SWC_CSPF_CSPF_RecstDmpCtLReq
        Rte_Read_SWC_VCF_RP_SWC_CSPF_CSPF_RecstModeReq: implemented-entry=Rte_Read_SWC_VCF_RP_SWC_CSPF_CSPF_RecstModeReq
        Rte_Read_SWC_VCF_RP_SWC_HSPF_HSPF_nSlowFlt: implemented-entry=Rte_Read_SWC_VCF_RP_SWC_HSPF_HSPF_nSlowFlt
        Rte_Read_SWC_VCF_RP_SWC_MPC_MPC_TrqMechFlt: implemented-entry=Rte_Read_SWC_VCF_RP_SWC_MPC_MPC_TrqMechFlt
        Rte_Read_SWC_VCF_RP_SWC_PCF_PCF_SLtrqDes: implemented-entry=Rte_Read_SWC_VCF_RP_SWC_PCF_PCF_SLtrqDes
        Rte_Read_SWC_VCF_RP_SWC_PCF_PCF_stParkCtl: implemented-entry=Rte_Read_SWC_VCF_RP_SWC_PCF_PCF_stParkCtl
        Rte_Read_SWC_VCF_RP_SWC_RCF_RCF_TrqEmDesOfsClb: implemented-entry=Rte_Read_SWC_VCF_RP_SWC_RCF_RCF_TrqEmDesOfsClb
        Rte_Read_SWC_VCF_RP_SWC_RCF_RCF_cTrqSlpOfsClb: implemented-entry=Rte_Read_SWC_VCF_RP_SWC_RCF_RCF_cTrqSlpOfsClb
        Rte_Read_SWC_VCF_RP_SWC_Rdc_Rdc_nWoFlt: implemented-entry=Rte_Read_SWC_VCF_RP_SWC_Rdc_Rdc_nWoFlt
        Rte_Read_SWC_VCF_RP_SWC_SCF_SCF_stDrvCtl: implemented-entry=Rte_Read_SWC_VCF_RP_SWC_SCF_SCF_stDrvCtl
        Rte_Read_SWC_VCF_RP_SWC_TDC_TDC_TrqDes: implemented-entry=Rte_Read_SWC_VCF_RP_SWC_TDC_TDC_TrqDes
        Rte_Read_SWC_VCF_RP_SWC_TPC_TPC_SgnRotDir: implemented-entry=Rte_Read_SWC_VCF_RP_SWC_TPC_TPC_SgnRotDir
        Rte_Read_SWC_VCF_RP_SWC_TPC_TPC_SgnTrqMechDir: implemented-entry=Rte_Read_SWC_VCF_RP_SWC_TPC_TPC_SgnTrqMechDir
        Rte_SetEvent: implemented-entry=Rte_SetEvent
        Rte_Start: implemented-entry=Rte_Start
        Rte_Stop: implemented-entry=Rte_Stop
        Rte_Switch_Dcm_Pp_DcmCommunicationControl_ComMChannel_Can_Network_0_Channel_MDGP_DcmCommunicationControl_ComMChannel_Can_Network_0_Channel: implemented-entry=Rte_Switch_Dcm_Pp_DcmCommunicationControl_ComMChannel_Can_Network_0_Channel_MDGP_DcmCommunicationControl_ComMChannel_Can_Network_0_Channel
        Rte_Switch_Dcm_Pp_DcmCommunicationControl_ComMChannel_Can_Network_1_Channel_MDGP_DcmCommunicationControl_ComMChannel_Can_Network_1_Channel: implemented-entry=Rte_Switch_Dcm_Pp_DcmCommunicationControl_ComMChannel_Can_Network_1_Channel_MDGP_DcmCommunicationControl_ComMChannel_Can_Network_1_Channel
        Rte_Switch_Dcm_Pp_DcmControlDTCSetting_MDGP_DcmControlDTCSetting: implemented-entry=Rte_Switch_Dcm_Pp_DcmControlDTCSetting_MDGP_DcmControlDTCSetting
        Rte_Switch_Dcm_Pp_DcmDiagnosticSessionControl_MDGP_DcmDiagnosticSessionControl: implemented-entry=Rte_Switch_Dcm_Pp_DcmDiagnosticSessionControl_MDGP_DcmDiagnosticSessionControl
        Rte_Switch_Dcm_Pp_DcmEcuReset_MDGP_DcmEcuReset: implemented-entry=Rte_Switch_Dcm_Pp_DcmEcuReset_MDGP_DcmEcuReset
        Rte_Switch_Diag_SWC_PPort_Mdg2_MDGP_Mdg2: implemented-entry=Rte_Switch_Diag_SWC_PPort_Mdg2_MDGP_Mdg2
        Rte_WaitWithTimeout: implemented-entry=Rte_WaitWithTimeout
        Rte_WriteQueue: implemented-entry=Rte_WriteQueue
        Rte_Write_Dcm_P_DataServices_DspData_ASW_VER_F189_Data: implemented-entry=Rte_Write_Dcm_P_DataServices_DspData_ASW_VER_F189_Data
        Rte_Write_Dcm_P_DataServices_DspData_SYS_SUP_ID_F18A_Data: implemented-entry=Rte_Write_Dcm_P_DataServices_DspData_SYS_SUP_ID_F18A_Data
        Rte_Write_Diag_SWC_PPort_DataServices_DspData_ASW_VER_F189_Data: implemented-entry=Rte_Write_Diag_SWC_PPort_DataServices_DspData_ASW_VER_F189_Data
        Rte_Write_Diag_SWC_PPort_DataServices_DspData_MANU_DATE_F18B_Data: implemented-entry=Rte_Write_Diag_SWC_PPort_DataServices_DspData_MANU_DATE_F18B_Data
        Rte_Write_Diag_SWC_PPort_DataServices_DspData_SYS_SUP_ID_F18A_Data: implemented-entry=Rte_Write_Diag_SWC_PPort_DataServices_DspData_SYS_SUP_ID_F18A_Data
        Rte_Write_Diag_SWC_PPort_Diag_Request_Shutdown_uint16: implemented-entry=Rte_Write_Diag_SWC_PPort_Diag_Request_Shutdown_uint16
        Rte_Write_Diag_SWC_PPort_TST_FimPermisison_TST_FimPermission: implemented-entry=Rte_Write_Diag_SWC_PPort_TST_FimPermisison_TST_FimPermission
        Rte_Write_NvM_SWC_PP_SWC_NvM_NvM_AngAutoClbOffset: implemented-entry=Rte_Write_NvM_SWC_PP_SWC_NvM_NvM_AngAutoClbOffset
        Rte_Write_NvM_SWC_PP_SWC_NvM_NvM_SLFnh: implemented-entry=Rte_Write_NvM_SWC_PP_SWC_NvM_NvM_SLFnh
        Rte_Write_NvM_SWC_PP_SWC_NvM_NvM_SLInPLimt: implemented-entry=Rte_Write_NvM_SWC_PP_SWC_NvM_NvM_SLInPLimt
        Rte_Write_NvM_SWC_PP_SWC_NvM_NvM_flgAngAutoClbOffset: implemented-entry=Rte_Write_NvM_SWC_PP_SWC_NvM_NvM_flgAngAutoClbOffset
        Rte_Write_NvM_SWC_PPort_NvM_Request_Shutdown_uint16: implemented-entry=Rte_Write_NvM_SWC_PPort_NvM_Request_Shutdown_uint16
        Rte_Write_SWC_BCC_PP_SWC_BCC_BCC_iDcLnkEstFlt: implemented-entry=Rte_Write_SWC_BCC_PP_SWC_BCC_BCC_iDcLnkEstFlt
        Rte_Write_SWC_BCC_PP_SWC_BCC_BCC_tCoolantTj: implemented-entry=Rte_Write_SWC_BCC_PP_SWC_BCC_BCC_tCoolantTj
        Rte_Write_SWC_BCC_PP_SWC_BCC_BCC_tIgbtTj: implemented-entry=Rte_Write_SWC_BCC_PP_SWC_BCC_BCC_tIgbtTj
        Rte_Write_SWC_CSPF_PP_SWC_CSPF_CSPF_RecKpDmp: implemented-entry=Rte_Write_SWC_CSPF_PP_SWC_CSPF_CSPF_RecKpDmp
        Rte_Write_SWC_CSPF_PP_SWC_CSPF_CSPF_RecKpHighNCtL: implemented-entry=Rte_Write_SWC_CSPF_PP_SWC_CSPF_CSPF_RecKpHighNCtL
        Rte_Write_SWC_CSPF_PP_SWC_CSPF_CSPF_RecKpLowNCtL: implemented-entry=Rte_Write_SWC_CSPF_PP_SWC_CSPF_CSPF_RecKpLowNCtL
        Rte_Write_SWC_CSPF_PP_SWC_CSPF_CSPF_RecNDiffMax: implemented-entry=Rte_Write_SWC_CSPF_PP_SWC_CSPF_CSPF_RecNDiffMax
        Rte_Write_SWC_CSPF_PP_SWC_CSPF_CSPF_RecNSetP: implemented-entry=Rte_Write_SWC_CSPF_PP_SWC_CSPF_CSPF_RecNSetP
        Rte_Write_SWC_CSPF_PP_SWC_CSPF_CSPF_RecTrqDmpMax: implemented-entry=Rte_Write_SWC_CSPF_PP_SWC_CSPF_CSPF_RecTrqDmpMax
        Rte_Write_SWC_CSPF_PP_SWC_CSPF_CSPF_RecTrqDmpMin: implemented-entry=Rte_Write_SWC_CSPF_PP_SWC_CSPF_CSPF_RecTrqDmpMin
        Rte_Write_SWC_CSPF_PP_SWC_CSPF_CSPF_RecTrqMax: implemented-entry=Rte_Write_SWC_CSPF_PP_SWC_CSPF_CSPF_RecTrqMax
        Rte_Write_SWC_CSPF_PP_SWC_CSPF_CSPF_RecTrqMaxNCtL: implemented-entry=Rte_Write_SWC_CSPF_PP_SWC_CSPF_CSPF_RecTrqMaxNCtL
        Rte_Write_SWC_CSPF_PP_SWC_CSPF_CSPF_RecTrqMin: implemented-entry=Rte_Write_SWC_CSPF_PP_SWC_CSPF_CSPF_RecTrqMin
        Rte_Write_SWC_CSPF_PP_SWC_CSPF_CSPF_RecTrqMinNCtL: implemented-entry=Rte_Write_SWC_CSPF_PP_SWC_CSPF_CSPF_RecTrqMinNCtL
        Rte_Write_SWC_CSPF_PP_SWC_CSPF_CSPF_RecTrqSLope: implemented-entry=Rte_Write_SWC_CSPF_PP_SWC_CSPF_CSPF_RecTrqSLope
        Rte_Write_SWC_CSPF_PP_SWC_CSPF_CSPF_RecTrqSetP: implemented-entry=Rte_Write_SWC_CSPF_PP_SWC_CSPF_CSPF_RecTrqSetP
        Rte_Write_SWC_CSPF_PP_SWC_CSPF_CSPF_RecUdcMax: implemented-entry=Rte_Write_SWC_CSPF_PP_SWC_CSPF_CSPF_RecUdcMax
        Rte_Write_SWC_CSPF_PP_SWC_CSPF_CSPF_RecUdcMin: implemented-entry=Rte_Write_SWC_CSPF_PP_SWC_CSPF_CSPF_RecUdcMin
        Rte_Write_SWC_CSPF_PP_SWC_CSPF_CSPF_RecflgCrash: implemented-entry=Rte_Write_SWC_CSPF_PP_SWC_CSPF_CSPF_RecflgCrash
        Rte_Write_SWC_CSPF_PP_SWC_CSPF_CSPF_RecflgDchaReq: implemented-entry=Rte_Write_SWC_CSPF_PP_SWC_CSPF_CSPF_RecflgDchaReq
        Rte_Write_SWC_CSPF_PP_SWC_CSPF_CSPF_RecidcMax: implemented-entry=Rte_Write_SWC_CSPF_PP_SWC_CSPF_CSPF_RecidcMax
        Rte_Write_SWC_CSPF_PP_SWC_CSPF_CSPF_RecidcMin: implemented-entry=Rte_Write_SWC_CSPF_PP_SWC_CSPF_CSPF_RecidcMin
        Rte_Write_SWC_CSPF_PP_SWC_CSPF_CSPF_RecstDmpCtLReq: implemented-entry=Rte_Write_SWC_CSPF_PP_SWC_CSPF_CSPF_RecstDmpCtLReq
        Rte_Write_SWC_CSPF_PP_SWC_CSPF_CSPF_RecstMainReLay: implemented-entry=Rte_Write_SWC_CSPF_PP_SWC_CSPF_CSPF_RecstMainReLay
        Rte_Write_SWC_CSPF_PP_SWC_CSPF_CSPF_RecstModeReq: implemented-entry=Rte_Write_SWC_CSPF_PP_SWC_CSPF_CSPF_RecstModeReq
        Rte_Write_SWC_CSPF_PP_SWC_CSPF_CSPF_TraCodeVer: implemented-entry=Rte_Write_SWC_CSPF_PP_SWC_CSPF_CSPF_TraCodeVer
        Rte_Write_SWC_CSPF_PP_SWC_CSPF_CSPF_TraCpldVer: implemented-entry=Rte_Write_SWC_CSPF_PP_SWC_CSPF_CSPF_TraCpldVer
        Rte_Write_SWC_CSPF_PP_SWC_CSPF_CSPF_TraDataVer: implemented-entry=Rte_Write_SWC_CSPF_PP_SWC_CSPF_CSPF_TraDataVer
        Rte_Write_SWC_CSPF_PP_SWC_CSPF_CSPF_TraFailCode{1..8}: implemented-entry=Rte_Write_SWC_CSPF_PP_SWC_CSPF_CSPF_TraFailCode{1..8}
        Rte_Write_SWC_CSPF_PP_SWC_CSPF_CSPF_TraHvMcuVer: implemented-entry=Rte_Write_SWC_CSPF_PP_SWC_CSPF_CSPF_TraHvMcuVer
        Rte_Write_SWC_CSPF_PP_SWC_CSPF_CSPF_TraHwVer: implemented-entry=Rte_Write_SWC_CSPF_PP_SWC_CSPF_CSPF_TraHwVer
        Rte_Write_SWC_CSPF_PP_SWC_CSPF_CSPF_TraNCurr: implemented-entry=Rte_Write_SWC_CSPF_PP_SWC_CSPF_CSPF_TraNCurr
        Rte_Write_SWC_CSPF_PP_SWC_CSPF_CSPF_TraOfsAL: implemented-entry=Rte_Write_SWC_CSPF_PP_SWC_CSPF_CSPF_TraOfsAL
        Rte_Write_SWC_CSPF_PP_SWC_CSPF_CSPF_TraTempCurrCooL: implemented-entry=Rte_Write_SWC_CSPF_PP_SWC_CSPF_CSPF_TraTempCurrCooL
        Rte_Write_SWC_CSPF_PP_SWC_CSPF_CSPF_TraTempCurrStr1: implemented-entry=Rte_Write_SWC_CSPF_PP_SWC_CSPF_CSPF_TraTempCurrStr1
        Rte_Write_SWC_CSPF_PP_SWC_CSPF_CSPF_TraTempCurrStr2: implemented-entry=Rte_Write_SWC_CSPF_PP_SWC_CSPF_CSPF_TraTempCurrStr2
        Rte_Write_SWC_CSPF_PP_SWC_CSPF_CSPF_TraTrqAbsMax: implemented-entry=Rte_Write_SWC_CSPF_PP_SWC_CSPF_CSPF_TraTrqAbsMax
        Rte_Write_SWC_CSPF_PP_SWC_CSPF_CSPF_TraTrqAbsMin: implemented-entry=Rte_Write_SWC_CSPF_PP_SWC_CSPF_CSPF_TraTrqAbsMin
        Rte_Write_SWC_CSPF_PP_SWC_CSPF_CSPF_TraTrqCurr: implemented-entry=Rte_Write_SWC_CSPF_PP_SWC_CSPF_CSPF_TraTrqCurr
        Rte_Write_SWC_CSPF_PP_SWC_CSPF_CSPF_TraTrqCurrWoDmpC: implemented-entry=Rte_Write_SWC_CSPF_PP_SWC_CSPF_CSPF_TraTrqCurrWoDmpC
        Rte_Write_SWC_CSPF_PP_SWC_CSPF_CSPF_TraUT30Curr: implemented-entry=Rte_Write_SWC_CSPF_PP_SWC_CSPF_CSPF_TraUT30Curr
        Rte_Write_SWC_CSPF_PP_SWC_CSPF_CSPF_TraUdcCurr: implemented-entry=Rte_Write_SWC_CSPF_PP_SWC_CSPF_CSPF_TraUdcCurr
        Rte_Write_SWC_CSPF_PP_SWC_CSPF_CSPF_TraagRtrELecSnsr: implemented-entry=Rte_Write_SWC_CSPF_PP_SWC_CSPF_CSPF_TraagRtrELecSnsr
        Rte_Write_SWC_CSPF_PP_SWC_CSPF_CSPF_TrabDernCAN: implemented-entry=Rte_Write_SWC_CSPF_PP_SWC_CSPF_CSPF_TrabDernCAN
        Rte_Write_SWC_CSPF_PP_SWC_CSPF_CSPF_TrabDernDrvBoardTemp: implemented-entry=Rte_Write_SWC_CSPF_PP_SWC_CSPF_CSPF_TrabDernDrvBoardTemp
        Rte_Write_SWC_CSPF_PP_SWC_CSPF_CSPF_TrabDernN: implemented-entry=Rte_Write_SWC_CSPF_PP_SWC_CSPF_CSPF_TrabDernN
        Rte_Write_SWC_CSPF_PP_SWC_CSPF_CSPF_TrabDernOvrUdc: implemented-entry=Rte_Write_SWC_CSPF_PP_SWC_CSPF_CSPF_TrabDernOvrUdc
        Rte_Write_SWC_CSPF_PP_SWC_CSPF_CSPF_TrabDernOvridc: implemented-entry=Rte_Write_SWC_CSPF_PP_SWC_CSPF_CSPF_TrabDernOvridc
        Rte_Write_SWC_CSPF_PP_SWC_CSPF_CSPF_TrabDernStrTemp: implemented-entry=Rte_Write_SWC_CSPF_PP_SWC_CSPF_CSPF_TrabDernStrTemp
        Rte_Write_SWC_CSPF_PP_SWC_CSPF_CSPF_TrabDernTempCooL: implemented-entry=Rte_Write_SWC_CSPF_PP_SWC_CSPF_CSPF_TrabDernTempCooL
        Rte_Write_SWC_CSPF_PP_SWC_CSPF_CSPF_TrabDernTempiGBT: implemented-entry=Rte_Write_SWC_CSPF_PP_SWC_CSPF_CSPF_TrabDernTempiGBT
        Rte_Write_SWC_CSPF_PP_SWC_CSPF_CSPF_TrabDernTrqMax: implemented-entry=Rte_Write_SWC_CSPF_PP_SWC_CSPF_CSPF_TrabDernTrqMax
        Rte_Write_SWC_CSPF_PP_SWC_CSPF_CSPF_TrabDernTrqMin: implemented-entry=Rte_Write_SWC_CSPF_PP_SWC_CSPF_CSPF_TrabDernTrqMin
        Rte_Write_SWC_CSPF_PP_SWC_CSPF_CSPF_TrabDernUndrUdc: implemented-entry=Rte_Write_SWC_CSPF_PP_SWC_CSPF_CSPF_TrabDernUndrUdc
        Rte_Write_SWC_CSPF_PP_SWC_CSPF_CSPF_TrabDmpCActv: implemented-entry=Rte_Write_SWC_CSPF_PP_SWC_CSPF_CSPF_TrabDmpCActv
        Rte_Write_SWC_CSPF_PP_SWC_CSPF_CSPF_TrabReadyHv: implemented-entry=Rte_Write_SWC_CSPF_PP_SWC_CSPF_CSPF_TrabReadyHv
        Rte_Write_SWC_CSPF_PP_SWC_CSPF_CSPF_TraiGBTTempU: implemented-entry=Rte_Write_SWC_CSPF_PP_SWC_CSPF_CSPF_TraiGBTTempU
        Rte_Write_SWC_CSPF_PP_SWC_CSPF_CSPF_TraiGBTTempV: implemented-entry=Rte_Write_SWC_CSPF_PP_SWC_CSPF_CSPF_TraiGBTTempV
        Rte_Write_SWC_CSPF_PP_SWC_CSPF_CSPF_TraiGBTTempW: implemented-entry=Rte_Write_SWC_CSPF_PP_SWC_CSPF_CSPF_TraiGBTTempW
        Rte_Write_SWC_CSPF_PP_SWC_CSPF_CSPF_TraidcCurr: implemented-entry=Rte_Write_SWC_CSPF_PP_SWC_CSPF_CSPF_TraidcCurr
        Rte_Write_SWC_CSPF_PP_SWC_CSPF_CSPF_TraisCurr: implemented-entry=Rte_Write_SWC_CSPF_PP_SWC_CSPF_CSPF_TraisCurr
        Rte_Write_SWC_CSPF_PP_SWC_CSPF_CSPF_Traisd: implemented-entry=Rte_Write_SWC_CSPF_PP_SWC_CSPF_CSPF_Traisd
        Rte_Write_SWC_CSPF_PP_SWC_CSPF_CSPF_Traisq: implemented-entry=Rte_Write_SWC_CSPF_PP_SWC_CSPF_CSPF_Traisq
        Rte_Write_SWC_CSPF_PP_SWC_CSPF_CSPF_TrastDischg: implemented-entry=Rte_Write_SWC_CSPF_PP_SWC_CSPF_CSPF_TrastDischg
        Rte_Write_SWC_CSPF_PP_SWC_CSPF_CSPF_TrastGateDrv: implemented-entry=Rte_Write_SWC_CSPF_PP_SWC_CSPF_CSPF_TrastGateDrv
        Rte_Write_SWC_CSPF_PP_SWC_CSPF_CSPF_TrastMode: implemented-entry=Rte_Write_SWC_CSPF_PP_SWC_CSPF_CSPF_TrastMode
        Rte_Write_SWC_CSPF_PP_SWC_CSPF_CSPF_TrastTrqEmMax: implemented-entry=Rte_Write_SWC_CSPF_PP_SWC_CSPF_CSPF_TrastTrqEmMax
        Rte_Write_SWC_CSPF_PP_SWC_CSPF_CSPF_TrastTrqEmMin: implemented-entry=Rte_Write_SWC_CSPF_PP_SWC_CSPF_CSPF_TrastTrqEmMin
        Rte_Write_SWC_Cpld_PP_SWC_Cpld_Cpld_CpldSwVer: implemented-entry=Rte_Write_SWC_Cpld_PP_SWC_Cpld_Cpld_CpldSwVer
        Rte_Write_SWC_Cpld_PP_SWC_Cpld_Cpld_IgbtState: implemented-entry=Rte_Write_SWC_Cpld_PP_SWC_Cpld_Cpld_IgbtState
        Rte_Write_SWC_Cpld_PP_SWC_Cpld_Cpld_ProjectNum: implemented-entry=Rte_Write_SWC_Cpld_PP_SWC_Cpld_Cpld_ProjectNum
        Rte_Write_SWC_DiagCalib_PP_SWC_DiagCalib_DiagCalib_FailCode{1..8}: implemented-entry=Rte_Write_SWC_DiagCalib_PP_SWC_DiagCalib_DiagCalib_FailCode{1..8}
        Rte_Write_SWC_Epark_PP_SWC_Epark_Epark_iPcf: implemented-entry=Rte_Write_SWC_Epark_PP_SWC_Epark_Epark_iPcf
        Rte_Write_SWC_Epark_PP_SWC_Epark_Epark_posPcf: implemented-entry=Rte_Write_SWC_Epark_PP_SWC_Epark_Epark_posPcf
        Rte_Write_SWC_Epark_PP_SWC_Epark_Epark_posPcfMon: implemented-entry=Rte_Write_SWC_Epark_PP_SWC_Epark_Epark_posPcfMon
        Rte_Write_SWC_HSPF_PP_SWC_HSPF_HSPF_INV_Open: implemented-entry=Rte_Write_SWC_HSPF_PP_SWC_HSPF_HSPF_INV_Open
        Rte_Write_SWC_HSPF_PP_SWC_HSPF_HSPF_Motor_Open: implemented-entry=Rte_Write_SWC_HSPF_PP_SWC_HSPF_HSPF_Motor_Open
        Rte_Write_SWC_HSPF_PP_SWC_HSPF_HSPF_PwrDcLnk: implemented-entry=Rte_Write_SWC_HSPF_PP_SWC_HSPF_HSPF_PwrDcLnk
        Rte_Write_SWC_HSPF_PP_SWC_HSPF_HSPF_Wake: implemented-entry=Rte_Write_SWC_HSPF_PP_SWC_HSPF_HSPF_Wake
        Rte_Write_SWC_HSPF_PP_SWC_HSPF_HSPF_bt15: implemented-entry=Rte_Write_SWC_HSPF_PP_SWC_HSPF_HSPF_bt15
        Rte_Write_SWC_HSPF_PP_SWC_HSPF_HSPF_flgCrash: implemented-entry=Rte_Write_SWC_HSPF_PP_SWC_HSPF_HSPF_flgCrash
        Rte_Write_SWC_HSPF_PP_SWC_HSPF_HSPF_iDcLnkEstFlt: implemented-entry=Rte_Write_SWC_HSPF_PP_SWC_HSPF_HSPF_iDcLnkEstFlt
        Rte_Write_SWC_HSPF_PP_SWC_HSPF_HSPF_iPhaUOffset: implemented-entry=Rte_Write_SWC_HSPF_PP_SWC_HSPF_HSPF_iPhaUOffset
        Rte_Write_SWC_HSPF_PP_SWC_HSPF_HSPF_iPhaVOffset: implemented-entry=Rte_Write_SWC_HSPF_PP_SWC_HSPF_HSPF_iPhaVOffset
        Rte_Write_SWC_HSPF_PP_SWC_HSPF_HSPF_iPhaWOffset: implemented-entry=Rte_Write_SWC_HSPF_PP_SWC_HSPF_HSPF_iPhaWOffset
        Rte_Write_SWC_HSPF_PP_SWC_HSPF_HSPF_nSlowFlt: implemented-entry=Rte_Write_SWC_HSPF_PP_SWC_HSPF_HSPF_nSlowFlt
        Rte_Write_SWC_HSPF_PP_SWC_HSPF_HSPF_stIphaOffCal: implemented-entry=Rte_Write_SWC_HSPF_PP_SWC_HSPF_HSPF_stIphaOffCal
        Rte_Write_SWC_HSPF_PP_SWC_HSPF_HSPF_tCoolantTempFlt: implemented-entry=Rte_Write_SWC_HSPF_PP_SWC_HSPF_HSPF_tCoolantTempFlt
        Rte_Write_SWC_HSPF_PP_SWC_HSPF_HSPF_tCoolantTjFlt: implemented-entry=Rte_Write_SWC_HSPF_PP_SWC_HSPF_HSPF_tCoolantTjFlt
        Rte_Write_SWC_HSPF_PP_SWC_HSPF_HSPF_tDBCTempUFlt: implemented-entry=Rte_Write_SWC_HSPF_PP_SWC_HSPF_HSPF_tDBCTempUFlt
        Rte_Write_SWC_HSPF_PP_SWC_HSPF_HSPF_tDBCTempVFlt: implemented-entry=Rte_Write_SWC_HSPF_PP_SWC_HSPF_HSPF_tDBCTempVFlt
        Rte_Write_SWC_HSPF_PP_SWC_HSPF_HSPF_tDBCTempWFlt: implemented-entry=Rte_Write_SWC_HSPF_PP_SWC_HSPF_HSPF_tDBCTempWFlt
        Rte_Write_SWC_HSPF_PP_SWC_HSPF_HSPF_tDrvBoardTempFlt: implemented-entry=Rte_Write_SWC_HSPF_PP_SWC_HSPF_HSPF_tDrvBoardTempFlt
        Rte_Write_SWC_HSPF_PP_SWC_HSPF_HSPF_tIgbtTjFlt: implemented-entry=Rte_Write_SWC_HSPF_PP_SWC_HSPF_HSPF_tIgbtTjFlt
        Rte_Write_SWC_HSPF_PP_SWC_HSPF_HSPF_tStrrTemp1Flt: implemented-entry=Rte_Write_SWC_HSPF_PP_SWC_HSPF_HSPF_tStrrTemp1Flt
        Rte_Write_SWC_HSPF_PP_SWC_HSPF_HSPF_tStrrTemp2Flt: implemented-entry=Rte_Write_SWC_HSPF_PP_SWC_HSPF_HSPF_tStrrTemp2Flt
        Rte_Write_SWC_HSPF_PP_SWC_HSPF_HSPF_tStrrTempFlt: implemented-entry=Rte_Write_SWC_HSPF_PP_SWC_HSPF_HSPF_tStrrTempFlt
        Rte_Write_SWC_HSPF_PP_SWC_HSPF_HSPF_uDcLnkSlowFlt: implemented-entry=Rte_Write_SWC_HSPF_PP_SWC_HSPF_HSPF_uDcLnkSlowFlt
        Rte_Write_SWC_HSPF_PP_SWC_HSPF_HSPF_uKl30Flt: implemented-entry=Rte_Write_SWC_HSPF_PP_SWC_HSPF_HSPF_uKl30Flt
        Rte_Write_SWC_HvMcu_PP_SWC_HvMcu_HvMcu_AlOfsClb_TimeStamp: implemented-entry=Rte_Write_SWC_HvMcu_PP_SWC_HvMcu_HvMcu_AlOfsClb_TimeStamp
        Rte_Write_SWC_HvMcu_PP_SWC_HvMcu_HvMcu_HvMcuVer: implemented-entry=Rte_Write_SWC_HvMcu_PP_SWC_HvMcu_HvMcu_HvMcuVer
        Rte_Write_SWC_HvMcu_PP_SWC_HvMcu_HvMcu_VDD15L_Vol: implemented-entry=Rte_Write_SWC_HvMcu_PP_SWC_HvMcu_HvMcu_VDD15L_Vol
        Rte_Write_SWC_HvMcu_PP_SWC_HvMcu_HvMcu_flgUphaEdgeRiseCo: implemented-entry=Rte_Write_SWC_HvMcu_PP_SWC_HvMcu_HvMcu_flgUphaEdgeRiseCo
        Rte_Write_SWC_HvMcu_PP_SWC_HvMcu_HvMcu_tDBCTempU: implemented-entry=Rte_Write_SWC_HvMcu_PP_SWC_HvMcu_HvMcu_tDBCTempU
        Rte_Write_SWC_HvMcu_PP_SWC_HvMcu_HvMcu_tDBCTempV: implemented-entry=Rte_Write_SWC_HvMcu_PP_SWC_HvMcu_HvMcu_tDBCTempV
        Rte_Write_SWC_HvMcu_PP_SWC_HvMcu_HvMcu_tDBCTempW: implemented-entry=Rte_Write_SWC_HvMcu_PP_SWC_HvMcu_HvMcu_tDBCTempW
        Rte_Write_SWC_HvMcu_PP_SWC_HvMcu_HvMcu_tDrvBoardTemp: implemented-entry=Rte_Write_SWC_HvMcu_PP_SWC_HvMcu_HvMcu_tDrvBoardTemp
        Rte_Write_SWC_HvMcu_PP_SWC_HvMcu_HvMcu_uBackEMF_U: implemented-entry=Rte_Write_SWC_HvMcu_PP_SWC_HvMcu_HvMcu_uBackEMF_U
        Rte_Write_SWC_HvMcu_PP_SWC_HvMcu_HvMcu_uBackEMF_V: implemented-entry=Rte_Write_SWC_HvMcu_PP_SWC_HvMcu_HvMcu_uBackEMF_V
        Rte_Write_SWC_HvMcu_PP_SWC_HvMcu_HvMcu_uBackEMF_W: implemented-entry=Rte_Write_SWC_HvMcu_PP_SWC_HvMcu_HvMcu_uBackEMF_W
        Rte_Write_SWC_HvMcu_PP_SWC_HvMcu_HvMcu_uDcLnkHvMcu: implemented-entry=Rte_Write_SWC_HvMcu_PP_SWC_HvMcu_HvMcu_uDcLnkHvMcu
        Rte_Write_SWC_Igbt_PP_SWC_Igbt_Igbt_flgGateDrvRdyHs: implemented-entry=Rte_Write_SWC_Igbt_PP_SWC_Igbt_Igbt_flgGateDrvRdyHs
        Rte_Write_SWC_Igbt_PP_SWC_Igbt_Igbt_flgGateDrvRdyLs: implemented-entry=Rte_Write_SWC_Igbt_PP_SWC_Igbt_Igbt_flgGateDrvRdyLs
        Rte_Write_SWC_LvPower_PP_SWC_LvPower_LvPower_stLowpowerUp: implemented-entry=Rte_Write_SWC_LvPower_PP_SWC_LvPower_LvPower_stLowpowerUp
        Rte_Write_SWC_MCF_PP_SWC_MCF_MCF_DycU: implemented-entry=Rte_Write_SWC_MCF_PP_SWC_MCF_MCF_DycU
        Rte_Write_SWC_MCF_PP_SWC_MCF_MCF_DycV: implemented-entry=Rte_Write_SWC_MCF_PP_SWC_MCF_MCF_DycV
        Rte_Write_SWC_MCF_PP_SWC_MCF_MCF_DycW: implemented-entry=Rte_Write_SWC_MCF_PP_SWC_MCF_MCF_DycW
        Rte_Write_SWC_MCF_PP_SWC_MCF_MCF_Is: implemented-entry=Rte_Write_SWC_MCF_PP_SWC_MCF_MCF_Is
        Rte_Write_SWC_MCF_PP_SWC_MCF_MCF_VoltModuRate: implemented-entry=Rte_Write_SWC_MCF_PP_SWC_MCF_MCF_VoltModuRate
        Rte_Write_SWC_MCF_PP_SWC_MCF_MCF_cofFrqPwm: implemented-entry=Rte_Write_SWC_MCF_PP_SWC_MCF_MCF_cofFrqPwm
        Rte_Write_SWC_MCF_PP_SWC_MCF_MCF_dtPwm: implemented-entry=Rte_Write_SWC_MCF_PP_SWC_MCF_MCF_dtPwm
        Rte_Write_SWC_MCF_PP_SWC_MCF_MCF_frqPwm: implemented-entry=Rte_Write_SWC_MCF_PP_SWC_MCF_MCF_frqPwm
        Rte_Write_SWC_MCF_PP_SWC_MCF_MCF_iU: implemented-entry=Rte_Write_SWC_MCF_PP_SWC_MCF_MCF_iU
        Rte_Write_SWC_MCF_PP_SWC_MCF_MCF_iV: implemented-entry=Rte_Write_SWC_MCF_PP_SWC_MCF_MCF_iV
        Rte_Write_SWC_MCF_PP_SWC_MCF_MCF_iW: implemented-entry=Rte_Write_SWC_MCF_PP_SWC_MCF_MCF_iW
        Rte_Write_SWC_MCF_PP_SWC_MCF_MCF_idDes: implemented-entry=Rte_Write_SWC_MCF_PP_SWC_MCF_MCF_idDes
        Rte_Write_SWC_MCF_PP_SWC_MCF_MCF_iqDes: implemented-entry=Rte_Write_SWC_MCF_PP_SWC_MCF_MCF_iqDes
        Rte_Write_SWC_MCF_PP_SWC_MCF_MCF_isd: implemented-entry=Rte_Write_SWC_MCF_PP_SWC_MCF_MCF_isd
        Rte_Write_SWC_MCF_PP_SWC_MCF_MCF_isq: implemented-entry=Rte_Write_SWC_MCF_PP_SWC_MCF_MCF_isq
        Rte_Write_SWC_MCF_PP_SWC_MCF_MCF_secVolt: implemented-entry=Rte_Write_SWC_MCF_PP_SWC_MCF_MCF_secVolt
        Rte_Write_SWC_MCF_PP_SWC_MCF_MCF_stPwmMode: implemented-entry=Rte_Write_SWC_MCF_PP_SWC_MCF_MCF_stPwmMode
        Rte_Write_SWC_MCF_PP_SWC_MCF_MCF_tiLock: implemented-entry=Rte_Write_SWC_MCF_PP_SWC_MCF_MCF_tiLock
        Rte_Write_SWC_MCF_PP_SWC_MCF_MCF_uDcLnk: implemented-entry=Rte_Write_SWC_MCF_PP_SWC_MCF_MCF_uDcLnk
        Rte_Write_SWC_MCF_PP_SWC_MCF_MCF_udDes: implemented-entry=Rte_Write_SWC_MCF_PP_SWC_MCF_MCF_udDes
        Rte_Write_SWC_MCF_PP_SWC_MCF_MCF_uqDes: implemented-entry=Rte_Write_SWC_MCF_PP_SWC_MCF_MCF_uqDes
        Rte_Write_SWC_MDF_PP_SWC_MDF_MDF_bFaultEMBlkWarnSt: implemented-entry=Rte_Write_SWC_MDF_PP_SWC_MDF_MDF_bFaultEMBlkWarnSt
        Rte_Write_SWC_MDF_PP_SWC_MDF_MDF_stFrwhl: implemented-entry=Rte_Write_SWC_MDF_PP_SWC_MDF_MDF_stFrwhl
        Rte_Write_SWC_MPC_PP_SWC_MPC_MPC_CofRandomPwm: implemented-entry=Rte_Write_SWC_MPC_PP_SWC_MPC_MPC_CofRandomPwm
        Rte_Write_SWC_MPC_PP_SWC_MPC_MPC_IsFlt: implemented-entry=Rte_Write_SWC_MPC_PP_SWC_MPC_MPC_IsFlt
        Rte_Write_SWC_MPC_PP_SWC_MPC_MPC_Ld: implemented-entry=Rte_Write_SWC_MPC_PP_SWC_MPC_MPC_Ld
        Rte_Write_SWC_MPC_PP_SWC_MPC_MPC_LdSubLq: implemented-entry=Rte_Write_SWC_MPC_PP_SWC_MPC_MPC_LdSubLq
        Rte_Write_SWC_MPC_PP_SWC_MPC_MPC_Lq: implemented-entry=Rte_Write_SWC_MPC_PP_SWC_MPC_MPC_Lq
        Rte_Write_SWC_MPC_PP_SWC_MPC_MPC_OmBw: implemented-entry=Rte_Write_SWC_MPC_PP_SWC_MPC_MPC_OmBw
        Rte_Write_SWC_MPC_PP_SWC_MPC_MPC_Psi: implemented-entry=Rte_Write_SWC_MPC_PP_SWC_MPC_MPC_Psi
        Rte_Write_SWC_MPC_PP_SWC_MPC_MPC_Rs: implemented-entry=Rte_Write_SWC_MPC_PP_SWC_MPC_MPC_Rs
        Rte_Write_SWC_MPC_PP_SWC_MPC_MPC_Rv: implemented-entry=Rte_Write_SWC_MPC_PP_SWC_MPC_MPC_Rv
        Rte_Write_SWC_MPC_PP_SWC_MPC_MPC_TrqMech: implemented-entry=Rte_Write_SWC_MPC_PP_SWC_MPC_MPC_TrqMech
        Rte_Write_SWC_MPC_PP_SWC_MPC_MPC_TrqMechFlt: implemented-entry=Rte_Write_SWC_MPC_PP_SWC_MPC_MPC_TrqMechFlt
        Rte_Write_SWC_MPC_PP_SWC_MPC_MPC_dtCorFac: implemented-entry=Rte_Write_SWC_MPC_PP_SWC_MPC_MPC_dtCorFac
        Rte_Write_SWC_MPC_PP_SWC_MPC_MPC_frqPwmVF: implemented-entry=Rte_Write_SWC_MPC_PP_SWC_MPC_MPC_frqPwmVF
        Rte_Write_SWC_MPC_PP_SWC_MPC_MPC_isdFF: implemented-entry=Rte_Write_SWC_MPC_PP_SWC_MPC_MPC_isdFF
        Rte_Write_SWC_MPC_PP_SWC_MPC_MPC_isdFlt: implemented-entry=Rte_Write_SWC_MPC_PP_SWC_MPC_MPC_isdFlt
        Rte_Write_SWC_MPC_PP_SWC_MPC_MPC_isdMTPA: implemented-entry=Rte_Write_SWC_MPC_PP_SWC_MPC_MPC_isdMTPA
        Rte_Write_SWC_MPC_PP_SWC_MPC_MPC_isdMTPV: implemented-entry=Rte_Write_SWC_MPC_PP_SWC_MPC_MPC_isdMTPV
        Rte_Write_SWC_MPC_PP_SWC_MPC_MPC_isqFlt: implemented-entry=Rte_Write_SWC_MPC_PP_SWC_MPC_MPC_isqFlt
        Rte_Write_SWC_PCF_PP_SWC_PCF_PCF_MotDir: implemented-entry=Rte_Write_SWC_PCF_PP_SWC_PCF_PCF_MotDir
        Rte_Write_SWC_PCF_PP_SWC_PCF_PCF_Pos1: implemented-entry=Rte_Write_SWC_PCF_PP_SWC_PCF_PCF_Pos1
        Rte_Write_SWC_PCF_PP_SWC_PCF_PCF_SLEnMotorAcc: implemented-entry=Rte_Write_SWC_PCF_PP_SWC_PCF_PCF_SLEnMotorAcc
        Rte_Write_SWC_PCF_PP_SWC_PCF_PCF_SLInPLimt: implemented-entry=Rte_Write_SWC_PCF_PP_SWC_PCF_PCF_SLInPLimt
        Rte_Write_SWC_PCF_PP_SWC_PCF_PCF_SLInPLimtPos: implemented-entry=Rte_Write_SWC_PCF_PP_SWC_PCF_PCF_SLInPLimtPos
        Rte_Write_SWC_PCF_PP_SWC_PCF_PCF_SLtrqDes: implemented-entry=Rte_Write_SWC_PCF_PP_SWC_PCF_PCF_SLtrqDes
        Rte_Write_SWC_PCF_PP_SWC_PCF_PCF_Status: implemented-entry=Rte_Write_SWC_PCF_PP_SWC_PCF_PCF_Status
        Rte_Write_SWC_PCF_PP_SWC_PCF_PCF_dycPWM: implemented-entry=Rte_Write_SWC_PCF_PP_SWC_PCF_PCF_dycPWM
        Rte_Write_SWC_PCF_PP_SWC_PCF_PCF_enMos: implemented-entry=Rte_Write_SWC_PCF_PP_SWC_PCF_PCF_enMos
        Rte_Write_SWC_PCF_PP_SWC_PCF_PCF_flgAllowPwmRun: implemented-entry=Rte_Write_SWC_PCF_PP_SWC_PCF_PCF_flgAllowPwmRun
        Rte_Write_SWC_PCF_PP_SWC_PCF_PCF_flgSLWD: implemented-entry=Rte_Write_SWC_PCF_PP_SWC_PCF_PCF_flgSLWD
        Rte_Write_SWC_PCF_PP_SWC_PCF_PCF_flgShtDwnReq: implemented-entry=Rte_Write_SWC_PCF_PP_SWC_PCF_PCF_flgShtDwnReq
        Rte_Write_SWC_PCF_PP_SWC_PCF_PCF_iPcf: implemented-entry=Rte_Write_SWC_PCF_PP_SWC_PCF_PCF_iPcf
        Rte_Write_SWC_PCF_PP_SWC_PCF_PCF_stParkCtl: implemented-entry=Rte_Write_SWC_PCF_PP_SWC_PCF_PCF_stParkCtl
        Rte_Write_SWC_PhC_PP_SWC_PhC_PhC_iUNoOff: implemented-entry=Rte_Write_SWC_PhC_PP_SWC_PhC_PhC_iUNoOff
        Rte_Write_SWC_PhC_PP_SWC_PhC_PhC_iVNoOff: implemented-entry=Rte_Write_SWC_PhC_PP_SWC_PhC_PhC_iVNoOff
        Rte_Write_SWC_PhC_PP_SWC_PhC_PhC_iWNoOff: implemented-entry=Rte_Write_SWC_PhC_PP_SWC_PhC_PhC_iWNoOff
        Rte_Write_SWC_PhC_PP_SWC_PhC_PhC_uDcLnkLowMcu: implemented-entry=Rte_Write_SWC_PhC_PP_SWC_PhC_PhC_uDcLnkLowMcu
        Rte_Write_SWC_RCF_PP_SWC_RCF_RCF_AutoClbOffset: implemented-entry=Rte_Write_SWC_RCF_PP_SWC_RCF_RCF_AutoClbOffset
        Rte_Write_SWC_RCF_PP_SWC_RCF_RCF_TrqEmDesOfsClb: implemented-entry=Rte_Write_SWC_RCF_PP_SWC_RCF_RCF_TrqEmDesOfsClb
        Rte_Write_SWC_RCF_PP_SWC_RCF_RCF_UsAlfaScalSet: implemented-entry=Rte_Write_SWC_RCF_PP_SWC_RCF_RCF_UsAlfaScalSet
        Rte_Write_SWC_RCF_PP_SWC_RCF_RCF_UsBetaScalSet: implemented-entry=Rte_Write_SWC_RCF_PP_SWC_RCF_RCF_UsBetaScalSet
        Rte_Write_SWC_RCF_PP_SWC_RCF_RCF_agRtrOffsEstimd: implemented-entry=Rte_Write_SWC_RCF_PP_SWC_RCF_RCF_agRtrOffsEstimd
        Rte_Write_SWC_RCF_PP_SWC_RCF_RCF_cTrqSlpOfsClb: implemented-entry=Rte_Write_SWC_RCF_PP_SWC_RCF_RCF_cTrqSlpOfsClb
        Rte_Write_SWC_RCF_PP_SWC_RCF_RCF_flgOfsClbSuc: implemented-entry=Rte_Write_SWC_RCF_PP_SWC_RCF_RCF_flgOfsClbSuc
        Rte_Write_SWC_RCF_PP_SWC_RCF_RCF_flgOfsClbSucToNVM: implemented-entry=Rte_Write_SWC_RCF_PP_SWC_RCF_RCF_flgOfsClbSucToNVM
        Rte_Write_SWC_RCF_PP_SWC_RCF_RCF_flgUseUsSet: implemented-entry=Rte_Write_SWC_RCF_PP_SWC_RCF_RCF_flgUseUsSet
        Rte_Write_SWC_RCF_PP_SWC_RCF_RCF_stAgRtrOfsCal: implemented-entry=Rte_Write_SWC_RCF_PP_SWC_RCF_RCF_stAgRtrOfsCal
        Rte_Write_SWC_RCF_PP_SWC_RCF_RCF_stEstAlRtrOfs: implemented-entry=Rte_Write_SWC_RCF_PP_SWC_RCF_RCF_stEstAlRtrOfs
        Rte_Write_SWC_Rdc_PP_SWC_Rdc_Rdc_ArctanAgRtr: implemented-entry=Rte_Write_SWC_Rdc_PP_SWC_Rdc_Rdc_ArctanAgRtr
        Rte_Write_SWC_Rdc_PP_SWC_Rdc_Rdc_nWoFlt: implemented-entry=Rte_Write_SWC_Rdc_PP_SWC_Rdc_Rdc_nWoFlt
        Rte_Write_SWC_SCF_PP_SWC_SCF_SCF_FIM_ReqFailrMod: implemented-entry=Rte_Write_SWC_SCF_PP_SWC_SCF_SCF_FIM_ReqFailrMod
        Rte_Write_SWC_SCF_PP_SWC_SCF_SCF_bHvReady: implemented-entry=Rte_Write_SWC_SCF_PP_SWC_SCF_SCF_bHvReady
        Rte_Write_SWC_SCF_PP_SWC_SCF_SCF_flgActvDcha: implemented-entry=Rte_Write_SWC_SCF_PP_SWC_SCF_SCF_flgActvDcha
        Rte_Write_SWC_SCF_PP_SWC_SCF_SCF_flgDataStrgBgnToBsw: implemented-entry=Rte_Write_SWC_SCF_PP_SWC_SCF_SCF_flgDataStrgBgnToBsw
        Rte_Write_SWC_SCF_PP_SWC_SCF_SCF_flgEmgReqInvDcha: implemented-entry=Rte_Write_SWC_SCF_PP_SWC_SCF_SCF_flgEmgReqInvDcha
        Rte_Write_SWC_SCF_PP_SWC_SCF_SCF_flgEnDchaToMc: implemented-entry=Rte_Write_SWC_SCF_PP_SWC_SCF_SCF_flgEnDchaToMc
        Rte_Write_SWC_SCF_PP_SWC_SCF_SCF_flgUdcLowToTpc: implemented-entry=Rte_Write_SWC_SCF_PP_SWC_SCF_SCF_flgUdcLowToTpc
        Rte_Write_SWC_SCF_PP_SWC_SCF_SCF_flginitPI: implemented-entry=Rte_Write_SWC_SCF_PP_SWC_SCF_SCF_flginitPI
        Rte_Write_SWC_SCF_PP_SWC_SCF_SCF_stDisChg: implemented-entry=Rte_Write_SWC_SCF_PP_SWC_SCF_SCF_stDisChg
        Rte_Write_SWC_SCF_PP_SWC_SCF_SCF_stDrvCtl: implemented-entry=Rte_Write_SWC_SCF_PP_SWC_SCF_SCF_stDrvCtl
        Rte_Write_SWC_SCF_PP_SWC_SCF_SCF_stFFAction: implemented-entry=Rte_Write_SWC_SCF_PP_SWC_SCF_SCF_stFFAction
        Rte_Write_SWC_SCF_PP_SWC_SCF_SCF_stGateDrv: implemented-entry=Rte_Write_SWC_SCF_PP_SWC_SCF_SCF_stGateDrv
        Rte_Write_SWC_SCF_PP_SWC_SCF_SCF_stModeReqToTdc: implemented-entry=Rte_Write_SWC_SCF_PP_SWC_SCF_SCF_stModeReqToTdc
        Rte_Write_SWC_SCF_PP_SWC_SCF_SCF_stPreDrvCtl: implemented-entry=Rte_Write_SWC_SCF_PP_SWC_SCF_SCF_stPreDrvCtl
        Rte_Write_SWC_SCF_PP_SWC_SCF_SCF_stPwmMode: implemented-entry=Rte_Write_SWC_SCF_PP_SWC_SCF_SCF_stPwmMode
        Rte_Write_SWC_SCF_PP_SWC_SCF_SCF_stSysCtl: implemented-entry=Rte_Write_SWC_SCF_PP_SWC_SCF_SCF_stSysCtl
        Rte_Write_SWC_Snapshot_PP_SWC_Snapshot_Snapshot_flgPostDrvDone: implemented-entry=Rte_Write_SWC_Snapshot_PP_SWC_Snapshot_Snapshot_flgPostDrvDone
        Rte_Write_SWC_TDC_PP_SWC_TDC_TDC_TrqDes: implemented-entry=Rte_Write_SWC_TDC_PP_SWC_TDC_TDC_TrqDes
        Rte_Write_SWC_TDC_PP_SWC_TDC_TDC_flgTrqLmtActv: implemented-entry=Rte_Write_SWC_TDC_PP_SWC_TDC_TDC_flgTrqLmtActv
        Rte_Write_SWC_TPC_PP_SWC_TPC_TPC_SgnRotDir: implemented-entry=Rte_Write_SWC_TPC_PP_SWC_TPC_TPC_SgnRotDir
        Rte_Write_SWC_TPC_PP_SWC_TPC_TPC_SgnTrqMechDir: implemented-entry=Rte_Write_SWC_TPC_PP_SWC_TPC_TPC_SgnTrqMechDir
        Rte_Write_SWC_TPC_PP_SWC_TPC_TPC_TDbcTrqMax: implemented-entry=Rte_Write_SWC_TPC_PP_SWC_TPC_TPC_TDbcTrqMax
        Rte_Write_SWC_TPC_PP_SWC_TPC_TPC_TrqMax: implemented-entry=Rte_Write_SWC_TPC_PP_SWC_TPC_TPC_TrqMax
        Rte_Write_SWC_TPC_PP_SWC_TPC_TPC_TrqMaxTrans: implemented-entry=Rte_Write_SWC_TPC_PP_SWC_TPC_TPC_TrqMaxTrans
        Rte_Write_SWC_TPC_PP_SWC_TPC_TPC_TrqMin: implemented-entry=Rte_Write_SWC_TPC_PP_SWC_TPC_TPC_TrqMin
        Rte_Write_SWC_TPC_PP_SWC_TPC_TPC_TrqMinTrans: implemented-entry=Rte_Write_SWC_TPC_PP_SWC_TPC_TPC_TrqMinTrans
        Rte_Write_SWC_TPC_PP_SWC_TPC_TPC_bDernCAN: implemented-entry=Rte_Write_SWC_TPC_PP_SWC_TPC_TPC_bDernCAN
        Rte_Write_SWC_TPC_PP_SWC_TPC_TPC_bDernCoolantTemp: implemented-entry=Rte_Write_SWC_TPC_PP_SWC_TPC_TPC_bDernCoolantTemp
        Rte_Write_SWC_TPC_PP_SWC_TPC_TPC_bDernDbcTemp: implemented-entry=Rte_Write_SWC_TPC_PP_SWC_TPC_TPC_bDernDbcTemp
        Rte_Write_SWC_TPC_PP_SWC_TPC_TPC_bDernDrvBoardTemp: implemented-entry=Rte_Write_SWC_TPC_PP_SWC_TPC_TPC_bDernDrvBoardTemp
        Rte_Write_SWC_TPC_PP_SWC_TPC_TPC_bDernElecOvrIdc: implemented-entry=Rte_Write_SWC_TPC_PP_SWC_TPC_TPC_bDernElecOvrIdc
        Rte_Write_SWC_TPC_PP_SWC_TPC_TPC_bDernExcMax: implemented-entry=Rte_Write_SWC_TPC_PP_SWC_TPC_TPC_bDernExcMax
        Rte_Write_SWC_TPC_PP_SWC_TPC_TPC_bDernExcMin: implemented-entry=Rte_Write_SWC_TPC_PP_SWC_TPC_TPC_bDernExcMin
        Rte_Write_SWC_TPC_PP_SWC_TPC_TPC_bDernGenOvrIdc: implemented-entry=Rte_Write_SWC_TPC_PP_SWC_TPC_TPC_bDernGenOvrIdc
        Rte_Write_SWC_TPC_PP_SWC_TPC_TPC_bDernIGBTTemp: implemented-entry=Rte_Write_SWC_TPC_PP_SWC_TPC_TPC_bDernIGBTTemp
        Rte_Write_SWC_TPC_PP_SWC_TPC_TPC_bDernMtrSpd: implemented-entry=Rte_Write_SWC_TPC_PP_SWC_TPC_TPC_bDernMtrSpd
        Rte_Write_SWC_TPC_PP_SWC_TPC_TPC_bDernOvrIdc: implemented-entry=Rte_Write_SWC_TPC_PP_SWC_TPC_TPC_bDernOvrIdc
        Rte_Write_SWC_TPC_PP_SWC_TPC_TPC_bDernOvrUdc: implemented-entry=Rte_Write_SWC_TPC_PP_SWC_TPC_TPC_bDernOvrUdc
        Rte_Write_SWC_TPC_PP_SWC_TPC_TPC_bDernStrTemp: implemented-entry=Rte_Write_SWC_TPC_PP_SWC_TPC_TPC_bDernStrTemp
        Rte_Write_SWC_TPC_PP_SWC_TPC_TPC_bDernUndrUdc: implemented-entry=Rte_Write_SWC_TPC_PP_SWC_TPC_TPC_bDernUndrUdc
        Rte_Write_SWC_TPC_PP_SWC_TPC_TPC_stMotorMod: implemented-entry=Rte_Write_SWC_TPC_PP_SWC_TPC_TPC_stMotorMod
        Rte_Write_SWC_TPC_PP_SWC_TPC_TPC_stTrqEmMax: implemented-entry=Rte_Write_SWC_TPC_PP_SWC_TPC_TPC_stTrqEmMax
        Rte_Write_SWC_TPC_PP_SWC_TPC_TPC_stTrqEmMin: implemented-entry=Rte_Write_SWC_TPC_PP_SWC_TPC_TPC_stTrqEmMin
        Rte_Write_SWC_Tja1043_PP_SWC_Tja1043_Tja1043_flgCAN_WakeUp: implemented-entry=Rte_Write_SWC_Tja1043_PP_SWC_Tja1043_Tja1043_flgCAN_WakeUp
        Rte_Write_SWC_VCF_PP_SWC_VCF_VCF_HoldStartTrq: implemented-entry=Rte_Write_SWC_VCF_PP_SWC_VCF_VCF_HoldStartTrq
        Rte_Write_SWC_VCF_PP_SWC_VCF_VCF_KpNCtl: implemented-entry=Rte_Write_SWC_VCF_PP_SWC_VCF_VCF_KpNCtl
        Rte_Write_SWC_VCF_PP_SWC_VCF_VCF_NsetPReq: implemented-entry=Rte_Write_SWC_VCF_PP_SWC_VCF_VCF_NsetPReq
        Rte_Write_SWC_VCF_PP_SWC_VCF_VCF_TrqDes: implemented-entry=Rte_Write_SWC_VCF_PP_SWC_VCF_VCF_TrqDes
        Rte_Write_SWC_VCF_PP_SWC_VCF_VCF_stModeReq: implemented-entry=Rte_Write_SWC_VCF_PP_SWC_VCF_VCF_stModeReq
        Rte_Write_SWC_VCF_PP_SWC_VCF_VCF_trqDesUnProc: implemented-entry=Rte_Write_SWC_VCF_PP_SWC_VCF_VCF_trqDesUnProc
        Rte_Write_SWC_VCF_PP_SWC_VCF_VCF_trqRamp: implemented-entry=Rte_Write_SWC_VCF_PP_SWC_VCF_VCF_trqRamp
        Rte_memcpy: implemented-entry=Rte_memcpy
        SchM_Deinit: implemented-entry=SchM_Deinit
        SchM_IModeInit: implemented-entry=SchM_IModeInit
        SchM_Init: implemented-entry=SchM_Init
        SchM_Mode_BswM_MDGR_BswM_MRP_BswM_MDG: implemented-entry=SchM_Mode_BswM_MDGR_BswM_MRP_BswM_MDG
        SchM_Mode_Dcm_R_DcmCommunicationControl_ComMChannel_Can_Network_0_Channel: implemented-entry=SchM_Mode_Dcm_R_DcmCommunicationControl_ComMChannel_Can_Network_0_Channel
        SchM_Mode_Dcm_R_DcmCommunicationControl_ComMChannel_Can_Network_1_Channel: implemented-entry=SchM_Mode_Dcm_R_DcmCommunicationControl_ComMChannel_Can_Network_1_Channel
        SchM_Switch_BswM_MDGP_AUTOSAR_BswM_ModeDeclarationGroups_MDG_ECUM_STATE: implemented-entry=SchM_Switch_BswM_MDGP_AUTOSAR_BswM_ModeDeclarationGroups_MDG_ECUM_STATE
        SchM_Switch_Dcm_DcmDiagnosticSessionControl: implemented-entry=SchM_Switch_Dcm_DcmDiagnosticSessionControl
        SchM_Switch_Dcm_DcmEcuReset: implemented-entry=SchM_Switch_Dcm_DcmEcuReset
