AUTOSAR XML (schema 4-0-3)
package /RTAOS
  module config Os
    RTE_RESOURCE (OsResource): OsResourceProperty=STANDARD
    Rte_EA_BSWImpl4_CanTp_EXCLUSIVE_AREA (OsResource): OsResourceProperty=STANDARD
    14 x OsTask, all with OsTaskSchedule=FULL, OsTaskResourceRef=RTE_RESOURCE:
      SWC_1000ms_Task_Core0: OsTaskActivation=1, OsTaskPriority=18
      SWC_100ms_Task_Core0: OsTaskActivation=2, OsTaskPriority=19
      SWC_20ms_Task_Core0: OsTaskActivation=1, OsTaskPriority=21
      SWC_10ms_Task_Core0: OsTaskActivation=1, OsTaskPriority=22
      BSW_10ms_Task_Core0: OsTaskActivation=2, OsTaskPriority=28
      BSW_1ms_Task_Core0: OsTaskActivation=1, OsTaskPriority=30, OsTaskResourceRef=Rte_EA_BSWImpl4_CanTp_EXCLUSIVE_AREA
      Os_Com_Pwm3ph_Edge_Core2_ISR: OsTaskActivation=1, OsTaskPriority=103
      Os_GpDsadc_Res_Core0_ISR: OsTaskActivation=1, OsTaskPriority=104
      Os_Gpt100us_core0_ISR: OsTaskActivation=1, OsTaskPriority=105
      Os_Init_Task_Core2: OsTaskActivation=1, OsTaskPriority=150
      Os_Init_Task_Core1: OsTaskActivation=1, OsTaskPriority=151
      Os_Init_Task_Core0: OsTaskActivation=1, OsTaskPriority=152
      Os_U1_V2_Core0_ISR: OsTaskActivation=1, OsTaskPriority=153
      BSW_2ms_Task_Core0: OsTaskActivation=1, OsTaskPriority=160
