AUTOSAR XML (schema 4.0)
standard types defined: float32, uint8, boolean, uint16
package /RTAOS
  module config Os
    IocOs (OsIoc)
      63 x OsIocCommunication:
        Rte_Rx_000045_HSPF_iPhaUOffset: OsIocDataTypeRef=float32
          iocSemantic00000 (OsIocCommunicationSemantics)
            iocLastIsBest00000 (OsIocLastIsBestCommunication)
          c00000rx (OsIocReceiverProperties): OsIocReceivingOsApplicationRef=OsAppCore2
          c00000tx (OsIocSenderProperties): OsIocSendingOsApplicationRef=OsAppCore0
        Rte_Rx_000046_HSPF_iPhaVOffset: OsIocDataTypeRef=float32
          iocSemantic00001 (OsIocCommunicationSemantics)
            iocLastIsBest00001 (OsIocLastIsBestCommunication)
          c00001rx (OsIocReceiverProperties): OsIocReceivingOsApplicationRef=OsAppCore2
          c00001tx (OsIocSenderProperties): OsIocSendingOsApplicationRef=OsAppCore0
        Rte_Rx_000047_HSPF_iPhaWOffset: OsIocDataTypeRef=float32
          iocSemantic00002 (OsIocCommunicationSemantics)
            iocLastIsBest00002 (OsIocLastIsBestCommunication)
          c00002rx (OsIocReceiverProperties): OsIocReceivingOsApplicationRef=OsAppCore2
          c00002tx (OsIocSenderProperties): OsIocSendingOsApplicationRef=OsAppCore0
        Rte_Rx_000049_HSPF_stIphaOffCal: OsIocDataTypeRef=uint8
          iocSemantic00003 (OsIocCommunicationSemantics)
            iocLastIsBest00003 (OsIocLastIsBestCommunication)
          c00003rx (OsIocReceiverProperties): OsIocReceivingOsApplicationRef=OsAppCore2
          c00003tx (OsIocSenderProperties): OsIocSendingOsApplicationRef=OsAppCore0
        Rte_Rx_000052_HSPF_tCoolantTempFlt: OsIocDataTypeRef=float32
          iocSemantic00004 (OsIocCommunicationSemantics)
            iocLastIsBest00004 (OsIocLastIsBestCommunication)
          c00004rx (OsIocReceiverProperties): OsIocReceivingOsApplicationRef=OsAppCore2
          c00004tx (OsIocSenderProperties): OsIocSendingOsApplicationRef=OsAppCore0
        Rte_Rx_000055_HSPF_tDBCTempUFlt: OsIocDataTypeRef=float32
          iocSemantic00005 (OsIocCommunicationSemantics)
            iocLastIsBest00005 (OsIocLastIsBestCommunication)
          c00005rx (OsIocReceiverProperties): OsIocReceivingOsApplicationRef=OsAppCore2
          c00005tx (OsIocSenderProperties): OsIocSendingOsApplicationRef=OsAppCore0
        Rte_Rx_000057_HSPF_tDBCTempVFlt: OsIocDataTypeRef=float32
          iocSemantic00006 (OsIocCommunicationSemantics)
            iocLastIsBest00006 (OsIocLastIsBestCommunication)
          c00006rx (OsIocReceiverProperties): OsIocReceivingOsApplicationRef=OsAppCore2
          c00006tx (OsIocSenderProperties): OsIocSendingOsApplicationRef=OsAppCore0
        Rte_Rx_000059_HSPF_tDBCTempWFlt: OsIocDataTypeRef=float32
          iocSemantic00007 (OsIocCommunicationSemantics)
            iocLastIsBest00007 (OsIocLastIsBestCommunication)
          c00007rx (OsIocReceiverProperties): OsIocReceivingOsApplicationRef=OsAppCore2
          c00007tx (OsIocSenderProperties): OsIocSendingOsApplicationRef=OsAppCore0
        Rte_Rx_000064_HSPF_tStrrTempFlt: OsIocDataTypeRef=float32
          iocSemantic00008 (OsIocCommunicationSemantics)
            iocLastIsBest00008 (OsIocLastIsBestCommunication)
          c00008rx (OsIocReceiverProperties): OsIocReceivingOsApplicationRef=OsAppCore2
          c00008tx (OsIocSenderProperties): OsIocSendingOsApplicationRef=OsAppCore0
        Rte_Rx_000067_HSPF_uDcLnkSlowFlt: OsIocDataTypeRef=float32
          iocSemantic00009 (OsIocCommunicationSemantics)
            iocLastIsBest00009 (OsIocLastIsBestCommunication)
          c00009rx (OsIocReceiverProperties): OsIocReceivingOsApplicationRef=OsAppCore2
          c00009tx (OsIocSenderProperties): OsIocSendingOsApplicationRef=OsAppCore0
        Rte_Rx_000077_HvMcu_uDcLnkHvMcu: OsIocDataTypeRef=float32
          iocSemantic00010 (OsIocCommunicationSemantics)
            iocLastIsBest00010 (OsIocLastIsBestCommunication)
          c00010rx (OsIocReceiverProperties): OsIocReceivingOsApplicationRef=OsAppCore2
          c00010tx (OsIocSenderProperties): OsIocSendingOsApplicationRef=OsAppCore0
        Rte_Rx_000085_MCF_Is: OsIocDataTypeRef=float32
          iocSemantic00011 (OsIocCommunicationSemantics)
            iocLastIsBest00011 (OsIocLastIsBestCommunication)
          c00011rx (OsIocReceiverProperties): OsIocReceivingOsApplicationRef=OsAppCore0
          c00011tx (OsIocSenderProperties): OsIocSendingOsApplicationRef=OsAppCore2
        Rte_Rx_000087_MCF_VoltModuRate: OsIocDataTypeRef=float32
          iocSemantic00012 (OsIocCommunicationSemantics)
            iocLastIsBest00012 (OsIocLastIsBestCommunication)
          c00012rx (OsIocReceiverProperties): OsIocReceivingOsApplicationRef=OsAppCore0
          c00012tx (OsIocSenderProperties): OsIocSendingOsApplicationRef=OsAppCore2
        Rte_Rx_000088_MCF_cofFrqPwm: OsIocDataTypeRef=float32
          iocSemantic00013 (OsIocCommunicationSemantics)
            iocLastIsBest00013 (OsIocLastIsBestCommunication)
          c00013rx (OsIocReceiverProperties): OsIocReceivingOsApplicationRef=OsAppCore0
          c00013tx (OsIocSenderProperties): OsIocSendingOsApplicationRef=OsAppCore2
        Rte_Rx_000089_MCF_dtPwm: OsIocDataTypeRef=float32
          iocSemantic00014 (OsIocCommunicationSemantics)
            iocLastIsBest00014 (OsIocLastIsBestCommunication)
          c00014rx (OsIocReceiverProperties): OsIocReceivingOsApplicationRef=OsAppCore0
          c00014tx (OsIocSenderProperties): OsIocSendingOsApplicationRef=OsAppCore2
        Rte_Rx_000091_MCF_iU: OsIocDataTypeRef=float32
          iocSemantic00015 (OsIocCommunicationSemantics)
            iocLastIsBest00015 (OsIocLastIsBestCommunication)
          c00015rx (OsIocReceiverProperties): OsIocReceivingOsApplicationRef=OsAppCore0
          c00015tx (OsIocSenderProperties): OsIocSendingOsApplicationRef=OsAppCore2
        Rte_Rx_000093_MCF_iV: OsIocDataTypeRef=float32
          iocSemantic00016 (OsIocCommunicationSemantics)
            iocLastIsBest00016 (OsIocLastIsBestCommunication)
          c00016rx (OsIocReceiverProperties): OsIocReceivingOsApplicationRef=OsAppCore0
          c00016tx (OsIocSenderProperties): OsIocSendingOsApplicationRef=OsAppCore2
        Rte_Rx_000095_MCF_iW: OsIocDataTypeRef=float32
          iocSemantic00017 (OsIocCommunicationSemantics)
            iocLastIsBest00017 (OsIocLastIsBestCommunication)
          c00017rx (OsIocReceiverProperties): OsIocReceivingOsApplicationRef=OsAppCore0
          c00017tx (OsIocSenderProperties): OsIocSendingOsApplicationRef=OsAppCore2
        Rte_Rx_000097_MCF_idDes: OsIocDataTypeRef=float32
          iocSemantic00018 (OsIocCommunicationSemantics)
            iocLastIsBest00018 (OsIocLastIsBestCommunication)
          c00018rx (OsIocReceiverProperties): OsIocReceivingOsApplicationRef=OsAppCore0
          c00018tx (OsIocSenderProperties): OsIocSendingOsApplicationRef=OsAppCore2
        Rte_Rx_000098_MCF_iqDes: OsIocDataTypeRef=float32
          iocSemantic00019 (OsIocCommunicationSemantics)
            iocLastIsBest00019 (OsIocLastIsBestCommunication)
          c00019rx (OsIocReceiverProperties): OsIocReceivingOsApplicationRef=OsAppCore0
          c00019tx (OsIocSenderProperties): OsIocSendingOsApplicationRef=OsAppCore2
        Rte_Rx_000099_MCF_isd: OsIocDataTypeRef=float32
          iocSemantic00020 (OsIocCommunicationSemantics)
            iocLastIsBest00020 (OsIocLastIsBestCommunication)
          c00020rx (OsIocReceiverProperties): OsIocReceivingOsApplicationRef=OsAppCore0
          c00020tx (OsIocSenderProperties): OsIocSendingOsApplicationRef=OsAppCore2
        Rte_Rx_000100_MCF_isq: OsIocDataTypeRef=float32
          iocSemantic00021 (OsIocCommunicationSemantics)
            iocLastIsBest00021 (OsIocLastIsBestCommunication)
          c00021rx (OsIocReceiverProperties): OsIocReceivingOsApplicationRef=OsAppCore0
          c00021tx (OsIocSenderProperties): OsIocSendingOsApplicationRef=OsAppCore2
        Rte_Rx_000104_MCF_uDcLnk: OsIocDataTypeRef=float32
          iocSemantic00022 (OsIocCommunicationSemantics)
            iocLastIsBest00022 (OsIocLastIsBestCommunication)
          c00022rx (OsIocReceiverProperties): OsIocReceivingOsApplicationRef=OsAppCore0
          c00022tx (OsIocSenderProperties): OsIocSendingOsApplicationRef=OsAppCore2
        Rte_Rx_000105_MCF_udDes: OsIocDataTypeRef=float32
          iocSemantic00023 (OsIocCommunicationSemantics)
            iocLastIsBest00023 (OsIocLastIsBestCommunication)
          c00023rx (OsIocReceiverProperties): OsIocReceivingOsApplicationRef=OsAppCore0
          c00023tx (OsIocSenderProperties): OsIocSendingOsApplicationRef=OsAppCore2
        Rte_Rx_000106_MCF_uqDes: OsIocDataTypeRef=float32
          iocSemantic00024 (OsIocCommunicationSemantics)
            iocLastIsBest00024 (OsIocLastIsBestCommunication)
          c00024rx (OsIocReceiverProperties): OsIocReceivingOsApplicationRef=OsAppCore0
          c00024tx (OsIocSenderProperties): OsIocSendingOsApplicationRef=OsAppCore2
        Rte_Rx_000108_MDF_bFaultEMBlkWarnSt: OsIocDataTypeRef=uint8
          iocSemantic00025 (OsIocCommunicationSemantics)
            iocLastIsBest00025 (OsIocLastIsBestCommunication)
          c00025rx (OsIocReceiverProperties): OsIocReceivingOsApplicationRef=OsAppCore2
          c00025tx (OsIocSenderProperties): OsIocSendingOsApplicationRef=OsAppCore0
        Rte_Rx_000110_MPC_CofRandomPwm: OsIocDataTypeRef=float32
          iocSemantic00026 (OsIocCommunicationSemantics)
            iocLastIsBest00026 (OsIocLastIsBestCommunication)
          c00026rx (OsIocReceiverProperties): OsIocReceivingOsApplicationRef=OsAppCore2
          c00026tx (OsIocSenderProperties): OsIocSendingOsApplicationRef=OsAppCore0
        Rte_Rx_000112_MPC_Ld: OsIocDataTypeRef=float32
          iocSemantic00027 (OsIocCommunicationSemantics)
            iocLastIsBest00027 (OsIocLastIsBestCommunication)
          c00027rx (OsIocReceiverProperties): OsIocReceivingOsApplicationRef=OsAppCore2
          c00027tx (OsIocSenderProperties): OsIocSendingOsApplicationRef=OsAppCore0
        Rte_Rx_000114_MPC_LdSubLq: OsIocDataTypeRef=float32
          iocSemantic00028 (OsIocCommunicationSemantics)
            iocLastIsBest00028 (OsIocLastIsBestCommunication)
          c00028rx (OsIocReceiverProperties): OsIocReceivingOsApplicationRef=OsAppCore2
          c00028tx (OsIocSenderProperties): OsIocSendingOsApplicationRef=OsAppCore0
        Rte_Rx_000115_MPC_Lq: OsIocDataTypeRef=float32
          iocSemantic00029 (OsIocCommunicationSemantics)
            iocLastIsBest00029 (OsIocLastIsBestCommunication)
          c00029rx (OsIocReceiverProperties): OsIocReceivingOsApplicationRef=OsAppCore2
          c00029tx (OsIocSenderProperties): OsIocSendingOsApplicationRef=OsAppCore0
        Rte_Rx_000117_MPC_OmBw: OsIocDataTypeRef=float32
          iocSemantic00030 (OsIocCommunicationSemantics)
            iocLastIsBest00030 (OsIocLastIsBestCommunication)
          c00030rx (OsIocReceiverProperties): OsIocReceivingOsApplicationRef=OsAppCore2
          c00030tx (OsIocSenderProperties): OsIocSendingOsApplicationRef=OsAppCore0
        Rte_Rx_000118_MPC_Psi: OsIocDataTypeRef=float32
          iocSemantic00031 (OsIocCommunicationSemantics)
            iocLastIsBest00031 (OsIocLastIsBestCommunication)
          c00031rx (OsIocReceiverProperties): OsIocReceivingOsApplicationRef=OsAppCore2
          c00031tx (OsIocSenderProperties): OsIocSendingOsApplicationRef=OsAppCore0
        Rte_Rx_000120_MPC_Rs: OsIocDataTypeRef=float32
          iocSemantic00032 (OsIocCommunicationSemantics)
            iocLastIsBest00032 (OsIocLastIsBestCommunication)
          c00032rx (OsIocReceiverProperties): OsIocReceivingOsApplicationRef=OsAppCore2
          c00032tx (OsIocSenderProperties): OsIocSendingOsApplicationRef=OsAppCore0
        Rte_Rx_000122_MPC_Rv: OsIocDataTypeRef=float32
          iocSemantic00033 (OsIocCommunicationSemantics)
            iocLastIsBest00033 (OsIocLastIsBestCommunication)
          c00033rx (OsIocReceiverProperties): OsIocReceivingOsApplicationRef=OsAppCore2
          c00033tx (OsIocSenderProperties): OsIocSendingOsApplicationRef=OsAppCore0
        Rte_Rx_000124_MPC_TrqMechFlt: OsIocDataTypeRef=float32
          iocSemantic00034 (OsIocCommunicationSemantics)
            iocLastIsBest00034 (OsIocLastIsBestCommunication)
          c00034rx (OsIocReceiverProperties): OsIocReceivingOsApplicationRef=OsAppCore2
          c00034tx (OsIocSenderProperties): OsIocSendingOsApplicationRef=OsAppCore0
        Rte_Rx_000126_MPC_dtCorFac: OsIocDataTypeRef=float32
          iocSemantic00035 (OsIocCommunicationSemantics)
            iocLastIsBest00035 (OsIocLastIsBestCommunication)
          c00035rx (OsIocReceiverProperties): OsIocReceivingOsApplicationRef=OsAppCore2
          c00035tx (OsIocSenderProperties): OsIocSendingOsApplicationRef=OsAppCore0
        Rte_Rx_000127_MPC_frqPwmVF: OsIocDataTypeRef=float32
          iocSemantic00036 (OsIocCommunicationSemantics)
            iocLastIsBest00036 (OsIocLastIsBestCommunication)
          c00036rx (OsIocReceiverProperties): OsIocReceivingOsApplicationRef=OsAppCore2
          c00036tx (OsIocSenderProperties): OsIocSendingOsApplicationRef=OsAppCore0
        Rte_Rx_000128_MPC_isdFF: OsIocDataTypeRef=float32
          iocSemantic00037 (OsIocCommunicationSemantics)
            iocLastIsBest00037 (OsIocLastIsBestCommunication)
          c00037rx (OsIocReceiverProperties): OsIocReceivingOsApplicationRef=OsAppCore2
          c00037tx (OsIocSenderProperties): OsIocSendingOsApplicationRef=OsAppCore0
        Rte_Rx_000130_MPC_isdMTPA: OsIocDataTypeRef=float32
          iocSemantic00038 (OsIocCommunicationSemantics)
            iocLastIsBest00038 (OsIocLastIsBestCommunication)
          c00038rx (OsIocReceiverProperties): OsIocReceivingOsApplicationRef=OsAppCore2
          c00038tx (OsIocSenderProperties): OsIocSendingOsApplicationRef=OsAppCore0
        Rte_Rx_000131_MPC_isdMTPV: OsIocDataTypeRef=float32
          iocSemantic00039 (OsIocCommunicationSemantics)
            iocLastIsBest00039 (OsIocLastIsBestCommunication)
          c00039rx (OsIocReceiverProperties): OsIocReceivingOsApplicationRef=OsAppCore2
          c00039tx (OsIocSenderProperties): OsIocSendingOsApplicationRef=OsAppCore0
        Rte_Rx_000133_NvM_AngAutoClbOffset: OsIocDataTypeRef=float32
          iocSemantic00040 (OsIocCommunicationSemantics)
            iocLastIsBest00040 (OsIocLastIsBestCommunication)
          c00040rx (OsIocReceiverProperties): OsIocReceivingOsApplicationRef=OsAppCore2
          c00040tx (OsIocSenderProperties): OsIocSendingOsApplicationRef=OsAppCore0
        Rte_Rx_000136_NvM_flgAngAutoClbOffset: OsIocDataTypeRef=boolean
          iocSemantic00041 (OsIocCommunicationSemantics)
            iocLastIsBest00041 (OsIocLastIsBestCommunication)
          c00041rx (OsIocReceiverProperties): OsIocReceivingOsApplicationRef=OsAppCore2
          c00041tx (OsIocSenderProperties): OsIocSendingOsApplicationRef=OsAppCore0
        Rte_Rx_000149_PhC_iUNoOff: OsIocDataTypeRef=uint16
          iocSemantic00042 (OsIocCommunicationSemantics)
            iocLastIsBest00042 (OsIocLastIsBestCommunication)
          c00042rx (OsIocReceiverProperties): OsIocReceivingOsApplicationRef=OsAppCore2
          c00042tx (OsIocSenderProperties): OsIocSendingOsApplicationRef=OsAppCore0
        Rte_Rx_000151_PhC_iVNoOff: OsIocDataTypeRef=uint16
          iocSemantic00043 (OsIocCommunicationSemantics)
            iocLastIsBest00043 (OsIocLastIsBestCommunication)
          c00043rx (OsIocReceiverProperties): OsIocReceivingOsApplicationRef=OsAppCore2
          c00043tx (OsIocSenderProperties): OsIocSendingOsApplicationRef=OsAppCore0
        Rte_Rx_000153_PhC_iWNoOff: OsIocDataTypeRef=uint16
          iocSemantic00044 (OsIocCommunicationSemantics)
            iocLastIsBest00044 (OsIocLastIsBestCommunication)
          c00044rx (OsIocReceiverProperties): OsIocReceivingOsApplicationRef=OsAppCore2
          c00044tx (OsIocSenderProperties): OsIocSendingOsApplicationRef=OsAppCore0
        Rte_Rx_000154_PhC_uDcLnkLowMcu: OsIocDataTypeRef=float32
          iocSemantic00045 (OsIocCommunicationSemantics)
            iocLastIsBest00045 (OsIocLastIsBestCommunication)
          c00045rx (OsIocReceiverProperties): OsIocReceivingOsApplicationRef=OsAppCore2
          c00045tx (OsIocSenderProperties): OsIocSendingOsApplicationRef=OsAppCore0
        Rte_Rx_000157_RCF_UsAlfaScalSet: OsIocDataTypeRef=float32
          iocSemantic00046 (OsIocCommunicationSemantics)
            iocLastIsBest00046 (OsIocLastIsBestCommunication)
          c00046rx (OsIocReceiverProperties): OsIocReceivingOsApplicationRef=OsAppCore2
          c00046tx (OsIocSenderProperties): OsIocSendingOsApplicationRef=OsAppCore0
        Rte_Rx_000158_RCF_UsBetaScalSet: OsIocDataTypeRef=float32
          iocSemantic00047 (OsIocCommunicationSemantics)
            iocLastIsBest00047 (OsIocLastIsBestCommunication)
          c00047rx (OsIocReceiverProperties): OsIocReceivingOsApplicationRef=OsAppCore2
          c00047tx (OsIocSenderProperties): OsIocSendingOsApplicationRef=OsAppCore0
        Rte_Rx_000159_RCF_agRtrOffsEstimd: OsIocDataTypeRef=float32
          iocSemantic00048 (OsIocCommunicationSemantics)
            iocLastIsBest00048 (OsIocLastIsBestCommunication)
          c00048rx (OsIocReceiverProperties): OsIocReceivingOsApplicationRef=OsAppCore2
          c00048tx (OsIocSenderProperties): OsIocSendingOsApplicationRef=OsAppCore0
        Rte_Rx_000163_RCF_flgUseUsSet: OsIocDataTypeRef=boolean
          iocSemantic00049 (OsIocCommunicationSemantics)
            iocLastIsBest00049 (OsIocLastIsBestCommunication)
          c00049rx (OsIocReceiverProperties): OsIocReceivingOsApplicationRef=OsAppCore2
          c00049tx (OsIocSenderProperties): OsIocSendingOsApplicationRef=OsAppCore0
        Rte_Rx_000166_Rdc_ArctanAgRtr: OsIocDataTypeRef=float32
          iocSemantic00050 (OsIocCommunicationSemantics)
            iocLastIsBest00050 (OsIocLastIsBestCommunication)
          c00050rx (OsIocReceiverProperties): OsIocReceivingOsApplicationRef=OsAppCore2
          c00050tx (OsIocSenderProperties): OsIocSendingOsApplicationRef=OsAppCore0
        Rte_Rx_000169_Rdc_nWoFlt: OsIocDataTypeRef=float32
          iocSemantic00051 (OsIocCommunicationSemantics)
            iocLastIsBest00051 (OsIocLastIsBestCommunication)
          c00051rx (OsIocReceiverProperties): OsIocReceivingOsApplicationRef=OsAppCore2
          c00051tx (OsIocSenderProperties): OsIocSendingOsApplicationRef=OsAppCore0
        Rte_Rx_000170_SCF_FIM_ReqFailrMod: OsIocDataTypeRef=boolean
          iocSemantic00052 (OsIocCommunicationSemantics)
            iocLastIsBest00052 (OsIocLastIsBestCommunication)
          c00052rx (OsIocReceiverProperties): OsIocReceivingOsApplicationRef=OsAppCore2
          c00052tx (OsIocSenderProperties): OsIocSendingOsApplicationRef=OsAppCore0
        Rte_Rx_000173_SCF_flgEnDchaToMc: OsIocDataTypeRef=boolean
          iocSemantic00053 (OsIocCommunicationSemantics)
            iocLastIsBest00053 (OsIocLastIsBestCommunication)
          c00053rx (OsIocReceiverProperties): OsIocReceivingOsApplicationRef=OsAppCore2
          c00053tx (OsIocSenderProperties): OsIocSendingOsApplicationRef=OsAppCore0
        Rte_Rx_000175_SCF_flginitPI: OsIocDataTypeRef=boolean
          iocSemantic00054 (OsIocCommunicationSemantics)
            iocLastIsBest00054 (OsIocLastIsBestCommunication)
          c00054rx (OsIocReceiverProperties): OsIocReceivingOsApplicationRef=OsAppCore2
          c00054tx (OsIocSenderProperties): OsIocSendingOsApplicationRef=OsAppCore0
        Rte_Rx_000179_SCF_stGateDrv: OsIocDataTypeRef=uint8
          iocSemantic00055 (OsIocCommunicationSemantics)
            iocLastIsBest00055 (OsIocLastIsBestCommunication)
          c00055rx (OsIocReceiverProperties): OsIocReceivingOsApplicationRef=OsAppCore2
          c00055tx (OsIocSenderProperties): OsIocSendingOsApplicationRef=OsAppCore0
        Rte_Rx_000183_SCF_stPwmMode: OsIocDataTypeRef=uint8
          iocSemantic00056 (OsIocCommunicationSemantics)
            iocLastIsBest00056 (OsIocLastIsBestCommunication)
          c00056rx (OsIocReceiverProperties): OsIocReceivingOsApplicationRef=OsAppCore2
          c00056tx (OsIocSenderProperties): OsIocSendingOsApplicationRef=OsAppCore0
        Rte_Rx_000185_BCC_iDcLnkEstFlt: OsIocDataTypeRef=float32
          iocSemantic00057 (OsIocCommunicationSemantics)
            iocLastIsBest00057 (OsIocLastIsBestCommunication)
          c00057rx (OsIocReceiverProperties): OsIocReceivingOsApplicationRef=OsAppCore0
          c00057tx (OsIocSenderProperties): OsIocSendingOsApplicationRef=OsAppCore2
        Rte_Rx_000187_BCC_tCoolantTj: OsIocDataTypeRef=float32
          iocSemantic00058 (OsIocCommunicationSemantics)
            iocLastIsBest00058 (OsIocLastIsBestCommunication)
          c00058rx (OsIocReceiverProperties): OsIocReceivingOsApplicationRef=OsAppCore0
          c00058tx (OsIocSenderProperties): OsIocSendingOsApplicationRef=OsAppCore2
        Rte_Rx_000188_BCC_tIgbtTj: OsIocDataTypeRef=float32
          iocSemantic00059 (OsIocCommunicationSemantics)
            iocLastIsBest00059 (OsIocLastIsBestCommunication)
          c00059rx (OsIocReceiverProperties): OsIocReceivingOsApplicationRef=OsAppCore0
          c00059tx (OsIocSenderProperties): OsIocSendingOsApplicationRef=OsAppCore2
        Rte_Rx_000225_TDC_TrqDes: OsIocDataTypeRef=float32
          iocSemantic00060 (OsIocCommunicationSemantics)
            iocLastIsBest00060 (OsIocLastIsBestCommunication)
          c00060rx (OsIocReceiverProperties): OsIocReceivingOsApplicationRef=OsAppCore2
          c00060tx (OsIocSenderProperties): OsIocSendingOsApplicationRef=OsAppCore0
        Rte_Rx_000230_TPC_TDbcTrqMax: OsIocDataTypeRef=float32
          iocSemantic00061 (OsIocCommunicationSemantics)
            iocLastIsBest00061 (OsIocLastIsBestCommunication)
          c00061rx (OsIocReceiverProperties): OsIocReceivingOsApplicationRef=OsAppCore2
          c00061tx (OsIocSenderProperties): OsIocSendingOsApplicationRef=OsAppCore0
        Rte_Rx_000245_TPC_stMotorMod: OsIocDataTypeRef=uint8
          iocSemantic00062 (OsIocCommunicationSemantics)
            iocLastIsBest00062 (OsIocLastIsBestCommunication)
          c00062rx (OsIocReceiverProperties): OsIocReceivingOsApplicationRef=OsAppCore2
          c00062tx (OsIocSenderProperties): OsIocSendingOsApplicationRef=OsAppCore0
  compu method Methods_boolean: 0=FALSE, 1=TRUE
