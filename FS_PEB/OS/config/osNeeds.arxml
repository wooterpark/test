AUTOSAR XML (schema 4-0-3)
package /RTAOS
  module config Os
    RTE_RESOURCE (OsResource): OsResourceProperty=STANDARD
    Rte_EA_BSWImpl4_CanTp_EXCLUSIVE_AREA (OsResource): OsResourceProperty=STANDARD
    21 x OsTask, all with OsTaskSchedule=FULL, OsTaskActivation=1:
      SWC_1000ms_Task_Core1: OsTaskPriority=16
      SWC_100ms_Task_Core1: OsTaskPriority=17
      SWC_50ms_Task_Core1: OsTaskPriority=20
      SWC_20ms_Task_Core1: OsTaskPriority=21
      SWC_10ms_Task_Core1: OsTaskPriority=22
      SWC_5ms_Task_Core1: OsTaskPriority=24
      SWC_1ms_Task_Core1: OsTaskPriority=26
      SWC_1000ms_Task_Core0: OsTaskPriority=30
      SWC_100ms_Task_Core0: OsTaskPriority=31
      SWC_50ms_Task_Core0: OsTaskPriority=32
      SWC_20ms_Task_Core0: OsTaskPriority=33
      SWC_10ms_Task_Core0: OsTaskPriority=34
      SWC_5ms_Task_Core0: OsTaskPriority=36
      SWC_1ms_Task_Core0: OsTaskPriority=39
      BSW_10ms_Task_Core1: OsTaskPriority=23
      BSW_5ms_Task_Core1: OsTaskPriority=25
      BSW_1ms_Task_Core1: OsTaskPriority=27
      BSW_10ms_Task_Core0: OsTaskPriority=35
      BSW_5ms_Task_Core0: OsTaskPriority=37
      BSW_1ms_Task_Core0: OsTaskPriority=40, OsTaskResourceRef=RTE_RESOURCE, OsTaskResourceRef=Rte_EA_BSWImpl4_CanTp_EXCLUSIVE_AREA
      BSW_10ms_Task_Core2: OsTaskPriority=49
    Rte_TickCounter (OsCounter): OsCounterMaxAllowedValue=65535, OsCounterMinCycle=1, OsCounterTicksPerBase=1, OsCounterType=SOFTWARE
