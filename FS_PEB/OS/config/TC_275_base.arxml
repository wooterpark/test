AUTOSAR XML (schema 4-2-2)
package /RTAOS
  module config Os
    OsOS:
      OsCyclesPerSecond = 200000000
      OsDefaultInterrupt = DefaultInterruptHandler
      OsScalabilityClass = SC3
      OsStackMonitoring = false
      OsStatus = EXTENDED
      OsSuppressVectorGen = false
      OsTicksPerSecond = 100000000
      OsUseGetServiceId = true
      OsUseParameterAccess = true
      OsUseResScheduler = false
      OsNumberOfCores = 3
      OsHooks: OsErrorHook=true, OsPostTaskHook=false, OsPreTaskHook=false, OsProtectionHook=true, OsShutdownHook=true, OsStackFaultHook=false, OsStartupHook=true
      5 x Param:
        meter_execution: Value=true
        no_timing_protection: Value=true
        task_lifetime_hooks: Value=true
        meter_elapsed_time: Value=true
        metrics: Value=false
    OSDEFAULTAPPMODE (OsAppMode)
    SystemTimer_ISR (OsIsr): OsIsrAddress=SRC_STM0SR0, OsIsrCategory=CATEGORY_2, OsIsrPriority=2
    STM_OsCounter_Core2 (OsIsr): OsIsrAddress=SRC_STM1SR0, OsIsrCategory=CATEGORY_2, OsIsrPriority=40
    Rte_TickCounter (OsCounter): OsSecondsPerTick=0.001, OsCounterAccessingApplication=OsAppCore1
    Rte_TOutCounter (OsCounter): OsCounterMaxAllowedValue=65535, OsCounterMinCycle=1, OsCounterTicksPerBase=1, OsCounterType=SOFTWARE, OsCounterAccessingApplication=OsAppCore1
    20 x OsTask, all with OsTaskAccessingApplication=OsAppCore0, OsTaskAccessingApplication=OsAppCore1:
      SWC_10ms_Task_Core0: OsTaskResourceRef=RTE_RESOURCE
      SWC_10ms_Task_Core1: OsTaskStackAllocation=256,256, OsTaskWaitStack=256,256, OsTaskEventRef=Rte_Activity, OsTaskEventRef=Rte_Timeout
      BSW_10ms_Task_Core1: OsTaskStackAllocation=256,256, OsTaskWaitStack=256,256
      BSW_1ms_Task_Core1: OsTaskStackAllocation=256,256, OsTaskWaitStack=256,256
      BSW_5ms_Task_Core1: OsTaskStackAllocation=256,256, OsTaskWaitStack=256,256
      SWC_1000ms_Task_Core1: OsTaskStackAllocation=256,256, OsTaskWaitStack=256,256
      SWC_100ms_Task_Core1: OsTaskStackAllocation=256,256, OsTaskWaitStack=256,256
      SWC_1ms_Task_Core1: OsTaskStackAllocation=256,256, OsTaskWaitStack=256,256
      SWC_20ms_Task_Core1: OsTaskStackAllocation=256,256, OsTaskWaitStack=256,256
      SWC_50ms_Task_Core1: OsTaskStackAllocation=256,256, OsTaskWaitStack=256,256
      SWC_5ms_Task_Core1: OsTaskStackAllocation=256,256, OsTaskWaitStack=256,256
      BSW_1ms_Task_Core0: OsTaskResourceRef=RTE_RESOURCE
      BSW_10ms_Task_Core0: OsTaskResourceRef=RTE_RESOURCE
      BSW_5ms_Task_Core0: OsTaskResourceRef=RTE_RESOURCE
      SWC_1000ms_Task_Core0: OsTaskStackAllocation=256,256, OsTaskWaitStack=256,256, OsTaskResourceRef=RTE_RESOURCE
      SWC_100ms_Task_Core0: OsTaskStackAllocation=256,256, OsTaskWaitStack=256,256, OsTaskResourceRef=RTE_RESOURCE
      SWC_20ms_Task_Core0: OsTaskStackAllocation=256,256, OsTaskWaitStack=256,256, OsTaskResourceRef=RTE_RESOURCE
      SWC_1ms_Task_Core0: OsTaskResourceRef=RTE_RESOURCE
      SWC_5ms_Task_Core0: OsTaskResourceRef=RTE_RESOURCE
      SWC_50ms_Task_Core0: OsTaskStackAllocation=256,256, OsTaskWaitStack=256,256, OsTaskResourceRef=RTE_RESOURCE
    OsRTATarget: OsRTATargetName=TriCoreHighTec, OsRTATargetVariant=TC27xC, OsRTATargetVersion=5.0.21
      13 x Param:
        AlignUntrustedStacks: Value=true
        Optimization: Value=2
        OsMemoryModel: Value=large
        TWPprs: Value=2
        UserMode: Value=User-0
        OrtiStackFill: Value=true
        SpPreStartOS: Value=16,64
        SpStartOS: Value=0,64
        SpIDisp: Value=224,64
        SpECC: Value=96,64
        SpPreemption: Value=104,64
        Orti22Lauterbach: Value=true
        OrtiSMPProposal: Value=true
    9 x OsIsr:
      ADC1SR1_ISR: OsIsrAddress=SRC_VADCG1SR1, OsIsrCategory=CATEGORY_2, OsIsrPriority=61
      ADC2SR1_ISR: OsIsrAddress=SRC_VADCG2SR1, OsIsrCategory=CATEGORY_2, OsIsrPriority=62
      ADC3SR1_ISR: OsIsrAddress=SRC_VADCG3SR1, OsIsrCategory=CATEGORY_2, OsIsrPriority=63
      NMI_Trap: OsIsrAddress=Trap7, OsIsrCategory=CATEGORY_1, OsIsrPriority=256
      ADC0SR0_ISR: OsIsrAddress=SRC_VADCG0SR0, OsIsrCategory=CATEGORY_2, OsIsrPriority=149
      ADC4SR1_ISR: OsIsrAddress=SRC_VADCG4SR1, OsIsrCategory=CATEGORY_2, OsIsrPriority=64
      DMACH30SR_ISR: OsIsrAddress=SRC_DMACH30, OsIsrCategory=CATEGORY_2, OsIsrPriority=90
      QSPI2ERR_ISR: OsIsrAddress=SRC_QSPI2ERR, OsIsrCategory=CATEGORY_2, OsIsrPriority=33
      DMACH31SR_ISR: OsIsrAddress=SRC_DMACH31, OsIsrCategory=CATEGORY_2, OsIsrPriority=91
    Rte_Activity (OsEvent): OsEventMask=1
    Rte_Timeout (OsEvent): OsEventMask=2
    Rte_TimeoutAlarm1 (OsAlarm): OsAlarmAccessingApplication=OsAppCore1, OsAlarmCounterRef=Rte_TOutCounter
      Action (OsAlarmAction)
        OsAlarmSetEvent: OsAlarmSetEventRef=Rte_Timeout, OsAlarmSetEventTaskRef=SWC_10ms_Task_Core1
    3 x OsApplication:
      OsAppCore0: OsTrusted=1, OsTrustedApplicationDelayTimingViolationCall=0, OsTrustedApplicationWithProtection=0, OsAppAlarmRef=Rte_TimeoutAlarm1, OsAppCounterRef=Rte_TOutCounter, OsAppCounterRef=Rte_TickCounter, OsAppEcucPartitionRef=Partition_Core0, OsAppIsrRef=DMACH30SR_ISR, OsAppIsrRef=DMACH31SR_ISR, OsAppIsrRef=QSPI2ERR_ISR, OsAppIsrRef=ADC0SR0_ISR, OsAppIsrRef=ADC1SR1_ISR, OsAppIsrRef=ADC2SR1_ISR, OsAppIsrRef=ADC3SR1_ISR, OsAppIsrRef=ADC4SR1_ISR, OsAppIsrRef=NMI_Trap, OsApplicationCoreRef=EcucCore0, OsAppTaskRef=BSW_10ms_Task_Core0, OsAppTaskRef=BSW_1ms_Task_Core0, OsAppTaskRef=BSW_5ms_Task_Core0, OsAppTaskRef=SWC_1000ms_Task_Core0, OsAppTaskRef=SWC_100ms_Task_Core0, OsAppTaskRef=SWC_10ms_Task_Core0, OsAppTaskRef=SWC_1ms_Task_Core0, OsAppTaskRef=SWC_20ms_Task_Core0, OsAppTaskRef=SWC_50ms_Task_Core0, OsAppTaskRef=SWC_5ms_Task_Core0, OsAppCounterRef=SystemTimer, OsAppTaskRef=BSW_2ms_Task_Core0, OsAppTaskRef=Os_Init_Task_Core0, OsAppScheduleTableRef=Rte_ScheduleTable, OsAppTaskRef=BSW_Interact_Task_0_Core0, OsAppTaskRef=BSW_Interact_Task_1_Core0, OsAppIsrRef=DSADCSRM4_ISR, OsAppIsrRef=GTMATOM3SR2_ISR, OsAppIsrRef=ADC0SR1_ISR, OsAppIsrRef=ADC5SR1_ISR, OsAppTaskRef=BSW_Idle_Task_Core0, OsAppIsrRef=SystemTimer_ISR
        OsApplicationHooks_0 (OsApplicationHooks): OsAppErrorHook=false, OsAppShutdownHook=true, OsAppStartupHook=true
      OsAppCore1: OsTrusted=1, OsTrustedApplicationDelayTimingViolationCall=0, OsTrustedApplicationWithProtection=0, OsAppEcucPartitionRef=Partition_Core1, OsApplicationCoreRef=EcucCore1, OsAppTaskRef=BSW_10ms_Task_Core1, OsAppTaskRef=BSW_1ms_Task_Core1, OsAppTaskRef=BSW_5ms_Task_Core1, OsAppTaskRef=SWC_1000ms_Task_Core1, OsAppTaskRef=SWC_100ms_Task_Core1, OsAppTaskRef=SWC_10ms_Task_Core1, OsAppTaskRef=SWC_1ms_Task_Core1, OsAppTaskRef=SWC_20ms_Task_Core1, OsAppTaskRef=SWC_50ms_Task_Core1, OsAppTaskRef=SWC_5ms_Task_Core1, OsAppTaskRef=Os_Init_Task_Core1, OsAppTaskRef=BSW_Interact_Task_0_Core1, OsAppTaskRef=BSW_Interact_Task_1_Core1, OsAppIsrRef=WdgGptSrvISR, OsAppTaskRef=BSW_Idle_Task_Core1, OsAppIsrRef=GTMTOM0SR0_ISR, OsAppIsrRef=GTMTOM2SR6_ISR, OsAppIsrRef=SCUERUSR0_ISR, OsAppIsrRef=GTMTOM0SR1_ISR
        OsApplicationHooks_0 (OsApplicationHooks): OsAppErrorHook=false, OsAppShutdownHook=true, OsAppStartupHook=true
      OsAppCore2: OsTrusted=true, OsTrustedApplicationDelayTimingViolationCall=false, OsTrustedApplicationWithProtection=false, OsAppEcucPartitionRef=Partition_Core2, OsAppIsrRef=STM_OsCounter_Core2, OsApplicationCoreRef=EcucCore2, OsAppTaskRef=BSW_10ms_Task_Core2, OsAppTaskRef=Os_Init_Task_Core2, OsAppIsrRef=GTMTOM0SR7_ISR, OsAppTaskRef=BSW_Interact_Task_0_Core2, OsAppTaskRef=BSW_Interact_Task_1_Core2, OsAppTaskRef=BSW_Idle_Task_Core2, OsAppIsrRef=GTMTIM0SR5_ISR
        OsApplicationHooks: OsAppErrorHook=false, OsAppShutdownHook=false, OsAppStartupHook=false
    BSW_10ms_Task_Core2 (OsTask): OsTaskAccessingApplication=OsAppCore0, OsTaskAccessingApplication=OsAppCore1, OsTaskAccessingApplication=OsAppCore2
    RTE_RESOURCE (OsResource): OsResourceAccessingApplication=OsAppCore0
    SystemTimer (OsCounter):
      OsCounterMinCycle = 1
      OsCounterMaxAllowedValue = 4294967295
      OsCounterTicksPerBase = 1
      OsCounterType = HARDWARE
      OsSecondsPerTick = 1E-08
      OsCounterAccessingApplication = OsAppCore0
    BSW_2ms_Task_Core0 (OsTask): OsTaskSchedule=FULL, OsTaskActivation=1, OsTaskPriority=38, OsTaskAccessingApplication=OsAppCore0, OsTaskAccessingApplication=OsAppCore1
    Rte_ScheduleTable (OsScheduleTable): OsScheduleTableRepeating=true, OsScheduleTableDuration=1000000, OsSchTblAccessingApplication=OsAppCore0, OsScheduleTableCounterRef=SystemTimer
      10 x OsScheduleTableExpiryPoint:
        EP_0: OsScheduleTblExpPointOffset=0
          7 x OsScheduleTableTaskActivation:
            Ac0: OsScheduleTableActivateTaskRef=BSW_1ms_Task_Core0
            Ac1: OsScheduleTableActivateTaskRef=BSW_1ms_Task_Core1
            Ac2: OsScheduleTableActivateTaskRef=BSW_2ms_Task_Core0
            Ac3: OsScheduleTableActivateTaskRef=BSW_5ms_Task_Core0
            Ac4: OsScheduleTableActivateTaskRef=BSW_5ms_Task_Core1
            Ac5: OsScheduleTableActivateTaskRef=BSW_10ms_Task_Core0
            Ac6: OsScheduleTableActivateTaskRef=BSW_10ms_Task_Core1
        EP_100000: OsScheduleTblExpPointOffset=100000
          Ac0 (OsScheduleTableTaskActivation): OsScheduleTableActivateTaskRef=BSW_1ms_Task_Core0
          Ac1 (OsScheduleTableTaskActivation): OsScheduleTableActivateTaskRef=BSW_1ms_Task_Core1
        EP_200000: OsScheduleTblExpPointOffset=200000
          3 x OsScheduleTableTaskActivation:
            Ac0: OsScheduleTableActivateTaskRef=BSW_1ms_Task_Core0
            Ac1: OsScheduleTableActivateTaskRef=BSW_1ms_Task_Core1
            Ac2: OsScheduleTableActivateTaskRef=BSW_2ms_Task_Core0
        EP_300000: OsScheduleTblExpPointOffset=300000
          Ac0 (OsScheduleTableTaskActivation): OsScheduleTableActivateTaskRef=BSW_1ms_Task_Core0
          Ac1 (OsScheduleTableTaskActivation): OsScheduleTableActivateTaskRef=BSW_1ms_Task_Core1
        EP_400000: OsScheduleTblExpPointOffset=400000
          3 x OsScheduleTableTaskActivation:
            Ac0: OsScheduleTableActivateTaskRef=BSW_1ms_Task_Core0
            Ac1: OsScheduleTableActivateTaskRef=BSW_1ms_Task_Core1
            Ac2: OsScheduleTableActivateTaskRef=BSW_2ms_Task_Core0
        EP_500000: OsScheduleTblExpPointOffset=500000
          4 x OsScheduleTableTaskActivation:
            Ac0: OsScheduleTableActivateTaskRef=BSW_1ms_Task_Core0
            Ac1: OsScheduleTableActivateTaskRef=BSW_1ms_Task_Core1
            Ac2: OsScheduleTableActivateTaskRef=BSW_5ms_Task_Core0
            Ac3: OsScheduleTableActivateTaskRef=BSW_5ms_Task_Core1
        EP_600000: OsScheduleTblExpPointOffset=600000
          3 x OsScheduleTableTaskActivation:
            Ac0: OsScheduleTableActivateTaskRef=BSW_1ms_Task_Core0
            Ac1: OsScheduleTableActivateTaskRef=BSW_1ms_Task_Core1
            Ac2: OsScheduleTableActivateTaskRef=BSW_2ms_Task_Core0
        EP_700000: OsScheduleTblExpPointOffset=700000
          Ac0 (OsScheduleTableTaskActivation): OsScheduleTableActivateTaskRef=BSW_1ms_Task_Core0
          Ac1 (OsScheduleTableTaskActivation): OsScheduleTableActivateTaskRef=BSW_1ms_Task_Core1
        EP_800000: OsScheduleTblExpPointOffset=800000
          3 x OsScheduleTableTaskActivation:
            Ac0: OsScheduleTableActivateTaskRef=BSW_1ms_Task_Core0
            Ac1: OsScheduleTableActivateTaskRef=BSW_1ms_Task_Core1
            Ac2: OsScheduleTableActivateTaskRef=BSW_2ms_Task_Core0
        EP_900000: OsScheduleTblExpPointOffset=900000
          Ac0 (OsScheduleTableTaskActivation): OsScheduleTableActivateTaskRef=BSW_1ms_Task_Core0
          Ac1 (OsScheduleTableTaskActivation): OsScheduleTableActivateTaskRef=BSW_1ms_Task_Core1
    3 x OsTask, all with OsTaskSchedule=NON, OsTaskActivation=1, OsTaskAccessingApplication=OsAppCore0, OsTaskAccessingApplication=OsAppCore1:
      Os_Init_Task_Core0: OsTaskPriority=52
        OsTaskAutostart: OsTaskAppModeRef=OSDEFAULTAPPMODE
      Os_Init_Task_Core1: OsTaskPriority=51
      Os_Init_Task_Core2: OsTaskPriority=50, OsTaskAccessingApplication=OsAppCore2
    4 x OsSpinlock, all with OsSpinlockLockMethod=LOCK_ALL_INTERRUPTS:
      Os_Spinlock_Core0Core1: OsSpinlockAccessingApplication=OsAppCore0, OsSpinlockAccessingApplication=OsAppCore1
      Os_Spinlock_Core1Core2: OsSpinlockAccessingApplication=OsAppCore1, OsSpinlockAccessingApplication=OsAppCore2
      Os_Spinlock_Core0Core2: OsSpinlockAccessingApplication=OsAppCore0, OsSpinlockAccessingApplication=OsAppCore2
      Os_Spinlock_Core0Core1Core2: OsSpinlockAccessingApplication=OsAppCore0, OsSpinlockAccessingApplication=OsAppCore1, OsSpinlockAccessingApplication=OsAppCore2
    GTMATOM3SR2_ISR (OsIsr): OsIsrCategory=CATEGORY_2, OsIsrPriority=140, OsIsrAddress=SRC_GTMATOM32
    GTMTOM0SR7_ISR (OsIsr): OsIsrCategory=CATEGORY_2, OsIsrPriority=150, OsIsrAddress=SRC_GTMTOM07
    6 x OsTask, all with OsTaskSchedule=FULL, OsTaskActivation=3, OsTaskAccessingApplication=OsAppCore0, OsTaskAccessingApplication=OsAppCore1, OsTaskAccessingApplication=OsAppCore2:
      BSW_Interact_Task_0_Core0: OsTaskPriority=60
      BSW_Interact_Task_0_Core1: OsTaskPriority=61
      BSW_Interact_Task_0_Core2: OsTaskPriority=62
      BSW_Interact_Task_1_Core0: OsTaskPriority=63
      BSW_Interact_Task_1_Core1: OsTaskPriority=64
      BSW_Interact_Task_1_Core2: OsTaskPriority=65
    3 x OsIsr, all with OsIsrCategory=CATEGORY_2:
      ADC5SR1_ISR: OsIsrAddress=SRC_VADCG5SR1, OsIsrPriority=65
      ADC0SR1_ISR: OsIsrAddress=SRC_VADCG0SR1, OsIsrPriority=60
      DSADCSRM4_ISR: OsIsrAddress=SRC_DSADCSRM4, OsIsrPriority=151
    Rte_EA_BSWImpl4_CanTp_EXCLUSIVE_AREA (OsResource): OsResourceAccessingApplication=OsAppCore0
    WdgGptSrvISR (OsIsr): OsIsrCategory=CATEGORY_2, OsIsrPriority=152, OsIsrAddress=SRC_GTMATOM30
    3 x OsTask, all with OsTaskSchedule=FULL, OsTaskActivation=1, OsTaskStackAllocation=256,256, OsTaskWaitStack=256,256:
      BSW_Idle_Task_Core0: OsTaskPriority=1, OsTaskAccessingApplication=OsAppCore0
        OsTaskAutostart: OsTaskAppModeRef=OSDEFAULTAPPMODE
      BSW_Idle_Task_Core1: OsTaskPriority=2, OsTaskAccessingApplication=OsAppCore1
        OsTaskAutostart: OsTaskAppModeRef=OSDEFAULTAPPMODE
      BSW_Idle_Task_Core2: OsTaskPriority=3, OsTaskAccessingApplication=OsAppCore2
        OsTaskAutostart: OsTaskAppModeRef=OSDEFAULTAPPMODE
    5 x OsIsr, all with OsIsrCategory=CATEGORY_1:
      GTMTIM0SR5_ISR: OsIsrPriority=200, OsIsrAddress=SRC_GTMTIM05
      GTMTOM0SR0_ISR: OsIsrPriority=198, OsIsrAddress=SRC_GTMTOM00
      GTMTOM2SR6_ISR: OsIsrPriority=199, OsIsrAddress=SRC_GTMTOM26
      SCUERUSR0_ISR: OsIsrAddress=SRC_SCUERU0, OsIsrPriority=234
      GTMTOM0SR1_ISR: OsIsrPriority=160, OsIsrAddress=SRC_GTMTOM01
