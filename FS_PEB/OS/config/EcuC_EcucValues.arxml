AUTOSAR XML (schema 4-2-2)
package /RTAOS/EcucModuleConfigurationValuess
  module config EcuC
    EcucPartitionCollection
      3 x EcucPartition:
        Partition_Core0: EcucPartitionBswModuleExecution=1, PartitionCanBeRestarted=0, EcucPartitionSoftwareComponentInstanceRef=CPT_Base_SWC, EcucPartitionSoftwareComponentInstanceRef=CPT_BswM, EcucPartitionSoftwareComponentInstanceRef=CPT_COM_SWC_Core0, EcucPartitionSoftwareComponentInstanceRef=CPT_ComM, EcucPartitionSoftwareComponentInstanceRef=CPT_Dcm, EcucPartitionSoftwareComponentInstanceRef=CPT_Dem, EcucPartitionSoftwareComponentInstanceRef=CPT_Demo_SWC_Core0, EcucPartitionSoftwareComponentInstanceRef=CPT_Det, EcucPartitionSoftwareComponentInstanceRef=CPT_Diag_SWC, EcucPartitionSoftwareComponentInstanceRef=CPT_EcuM, EcucPartitionSoftwareComponentInstanceRef=CPT_FiM, EcucPartitionSoftwareComponentInstanceRef=CPT_IoHwAbW, EcucPartitionSoftwareComponentInstanceRef=CPT_NvM, EcucPartitionSoftwareComponentInstanceRef=CPT_NvM_SWC, EcucPartitionSoftwareComponentInstanceRef=CPT_Proxy_SWC_Core0, EcucPartitionSoftwareComponentInstanceRef=CPT_Test_SWC_Core0, EcucPartitionSoftwareComponentInstanceRef=CPT_WdgM, EcucPartitionSoftwareComponentInstanceRef=CPT_WdgM_SWC
        Partition_Core1: EcucPartitionBswModuleExecution=0, PartitionCanBeRestarted=0, EcucPartitionSoftwareComponentInstanceRef=CPT_Demo_SWC_Core1, EcucPartitionSoftwareComponentInstanceRef=CPT_Test_SWC_Core1
        Partition_Core2: EcucPartitionQmBswModuleExecution=1, EcucPartitionBswModuleExecution=false, PartitionCanBeRestarted=false
    EcucHardware_0 (EcucHardware)
      3 x EcucCoreDefinition:
        EcucCore{0..2}: EcucCoreId={0..2}
