ASAP2_VERSION 1 60
/begin PROJECT ETAS_AUTOSAR "XCP on CAN"
/begin HEADER "" VERSION "1.0.0.0" PROJECT_NO ETAS_AUTOSAR /end HEADER
/begin MODULE ETAS_AUTOSAR ""
/begin MOD_COMMON "" DEPOSIT ABSOLUTE BYTE_ORDER MSB_LAST /end MOD_COMMON
/begin COMPU_METHOD RTE_A2L_Ident_Float "Q = V" RAT_FUNC "%8.6" "" COEFFS 0 1 0 0 0 1 /end COMPU_METHOD
/begin COMPU_METHOD RTE_A2L_Ident_Int "Q = V" RAT_FUNC "%8.0" "" COEFFS 0 1 0 0 0 1 /end COMPU_METHOD
/begin COMPU_METHOD BSW_A2L_Ident_Float "Q = V" RAT_FUNC "%8.6" "" COEFFS 0 1 0 0 0 1 /end COMPU_METHOD
/begin COMPU_METHOD BSW_A2L_Ident_Int "Q = V" RAT_FUNC "%8.0" "" COEFFS 0 1 0 0 0 1 /end COMPU_METHOD
/begin COMPU_METHOD DFC_Verb "" TAB_VERB " % 2.1" " - " COMPU_TAB_REF DFC_LIST /end COMPU_METHOD
/begin COMPU_METHOD FID_Verb "" TAB_VERB " % 2.1" " - " COMPU_TAB_REF FID_LIST /end COMPU_METHOD
/begin COMPU_METHOD SWC_RCF_CM_boolean "Q = V" RAT_FUNC "%1.0" "" COEFFS 0 1 0 0 0 1 /end COMPU_METHOD
/begin COMPU_METHOD SWC_TRSP_CM_single "Q = V" RAT_FUNC "%8.6" "" COEFFS 0 1 0 0 0 1 /end COMPU_METHOD
/begin COMPU_METHOD SWC_TRSP_CM_boolean "Q = V" RAT_FUNC "%1.0" "" COEFFS 0 1 0 0 0 1 /end COMPU_METHOD
/begin COMPU_METHOD SWC_VCF_CM_single "Q = V" RAT_FUNC "%8.6" "" COEFFS 0 1 0 0 0 1 /end COMPU_METHOD
/begin COMPU_METHOD SWC_VCF_CM_boolean "Q = V" RAT_FUNC "%1.0" "" COEFFS 0 1 0 0 0 1 /end COMPU_METHOD
/begin COMPU_METHOD SWC_VCF_CM_uint8 "Q = V" RAT_FUNC "%3.0" "" COEFFS 0 1 0 0 0 1 /end COMPU_METHOD
/begin COMPU_VTAB DFC_LIST "" TAB_VERB 127 1 "ADC_UPhaseBISTFail" 2 "ADC_VPhaseBISTFail" 3 "ADC_WPhaseBISTFail" 4 "CANSM_E_BUS_OFF_NETWORK_0" 5 "CANSM_E_BUS_OFF_NETWORK_1" 6 "Can_Timeout" 7 "Cpld_AliveChkErr" 8 "Cpld_DI_ExdClk_InFail" 9 "Cpld_ExdClkInFail" 10 "Cpld_IphaOC" 11 "Cpld_NEN_InFail" 12 "Cpld_ParityChkErr" 13 "Cpld_Rx_SelfTest_Fail" 14 "Cpld_SPIComFail" 15 "Cpld_SZTKT_InFail" 16 "Cpld_Short_Circuit_HS_InFail" 17 "Cpld_Short_Circuit_LS_InFail" 18 "Cpld_UdcOverVolFail" 19 "Cpld_UnderVol_HS_InFail" 20 "Cpld_UnderVol_LS_InFail" 21 "Epark_OverCurFail" 22 "Epark_PosMonSampFail" 23 "Epark_PosSampFail" 24 "Epark_SampFail" 25 "Event_NvM_ReadErr" 26 "Event_NvM_WriteErr" 27 "FR_StorageErr" 28 "HSPF_InvOpenErr" 29 "HSPF_MotorOpenErr" 30 "HSPF_VerMatchFailureErr" 31 "HSPF_stIphaOffCalFail" 32 "HSPF_tDBCTempCmpErr" 33 "HvMcu_ComErr" 34 "HvMcu_DisChrgDutyErr" 35 "HvMcu_DisChrgFail" 36 "HvMcu_DisChrgFreqErr" 37 "HvMcu_EmerPowerSapErr" 38 "HvMcu_UartCheckFailErr" 39 "HvMcu_UartLostFrameErr" 40 "HvMcu_UdcCheckErr" 41 "HvMcu_UdcOverFlagLimit" 42 "HvMcu_UdcOverVolErr" 43 "IOHWAB_12VNarrSampErr" 44 "IOHWAB_12VSampErr" 45 "IOHWAB_12VWideSampErr" 46 "IOHWAB_18VLwBrgSampFail" 47 "IOHWAB_18VUpBrgSampFail" 48 "IOHWAB_1V3MCU_SampFail" 49 "IOHWAB_3V3MCU_SampFail" 50 "IOHWAB_5VQcoSampFail" 51 "IOHWAB_5VQt1SampFail" 52 "IOHWAB_5VQt2SampFail" 53 "IOHWAB_Cpld1v8SampFail" 54 "IOHWAB_Cpld3v3SampFail" 55 "IOHWAB_CrashFail" 56 "IOHWAB_DcLnkOverVolFail" 57 "IOHWAB_IphaOCFail" 58 "IOHWAB_KL30OverVolErr" 59 "IOHWAB_KL30SevOverVolFail" 60 "IOHWAB_KL30SevUnderVolFail" 61 "IOHWAB_KL30UnderVolErr" 62 "IOHWAB_Nen33Fail" 63 "IOHWAB_SttrSenorShrFail" 64 "IOHWAB_SttrTemp1SampFail" 65 "IOHWAB_SttrTemp2SampFail" 66 "IOHWAB_TCoolantSampFail" 67 "IOHWAB_VDD5_D_SampFail" 68 "IgbtDrv_ComErr" 69 "IgbtDrv_LwBrgFaultAFail" 70 "IgbtDrv_LwBrgFaultBFail" 71 "IgbtDrv_UpBrgFaultAFail" 72 "IgbtDrv_UpBrgFaultBFail" 73 "MDF_AlOfsNoPlausErr" 74 "MDF_DiashCirNoPsblErr" 75 "MDF_EmacBlkdErr" 76 "MDF_EmacBlkdWarn" 77 "MDF_ICtlRatErr" 78 "MDF_IsOvHiErr" 79 "MDF_OpenCirNoPsblErr" 80 "MDF_OperOutdRngErr" 81 "MDF_PhaseLossFaultErr" 82 "MDF_PrfElDrvErr" 83 "PCF_ActOvTiErr" 84 "PCF_IdcOvErr" 85 "PCF_SelfcheckErr" 86 "PCF_SenClbErr" 87 "PCF_SenOvErr" 88 "PCF_StallRetryErr" 89 "PCF_StallWarn" 90 "PCF_UnexpPosErr" 91 "RCF_AccOvTiErr" 92 "RCF_EstOfsErr" 93 "RCF_FwlBwdOvTiErr" 94 "RCF_FwlFwdOvTiErr" 95 "RCF_OfsClbFail" 96 "RCF_PsiOvErr" 97 "RSL_DOSErr" 98 "RSL_ExcErr" 99 "RSL_LOSErr" 100 "RSL_LOTErr" 101 "SCF_DisChgOvTiFail" 102 "SCF_LowPwrShtDwnOvTiFail" 103 "SCF_RunToDischarErr" 104 "TPC_SpdOvHiLimFail" 105 "TPC_SpdOvHiWarn" 106 "TPC_TCoolantOvHiWarn" 107 "TPC_TDbcOvHiWarn" 108 "TPC_TDbcOvLoWarn" 109 "TPC_TDbcUHiLimFail" 110 "TPC_TDbcULoLimFail" 111 "TPC_TDbcVHiLimFail" 112 "TPC_TDbcVLoLimFail" 113 "TPC_TDbcWHiLimFail" 114 "TPC_TDbcWLoLimFail" 115 "TPC_TDrvBoardOvHiWarn" 116 "TPC_TIGBTOvHiLimErr" 117 "TPC_TIGBTOvHiWarn" 118 "TPC_TIGBTOvLoWarn" 119 "TPC_TSttrOvHiLimFail" 120 "TPC_TSttrOvHiWarn" 121 "TPC_TSttrOvLoWarn" 122 "TPC_iDcLnkOvCLimFail" 123 "TPC_iDcLnkOvcWarn" 124 "TPC_uDcLnkOvVLimFail" 125 "TPC_uDcLnkOvWarn" 126 "TPC_uDcLnkUnVLimFail" 127 "TPC_uDcLnkUnvWarn" DEFAULT_VALUE "---" /end COMPU_VTAB
/begin COMPU_VTAB FID_LIST "" TAB_VERB 162 1 "FIM_ADC_UPhaseBISTFail" 2 "FIM_ADC_VPhaseBISTFail" 3 "FIM_ADC_WPhaseBISTFail" 4 "FIM_CANSM_E_BUS_OFF_NETWORK_0" 5 "FIM_Can_Timeout" 6 "FIM_CpldErr" 7 "FIM_Cpld_AliveChkErr" 8 "FIM_Cpld_DI_ExdClk_InFail" 9 "FIM_Cpld_ExdClkInFail" 10 "FIM_Cpld_IphaOC" 11 "FIM_Cpld_NEN_InFail" 12 "FIM_Cpld_ParityChkErr" 13 "FIM_Cpld_SPIComFail" 14 "FIM_Cpld_SZTKT_InFail" 15 "FIM_Cpld_Short_Circuit_HS_InFail" 16 "FIM_Cpld_Short_Circuit_LS_InFail" 17 "FIM_Cpld_UdcOverVolFail" 18 "FIM_Cpld_UnderVol_HS_InFail" 19 "FIM_Cpld_UnderVol_LS_InFail" 20 "FIM_Epark_OverCurFail" 21 "FIM_Epark_PosMonSampFail" 22 "FIM_Epark_PosSampFail" 23 "FIM_Epark_SampFail" 24 "FIM_Event_NvM_ReadErr" 25 "FIM_Event_NvM_WriteErr" 26 "FIM_FRStoErr" 27 "FIM_FR_StorageErr" 28 "FIM_HSPF_InvOpenErr" 29 "FIM_HSPF_MotorOpenErr" 30 "FIM_HSPF_VerMatchFailureErr" 31 "FIM_HSPF_stIphaOffCalFail" 32 "FIM_HSPF_tDBCTempCmpErr" 33 "FIM_HvMcu_ComErr" 34 "FIM_HvMcu_DisChrgDutyErr" 35 "FIM_HvMcu_DisChrgFail" 36 "FIM_HvMcu_DisChrgFreqErr" 37 "FIM_HvMcu_EmerPowerSapErr" 38 "FIM_HvMcu_UartCheckFailErr" 39 "FIM_HvMcu_UartLostFrameErr" 40 "FIM_HvMcu_UdcCheckErr" 41 "FIM_HvMcu_UdcOverVolErr" 42 "FIM_HvmcuErr" 43 "FIM_IGBTOvTempErr" 44 "FIM_IGBTOvTempWarn" 45 "FIM_IOHWAB_12VNarrSampErr" 46 "FIM_IOHWAB_12VSampErr" 47 "FIM_IOHWAB_12VWideSampErr" 48 "FIM_IOHWAB_18VLwBrgSampFail" 49 "FIM_IOHWAB_18VUpBrgSampFail" 50 "FIM_IOHWAB_1V3MCU_SampFail" 51 "FIM_IOHWAB_3V3MCU_SampFail" 52 "FIM_IOHWAB_5VQcoSampFail" 53 "FIM_IOHWAB_5VQt1SampFail" 54 "FIM_IOHWAB_5VQt2SampFail" 55 "FIM_IOHWAB_Cpld1v8SampFail" 56 "FIM_IOHWAB_Cpld3v3SampFail" 57 "FIM_IOHWAB_CrashFail" 58 "FIM_IOHWAB_DcLnkOverVolFail" 59 "FIM_IOHWAB_IphaOCFail" 60 "FIM_IOHWAB_KL30OverVolErr" 61 "FIM_IOHWAB_KL30SevOverVolFail" 62 "FIM_IOHWAB_KL30SevUnderVolFail" 63 "FIM_IOHWAB_KL30UnderVolErr" 64 "FIM_IOHWAB_Nen33Fail" 65 "FIM_IOHWAB_SttrSenorShrFail" 66 "FIM_IOHWAB_SttrTemp1SampFail" 67 "FIM_IOHWAB_SttrTemp2SampFail" 68 "FIM_IOHWAB_TCoolantSampFail" 69 "FIM_IOHWAB_VDD5_D_SampFail" 70 "FIM_IgbtDrvErr" 71 "FIM_IgbtDrv_ComErr" 72 "FIM_IgbtDrv_LwBrgFaultAFail" 73 "FIM_IgbtDrv_LwBrgFaultBFail" 74 "FIM_IgbtDrv_UpBrgFaultAFail" 75 "FIM_IgbtDrv_UpBrgFaultBFail" 76 "FIM_IohwabSampErr" 77 "FIM_Lamp" 78 "FIM_LowPowerOvVErr" 79 "FIM_LowPowerUnVErr" 80 "FIM_MDF_AlOfsNoPlausErr" 81 "FIM_MDF_DiashCirNoPsblErr" 82 "FIM_MDF_EmacBlkdErr" 83 "FIM_MDF_EmacBlkdWarn" 84 "FIM_MDF_ICtlRatErr" 85 "FIM_MDF_IsOvHiErr" 86 "FIM_MDF_OpenCirNoPsblErr" 87 "FIM_MDF_OperOutdRngErr" 88 "FIM_MDF_PhaseLossFaultErr" 89 "FIM_MDF_PrfElDrvErr" 90 "FIM_MtrOvTempErr" 91 "FIM_MtrOvTempWarn" 92 "FIM_PCF_ActOvTiErr" 93 "FIM_PCF_IdcOvErr" 94 "FIM_PCF_SelfcheckErr" 95 "FIM_PCF_SenClbErr" 96 "FIM_PCF_SenOvErr" 97 "FIM_PCF_StallRetryErr" 98 "FIM_PCF_StallWarn" 99 "FIM_PCF_UnexpPosErr" 100 "FIM_PwrLimLvFour" 101 "FIM_PwrLimLvOne" 102 "FIM_PwrLimLvThree" 103 "FIM_PwrLimLvTwo" 104 "FIM_RCF_AccOvTiErr" 105 "FIM_RCF_EstOfsErr" 106 "FIM_RCF_FwlBwdOvTiErr" 107 "FIM_RCF_FwlFwdOvTiErr" 108 "FIM_RCF_OfsClbFail" 109 "FIM_RCF_PsiOvErr" 110 "FIM_RSL_DOSErr" 111 "FIM_RSL_ExcErr" 112 "FIM_RSL_LOSErr" 113 "FIM_RSL_LOTErr" 114 "FIM_ReqFailrMod" 115 "FIM_RslvOpen" 116 "FIM_SCF_DisChgOvTiFail" 117 "FIM_SCF_LowPwrShtDwnOvTiFail" 118 "FIM_SCF_RunToDischarErr" 119 "FIM_SpdOvHiErr" 120 "FIM_SpdOvHiWarn" 121 "FIM_Sttr1Err" 122 "FIM_Sttr2Err" 123 "FIM_TPC_SpdOvHiLimFail" 124 "FIM_TPC_SpdOvHiWarn" 125 "FIM_TPC_TCoolantOvHiWarn" 126 "FIM_TPC_TDbcOvHiWarn" 127 "FIM_TPC_TDbcOvLoWarn" 128 "FIM_TPC_TDbcUHiLimFail" 129 "FIM_TPC_TDbcULoLimFail" 130 "FIM_TPC_TDbcVHiLimFail" 131 "FIM_TPC_TDbcVLoLimFail" 132 "FIM_TPC_TDbcWHiLimFail" 133 "FIM_TPC_TDbcWLoLimFail" 134 "FIM_TPC_TDrvBoardOvHiWarn" 135 "FIM_TPC_TIGBTOvHiLimErr" 136 "FIM_TPC_TIGBTOvHiWarn" 137 "FIM_TPC_TIGBTOvLoWarn" 138 "FIM_TPC_TSttrOvHiLimFail" 139 "FIM_TPC_TSttrOvHiWarn" 140 "FIM_TPC_TSttrOvLoWarn" 141 "FIM_TPC_iDcLnkOvCLimFail" 142 "FIM_TPC_iDcLnkOvcWarn" 143 "FIM_TPC_uDcLnkOvVLimFail" 144 "FIM_TPC_uDcLnkOvWarn" 145 "FIM_TPC_uDcLnkUnVLimFail" 146 "FIM_TPC_uDcLnkUnvWarn" 147 "FIM_TrqLimLvFour" 148 "FIM_TrqLimLvOne" 149 "FIM_TrqLimLvThree" 150 "FIM_TrqLimLvTwo" 151 "FIM_Unused" 152 "FIM_VCUComTimeOut" 153 "FIM_flgDchaFailr" 154 "FIM_flgFaultLvFive" 155 "FIM_flgFaultLvFour" 156 "FIM_iDcLnkOvcErr" 157 "FIM_iDcLnkOvcWarn" 158 "FIM_uDcLnkOvErr" 159 "FIM_uDcLnkOvWarn" 160 "FIM_uDcLnkUnvErr" 161 "FIM_uDcLnkUnvWarn" 162 "FiM_FlagforFR" DEFAULT_VALUE "---" /end COMPU_VTAB
/begin RECORD_LAYOUT Scalar_BOOLEAN FNC_VALUES 1 UBYTE COLUMN_DIR DIRECT /end RECORD_LAYOUT
/begin RECORD_LAYOUT Scalar_UBYTE FNC_VALUES 1 UBYTE COLUMN_DIR DIRECT /end RECORD_LAYOUT
/begin RECORD_LAYOUT Scalar_BYTE FNC_VALUES 1 SBYTE COLUMN_DIR DIRECT /end RECORD_LAYOUT
/begin RECORD_LAYOUT Scalar_UWORD FNC_VALUES 1 UWORD COLUMN_DIR DIRECT /end RECORD_LAYOUT
/begin RECORD_LAYOUT Scalar_SWORD FNC_VALUES 1 SWORD COLUMN_DIR DIRECT /end RECORD_LAYOUT
/begin RECORD_LAYOUT Scalar_LONG FNC_VALUES 1 SLONG COLUMN_DIR DIRECT /end RECORD_LAYOUT
/begin RECORD_LAYOUT Scalar_FLOAT32_IEEE FNC_VALUES 1 FLOAT32_IEEE COLUMN_DIR DIRECT /end RECORD_LAYOUT
/begin RECORD_LAYOUT Lookup1D_X_UBYTE AXIS_PTS_X 1 UBYTE INDEX_INCR DIRECT /end RECORD_LAYOUT
/begin RECORD_LAYOUT Lookup1D_UWORD FNC_VALUES 1 UWORD COLUMN_DIR DIRECT /end RECORD_LAYOUT
/begin RECORD_LAYOUT Lookup1D_X_UWORD AXIS_PTS_X 1 UWORD INDEX_INCR DIRECT /end RECORD_LAYOUT
/begin RECORD_LAYOUT Lookup1D_WORD FNC_VALUES 1 SWORD COLUMN_DIR DIRECT /end RECORD_LAYOUT
/begin RECORD_LAYOUT Lookup1D_X_WORD AXIS_PTS_X 1 SWORD INDEX_INCR DIRECT /end RECORD_LAYOUT
/begin RECORD_LAYOUT Lookup1D_ULONG FNC_VALUES 1 ULONG COLUMN_DIR DIRECT /end RECORD_LAYOUT
/begin RECORD_LAYOUT Lookup1D_X_ULONG AXIS_PTS_X 1 ULONG INDEX_INCR DIRECT /end RECORD_LAYOUT
/begin RECORD_LAYOUT Lookup1D_SLONG FNC_VALUES 1 SLONG COLUMN_DIR DIRECT /end RECORD_LAYOUT
/begin RECORD_LAYOUT Lookup1D_X_LONG AXIS_PTS_X 1 SLONG INDEX_INCR DIRECT /end RECORD_LAYOUT
/begin RECORD_LAYOUT Lookup1D_FLOAT32_IEEE FNC_VALUES 1 FLOAT32_IEEE COLUMN_DIR DIRECT /end RECORD_LAYOUT
/begin RECORD_LAYOUT Lookup1D_X_FLOAT32_IEEE AXIS_PTS_X 1 FLOAT32_IEEE INDEX_INCR DIRECT /end RECORD_LAYOUT
/begin RECORD_LAYOUT Lookup1D_FLOAT64_IEEE FNC_VALUES 1 FLOAT64_IEEE COLUMN_DIR DIRECT /end RECORD_LAYOUT
/begin RECORD_LAYOUT Lookup1D_X_FLOAT64_IEEE AXIS_PTS_X 1 FLOAT64_IEEE INDEX_INCR DIRECT /end RECORD_LAYOUT
/begin RECORD_LAYOUT Lookup2D_BOOLEAN FNC_VALUES 1 UBYTE COLUMN_DIR DIRECT /end RECORD_LAYOUT
/begin RECORD_LAYOUT Lookup2D_X_BOOLEAN AXIS_PTS_X 1 UBYTE INDEX_INCR DIRECT /end RECORD_LAYOUT
/begin RECORD_LAYOUT Lookup2D_UBYTE FNC_VALUES 1 UBYTE COLUMN_DIR DIRECT /end RECORD_LAYOUT
/begin RECORD_LAYOUT Lookup2D_X_UBYTE AXIS_PTS_X 1 UBYTE INDEX_INCR DIRECT /end RECORD_LAYOUT
/begin RECORD_LAYOUT Lookup2D_BYTE FNC_VALUES 1 SBYTE COLUMN_DIR DIRECT /end RECORD_LAYOUT
/begin RECORD_LAYOUT Lookup2D_X_BYTE AXIS_PTS_X 1 SBYTE INDEX_INCR DIRECT /end RECORD_LAYOUT
/begin RECORD_LAYOUT Lookup2D_UWORD FNC_VALUES 1 UWORD COLUMN_DIR DIRECT /end RECORD_LAYOUT
/begin RECORD_LAYOUT Lookup2D_X_UWORD AXIS_PTS_X 1 UWORD INDEX_INCR DIRECT /end RECORD_LAYOUT
/begin RECORD_LAYOUT Lookup2D_WORD FNC_VALUES 1 SWORD COLUMN_DIR DIRECT /end RECORD_LAYOUT
/begin RECORD_LAYOUT Lookup2D_X_WORD AXIS_PTS_X 1 SWORD INDEX_INCR DIRECT /end RECORD_LAYOUT
/begin RECORD_LAYOUT Lookup2D_ULONG FNC_VALUES 1 ULONG COLUMN_DIR DIRECT /end RECORD_LAYOUT
/begin RECORD_LAYOUT Lookup2D_X_ULONG AXIS_PTS_X 1 ULONG INDEX_INCR DIRECT /end RECORD_LAYOUT
/begin RECORD_LAYOUT Lookup2D_LONG FNC_VALUES 1 SLONG COLUMN_DIR DIRECT /end RECORD_LAYOUT
/begin RECORD_LAYOUT Lookup2D_X_LONG AXIS_PTS_X 1 SLONG INDEX_INCR DIRECT /end RECORD_LAYOUT
/begin RECORD_LAYOUT Lookup2D_FLOAT64_IEEE FNC_VALUES 1 FLOAT64_IEEE COLUMN_DIR DIRECT /end RECORD_LAYOUT
/begin RECORD_LAYOUT Lookup2D_X_FLOAT64_IEEE AXIS_PTS_X 1 FLOAT64_IEEE INDEX_INCR DIRECT /end RECORD_LAYOUT
/begin RECORD_LAYOUT RL.FNC.FLOAT32_IEEE.ROW_DIR FNC_VALUES 1 FLOAT32_IEEE ROW_DIR DIRECT /end RECORD_LAYOUT
/begin RECORD_LAYOUT STANDARD_VALUE_S8 FNC_VALUES 1 SBYTE COLUMN_DIR DIRECT /end RECORD_LAYOUT
/begin RECORD_LAYOUT STANDARD_VALUE_S16 FNC_VALUES 1 SWORD COLUMN_DIR DIRECT /end RECORD_LAYOUT
/begin RECORD_LAYOUT STANDARD_VALUE_S32 FNC_VALUES 1 SLONG COLUMN_DIR DIRECT /end RECORD_LAYOUT
/begin RECORD_LAYOUT STANDARD_VALUE_U8 FNC_VALUES 1 UBYTE COLUMN_DIR DIRECT /end RECORD_LAYOUT
/begin RECORD_LAYOUT STANDARD_VALUE_U16 FNC_VALUES 1 UWORD COLUMN_DIR DIRECT /end RECORD_LAYOUT
/begin RECORD_LAYOUT STANDARD_VALUE_U32 FNC_VALUES 1 ULONG COLUMN_DIR DIRECT /end RECORD_LAYOUT
/begin RECORD_LAYOUT STANDARD_VALUE_R32 FNC_VALUES 1 FLOAT32_IEEE COLUMN_DIR DIRECT /end RECORD_LAYOUT
/begin CHARACTERISTIC CAL_DEM_FIM_DFC_RSL_LOSErr_au8 "CAL_DEM_FIM_DFC_RSL_LOSErr_au8" VAL_BLK 0x80146708 Scalar_UBYTE 0 FID_Verb 0 255 NUMBER 10 /end CHARACTERISTIC
/begin CHARACTERISTIC CAL_DEM_Disbl_DFC_PCF_ActOvTiErr_u8 "CAL_DEM_Disbl_DFC_PCF_ActOvTiErr_u8" VALUE 0x8014659D Scalar_UBYTE 0 BSW_A2L_Ident_Int 0 255 /end CHARACTERISTIC
/begin CHARACTERISTIC CAL_DEM_Disbl_DFC_HvMcu_DisChrgFreqErr_u8 "CAL_DEM_Disbl_DFC_HvMcu_DisChrgFreqErr_u8" VALUE 0x801465CC Scalar_UBYTE 0 BSW_A2L_Ident_Int 0 255 /end CHARACTERISTIC
/begin CHARACTERISTIC CAL_DEM_Disbl_DFC_Cpld_IphaOC_u8 "CAL_DEM_Disbl_DFC_Cpld_IphaOC_u8" VALUE 0x801465E6 Scalar_UBYTE 0 BSW_A2L_Ident_Int 0 255 /end CHARACTERISTIC
/begin CHARACTERISTIC CAL_DEM_Disbl_DFC_ADC_UPhaseBISTFail_u8 "CAL_DEM_Disbl_DFC_ADC_UPhaseBISTFail_u8" VALUE 0x801465EF Scalar_UBYTE 0 BSW_A2L_Ident_Int 0 255 /end CHARACTERISTIC
/begin CHARACTERISTIC CAL_DEM_FIM_DFC_HSPF_MotorOpenErr_au8 "CAL_DEM_FIM_DFC_HSPF_MotorOpenErr_au8" VAL_BLK 0x801469C4 Scalar_UBYTE 0 FID_Verb 0 255 NUMBER 10 /end CHARACTERISTIC
/begin CHARACTERISTIC CAL_Vcf_FwdHoldOutSpdLim_f32 "CAL_Vcf_FwdHoldOutSpdLim_f32" VALUE 0x801464AC Scalar_FLOAT32_IEEE 0 BSW_A2L_Ident_Float -3.4E+38 3.4E+38 /end CHARACTERISTIC
/begin CHARACTERISTIC CAL_DEM_Disbl_DFC_IOHWAB_5VQt1SampFail_u8 "CAL_DEM_Disbl_DFC_IOHWAB_5VQt1SampFail_u8" VALUE 0x801465BD Scalar_UBYTE 0 BSW_A2L_Ident_Int 0 255 /end CHARACTERISTIC
/begin CHARACTERISTIC CAL_TRSP_Diff_UBR_SBCLim_f32 "CAL_TRSP_Diff_UBR_SBCLim_f32" VALUE 0x80146344 Scalar_FLOAT32_IEEE 0 BSW_A2L_Ident_Float -3.4E+38 3.4E+38 /end CHARACTERISTIC
/begin CHARACTERISTIC CAL_Vcf_BetLimSlope_u8 "CAL_Vcf_BetLimSlope_u8" VALUE 0x8014655D Scalar_UBYTE 0 BSW_A2L_Ident_Int 0 255 /end CHARACTERISTIC
/begin CHARACTERISTIC CAL_Vcf_HoldModVcuReq_u8 "CAL_Vcf_HoldModVcuReq_u8" VALUE 0x8014649C Scalar_UBYTE 0 BSW_A2L_Ident_Int 0 255 /end CHARACTERISTIC
/begin CHARACTERISTIC CAL_DEM_FIM_DFC_IOHWAB_18VUpBrgSampFail_au8 "CAL_DEM_FIM_DFC_IOHWAB_18VUpBrgSampFail_au8" VAL_BLK 0x80146910 Scalar_UBYTE 0 FID_Verb 0 255 NUMBER 10 /end CHARACTERISTIC
/begin CHARACTERISTIC CAL_DEM_Disbl_DFC_IgbtDrv_LwBrgFaultAFail_u8 "CAL_DEM_Disbl_DFC_IgbtDrv_LwBrgFaultAFail_u8" VALUE 0x801465AB Scalar_UBYTE 0 BSW_A2L_Ident_Int 0 255 /end CHARACTERISTIC
/begin CHARACTERISTIC CAL_DEM_Disbl_DFC_HvMcu_UartLostFrameErr_u8 "CAL_DEM_Disbl_DFC_HvMcu_UartLostFrameErr_u8" VALUE 0x801465C9 Scalar_UBYTE 0 BSW_A2L_Ident_Int 0 255 /end CHARACTERISTIC
/begin CHARACTERISTIC CAL_DEM_FIM_DFC_HvMcu_UdcOverVolErr_au8 "CAL_DEM_FIM_DFC_HvMcu_UdcOverVolErr_au8" VAL_BLK 0x80146942 Scalar_UBYTE 0 FID_Verb 0 255 NUMBER 10 /end CHARACTERISTIC
/begin CHARACTERISTIC CAL_DEM_Disbl_DFC_RSL_LOSErr_u8 "CAL_DEM_Disbl_DFC_RSL_LOSErr_u8" VALUE 0x8014658D Scalar_UBYTE 0 BSW_A2L_Ident_Int 0 255 /end CHARACTERISTIC
/begin CHARACTERISTIC CAL_DEM_FIM_DFC_TPC_TSttrOvHiLimFail_au8 "CAL_DEM_FIM_DFC_TPC_TSttrOvHiLimFail_au8" VAL_BLK 0x80146640 Scalar_UBYTE 0 FID_Verb 0 255 NUMBER 10 /end CHARACTERISTIC
/begin CHARACTERISTIC CAL_Vcf_AutoHoldSpd_f32 "CAL_Vcf_AutoHoldSpd_f32" VALUE 0x80146560 Scalar_FLOAT32_IEEE 0 BSW_A2L_Ident_Float -3.4E+38 3.4E+38 /end CHARACTERISTIC
/begin CHARACTERISTIC CAL_DEM_Disbl_DFC_MDF_EmacBlkdWarn_u8 "CAL_DEM_Disbl_DFC_MDF_EmacBlkdWarn_u8" VALUE 0x801465A4 Scalar_UBYTE 0 BSW_A2L_Ident_Int 0 255 /end CHARACTERISTIC
/begin CHARACTERISTIC CAL_DEM_FIM_DFC_MDF_EmacBlkdWarn_au8 "CAL_DEM_FIM_DFC_MDF_EmacBlkdWarn_au8" VAL_BLK 0x801467EE Scalar_UBYTE 0 FID_Verb 0 255 NUMBER 10 /end CHARACTERISTIC
/begin CHARACTERISTIC CAL_DEM_Disbl_DFC_IOHWAB_18VUpBrgSampFail_u8 "CAL_DEM_Disbl_DFC_IOHWAB_18VUpBrgSampFail_u8" VALUE 0x801465C1 Scalar_UBYTE 0 BSW_A2L_Ident_Int 0 255 /end CHARACTERISTIC
/begin CHARACTERISTIC CAL_DEM_FIM_DFC_IOHWAB_1V3MCU_SampFail_au8 "CAL_DEM_FIM_DFC_IOHWAB_1V3MCU_SampFail_au8" VAL_BLK 0x80146906 Scalar_UBYTE 0 FID_Verb 0 255 NUMBER 10 /end CHARACTERISTIC
/begin CHARACTERISTIC CAL_DEM_FIM_DFC_MDF_IsOvHiErr_au8 "CAL_DEM_FIM_DFC_MDF_IsOvHiErr_au8" VAL_BLK 0x801467DA Scalar_UBYTE 0 FID_Verb 0 255 NUMBER 10 /end CHARACTERISTIC
/begin CHARACTERISTIC CAL_DEM_Disbl_DFC_TPC_TSttrOvHiWarn_u8 "CAL_DEM_Disbl_DFC_TPC_TSttrOvHiWarn_u8" VALUE 0x80146578 Scalar_UBYTE 0 BSW_A2L_Ident_Int 0 255 /end CHARACTERISTIC
/begin CHARACTERISTIC CAL_DEM_FIM_DFC_PCF_ActOvTiErr_au8 "CAL_DEM_FIM_DFC_PCF_ActOvTiErr_au8" VAL_BLK 0x801467A8 Scalar_UBYTE 0 FID_Verb 0 255 NUMBER 10 /end CHARACTERISTIC
/begin CHARACTERISTIC CAL_DEM_Disbl_DFC_HvMcu_EmerPowerSapErr_u8 "CAL_DEM_Disbl_DFC_HvMcu_EmerPowerSapErr_u8" VALUE 0x801465CB Scalar_UBYTE 0 BSW_A2L_Ident_Int 0 255 /end CHARACTERISTIC
/begin CHARACTERISTIC CAL_DEM_FIM_DFC_MDF_PhaseLossFaultErr_au8 "CAL_DEM_FIM_DFC_MDF_PhaseLossFaultErr_au8" VAL_BLK 0x801467BC Scalar_UBYTE 0 FID_Verb 0 255 NUMBER 10 /end CHARACTERISTIC
/begin CHARACTERISTIC CAL_Hvmcu_ComErr_Rate_u16 "CAL_Hvmcu_ComErr_Rate_u16" VALUE 0x80140014 Scalar_UWORD 0 BSW_A2L_Ident_Int 0 65535 /end CHARACTERISTIC
/begin CHARACTERISTIC CAL_DEM_FIM_DFC_RCF_PsiOvErr_au8 "CAL_DEM_FIM_DFC_RCF_PsiOvErr_au8" VAL_BLK 0x80146726 Scalar_UBYTE 0 FID_Verb 0 255 NUMBER 10 /end CHARACTERISTIC
/begin CHARACTERISTIC CAL_DEM_Disbl_DFC_IOHWAB_12VWideSampErr_u8 "CAL_DEM_Disbl_DFC_IOHWAB_12VWideSampErr_u8" VALUE 0x801465C3 Scalar_UBYTE 0 BSW_A2L_Ident_Int 0 255 /end CHARACTERISTIC
/begin CHARACTERISTIC CAL_Vcf_BwdHoldOutSpdLim_f32 "CAL_Vcf_BwdHoldOutSpdLim_f32" VALUE 0x80146554 Scalar_FLOAT32_IEEE 0 BSW_A2L_Ident_Float -3.4E+38 3.4E+38 /end CHARACTERISTIC
/begin CHARACTERISTIC CAL_DEM_FIM_DFC_RCF_OfsClbFail_au8 "CAL_DEM_FIM_DFC_RCF_OfsClbFail_au8" VAL_BLK 0x80146730 Scalar_UBYTE 0 FID_Verb 0 255 NUMBER 10 /end CHARACTERISTIC
/begin CHARACTERISTIC CAL_DEM_Disbl_DFC_Cpld_ParityChkErr_u8 "CAL_DEM_Disbl_DFC_Cpld_ParityChkErr_u8" VALUE 0x801465E4 Scalar_UBYTE 0 BSW_A2L_Ident_Int 0 255 /end CHARACTERISTIC
/begin CHARACTERISTIC CAL_DEM_Disbl_DFC_Cpld_AliveChkErr_u8 "CAL_DEM_Disbl_DFC_Cpld_AliveChkErr_u8" VALUE 0x801465E9 Scalar_UBYTE 0 BSW_A2L_Ident_Int 0 255 /end CHARACTERISTIC
/begin CHARACTERISTIC CAL_DEM_FIM_DFC_HSPF_tDBCTempCmpErr_au8 "CAL_DEM_FIM_DFC_HSPF_tDBCTempCmpErr_au8" VAL_BLK 0x801469A6 Scalar_UBYTE 0 FID_Verb 0 255 NUMBER 10 /end CHARACTERISTIC
/begin CHARACTERISTIC CAL_DEM_FIM_DFC_IOHWAB_5VQt2SampFail_au8 "CAL_DEM_FIM_DFC_IOHWAB_5VQt2SampFail_au8" VAL_BLK 0x801468DE Scalar_UBYTE 0 FID_Verb 0 255 NUMBER 10 /end CHARACTERISTIC
/begin CHARACTERISTIC CAL_DEM_FIM_DFC_CANSM_E_BUS_OFF_NETWORK_1_au8 "CAL_DEM_FIM_DFC_CANSM_E_BUS_OFF_NETWORK_1_au8" VAL_BLK 0x80146AB4 Scalar_UBYTE 0 FID_Verb 0 255 NUMBER 10 /end CHARACTERISTIC
/begin CHARACTERISTIC CAL_DEM_Disbl_DFC_IOHWAB_SttrSenorShrFail_u8 "CAL_DEM_Disbl_DFC_IOHWAB_SttrSenorShrFail_u8" VALUE 0x801465B1 Scalar_UBYTE 0 BSW_A2L_Ident_Int 0 255 /end CHARACTERISTIC
/begin CHARACTERISTIC CAL_DEM_Disbl_DFC_HvMcu_UdcCheckErr_u8 "CAL_DEM_Disbl_DFC_HvMcu_UdcCheckErr_u8" VALUE 0x801465C8 Scalar_UBYTE 0 BSW_A2L_Ident_Int 0 255 /end CHARACTERISTIC
/begin CHARACTERISTIC CAL_DEM_FIM_DFC_IOHWAB_5VQcoSampFail_au8 "CAL_DEM_FIM_DFC_IOHWAB_5VQcoSampFail_au8" VAL_BLK 0x801468F2 Scalar_UBYTE 0 FID_Verb 0 255 NUMBER 10 /end CHARACTERISTIC
/begin CHARACTERISTIC CAL_DEM_Disbl_DFC_Cpld_SPIComFail_u8 "CAL_DEM_Disbl_DFC_Cpld_SPIComFail_u8" VALUE 0x801465E2 Scalar_UBYTE 0 BSW_A2L_Ident_Int 0 255 /end CHARACTERISTIC
/begin CHARACTERISTIC CAL_TRSP_flgChangPha_b "CAL_TRSP_flgChangPha_b" VALUE 0x801462C8 Scalar_BOOLEAN 0 BSW_A2L_Ident_Int 0 1 /end CHARACTERISTIC
/begin CHARACTERISTIC CAL_Vcf_BrkLgt_b "CAL_Vcf_BrkLgt_b" VALUE 0x8014655C Scalar_BOOLEAN 0 BSW_A2L_Ident_Int 0 1 /end CHARACTERISTIC
/begin CHARACTERISTIC CAL_RDC_SpdHiHyst_f32 "CAL_RDC_SpdHiHyst_f32" VALUE 0x80140074 Scalar_FLOAT32_IEEE 0 BSW_A2L_Ident_Float -3.4E+38 3.4E+38 /end CHARACTERISTIC
/begin CHARACTERISTIC CAL_Vcf_Crawltrqadd2_f32 "CAL_Vcf_Crawltrqadd2_f32" VALUE 0x8014652C Scalar_FLOAT32_IEEE 0 BSW_A2L_Ident_Float -3.4E+38 3.4E+38 /end CHARACTERISTIC
/begin CHARACTERISTIC CAL_RDC_RslDosOffMin_s16 "CAL_RDC_RslDosOffMin_s16" VALUE 0x80140082 Scalar_SWORD 0 BSW_A2L_Ident_Int -32768 32767 /end CHARACTERISTIC
/begin CHARACTERISTIC CAL_POWER_UBSBC_Parem_Vol_f32 "CAL_POWER_UBSBC_Parem_Vol_f32" VALUE 0x8014002C Scalar_FLOAT32_IEEE 0 BSW_A2L_Ident_Float -3.4E+38 3.4E+38 /end CHARACTERISTIC
/begin CHARACTERISTIC CAL_ADC_DClink_Sample_gain_f32 "CAL_ADC_DClink_Sample_gain_f32" VALUE 0x8014004C Scalar_FLOAT32_IEEE 0 BSW_A2L_Ident_Float -3.4E+38 3.4E+38 /end CHARACTERISTIC
/begin CHARACTERISTIC CAL_DEM_FIM_DFC_TPC_TDbcOvLoWarn_au8 "CAL_DEM_FIM_DFC_TPC_TDbcOvLoWarn_au8" VAL_BLK 0x801466AE Scalar_UBYTE 0 FID_Verb 0 255 NUMBER 10 /end CHARACTERISTIC
/begin CHARACTERISTIC CAL_DEM_Disbl_DFC_HvMcu_DisChrgDutyErr_u8 "CAL_DEM_Disbl_DFC_HvMcu_DisChrgDutyErr_u8" VALUE 0x801465CE Scalar_UBYTE 0 BSW_A2L_Ident_Int 0 255 /end CHARACTERISTIC
/begin CHARACTERISTIC CAL_Vcf_nAccChgHiLim_f32 "CAL_Vcf_nAccChgHiLim_f32" VALUE 0x8014641C Scalar_FLOAT32_IEEE 0 BSW_A2L_Ident_Float -3.4E+38 3.4E+38 /end CHARACTERISTIC
/begin CHARACTERISTIC CAL_DEM_FIM_DFC_TPC_TDbcVLoLimFail_au8 "CAL_DEM_FIM_DFC_TPC_TDbcVLoLimFail_au8" VAL_BLK 0x80146686 Scalar_UBYTE 0 FID_Verb 0 255 NUMBER 10 /end CHARACTERISTIC
/begin CHARACTERISTIC CAL_Vcf_spdThredDmpNeg_f32 "CAL_Vcf_spdThredDmpNeg_f32" VALUE 0x80146410 Scalar_FLOAT32_IEEE 0 BSW_A2L_Ident_Float -3.4E+38 3.4E+38 /end CHARACTERISTIC
/begin CHARACTERISTIC CAL_Vcf_GearD_u8 "CAL_Vcf_GearD_u8" VALUE 0x801464A9 Scalar_UBYTE 0 BSW_A2L_Ident_Int 0 255 /end CHARACTERISTIC
/begin CHARACTERISTIC CAL_DEM_Disbl_DFC_TPC_TDbcWLoLimFail_u8 "CAL_DEM_Disbl_DFC_TPC_TDbcWLoLimFail_u8" VALUE 0x8014657E Scalar_UBYTE 0 BSW_A2L_Ident_Int 0 255 /end CHARACTERISTIC
/begin CHARACTERISTIC CAL_DEM_FIM_DFC_TPC_uDcLnkOvVLimFail_au8 "CAL_DEM_FIM_DFC_TPC_uDcLnkOvVLimFail_au8" VAL_BLK 0x8014660E Scalar_UBYTE 0 FID_Verb 0 255 NUMBER 10 /end CHARACTERISTIC
/begin CHARACTERISTIC CAL_DEM_Disbl_DFC_TPC_TSttrOvLoWarn_u8 "CAL_DEM_Disbl_DFC_TPC_TSttrOvLoWarn_u8" VALUE 0x80146577 Scalar_UBYTE 0 BSW_A2L_Ident_Int 0 255 /end CHARACTERISTIC
/begin CHARACTERISTIC CAL_POWER_UBSBC_Threhold_V2_f32 "CAL_POWER_UBSBC_Threhold_V2_f32" VALUE 0x80140044 Scalar_FLOAT32_IEEE 0 BSW_A2L_Ident_Float -3.4E+38 3.4E+38 /end CHARACTERISTIC
/begin CHARACTERISTIC CAL_Vcf_MotorDrvSpd_f32 "CAL_Vcf_MotorDrvSpd_f32" VALUE 0x80146494 Scalar_FLOAT32_IEEE 0 BSW_A2L_Ident_Float -3.4E+38 3.4E+38 /end CHARACTERISTIC
/begin CHARACTERISTIC CAL_DEM_Disbl_DFC_IOHWAB_Nen33Fail_u8 "CAL_DEM_Disbl_DFC_IOHWAB_Nen33Fail_u8" VALUE 0x801465B2 Scalar_UBYTE 0 BSW_A2L_Ident_Int 0 255 /end CHARACTERISTIC
/begin CHARACTERISTIC CAL_Vcf_SpdDebounce_f32 "CAL_Vcf_SpdDebounce_f32" VALUE 0x80146464 Scalar_FLOAT32_IEEE 0 BSW_A2L_Ident_Float -3.4E+38 3.4E+38 /end CHARACTERISTIC
/begin CHARACTERISTIC CAL_Vcf_GearLvD_u8 "CAL_Vcf_GearLvD_u8" VALUE 0x801464A7 Scalar_UBYTE 0 BSW_A2L_Ident_Int 0 255 /end CHARACTERISTIC
/begin CHARACTERISTIC CAL_DEM_Disbl_DFC_HvMcu_UartCheckFailErr_u8 "CAL_DEM_Disbl_DFC_HvMcu_UartCheckFailErr_u8" VALUE 0x801465CA Scalar_UBYTE 0 BSW_A2L_Ident_Int 0 255 /end CHARACTERISTIC
/begin CHARACTERISTIC CAL_Vcf_FwdHoldInSpdLim_f32 "CAL_Vcf_FwdHoldInSpdLim_f32" VALUE 0x801464B0 Scalar_FLOAT32_IEEE 0 BSW_A2L_Ident_Float -3.4E+38 3.4E+38 /end CHARACTERISTIC
/begin CHARACTERISTIC CAL_DEM_Disbl_DFC_TPC_TDbcWHiLimFail_u8 "CAL_DEM_Disbl_DFC_TPC_TDbcWHiLimFail_u8" VALUE 0x8014657F Scalar_UBYTE 0 BSW_A2L_Ident_Int 0 255 /end CHARACTERISTIC
/begin CHARACTERISTIC CAL_DEM_FIM_DFC_MDF_DiashCirNoPsblErr_au8 "CAL_DEM_FIM_DFC_MDF_DiashCirNoPsblErr_au8" VAL_BLK 0x80146802 Scalar_UBYTE 0 FID_Verb 0 255 NUMBER 10 /end CHARACTERISTIC
/begin CHARACTERISTIC CAL_Vcf_AccPedSet_f32 "CAL_Vcf_AccPedSet_f32" VALUE 0x8014656C Scalar_FLOAT32_IEEE 0 BSW_A2L_Ident_Float -3.4E+38 3.4E+38 /end CHARACTERISTIC
/begin CHARACTERISTIC CAL_Vcf_TrqFbkLMin_f32 "CAL_Vcf_TrqFbkLMin_f32" VALUE 0x80146438 Scalar_FLOAT32_IEEE 0 BSW_A2L_Ident_Float -3.4E+38 3.4E+38 /end CHARACTERISTIC
/begin CHARACTERISTIC CAL_Pwm3ph_DutyMax_f32 "CAL_Pwm3ph_DutyMax_f32" VALUE 0x80140058 Scalar_FLOAT32_IEEE 0 BSW_A2L_Ident_Float -3.4E+38 3.4E+38 /end CHARACTERISTIC
/begin CHARACTERISTIC CAL_DEM_Disbl_DFC_CANSM_E_BUS_OFF_NETWORK_0_u8 "CAL_DEM_Disbl_DFC_CANSM_E_BUS_OFF_NETWORK_0_u8" VALUE 0x801465EC Scalar_UBYTE 0 BSW_A2L_Ident_Int 0 255 /end CHARACTERISTIC
/begin CHARACTERISTIC CAL_DEM_FIM_DFC_Epark_SampFail_au8 "CAL_DEM_FIM_DFC_Epark_SampFail_au8" VAL_BLK 0x801469F6 Scalar_UBYTE 0 FID_Verb 0 255 NUMBER 10 /end CHARACTERISTIC
/begin CHARACTERISTIC CAL_DEM_Disbl_DFC_HSPF_MotorOpenErr_u8 "CAL_DEM_Disbl_DFC_HSPF_MotorOpenErr_u8" VALUE 0x801465D3 Scalar_UBYTE 0 BSW_A2L_Ident_Int 0 255 /end CHARACTERISTIC
/begin CHARACTERISTIC CAL_Vcf_StandByReq_u8 "CAL_Vcf_StandByReq_u8" VALUE 0x80146461 Scalar_UBYTE 0 BSW_A2L_Ident_Int 0 255 /end CHARACTERISTIC
/begin CHARACTERISTIC CAL_DEM_FIM_DFC_Cpld_UnderVol_LS_InFail_au8 "CAL_DEM_FIM_DFC_Cpld_UnderVol_LS_InFail_au8" VAL_BLK 0x80146A1E Scalar_UBYTE 0 FID_Verb 0 255 NUMBER 10 /end CHARACTERISTIC
/begin CHARACTERISTIC CAL_DEM_Disbl_DFC_PCF_StallWarn_u8 "CAL_DEM_Disbl_DFC_PCF_StallWarn_u8" VALUE 0x80146597 Scalar_UBYTE 0 BSW_A2L_Ident_Int 0 255 /end CHARACTERISTIC
/begin CHARACTERISTIC CAL_DEM_Disbl_DFC_PCF_SenClbErr_u8 "CAL_DEM_Disbl_DFC_PCF_SenClbErr_u8" VALUE 0x8014659A Scalar_UBYTE 0 BSW_A2L_Ident_Int 0 255 /end CHARACTERISTIC
/begin CHARACTERISTIC CAL_Hvmcu_UdcOvLi_Value_f32 "CAL_Hvmcu_UdcOvLi_Value_f32" VALUE 0x80140018 Scalar_FLOAT32_IEEE 0 BSW_A2L_Ident_Float -3.4E+38 3.4E+38 /end CHARACTERISTIC
/begin CHARACTERISTIC CAL_DEM_Disbl_DFC_IOHWAB_KL30SevUnderVolFail_u8 "CAL_DEM_Disbl_DFC_IOHWAB_KL30SevUnderVolFail_u8" VALUE 0x801465B4 Scalar_UBYTE 0 BSW_A2L_Ident_Int 0 255 /end CHARACTERISTIC
/begin CHARACTERISTIC CAL_Vcf_Crawltrqadd1_f32 "CAL_Vcf_Crawltrqadd1_f32" VALUE 0x80146530 Scalar_FLOAT32_IEEE 0 BSW_A2L_Ident_Float -3.4E+38 3.4E+38 /end CHARACTERISTIC
/begin CHARACTERISTIC CAL_Vcf_OvCrawlDspd_f32 "CAL_Vcf_OvCrawlDspd_f32" VALUE 0x80146484 Scalar_FLOAT32_IEEE 0 BSW_A2L_Ident_Float -3.4E+38 3.4E+38 /end CHARACTERISTIC
/begin CHARACTERISTIC CAL_DEM_FIM_DFC_SCF_DisChgOvTiFail_au8 "CAL_DEM_FIM_DFC_SCF_DisChgOvTiFail_au8" VAL_BLK 0x801466F4 Scalar_UBYTE 0 FID_Verb 0 255 NUMBER 10 /end CHARACTERISTIC
/begin CHARACTERISTIC CAL_DEM_FIM_DFC_Cpld_UnderVol_HS_InFail_au8 "CAL_DEM_FIM_DFC_Cpld_UnderVol_HS_InFail_au8" VAL_BLK 0x80146A28 Scalar_UBYTE 0 FID_Verb 0 255 NUMBER 10 /end CHARACTERISTIC
/begin CHARACTERISTIC CAL_RDC_flgNrealOrNset_b "CAL_RDC_flgNrealOrNset_b" VALUE 0x8014006E Scalar_BOOLEAN 0 BSW_A2L_Ident_Int 0 1 /end CHARACTERISTIC
/begin CHARACTERISTIC CAL_DEM_Disbl_DFC_Epark_PosSampFail_u8 "CAL_DEM_Disbl_DFC_Epark_PosSampFail_u8" VALUE 0x801465D9 Scalar_UBYTE 0 BSW_A2L_Ident_Int 0 255 /end CHARACTERISTIC
/begin CHARACTERISTIC CAL_Vcf_TrqFbkLMaxNeg_f32 "CAL_Vcf_TrqFbkLMaxNeg_f32" VALUE 0x80146444 Scalar_FLOAT32_IEEE 0 BSW_A2L_Ident_Float -3.4E+38 3.4E+38 /end CHARACTERISTIC
/begin CHARACTERISTIC CAL_RdcRslExcFaultMin_f32 "CAL_RdcRslExcFaultMin_f32" VALUE 0x80140098 Scalar_FLOAT32_IEEE 0 BSW_A2L_Ident_Float -3.4E+38 3.4E+38 /end CHARACTERISTIC
/begin CHARACTERISTIC CAL_DEM_FIM_DFC_Epark_PosSampFail_au8 "CAL_DEM_FIM_DFC_Epark_PosSampFail_au8" VAL_BLK 0x80146A00 Scalar_UBYTE 0 FID_Verb 0 255 NUMBER 10 /end CHARACTERISTIC
/begin CHARACTERISTIC CAL_Vcf_tDamping_f32 "CAL_Vcf_tDamping_f32" VALUE 0x80146388 Scalar_FLOAT32_IEEE 0 BSW_A2L_Ident_Float -3.4E+38 3.4E+38 /end CHARACTERISTIC
/begin CHARACTERISTIC CAL_Vcf_TrqDmpSwt_b "CAL_Vcf_TrqDmpSwt_b" VALUE 0x80146448 Scalar_BOOLEAN 0 BSW_A2L_Ident_Int 0 1 /end CHARACTERISTIC
/begin CHARACTERISTIC CAL_DEM_Disbl_DFC_HSPF_stIphaOffCalFail_u8 "CAL_DEM_Disbl_DFC_HSPF_stIphaOffCalFail_u8" VALUE 0x801465D1 Scalar_UBYTE 0 BSW_A2L_Ident_Int 0 255 /end CHARACTERISTIC
/begin CHARACTERISTIC CAL_IOHWAB_DIO_AN30_IUVW_N_REF_DEM_f32 "CAL_IOHWAB_DIO_AN30_IUVW_N_REF_DEM_f32" VALUE 0x801400BC Scalar_FLOAT32_IEEE 0 BSW_A2L_Ident_Float -3.4E+38 3.4E+38 /end CHARACTERISTIC
/begin CHARACTERISTIC CAL_DEM_FIM_DFC_IgbtDrv_LwBrgFaultAFail_au8 "CAL_DEM_FIM_DFC_IgbtDrv_LwBrgFaultAFail_au8" VAL_BLK 0x80146834 Scalar_UBYTE 0 FID_Verb 0 255 NUMBER 10 /end CHARACTERISTIC
/begin CHARACTERISTIC CAL_DEM_FIM_DFC_IOHWAB_CrashFail_au8 "CAL_DEM_FIM_DFC_IOHWAB_CrashFail_au8" VAL_BLK 0x801468C0 Scalar_UBYTE 0 FID_Verb 0 255 NUMBER 10 /end CHARACTERISTIC
/begin CHARACTERISTIC CAL_POWER_VDD18_Threhold_Max_f32 "CAL_POWER_VDD18_Threhold_Max_f32" VALUE 0x80140028 Scalar_FLOAT32_IEEE 0 BSW_A2L_Ident_Float -3.4E+38 3.4E+38 /end CHARACTERISTIC
/begin CHARACTERISTIC CAL_DEM_Disbl_DFC_CANSM_E_BUS_OFF_NETWORK_1_u8 "CAL_DEM_Disbl_DFC_CANSM_E_BUS_OFF_NETWORK_1_u8" VALUE 0x801465EB Scalar_UBYTE 0 BSW_A2L_Ident_Int 0 255 /end CHARACTERISTIC
/begin CHARACTERISTIC CAL_DEM_Disbl_DFC_HvMcu_UdcOverVolErr_u8 "CAL_DEM_Disbl_DFC_HvMcu_UdcOverVolErr_u8" VALUE 0x801465C6 Scalar_UBYTE 0 BSW_A2L_Ident_Int 0 255 /end CHARACTERISTIC
/begin CHARACTERISTIC CAL_DEM_FIM_DFC_IgbtDrv_LwBrgFaultBFail_au8 "CAL_DEM_FIM_DFC_IgbtDrv_LwBrgFaultBFail_au8" VAL_BLK 0x8014682A Scalar_UBYTE 0 FID_Verb 0 255 NUMBER 10 /end CHARACTERISTIC
/begin CHARACTERISTIC CAL_Vcf_TrqDmpNegMax_f32 "CAL_Vcf_TrqDmpNegMax_f32" VALUE 0x80146450 Scalar_FLOAT32_IEEE 0 BSW_A2L_Ident_Float -3.4E+38 3.4E+38 /end CHARACTERISTIC
/begin CHARACTERISTIC CAL_DEM_FIM_DFC_HvMcu_EmerPowerSapErr_au8 "CAL_DEM_FIM_DFC_HvMcu_EmerPowerSapErr_au8" VAL_BLK 0x80146974 Scalar_UBYTE 0 FID_Verb 0 255 NUMBER 10 /end CHARACTERISTIC
/begin CHARACTERISTIC CAL_DEM_FIM_DFC_Epark_OverCurFail_au8 "CAL_DEM_FIM_DFC_Epark_OverCurFail_au8" VAL_BLK 0x80146A14 Scalar_UBYTE 0 FID_Verb 0 255 NUMBER 10 /end CHARACTERISTIC
/begin CHARACTERISTIC CAL_Vcf_HoldTrqInSwt_b "CAL_Vcf_HoldTrqInSwt_b" VALUE 0x80146499 Scalar_BOOLEAN 0 BSW_A2L_Ident_Int 0 1 /end CHARACTERISTIC
/begin CHARACTERISTIC CAL_DEM_Disbl_DFC_RSL_DOSErr_u8 "CAL_DEM_Disbl_DFC_RSL_DOSErr_u8" VALUE 0x8014658F Scalar_UBYTE 0 BSW_A2L_Ident_Int 0 255 /end CHARACTERISTIC
/begin CHARACTERISTIC CAL_CddEparkTEST_ManualMosDir_b "CAL_CddEparkTEST_ManualMosDir_b" VALUE 0x8014000C Scalar_BOOLEAN 0 BSW_A2L_Ident_Int 0 1 /end CHARACTERISTIC
/begin CHARACTERISTIC CAL_DEM_FIM_DFC_Cpld_Short_Circuit_HS_InFail_au8 "CAL_DEM_FIM_DFC_Cpld_Short_Circuit_HS_InFail_au8" VAL_BLK 0x80146A46 Scalar_UBYTE 0 FID_Verb 0 255 NUMBER 10 /end CHARACTERISTIC
/begin CHARACTERISTIC CAL_DEM_Disbl_DFC_TPC_TDbcUHiLimFail_u8 "CAL_DEM_Disbl_DFC_TPC_TDbcUHiLimFail_u8" VALUE 0x80146583 Scalar_UBYTE 0 BSW_A2L_Ident_Int 0 255 /end CHARACTERISTIC
/begin CHARACTERISTIC CAL_DEM_Disbl_DFC_IOHWAB_5VQt2SampFail_u8 "CAL_DEM_Disbl_DFC_IOHWAB_5VQt2SampFail_u8" VALUE 0x801465BC Scalar_UBYTE 0 BSW_A2L_Ident_Int 0 255 /end CHARACTERISTIC
/begin CHARACTERISTIC CAL_DEM_FIM_DFC_RCF_AccOvTiErr_au8 "CAL_DEM_FIM_DFC_RCF_AccOvTiErr_au8" VAL_BLK 0x80146758 Scalar_UBYTE 0 FID_Verb 0 255 NUMBER 10 /end CHARACTERISTIC
/begin CHARACTERISTIC CAL_DEM_FIM_DFC_Cpld_SZTKT_InFail_au8 "CAL_DEM_FIM_DFC_Cpld_SZTKT_InFail_au8" VAL_BLK 0x80146A50 Scalar_UBYTE 0 FID_Verb 0 255 NUMBER 10 /end CHARACTERISTIC
/begin CHARACTERISTIC CAL_DEM_Disbl_DFC_Cpld_NEN_InFail_u8 "CAL_DEM_Disbl_DFC_Cpld_NEN_InFail_u8" VALUE 0x801465E5 Scalar_UBYTE 0 BSW_A2L_Ident_Int 0 255 /end CHARACTERISTIC
/begin CHARACTERISTIC CAL_DEM_Disbl_DFC_IgbtDrv_ComErr_u8 "CAL_DEM_Disbl_DFC_IgbtDrv_ComErr_u8" VALUE 0x801465AC Scalar_UBYTE 0 BSW_A2L_Ident_Int 0 255 /end CHARACTERISTIC
/begin CHARACTERISTIC CAL_Vcf_trqHoldMin_f32 "CAL_Vcf_trqHoldMin_f32" VALUE 0x8014637C Scalar_FLOAT32_IEEE 0 BSW_A2L_Ident_Float -3.4E+38 3.4E+38 /end CHARACTERISTIC
/begin CHARACTERISTIC CAL_Vcf_trqHoldMax_f32 "CAL_Vcf_trqHoldMax_f32" VALUE 0x80146380 Scalar_FLOAT32_IEEE 0 BSW_A2L_Ident_Float -3.4E+38 3.4E+38 /end CHARACTERISTIC
/begin CHARACTERISTIC CAL_Vcf_HoldTimeCount_u16 "CAL_Vcf_HoldTimeCount_u16" VALUE 0x8014649A Scalar_UWORD 0 BSW_A2L_Ident_Int 0 65535 /end CHARACTERISTIC
/begin CHARACTERISTIC CAL_Vcf_nSetRamp_f32 "CAL_Vcf_nSetRamp_f32" VALUE 0x80146414 Scalar_FLOAT32_IEEE 0 BSW_A2L_Ident_Float -3.4E+38 3.4E+38 /end CHARACTERISTIC
/begin CHARACTERISTIC CAL_DEM_FIM_DFC_TPC_TIGBTOvHiLimErr_au8 "CAL_DEM_FIM_DFC_TPC_TIGBTOvHiLimErr_au8" VAL_BLK 0x8014665E Scalar_UBYTE 0 FID_Verb 0 255 NUMBER 10 /end CHARACTERISTIC
/begin CHARACTERISTIC CAL_DEM_Disbl_DFC_MDF_PhaseLossFaultErr_u8 "CAL_DEM_Disbl_DFC_MDF_PhaseLossFaultErr_u8" VALUE 0x8014659F Scalar_UBYTE 0 BSW_A2L_Ident_Int 0 255 /end CHARACTERISTIC
/begin CHARACTERISTIC CAL_DEM_FIM_DFC_Event_NvM_WriteErr_au8 "CAL_DEM_FIM_DFC_Event_NvM_WriteErr_au8" VAL_BLK 0x801469E2 Scalar_UBYTE 0 FID_Verb 0 255 NUMBER 10 /end CHARACTERISTIC
/begin CHARACTERISTIC CAL_DEM_FIM_DFC_MDF_OperOutdRngErr_au8 "CAL_DEM_FIM_DFC_MDF_OperOutdRngErr_au8" VAL_BLK 0x801467C6 Scalar_UBYTE 0 FID_Verb 0 255 NUMBER 10 /end CHARACTERISTIC
/begin CHARACTERISTIC CAL_DEM_FIM_DFC_TPC_iDcLnkOvcWarn_au8 "CAL_DEM_FIM_DFC_TPC_iDcLnkOvcWarn_au8" VAL_BLK 0x80146618 Scalar_UBYTE 0 FID_Verb 0 255 NUMBER 10 /end CHARACTERISTIC
/begin CHARACTERISTIC CAL_DEM_Disbl_DFC_HvMcu_ComErr_u8 "CAL_DEM_Disbl_DFC_HvMcu_ComErr_u8" VALUE 0x801465CF Scalar_UBYTE 0 BSW_A2L_Ident_Int 0 255 /end CHARACTERISTIC
/begin CHARACTERISTIC CAL_DEM_Disbl_DFC_IgbtDrv_UpBrgFaultBFail_u8 "CAL_DEM_Disbl_DFC_IgbtDrv_UpBrgFaultBFail_u8" VALUE 0x801465A8 Scalar_UBYTE 0 BSW_A2L_Ident_Int 0 255 /end CHARACTERISTIC
/begin CHARACTERISTIC CAL_Vcf_CrawlRspd_f32 "CAL_Vcf_CrawlRspd_f32" VALUE 0x80146540 Scalar_FLOAT32_IEEE 0 BSW_A2L_Ident_Float -3.4E+38 3.4E+38 /end CHARACTERISTIC
/begin CHARACTERISTIC CAL_DEM_FIM_DFC_ADC_WPhaseBISTFail_au8 "CAL_DEM_FIM_DFC_ADC_WPhaseBISTFail_au8" VAL_BLK 0x80146AC8 Scalar_UBYTE 0 FID_Verb 0 255 NUMBER 10 /end CHARACTERISTIC
/begin CHARACTERISTIC CAL_DEM_Disbl_DFC_ADC_VPhaseBISTFail_u8 "CAL_DEM_Disbl_DFC_ADC_VPhaseBISTFail_u8" VALUE 0x801465EE Scalar_UBYTE 0 BSW_A2L_Ident_Int 0 255 /end CHARACTERISTIC
/begin CHARACTERISTIC CAL_DEM_Disbl_DFC_Cpld_UnderVol_HS_InFail_u8 "CAL_DEM_Disbl_DFC_Cpld_UnderVol_HS_InFail_u8" VALUE 0x801465DD Scalar_UBYTE 0 BSW_A2L_Ident_Int 0 255 /end CHARACTERISTIC
/begin CHARACTERISTIC CAL_DEM_Disbl_DFC_TPC_iDcLnkOvCLimFail_u8 "CAL_DEM_Disbl_DFC_TPC_iDcLnkOvCLimFail_u8" VALUE 0x80146576 Scalar_UBYTE 0 BSW_A2L_Ident_Int 0 255 /end CHARACTERISTIC
/begin CHARACTERISTIC CAL_PWM_Set_DeadTime_us_f32 "CAL_PWM_Set_DeadTime_us_f32" VALUE 0x80140064 Scalar_FLOAT32_IEEE 0 BSW_A2L_Ident_Float -3.4E+38 3.4E+38 /end CHARACTERISTIC
/begin CHARACTERISTIC CAL_DEM_FIM_DFC_IOHWAB_KL30UnderVolErr_au8 "CAL_DEM_FIM_DFC_IOHWAB_KL30UnderVolErr_au8" VAL_BLK 0x80146884 Scalar_UBYTE 0 FID_Verb 0 255 NUMBER 10 /end CHARACTERISTIC
/begin CHARACTERISTIC CAL_POWER_UBSBC_Threhold_V7_f32 "CAL_POWER_UBSBC_Threhold_V7_f32" VALUE 0x80140030 Scalar_FLOAT32_IEEE 0 BSW_A2L_Ident_Float -3.4E+38 3.4E+38 /end CHARACTERISTIC
/begin CHARACTERISTIC CAL_IOHWAB_AN29_IUVW_P_REF_MAX_f32 "CAL_IOHWAB_AN29_IUVW_P_REF_MAX_f32" VALUE 0x801400B8 Scalar_FLOAT32_IEEE 0 BSW_A2L_Ident_Float -3.4E+38 3.4E+38 /end CHARACTERISTIC
/begin CHARACTERISTIC CAL_RDC_flgCorrectOrReal_b "CAL_RDC_flgCorrectOrReal_b" VALUE 0x8014006F Scalar_BOOLEAN 0 BSW_A2L_Ident_Int 0 1 /end CHARACTERISTIC
/begin CHARACTERISTIC CAL_POWER_VDD18_Threhold_Min_f32 "CAL_POWER_VDD18_Threhold_Min_f32" VALUE 0x80140024 Scalar_FLOAT32_IEEE 0 BSW_A2L_Ident_Float -3.4E+38 3.4E+38 /end CHARACTERISTIC
/begin CHARACTERISTIC CAL_DEM_Disbl_DFC_IOHWAB_1V3MCU_SampFail_u8 "CAL_DEM_Disbl_DFC_IOHWAB_1V3MCU_SampFail_u8" VALUE 0x801465C0 Scalar_UBYTE 0 BSW_A2L_Ident_Int 0 255 /end CHARACTERISTIC
/begin CHARACTERISTIC CAL_TRSP_UBRVoltErrRst_b "CAL_TRSP_UBRVoltErrRst_b" VALUE 0x801462EC Scalar_BOOLEAN 0 BSW_A2L_Ident_Int 0 1 /end CHARACTERISTIC
/begin CHARACTERISTIC CAL_DEM_FIM_DFC_CANSM_E_BUS_OFF_NETWORK_0_au8 "CAL_DEM_FIM_DFC_CANSM_E_BUS_OFF_NETWORK_0_au8" VAL_BLK 0x80146ABE Scalar_UBYTE 0 FID_Verb 0 255 NUMBER 10 /end CHARACTERISTIC
/begin CHARACTERISTIC CAL_DEM_FIM_DFC_HvMcu_DisChrgDutyErr_au8 "CAL_DEM_FIM_DFC_HvMcu_DisChrgDutyErr_au8" VAL_BLK 0x80146992 Scalar_UBYTE 0 FID_Verb 0 255 NUMBER 10 /end CHARACTERISTIC
/begin CHARACTERISTIC CAL_DEM_Disbl_DFC_SCF_RunToDischarErr_u8 "CAL_DEM_Disbl_DFC_SCF_RunToDischarErr_u8" VALUE 0x80146589 Scalar_UBYTE 0 BSW_A2L_Ident_Int 0 255 /end CHARACTERISTIC
/begin CHARACTERISTIC CAL_DEM_Disbl_DFC_TPC_TDbcULoLimFail_u8 "CAL_DEM_Disbl_DFC_TPC_TDbcULoLimFail_u8" VALUE 0x80146582 Scalar_UBYTE 0 BSW_A2L_Ident_Int 0 255 /end CHARACTERISTIC
/begin CHARACTERISTIC CAL_DEM_Disbl_DFC_Cpld_SZTKT_InFail_u8 "CAL_DEM_Disbl_DFC_Cpld_SZTKT_InFail_u8" VALUE 0x801465E1 Scalar_UBYTE 0 BSW_A2L_Ident_Int 0 255 /end CHARACTERISTIC
/begin CHARACTERISTIC CAL_DEM_Disbl_DFC_RCF_EstOfsErr_u8 "CAL_DEM_Disbl_DFC_RCF_EstOfsErr_u8" VALUE 0x80146594 Scalar_UBYTE 0 BSW_A2L_Ident_Int 0 255 /end CHARACTERISTIC
/begin CHARACTERISTIC CAL_DEM_FIM_DFC_IOHWAB_DcLnkOverVolFail_au8 "CAL_DEM_FIM_DFC_IOHWAB_DcLnkOverVolFail_au8" VAL_BLK 0x801468B6 Scalar_UBYTE 0 FID_Verb 0 255 NUMBER 10 /end CHARACTERISTIC
/begin CHARACTERISTIC CAL_DEM_FIM_DFC_TPC_SpdOvHiLimFail_au8 "CAL_DEM_FIM_DFC_TPC_SpdOvHiLimFail_au8" VAL_BLK 0x801466D6 Scalar_UBYTE 0 FID_Verb 0 255 NUMBER 10 /end CHARACTERISTIC
/begin CHARACTERISTIC CAL_TRSP_iPhasSensVoltCountTrh_s16 "CAL_TRSP_iPhasSensVoltCountTrh_s16" VALUE 0x801462B8 Scalar_SWORD 0 BSW_A2L_Ident_Int -32768 32767 /end CHARACTERISTIC
/begin CHARACTERISTIC CAL_DEM_Disbl_DFC_TPC_TDrvBoardOvHiWarn_u8 "CAL_DEM_Disbl_DFC_TPC_TDrvBoardOvHiWarn_u8" VALUE 0x8014657D Scalar_UBYTE 0 BSW_A2L_Ident_Int 0 255 /end CHARACTERISTIC
/begin CHARACTERISTIC CAL_RDC_SpdHi_f32 "CAL_RDC_SpdHi_f32" VALUE 0x80140070 Scalar_FLOAT32_IEEE 0 BSW_A2L_Ident_Float -3.4E+38 3.4E+38 /end CHARACTERISTIC
/begin CHARACTERISTIC CAL_IOHWAB_AN30_IUVW_N_REF_MIN_f32 "CAL_IOHWAB_AN30_IUVW_N_REF_MIN_f32" VALUE 0x801400AC Scalar_FLOAT32_IEEE 0 BSW_A2L_Ident_Float -3.4E+38 3.4E+38 /end CHARACTERISTIC
/begin CHARACTERISTIC CAL_POWER_UBSBC_Threhold_V5_f32 "CAL_POWER_UBSBC_Threhold_V5_f32" VALUE 0x80140038 Scalar_FLOAT32_IEEE 0 BSW_A2L_Ident_Float -3.4E+38 3.4E+38 /end CHARACTERISTIC
/begin CHARACTERISTIC CAL_DEM_Disbl_DFC_HSPF_tDBCTempCmpErr_u8 "CAL_DEM_Disbl_DFC_HSPF_tDBCTempCmpErr_u8" VALUE 0x801465D0 Scalar_UBYTE 0 BSW_A2L_Ident_Int 0 255 /end CHARACTERISTIC
/begin CHARACTERISTIC CAL_DEM_Disbl_DFC_MDF_AlOfsNoPlausErr_u8 "CAL_DEM_Disbl_DFC_MDF_AlOfsNoPlausErr_u8" VALUE 0x801465A7 Scalar_UBYTE 0 BSW_A2L_Ident_Int 0 255 /end CHARACTERISTIC
/begin CHARACTERISTIC CAL_TRSP_iVCnvFac_f32 "CAL_TRSP_iVCnvFac_f32" VALUE 0x801462A8 Scalar_FLOAT32_IEEE 0 BSW_A2L_Ident_Float -3.4E+38 3.4E+38 /end CHARACTERISTIC
/begin CHARACTERISTIC CAL_DEM_Disbl_DFC_IOHWAB_KL30SevOverVolFail_u8 "CAL_DEM_Disbl_DFC_IOHWAB_KL30SevOverVolFail_u8" VALUE 0x801465B5 Scalar_UBYTE 0 BSW_A2L_Ident_Int 0 255 /end CHARACTERISTIC
/begin CHARACTERISTIC CAL_DEM_Disbl_DFC_IOHWAB_TCoolantSampFail_u8 "CAL_DEM_Disbl_DFC_IOHWAB_TCoolantSampFail_u8" VALUE 0x801465AE Scalar_UBYTE 0 BSW_A2L_Ident_Int 0 255 /end CHARACTERISTIC
/begin CHARACTERISTIC CAL_DEM_FIM_DFC_TPC_uDcLnkUnvWarn_au8 "CAL_DEM_FIM_DFC_TPC_uDcLnkUnvWarn_au8" VAL_BLK 0x801465F0 Scalar_UBYTE 0 FID_Verb 0 255 NUMBER 10 /end CHARACTERISTIC
/begin CHARACTERISTIC CAL_DEM_FIM_DFC_MDF_ICtlRatErr_au8 "CAL_DEM_FIM_DFC_MDF_ICtlRatErr_au8" VAL_BLK 0x801467E4 Scalar_UBYTE 0 FID_Verb 0 255 NUMBER 10 /end CHARACTERISTIC
/begin CHARACTERISTIC CAL_DEM_Disbl_DFC_IgbtDrv_UpBrgFaultAFail_u8 "CAL_DEM_Disbl_DFC_IgbtDrv_UpBrgFaultAFail_u8" VALUE 0x801465A9 Scalar_UBYTE 0 BSW_A2L_Ident_Int 0 255 /end CHARACTERISTIC
/begin CHARACTERISTIC CAL_SnapshotRam_Enable_u8 "CAL_SnapshotRam_Enable_u8" VALUE 0x8014009F Scalar_UBYTE 0 BSW_A2L_Ident_Int 0 255 /end CHARACTERISTIC
/begin CHARACTERISTIC CAL_Vcf_SLCalTrqSlp_f32 "CAL_Vcf_SLCalTrqSlp_f32" VALUE 0x8014646C Scalar_FLOAT32_IEEE 0 BSW_A2L_Ident_Float -3.4E+38 3.4E+38 /end CHARACTERISTIC
/begin CHARACTERISTIC CAL_Vcf_SpdCtlReq_u8 "CAL_Vcf_SpdCtlReq_u8" VALUE 0x80146468 Scalar_UBYTE 0 BSW_A2L_Ident_Int 0 255 /end CHARACTERISTIC
/begin CHARACTERISTIC CAL_TRSP_UBRVoltDebTrh_s16 "CAL_TRSP_UBRVoltDebTrh_s16" VALUE 0x801462EE Scalar_SWORD 0 BSW_A2L_Ident_Int -32768 32767 /end CHARACTERISTIC
/begin CHARACTERISTIC CAL_DEM_FIM_DFC_HvMcu_ComErr_au8 "CAL_DEM_FIM_DFC_HvMcu_ComErr_au8" VAL_BLK 0x8014699C Scalar_UBYTE 0 FID_Verb 0 255 NUMBER 10 /end CHARACTERISTIC
/begin CHARACTERISTIC CAL_TRSP_iUCnvFac_f32 "CAL_TRSP_iUCnvFac_f32" VALUE 0x801462AC Scalar_FLOAT32_IEEE 0 BSW_A2L_Ident_Float -3.4E+38 3.4E+38 /end CHARACTERISTIC
/begin CHARACTERISTIC CAL_DEM_FIM_DFC_HvMcu_UdcOverFlagLimit_au8 "CAL_DEM_FIM_DFC_HvMcu_UdcOverFlagLimit_au8" VAL_BLK 0x8014694C Scalar_UBYTE 0 FID_Verb 0 255 NUMBER 10 /end CHARACTERISTIC
/begin CHARACTERISTIC CAL_Hvmcu_ComErr_deb_s8 "CAL_Hvmcu_ComErr_deb_s8" VALUE 0x80140013 Scalar_BYTE 0 BSW_A2L_Ident_Int -128 127 /end CHARACTERISTIC
/begin CHARACTERISTIC CAL_Vcf_HoldTrqLoadSwt_b "CAL_Vcf_HoldTrqLoadSwt_b" VALUE 0x80146498 Scalar_BOOLEAN 0 BSW_A2L_Ident_Int 0 1 /end CHARACTERISTIC
/begin CHARACTERISTIC CAL_DEM_FIM_DFC_MDF_PrfElDrvErr_au8 "CAL_DEM_FIM_DFC_MDF_PrfElDrvErr_au8" VAL_BLK 0x801467B2 Scalar_UBYTE 0 FID_Verb 0 255 NUMBER 10 /end CHARACTERISTIC
/begin CHARACTERISTIC CAL_DEM_Disbl_DFC_Cpld_DI_ExdClk_InFail_u8 "CAL_DEM_Disbl_DFC_Cpld_DI_ExdClk_InFail_u8" VALUE 0x801465E8 Scalar_UBYTE 0 BSW_A2L_Ident_Int 0 255 /end CHARACTERISTIC
/begin CHARACTERISTIC CAL_Vcf_TrqAbsDiff_f32 "CAL_Vcf_TrqAbsDiff_f32" VALUE 0x8014645C Scalar_FLOAT32_IEEE 0 BSW_A2L_Ident_Float -3.4E+38 3.4E+38 /end CHARACTERISTIC
/begin CHARACTERISTIC CAL_DEM_Disbl_DFC_TPC_TDbcOvHiWarn_u8 "CAL_DEM_Disbl_DFC_TPC_TDbcOvHiWarn_u8" VALUE 0x80146585 Scalar_UBYTE 0 BSW_A2L_Ident_Int 0 255 /end CHARACTERISTIC
/begin CHARACTERISTIC CAL_Vcf_FunctionReqSwt_b "CAL_Vcf_FunctionReqSwt_b" VALUE 0x801464B4 Scalar_BOOLEAN 0 BSW_A2L_Ident_Int 0 1 /end CHARACTERISTIC
/begin CHARACTERISTIC CAL_DEM_FIM_DFC_RSL_DOSErr_au8 "CAL_DEM_FIM_DFC_RSL_DOSErr_au8" VAL_BLK 0x8014671C Scalar_UBYTE 0 FID_Verb 0 255 NUMBER 10 /end CHARACTERISTIC
/begin CHARACTERISTIC CAL_Vcf_GearLvR_u8 "CAL_Vcf_GearLvR_u8" VALUE 0x801464A5 Scalar_UBYTE 0 BSW_A2L_Ident_Int 0 255 /end CHARACTERISTIC
/begin CHARACTERISTIC CAL_DEM_FIM_DFC_IgbtDrv_UpBrgFaultAFail_au8 "CAL_DEM_FIM_DFC_IgbtDrv_UpBrgFaultAFail_au8" VAL_BLK 0x80146820 Scalar_UBYTE 0 FID_Verb 0 255 NUMBER 10 /end CHARACTERISTIC
/begin CHARACTERISTIC CAL_Vcf_TrqSlopAccStep_f32 "CAL_Vcf_TrqSlopAccStep_f32" VALUE 0x8014642C Scalar_FLOAT32_IEEE 0 BSW_A2L_Ident_Float -3.4E+38 3.4E+38 /end CHARACTERISTIC
/begin CHARACTERISTIC CAL_DEM_FIM_DFC_TPC_TSttrOvHiWarn_au8 "CAL_DEM_FIM_DFC_TPC_TSttrOvHiWarn_au8" VAL_BLK 0x80146636 Scalar_UBYTE 0 FID_Verb 0 255 NUMBER 10 /end CHARACTERISTIC
/begin CHARACTERISTIC CAL_DEM_Disbl_DFC_TPC_SpdOvHiWarn_u8 "CAL_DEM_Disbl_DFC_TPC_SpdOvHiWarn_u8" VALUE 0x80146587 Scalar_UBYTE 0 BSW_A2L_Ident_Int 0 255 /end CHARACTERISTIC
/begin CHARACTERISTIC CAL_DEM_Disbl_DFC_MDF_DiashCirNoPsblErr_u8 "CAL_DEM_Disbl_DFC_MDF_DiashCirNoPsblErr_u8" VALUE 0x801465A6 Scalar_UBYTE 0 BSW_A2L_Ident_Int 0 255 /end CHARACTERISTIC
/begin CHARACTERISTIC CAL_Vcf_Crawltrqsub_f32 "CAL_Vcf_Crawltrqsub_f32" VALUE 0x80146528 Scalar_FLOAT32_IEEE 0 BSW_A2L_Ident_Float -3.4E+38 3.4E+38 /end CHARACTERISTIC
/begin CHARACTERISTIC CAL_DEM_Disbl_DFC_PCF_SenOvErr_u8 "CAL_DEM_Disbl_DFC_PCF_SenOvErr_u8" VALUE 0x80146599 Scalar_UBYTE 0 BSW_A2L_Ident_Int 0 255 /end CHARACTERISTIC
/begin CHARACTERISTIC CAL_Vcf_CrawlSwt_b "CAL_Vcf_CrawlSwt_b" VALUE 0x8014653C Scalar_BOOLEAN 0 BSW_A2L_Ident_Int 0 1 /end CHARACTERISTIC
/begin CHARACTERISTIC CAL_Vcf_GearHoldOutSwt_b "CAL_Vcf_GearHoldOutSwt_b" VALUE 0x801464A8 Scalar_BOOLEAN 0 BSW_A2L_Ident_Int 0 1 /end CHARACTERISTIC
/begin CHARACTERISTIC CAL_DEM_FIM_DFC_HvMcu_UartCheckFailErr_au8 "CAL_DEM_FIM_DFC_HvMcu_UartCheckFailErr_au8" VAL_BLK 0x8014696A Scalar_UBYTE 0 FID_Verb 0 255 NUMBER 10 /end CHARACTERISTIC
/begin CHARACTERISTIC CAL_DEM_Disbl_DFC_TPC_TDbcVLoLimFail_u8 "CAL_DEM_Disbl_DFC_TPC_TDbcVLoLimFail_u8" VALUE 0x80146580 Scalar_UBYTE 0 BSW_A2L_Ident_Int 0 255 /end CHARACTERISTIC
/begin CHARACTERISTIC CAL_DEM_FIM_DFC_Cpld_UdcOverVolFail_au8 "CAL_DEM_FIM_DFC_Cpld_UdcOverVolFail_au8" VAL_BLK 0x80146A32 Scalar_UBYTE 0 FID_Verb 0 255 NUMBER 10 /end CHARACTERISTIC
/begin CHARACTERISTIC CAL_DEM_Disbl_DFC_Cpld_ExdClkInFail_u8 "CAL_DEM_Disbl_DFC_Cpld_ExdClkInFail_u8" VALUE 0x801465E7 Scalar_UBYTE 0 BSW_A2L_Ident_Int 0 255 /end CHARACTERISTIC
/begin CHARACTERISTIC CAL_DEM_Disbl_DFC_MDF_IsOvHiErr_u8 "CAL_DEM_Disbl_DFC_MDF_IsOvHiErr_u8" VALUE 0x801465A2 Scalar_UBYTE 0 BSW_A2L_Ident_Int 0 255 /end CHARACTERISTIC
/begin CHARACTERISTIC CAL_DEM_Disbl_DFC_Cpld_Rx_SelfTest_Fail_u8 "CAL_DEM_Disbl_DFC_Cpld_Rx_SelfTest_Fail_u8" VALUE 0x801465E3 Scalar_UBYTE 0 BSW_A2L_Ident_Int 0 255 /end CHARACTERISTIC
/begin CHARACTERISTIC CAL_Vcf_TrqDecRatio_f32 "CAL_Vcf_TrqDecRatio_f32" VALUE 0x80146454 Scalar_FLOAT32_IEEE 0 BSW_A2L_Ident_Float -3.4E+38 3.4E+38 /end CHARACTERISTIC
/begin CHARACTERISTIC CAL_DEM_Disbl_DFC_TPC_iDcLnkOvcWarn_u8 "CAL_DEM_Disbl_DFC_TPC_iDcLnkOvcWarn_u8" VALUE 0x80146575 Scalar_UBYTE 0 BSW_A2L_Ident_Int 0 255 /end CHARACTERISTIC
/begin CHARACTERISTIC CAL_DEM_Disbl_DFC_RCF_PsiOvErr_u8 "CAL_DEM_Disbl_DFC_RCF_PsiOvErr_u8" VALUE 0x80146590 Scalar_UBYTE 0 BSW_A2L_Ident_Int 0 255 /end CHARACTERISTIC
/begin CHARACTERISTIC CAL_DEM_FIM_DFC_IOHWAB_Nen33Fail_au8 "CAL_DEM_FIM_DFC_IOHWAB_Nen33Fail_au8" VAL_BLK 0x8014687A Scalar_UBYTE 0 FID_Verb 0 255 NUMBER 10 /end CHARACTERISTIC
/begin CHARACTERISTIC CAL_VADC_RDC_offset_u16 "CAL_VADC_RDC_offset_u16" VALUE 0x80140010 Scalar_UWORD 0 BSW_A2L_Ident_Int 0 65535 /end CHARACTERISTIC
/begin CHARACTERISTIC CAL_DEM_FIM_DFC_IOHWAB_KL30SevUnderVolFail_au8 "CAL_DEM_FIM_DFC_IOHWAB_KL30SevUnderVolFail_au8" VAL_BLK 0x8014688E Scalar_UBYTE 0 FID_Verb 0 255 NUMBER 10 /end CHARACTERISTIC
/begin CHARACTERISTIC CAL_DEM_Disbl_DFC_IOHWAB_CrashFail_u8 "CAL_DEM_Disbl_DFC_IOHWAB_CrashFail_u8" VALUE 0x801465B9 Scalar_UBYTE 0 BSW_A2L_Ident_Int 0 255 /end CHARACTERISTIC
/begin CHARACTERISTIC CAL_DEM_Disbl_DFC_IOHWAB_KL30OverVolErr_u8 "CAL_DEM_Disbl_DFC_IOHWAB_KL30OverVolErr_u8" VALUE 0x801465B6 Scalar_UBYTE 0 BSW_A2L_Ident_Int 0 255 /end CHARACTERISTIC
/begin CHARACTERISTIC CAL_Vcf_cnCtlNrm_f32 "CAL_Vcf_cnCtlNrm_f32" VALUE 0x80146424 Scalar_FLOAT32_IEEE 0 BSW_A2L_Ident_Float -3.4E+38 3.4E+38 /end CHARACTERISTIC
/begin CHARACTERISTIC CAL_DEM_FIM_DFC_Cpld_NEN_InFail_au8 "CAL_DEM_FIM_DFC_Cpld_NEN_InFail_au8" VAL_BLK 0x80146A78 Scalar_UBYTE 0 FID_Verb 0 255 NUMBER 10 /end CHARACTERISTIC
/begin CHARACTERISTIC CAL_DEM_FIM_DFC_Cpld_IphaOC_au8 "CAL_DEM_FIM_DFC_Cpld_IphaOC_au8" VAL_BLK 0x80146A82 Scalar_UBYTE 0 FID_Verb 0 255 NUMBER 10 /end CHARACTERISTIC
/begin CHARACTERISTIC CAL_DEM_FIM_DFC_TPC_TDbcOvHiWarn_au8 "CAL_DEM_FIM_DFC_TPC_TDbcOvHiWarn_au8" VAL_BLK 0x801466B8 Scalar_UBYTE 0 FID_Verb 0 255 NUMBER 10 /end CHARACTERISTIC
/begin CHARACTERISTIC CAL_DEM_FIM_DFC_TPC_TDbcWLoLimFail_au8 "CAL_DEM_FIM_DFC_TPC_TDbcWLoLimFail_au8" VAL_BLK 0x80146672 Scalar_UBYTE 0 FID_Verb 0 255 NUMBER 10 /end CHARACTERISTIC
/begin CHARACTERISTIC CAL_DEM_Disbl_DFC_RSL_ExcErr_u8 "CAL_DEM_Disbl_DFC_RSL_ExcErr_u8" VALUE 0x8014658E Scalar_UBYTE 0 BSW_A2L_Ident_Int 0 255 /end CHARACTERISTIC
/begin CHARACTERISTIC CAL_DEM_FIM_DFC_SCF_LowPwrShtDwnOvTiFail_au8 "CAL_DEM_FIM_DFC_SCF_LowPwrShtDwnOvTiFail_au8" VAL_BLK 0x801466EA Scalar_UBYTE 0 FID_Verb 0 255 NUMBER 10 /end CHARACTERISTIC
/begin CHARACTERISTIC CAL_DEM_Disbl_DFC_TPC_TDbcVHiLimFail_u8 "CAL_DEM_Disbl_DFC_TPC_TDbcVHiLimFail_u8" VALUE 0x80146581 Scalar_UBYTE 0 BSW_A2L_Ident_Int 0 255 /end CHARACTERISTIC
/begin CHARACTERISTIC CAL_Vcf_ReqTrqMechTrqDif_f32 "CAL_Vcf_ReqTrqMechTrqDif_f32" VALUE 0x80146470 Scalar_FLOAT32_IEEE 0 BSW_A2L_Ident_Float -3.4E+38 3.4E+38 /end CHARACTERISTIC
/begin CHARACTERISTIC CAL_DEM_FIM_DFC_ADC_UPhaseBISTFail_au8 "CAL_DEM_FIM_DFC_ADC_UPhaseBISTFail_au8" VAL_BLK 0x80146ADC Scalar_UBYTE 0 FID_Verb 0 255 NUMBER 10 /end CHARACTERISTIC
/begin CHARACTERISTIC CAL_DEM_FIM_DFC_TPC_uDcLnkUnVLimFail_au8 "CAL_DEM_FIM_DFC_TPC_uDcLnkUnVLimFail_au8" VAL_BLK 0x801465FA Scalar_UBYTE 0 FID_Verb 0 255 NUMBER 10 /end CHARACTERISTIC
/begin CHARACTERISTIC CAL_DEM_FIM_DFC_IOHWAB_VDD5_D_SampFail_au8 "CAL_DEM_FIM_DFC_IOHWAB_VDD5_D_SampFail_au8" VAL_BLK 0x80146848 Scalar_UBYTE 0 FID_Verb 0 255 NUMBER 10 /end CHARACTERISTIC
/begin CHARACTERISTIC CAL_DEM_Disbl_DFC_SCF_DisChgOvTiFail_u8 "CAL_DEM_Disbl_DFC_SCF_DisChgOvTiFail_u8" VALUE 0x8014658B Scalar_UBYTE 0 BSW_A2L_Ident_Int 0 255 /end CHARACTERISTIC
/begin CHARACTERISTIC CAL_DEM_FIM_DFC_TPC_uDcLnkOvWarn_au8 "CAL_DEM_FIM_DFC_TPC_uDcLnkOvWarn_au8" VAL_BLK 0x80146604 Scalar_UBYTE 0 FID_Verb 0 255 NUMBER 10 /end CHARACTERISTIC
/begin CHARACTERISTIC CAL_Vcf_flgOpenHoldFcn_b "CAL_Vcf_flgOpenHoldFcn_b" VALUE 0x80146421 Scalar_BOOLEAN 0 BSW_A2L_Ident_Int 0 1 /end CHARACTERISTIC
/begin CHARACTERISTIC CAL_DEM_FIM_DFC_IOHWAB_KL30SevOverVolFail_au8 "CAL_DEM_FIM_DFC_IOHWAB_KL30SevOverVolFail_au8" VAL_BLK 0x80146898 Scalar_UBYTE 0 FID_Verb 0 255 NUMBER 10 /end CHARACTERISTIC
/begin CHARACTERISTIC CAL_DEM_Disbl_DFC_RCF_FwlBwdOvTiErr_u8 "CAL_DEM_Disbl_DFC_RCF_FwlBwdOvTiErr_u8" VALUE 0x80146593 Scalar_UBYTE 0 BSW_A2L_Ident_Int 0 255 /end CHARACTERISTIC
/begin CHARACTERISTIC CAL_POWER_UBSBC_Threhold_V4_f32 "CAL_POWER_UBSBC_Threhold_V4_f32" VALUE 0x8014003C Scalar_FLOAT32_IEEE 0 BSW_A2L_Ident_Float -3.4E+38 3.4E+38 /end CHARACTERISTIC
/begin CHARACTERISTIC CAL_Vcf_GearLvN_u8 "CAL_Vcf_GearLvN_u8" VALUE 0x801464A6 Scalar_UBYTE 0 BSW_A2L_Ident_Int 0 255 /end CHARACTERISTIC
/begin CHARACTERISTIC CAL_TRSP_OfstRngHiLim_f32 "CAL_TRSP_OfstRngHiLim_f32" VALUE 0x8014633C Scalar_FLOAT32_IEEE 0 BSW_A2L_Ident_Float -3.4E+38 3.4E+38 /end CHARACTERISTIC
/begin CHARACTERISTIC CAL_DEM_FIM_DFC_RSL_LOTErr_au8 "CAL_DEM_FIM_DFC_RSL_LOTErr_au8" VAL_BLK 0x801466FE Scalar_UBYTE 0 FID_Verb 0 255 NUMBER 10 /end CHARACTERISTIC
/begin CHARACTERISTIC CAL_DEM_Disbl_DFC_IOHWAB_VDD5_D_SampFail_u8 "CAL_DEM_Disbl_DFC_IOHWAB_VDD5_D_SampFail_u8" VALUE 0x801465AD Scalar_UBYTE 0 BSW_A2L_Ident_Int 0 255 /end CHARACTERISTIC
/begin CHARACTERISTIC CAL_DEM_Disbl_DFC_TPC_uDcLnkOvVLimFail_u8 "CAL_DEM_Disbl_DFC_TPC_uDcLnkOvVLimFail_u8" VALUE 0x80146574 Scalar_UBYTE 0 BSW_A2L_Ident_Int 0 255 /end CHARACTERISTIC
/begin CHARACTERISTIC CAL_DEM_Disbl_DFC_MDF_OpenCirNoPsblErr_u8 "CAL_DEM_Disbl_DFC_MDF_OpenCirNoPsblErr_u8" VALUE 0x801465A1 Scalar_UBYTE 0 BSW_A2L_Ident_Int 0 255 /end CHARACTERISTIC
/begin CHARACTERISTIC CAL_CddEparkTEST_ManualMosduty_f32 "CAL_CddEparkTEST_ManualMosduty_f32" VALUE 0x80140008 Scalar_FLOAT32_IEEE 0 BSW_A2L_Ident_Float -3.4E+38 3.4E+38 /end CHARACTERISTIC
/begin CHARACTERISTIC CAL_TRSP_iPhasSensVoltDebTrh_s16 "CAL_TRSP_iPhasSensVoltDebTrh_s16" VALUE 0x801462B6 Scalar_SWORD 0 BSW_A2L_Ident_Int -32768 32767 /end CHARACTERISTIC
/begin CHARACTERISTIC CAL_DEM_FIM_DFC_Cpld_SPIComFail_au8 "CAL_DEM_FIM_DFC_Cpld_SPIComFail_au8" VAL_BLK 0x80146A5A Scalar_UBYTE 0 FID_Verb 0 255 NUMBER 10 /end CHARACTERISTIC
/begin CHARACTERISTIC CAL_Vcf_spdThredDmpPos_f32 "CAL_Vcf_spdThredDmpPos_f32" VALUE 0x8014640C Scalar_FLOAT32_IEEE 0 BSW_A2L_Ident_Float -3.4E+38 3.4E+38 /end CHARACTERISTIC
/begin CHARACTERISTIC CAL_Hvmcu_ComErr_Cycle_u16 "CAL_Hvmcu_ComErr_Cycle_u16" VALUE 0x80140016 Scalar_UWORD 0 BSW_A2L_Ident_Int 0 65535 /end CHARACTERISTIC
/begin CHARACTERISTIC CAL_TRSP_ReqTrqErrRst_b "CAL_TRSP_ReqTrqErrRst_b" VALUE 0x80146330 Scalar_BOOLEAN 0 BSW_A2L_Ident_Int 0 1 /end CHARACTERISTIC
/begin CHARACTERISTIC CAL_DEM_FIM_DFC_PCF_StallRetryErr_au8 "CAL_DEM_FIM_DFC_PCF_StallRetryErr_au8" VAL_BLK 0x80146776 Scalar_UBYTE 0 FID_Verb 0 255 NUMBER 10 /end CHARACTERISTIC
/begin CHARACTERISTIC CAL_DEM_FIM_DFC_TPC_SpdOvHiWarn_au8 "CAL_DEM_FIM_DFC_TPC_SpdOvHiWarn_au8" VAL_BLK 0x801466CC Scalar_UBYTE 0 FID_Verb 0 255 NUMBER 10 /end CHARACTERISTIC
/begin CHARACTERISTIC CAL_DEM_FIM_DFC_TPC_TDbcULoLimFail_au8 "CAL_DEM_FIM_DFC_TPC_TDbcULoLimFail_au8" VAL_BLK 0x8014669A Scalar_UBYTE 0 FID_Verb 0 255 NUMBER 10 /end CHARACTERISTIC
/begin CHARACTERISTIC CAL_DEM_FIM_DFC_IOHWAB_18VLwBrgSampFail_au8 "CAL_DEM_FIM_DFC_IOHWAB_18VLwBrgSampFail_au8" VAL_BLK 0x8014691A Scalar_UBYTE 0 FID_Verb 0 255 NUMBER 10 /end CHARACTERISTIC
/begin CHARACTERISTIC CAL_Pwm3phT_ClosedThreshold_f32 "CAL_Pwm3phT_ClosedThreshold_f32" VALUE 0x8014005C Scalar_FLOAT32_IEEE 0 BSW_A2L_Ident_Float -3.4E+38 3.4E+38 /end CHARACTERISTIC
/begin CHARACTERISTIC CAL_DEM_Disbl_DFC_RSL_LOTErr_u8 "CAL_DEM_Disbl_DFC_RSL_LOTErr_u8" VALUE 0x8014658C Scalar_UBYTE 0 BSW_A2L_Ident_Int 0 255 /end CHARACTERISTIC
/begin CHARACTERISTIC CAL_DEM_Disbl_DFC_IOHWAB_DcLnkOverVolFail_u8 "CAL_DEM_Disbl_DFC_IOHWAB_DcLnkOverVolFail_u8" VALUE 0x801465B8 Scalar_UBYTE 0 BSW_A2L_Ident_Int 0 255 /end CHARACTERISTIC
/begin CHARACTERISTIC CAL_DEM_Disbl_DFC_RCF_OfsClbFail_u8 "CAL_DEM_Disbl_DFC_RCF_OfsClbFail_u8" VALUE 0x80146591 Scalar_UBYTE 0 BSW_A2L_Ident_Int 0 255 /end CHARACTERISTIC
/begin CHARACTERISTIC CAL_RDC_RslDosFaultValMax_s16 "CAL_RDC_RslDosFaultValMax_s16" VALUE 0x80140084 Scalar_SWORD 0 BSW_A2L_Ident_Int -32768 32767 /end CHARACTERISTIC
/begin CHARACTERISTIC CAL_DEM_Disbl_DFC_IOHWAB_5VQcoSampFail_u8 "CAL_DEM_Disbl_DFC_IOHWAB_5VQcoSampFail_u8" VALUE 0x801465BE Scalar_UBYTE 0 BSW_A2L_Ident_Int 0 255 /end CHARACTERISTIC
/begin CHARACTERISTIC CAL_DEM_Disbl_DFC_IOHWAB_12VSampErr_u8 "CAL_DEM_Disbl_DFC_IOHWAB_12VSampErr_u8" VALUE 0x801465C4 Scalar_UBYTE 0 BSW_A2L_Ident_Int 0 255 /end CHARACTERISTIC
/begin CHARACTERISTIC CAL_TRSP_ReqTrqHiLim_f32 "CAL_TRSP_ReqTrqHiLim_f32" VALUE 0x8014632C Scalar_FLOAT32_IEEE 0 BSW_A2L_Ident_Float -3.4E+38 3.4E+38 /end CHARACTERISTIC
/begin CHARACTERISTIC CAL_DEM_FIM_DFC_IOHWAB_12VSampErr_au8 "CAL_DEM_FIM_DFC_IOHWAB_12VSampErr_au8" VAL_BLK 0x8014692E Scalar_UBYTE 0 FID_Verb 0 255 NUMBER 10 /end CHARACTERISTIC
/begin CHARACTERISTIC CAL_DEM_FIM_DFC_TPC_TDrvBoardOvHiWarn_au8 "CAL_DEM_FIM_DFC_TPC_TDrvBoardOvHiWarn_au8" VAL_BLK 0x80146668 Scalar_UBYTE 0 FID_Verb 0 255 NUMBER 10 /end CHARACTERISTIC
/begin CHARACTERISTIC CAL_DEM_Disbl_DFC_TPC_TDbcOvLoWarn_u8 "CAL_DEM_Disbl_DFC_TPC_TDbcOvLoWarn_u8" VALUE 0x80146584 Scalar_UBYTE 0 BSW_A2L_Ident_Int 0 255 /end CHARACTERISTIC
/begin CHARACTERISTIC CAL_DEM_Disbl_DFC_IOHWAB_12VNarrSampErr_u8 "CAL_DEM_Disbl_DFC_IOHWAB_12VNarrSampErr_u8" VALUE 0x801465C5 Scalar_UBYTE 0 BSW_A2L_Ident_Int 0 255 /end CHARACTERISTIC
/begin CHARACTERISTIC CAL_DEM_FIM_DFC_IOHWAB_KL30OverVolErr_au8 "CAL_DEM_FIM_DFC_IOHWAB_KL30OverVolErr_au8" VAL_BLK 0x801468A2 Scalar_UBYTE 0 FID_Verb 0 255 NUMBER 10 /end CHARACTERISTIC
/begin CHARACTERISTIC CAL_TRSP_CurrSumLim_f32 "CAL_TRSP_CurrSumLim_f32" VALUE 0x80146348 Scalar_FLOAT32_IEEE 0 BSW_A2L_Ident_Float -3.4E+38 3.4E+38 /end CHARACTERISTIC
/begin CHARACTERISTIC CAL_DEM_FIM_DFC_Cpld_ExdClkInFail_au8 "CAL_DEM_FIM_DFC_Cpld_ExdClkInFail_au8" VAL_BLK 0x80146A8C Scalar_UBYTE 0 FID_Verb 0 255 NUMBER 10 /end CHARACTERISTIC
/begin CHARACTERISTIC CAL_IOHWAB_DIO_AN29_IUVW_P_REF_DEM_f32 "CAL_IOHWAB_DIO_AN29_IUVW_P_REF_DEM_f32" VALUE 0x801400C0 Scalar_FLOAT32_IEEE 0 BSW_A2L_Ident_Float -3.4E+38 3.4E+38 /end CHARACTERISTIC
/begin CHARACTERISTIC CAL_DEM_Disbl_DFC_TPC_TIGBTOvLoWarn_u8 "CAL_DEM_Disbl_DFC_TPC_TIGBTOvLoWarn_u8" VALUE 0x8014657A Scalar_UBYTE 0 BSW_A2L_Ident_Int 0 255 /end CHARACTERISTIC
/begin CHARACTERISTIC CAL_RdcRslExcFaultDebounce_u8 "CAL_RdcRslExcFaultDebounce_u8" VALUE 0x80140090 Scalar_UBYTE 0 BSW_A2L_Ident_Int 0 255 /end CHARACTERISTIC
/begin CHARACTERISTIC CAL_TRSP_UBRVoltCountTrh_s16 "CAL_TRSP_UBRVoltCountTrh_s16" VALUE 0x801462F0 Scalar_SWORD 0 BSW_A2L_Ident_Int -32768 32767 /end CHARACTERISTIC
/begin CHARACTERISTIC CAL_Vcf_CofHoldTrq_f32 "CAL_Vcf_CofHoldTrq_f32" VALUE 0x80146550 Scalar_FLOAT32_IEEE 0 BSW_A2L_Ident_Float -3.4E+38 3.4E+38 /end CHARACTERISTIC
/begin CHARACTERISTIC CAL_RDC_RslDosFaultValMin_s16 "CAL_RDC_RslDosFaultValMin_s16" VALUE 0x80140086 Scalar_SWORD 0 BSW_A2L_Ident_Int -32768 32767 /end CHARACTERISTIC
/begin CHARACTERISTIC CAL_DEM_Disbl_DFC_Epark_OverCurFail_u8 "CAL_DEM_Disbl_DFC_Epark_OverCurFail_u8" VALUE 0x801465DB Scalar_UBYTE 0 BSW_A2L_Ident_Int 0 255 /end CHARACTERISTIC
/begin CHARACTERISTIC CAL_DEM_Disbl_DFC_IOHWAB_Cpld3v3SampFail_u8 "CAL_DEM_Disbl_DFC_IOHWAB_Cpld3v3SampFail_u8" VALUE 0x801465BA Scalar_UBYTE 0 BSW_A2L_Ident_Int 0 255 /end CHARACTERISTIC
/begin CHARACTERISTIC CAL_RDC_Nset_f32 "CAL_RDC_Nset_f32" VALUE 0x80140078 Scalar_FLOAT32_IEEE 0 BSW_A2L_Ident_Float -3.4E+38 3.4E+38 /end CHARACTERISTIC
/begin CHARACTERISTIC CAL_Vcf_UnLoLimSlope_u8 "CAL_Vcf_UnLoLimSlope_u8" VALUE 0x80146428 Scalar_UBYTE 0 BSW_A2L_Ident_Int 0 255 /end CHARACTERISTIC
/begin CHARACTERISTIC CAL_TRSP_iPhasSensVoltHiLim_u16 "CAL_TRSP_iPhasSensVoltHiLim_u16" VALUE 0x801462B2 Scalar_UWORD 0 BSW_A2L_Ident_Int 0 65535 /end CHARACTERISTIC
/begin CHARACTERISTIC CAL_TRSP_UBRWIDECnvFac_f32 "CAL_TRSP_UBRWIDECnvFac_f32" VALUE 0x801462E8 Scalar_FLOAT32_IEEE 0 BSW_A2L_Ident_Float -3.4E+38 3.4E+38 /end CHARACTERISTIC
/begin CHARACTERISTIC CAL_RDC_RslDosOffMax_s16 "CAL_RDC_RslDosOffMax_s16" VALUE 0x80140080 Scalar_SWORD 0 BSW_A2L_Ident_Int -32768 32767 /end CHARACTERISTIC
/begin CHARACTERISTIC CAL_CddDPT_byte_au8 "CAL_CddDPT_byte_au8" VAL_BLK 0x80140002 Scalar_UBYTE 0 BSW_A2L_Ident_Int 0 255 NUMBER 6 /end CHARACTERISTIC
/begin CHARACTERISTIC CAL_Vcf_nAccChgLoLim_f32 "CAL_Vcf_nAccChgLoLim_f32" VALUE 0x80146418 Scalar_FLOAT32_IEEE 0 BSW_A2L_Ident_Float -3.4E+38 3.4E+38 /end CHARACTERISTIC
/begin CHARACTERISTIC CAL_DEM_Disbl_DFC_IOHWAB_IphaOCFail_u8 "CAL_DEM_Disbl_DFC_IOHWAB_IphaOCFail_u8" VALUE 0x801465B7 Scalar_UBYTE 0 BSW_A2L_Ident_Int 0 255 /end CHARACTERISTIC
/begin CHARACTERISTIC CAL_Vcf_CrawltrqUp_f32 "CAL_Vcf_CrawltrqUp_f32" VALUE 0x80146534 Scalar_FLOAT32_IEEE 0 BSW_A2L_Ident_Float -3.4E+38 3.4E+38 /end CHARACTERISTIC
/begin CHARACTERISTIC CAL_Vcf_PosDmpMaxTrq_f32 "CAL_Vcf_PosDmpMaxTrq_f32" VALUE 0x80146474 Scalar_FLOAT32_IEEE 0 BSW_A2L_Ident_Float -3.4E+38 3.4E+38 /end CHARACTERISTIC
/begin CHARACTERISTIC CAL_DEM_FIM_DFC_Cpld_DI_ExdClk_InFail_au8 "CAL_DEM_FIM_DFC_Cpld_DI_ExdClk_InFail_au8" VAL_BLK 0x80146A96 Scalar_UBYTE 0 FID_Verb 0 255 NUMBER 10 /end CHARACTERISTIC
/begin CHARACTERISTIC CAL_DEM_FIM_DFC_IOHWAB_12VWideSampErr_au8 "CAL_DEM_FIM_DFC_IOHWAB_12VWideSampErr_au8" VAL_BLK 0x80146924 Scalar_UBYTE 0 FID_Verb 0 255 NUMBER 10 /end CHARACTERISTIC
/begin CHARACTERISTIC CAL_DEM_FIM_DFC_IOHWAB_Cpld1v8SampFail_au8 "CAL_DEM_FIM_DFC_IOHWAB_Cpld1v8SampFail_au8" VAL_BLK 0x801468D4 Scalar_UBYTE 0 FID_Verb 0 255 NUMBER 10 /end CHARACTERISTIC
/begin CHARACTERISTIC CAL_Vcf_Drv_go_alOffsetcalReq_u8 "CAL_Vcf_Drv_go_alOffsetcalReq_u8" VALUE 0x801464B5 Scalar_UBYTE 0 BSW_A2L_Ident_Int 0 255 /end CHARACTERISTIC
/begin CHARACTERISTIC CAL_Vcf_OvHiLimSlope_u8 "CAL_Vcf_OvHiLimSlope_u8" VALUE 0x8014647C Scalar_UBYTE 0 BSW_A2L_Ident_Int 0 255 /end CHARACTERISTIC
/begin CHARACTERISTIC CAL_DEM_FIM_DFC_HvMcu_DisChrgFail_au8 "CAL_DEM_FIM_DFC_HvMcu_DisChrgFail_au8" VAL_BLK 0x80146988 Scalar_UBYTE 0 FID_Verb 0 255 NUMBER 10 /end CHARACTERISTIC
/begin CHARACTERISTIC CAL_TRSP_iPhaVOffset_f32 "CAL_TRSP_iPhaVOffset_f32" VALUE 0x801462C0 Scalar_FLOAT32_IEEE 0 BSW_A2L_Ident_Float -3.4E+38 3.4E+38 /end CHARACTERISTIC
/begin CHARACTERISTIC CAL_RDC_IsrTimeCmpsa_u16 "CAL_RDC_IsrTimeCmpsa_u16" VALUE 0x8014009C Scalar_UWORD 0 BSW_A2L_Ident_Int 0 65535 /end CHARACTERISTIC
/begin CHARACTERISTIC CAL_DEM_FIM_DFC_TPC_iDcLnkOvCLimFail_au8 "CAL_DEM_FIM_DFC_TPC_iDcLnkOvCLimFail_au8" VAL_BLK 0x80146622 Scalar_UBYTE 0 FID_Verb 0 255 NUMBER 10 /end CHARACTERISTIC
/begin CHARACTERISTIC CAL_DEM_FIM_DFC_TPC_TIGBTOvHiWarn_au8 "CAL_DEM_FIM_DFC_TPC_TIGBTOvHiWarn_au8" VAL_BLK 0x80146654 Scalar_UBYTE 0 FID_Verb 0 255 NUMBER 10 /end CHARACTERISTIC
/begin CHARACTERISTIC CAL_RDC_NRestrict_f32 "CAL_RDC_NRestrict_f32" VALUE 0x8014007C Scalar_FLOAT32_IEEE 0 BSW_A2L_Ident_Float -3.4E+38 3.4E+38 /end CHARACTERISTIC
/begin CHARACTERISTIC CAL_DEM_FIM_DFC_PCF_IdcOvErr_au8 "CAL_DEM_FIM_DFC_PCF_IdcOvErr_au8" VAL_BLK 0x8014679E Scalar_UBYTE 0 FID_Verb 0 255 NUMBER 10 /end CHARACTERISTIC
/begin CHARACTERISTIC CAL_Vcf_TrqFbkLMax_f32 "CAL_Vcf_TrqFbkLMax_f32" VALUE 0x80146440 Scalar_FLOAT32_IEEE 0 BSW_A2L_Ident_Float -3.4E+38 3.4E+38 /end CHARACTERISTIC
/begin CHARACTERISTIC CAL_Vcf_CrawlNsetD_f32 "CAL_Vcf_CrawlNsetD_f32" VALUE 0x80146548 Scalar_FLOAT32_IEEE 0 BSW_A2L_Ident_Float -3.4E+38 3.4E+38 /end CHARACTERISTIC
/begin CHARACTERISTIC CAL_Vcf_BwdHoldInSpdLim_f32 "CAL_Vcf_BwdHoldInSpdLim_f32" VALUE 0x80146558 Scalar_FLOAT32_IEEE 0 BSW_A2L_Ident_Float -3.4E+38 3.4E+38 /end CHARACTERISTIC
/begin CHARACTERISTIC CAL_DEM_FIM_DFC_IOHWAB_IphaOCFail_au8 "CAL_DEM_FIM_DFC_IOHWAB_IphaOCFail_au8" VAL_BLK 0x801468AC Scalar_UBYTE 0 FID_Verb 0 255 NUMBER 10 /end CHARACTERISTIC
/begin CHARACTERISTIC CAL_DEM_Disbl_DFC_PCF_SelfcheckErr_u8 "CAL_DEM_Disbl_DFC_PCF_SelfcheckErr_u8" VALUE 0x8014659B Scalar_UBYTE 0 BSW_A2L_Ident_Int 0 255 /end CHARACTERISTIC
/begin CHARACTERISTIC CAL_Pwm3ph_AdcTriggleOffset_u16 "CAL_Pwm3ph_AdcTriggleOffset_u16" VALUE 0x80140050 Scalar_UWORD 0 BSW_A2L_Ident_Int 0 65535 /end CHARACTERISTIC
/begin CHARACTERISTIC CAL_DEM_FIM_DFC_SCF_RunToDischarErr_au8 "CAL_DEM_FIM_DFC_SCF_RunToDischarErr_au8" VAL_BLK 0x801466E0 Scalar_UBYTE 0 FID_Verb 0 255 NUMBER 10 /end CHARACTERISTIC
/begin CHARACTERISTIC CAL_POWER_UBSBC_Threhold_V6_f32 "CAL_POWER_UBSBC_Threhold_V6_f32" VALUE 0x80140034 Scalar_FLOAT32_IEEE 0 BSW_A2L_Ident_Float -3.4E+38 3.4E+38 /end CHARACTERISTIC
/begin CHARACTERISTIC CAL_DEM_Disbl_DFC_MDF_EmacBlkdErr_u8 "CAL_DEM_Disbl_DFC_MDF_EmacBlkdErr_u8" VALUE 0x801465A5 Scalar_UBYTE 0 BSW_A2L_Ident_Int 0 255 /end CHARACTERISTIC
/begin CHARACTERISTIC CAL_DEM_FIM_DFC_Epark_PosMonSampFail_au8 "CAL_DEM_FIM_DFC_Epark_PosMonSampFail_au8" VAL_BLK 0x80146A0A Scalar_UBYTE 0 FID_Verb 0 255 NUMBER 10 /end CHARACTERISTIC
/begin CHARACTERISTIC CAL_DEM_FIM_DFC_TPC_TDbcVHiLimFail_au8 "CAL_DEM_FIM_DFC_TPC_TDbcVHiLimFail_au8" VAL_BLK 0x80146690 Scalar_UBYTE 0 FID_Verb 0 255 NUMBER 10 /end CHARACTERISTIC
/begin CHARACTERISTIC CAL_DEM_Disbl_DFC_RCF_FwlFwdOvTiErr_u8 "CAL_DEM_Disbl_DFC_RCF_FwlFwdOvTiErr_u8" VALUE 0x80146592 Scalar_UBYTE 0 BSW_A2L_Ident_Int 0 255 /end CHARACTERISTIC
/begin CHARACTERISTIC CAL_DEM_FIM_DFC_TPC_TIGBTOvLoWarn_au8 "CAL_DEM_FIM_DFC_TPC_TIGBTOvLoWarn_au8" VAL_BLK 0x8014664A Scalar_UBYTE 0 FID_Verb 0 255 NUMBER 10 /end CHARACTERISTIC
/begin CHARACTERISTIC CAL_VADC_RDC_ISR_offset_u16 "CAL_VADC_RDC_ISR_offset_u16" VALUE 0x8014000E Scalar_UWORD 0 BSW_A2L_Ident_Int 0 65535 /end CHARACTERISTIC
/begin CHARACTERISTIC CAL_DEM_Clear_DTC_Flag_u8 "CAL_DEM_Clear_DTC_Flag_u8" VALUE 0x80146570 Scalar_UBYTE 0 BSW_A2L_Ident_Int 0 255 /end CHARACTERISTIC
/begin CHARACTERISTIC CAL_DEM_FIM_DFC_PCF_SelfcheckErr_au8 "CAL_DEM_FIM_DFC_PCF_SelfcheckErr_au8" VAL_BLK 0x80146794 Scalar_UBYTE 0 FID_Verb 0 255 NUMBER 10 /end CHARACTERISTIC
/begin CHARACTERISTIC CAL_Vcf_NegDmpMaxTrq_f32 "CAL_Vcf_NegDmpMaxTrq_f32" VALUE 0x8014648C Scalar_FLOAT32_IEEE 0 BSW_A2L_Ident_Float -3.4E+38 3.4E+38 /end CHARACTERISTIC
/begin CHARACTERISTIC CAL_TRSP_ReqTrqDebTrh_s16 "CAL_TRSP_ReqTrqDebTrh_s16" VALUE 0x80146332 Scalar_SWORD 0 BSW_A2L_Ident_Int -32768 32767 /end CHARACTERISTIC
/begin CHARACTERISTIC CAL_Vcf_TrqCtlReq_u8 "CAL_Vcf_TrqCtlReq_u8" VALUE 0x80146458 Scalar_UBYTE 0 BSW_A2L_Ident_Int 0 255 /end CHARACTERISTIC
/begin CHARACTERISTIC CAL_DEM_Disbl_DFC_Epark_PosMonSampFail_u8 "CAL_DEM_Disbl_DFC_Epark_PosMonSampFail_u8" VALUE 0x801465DA Scalar_UBYTE 0 BSW_A2L_Ident_Int 0 255 /end CHARACTERISTIC
/begin CHARACTERISTIC CAL_DEM_FIM_DFC_Cpld_Rx_SelfTest_Fail_au8 "CAL_DEM_FIM_DFC_Cpld_Rx_SelfTest_Fail_au8" VAL_BLK 0x80146A64 Scalar_UBYTE 0 FID_Verb 0 255 NUMBER 10 /end CHARACTERISTIC
/begin CHARACTERISTIC CAL_DEM_FIM_DFC_Cpld_Short_Circuit_LS_InFail_au8 "CAL_DEM_FIM_DFC_Cpld_Short_Circuit_LS_InFail_au8" VAL_BLK 0x80146A3C Scalar_UBYTE 0 FID_Verb 0 255 NUMBER 10 /end CHARACTERISTIC
/begin CHARACTERISTIC CAL_DEM_FIM_DFC_Cpld_ParityChkErr_au8 "CAL_DEM_FIM_DFC_Cpld_ParityChkErr_au8" VAL_BLK 0x80146A6E Scalar_UBYTE 0 FID_Verb 0 255 NUMBER 10 /end CHARACTERISTIC
/begin CHARACTERISTIC CAL_DEM_FIM_DFC_PCF_SenOvErr_au8 "CAL_DEM_FIM_DFC_PCF_SenOvErr_au8" VAL_BLK 0x80146780 Scalar_UBYTE 0 FID_Verb 0 255 NUMBER 10 /end CHARACTERISTIC
/begin CHARACTERISTIC CAL_TRSP_RslvSqrtLoLim_u16 "CAL_TRSP_RslvSqrtLoLim_u16" VALUE 0x801462F4 Scalar_UWORD 0 BSW_A2L_Ident_Int 0 65535 /end CHARACTERISTIC
/begin CHARACTERISTIC CAL_DEM_Disbl_DFC_MDF_ICtlRatErr_u8 "CAL_DEM_Disbl_DFC_MDF_ICtlRatErr_u8" VALUE 0x801465A3 Scalar_UBYTE 0 BSW_A2L_Ident_Int 0 255 /end CHARACTERISTIC
/begin CHARACTERISTIC CAL_TRSP_iPhaUOffset_f32 "CAL_TRSP_iPhaUOffset_f32" VALUE 0x801462C4 Scalar_FLOAT32_IEEE 0 BSW_A2L_Ident_Float -3.4E+38 3.4E+38 /end CHARACTERISTIC
/begin CHARACTERISTIC CAL_DEM_Disbl_DFC_MDF_OperOutdRngErr_u8 "CAL_DEM_Disbl_DFC_MDF_OperOutdRngErr_u8" VALUE 0x801465A0 Scalar_UBYTE 0 BSW_A2L_Ident_Int 0 255 /end CHARACTERISTIC
/begin CHARACTERISTIC CAL_DEM_FIM_DFC_TPC_TDbcWHiLimFail_au8 "CAL_DEM_FIM_DFC_TPC_TDbcWHiLimFail_au8" VAL_BLK 0x8014667C Scalar_UBYTE 0 FID_Verb 0 255 NUMBER 10 /end CHARACTERISTIC
/begin CHARACTERISTIC CAL_DEM_FIM_DFC_IOHWAB_12VNarrSampErr_au8 "CAL_DEM_FIM_DFC_IOHWAB_12VNarrSampErr_au8" VAL_BLK 0x80146938 Scalar_UBYTE 0 FID_Verb 0 255 NUMBER 10 /end CHARACTERISTIC
/begin CHARACTERISTIC CAL_TRSP_OfstRngLoLim_f32 "CAL_TRSP_OfstRngLoLim_f32" VALUE 0x80146338 Scalar_FLOAT32_IEEE 0 BSW_A2L_Ident_Float -3.4E+38 3.4E+38 /end CHARACTERISTIC
/begin CHARACTERISTIC CAL_Vcf_GearR_u8 "CAL_Vcf_GearR_u8" VALUE 0x801464A4 Scalar_UBYTE 0 BSW_A2L_Ident_Int 0 255 /end CHARACTERISTIC
/begin CHARACTERISTIC CAL_DEM_FIM_DFC_IgbtDrv_ComErr_au8 "CAL_DEM_FIM_DFC_IgbtDrv_ComErr_au8" VAL_BLK 0x8014683E Scalar_UBYTE 0 FID_Verb 0 255 NUMBER 10 /end CHARACTERISTIC
/begin CHARACTERISTIC CAL_DEM_Disbl_DFC_Cpld_UnderVol_LS_InFail_u8 "CAL_DEM_Disbl_DFC_Cpld_UnderVol_LS_InFail_u8" VALUE 0x801465DC Scalar_UBYTE 0 BSW_A2L_Ident_Int 0 255 /end CHARACTERISTIC
/begin CHARACTERISTIC CAL_DEM_FIM_DFC_RCF_EstOfsErr_au8 "CAL_DEM_FIM_DFC_RCF_EstOfsErr_au8" VAL_BLK 0x8014674E Scalar_UBYTE 0 FID_Verb 0 255 NUMBER 10 /end CHARACTERISTIC
/begin CHARACTERISTIC CAL_DEM_FIM_DFC_MDF_EmacBlkdErr_au8 "CAL_DEM_FIM_DFC_MDF_EmacBlkdErr_au8" VAL_BLK 0x801467F8 Scalar_UBYTE 0 FID_Verb 0 255 NUMBER 10 /end CHARACTERISTIC
/begin CHARACTERISTIC CAL_Vcf_flgOpenCrawlFcn_b "CAL_Vcf_flgOpenCrawlFcn_b" VALUE 0x80146422 Scalar_BOOLEAN 0 BSW_A2L_Ident_Int 0 1 /end CHARACTERISTIC
/begin CHARACTERISTIC CAL_DEM_Disbl_DFC_IOHWAB_Cpld1v8SampFail_u8 "CAL_DEM_Disbl_DFC_IOHWAB_Cpld1v8SampFail_u8" VALUE 0x801465BB Scalar_UBYTE 0 BSW_A2L_Ident_Int 0 255 /end CHARACTERISTIC
/begin CHARACTERISTIC CAL_DEM_FIM_DFC_RSL_ExcErr_au8 "CAL_DEM_FIM_DFC_RSL_ExcErr_au8" VAL_BLK 0x80146712 Scalar_UBYTE 0 FID_Verb 0 255 NUMBER 10 /end CHARACTERISTIC
/begin CHARACTERISTIC CAL_TRSP_iPhasSensVoltErrRst_b "CAL_TRSP_iPhasSensVoltErrRst_b" VALUE 0x801462B4 Scalar_BOOLEAN 0 BSW_A2L_Ident_Int 0 1 /end CHARACTERISTIC
/begin CHARACTERISTIC CAL_DEM_Disbl_DFC_FR_StorageErr_u8 "CAL_DEM_Disbl_DFC_FR_StorageErr_u8" VALUE 0x801465D5 Scalar_UBYTE 0 BSW_A2L_Ident_Int 0 255 /end CHARACTERISTIC
/begin CHARACTERISTIC CAL_Vcf_TrqSlopAccMax_f32 "CAL_Vcf_TrqSlopAccMax_f32" VALUE 0x80146430 Scalar_FLOAT32_IEEE 0 BSW_A2L_Ident_Float -3.4E+38 3.4E+38 /end CHARACTERISTIC
/begin CHARACTERISTIC CAL_TRSP_SpeedCtlMode_u8 "CAL_TRSP_SpeedCtlMode_u8" VALUE 0x801462F3 Scalar_UBYTE 0 BSW_A2L_Ident_Int 0 255 /end CHARACTERISTIC
/begin CHARACTERISTIC CAL_Pwm3phB_ClosedThreshold_f32 "CAL_Pwm3phB_ClosedThreshold_f32" VALUE 0x80140060 Scalar_FLOAT32_IEEE 0 BSW_A2L_Ident_Float -3.4E+38 3.4E+38 /end CHARACTERISTIC
/begin CHARACTERISTIC CAL_DEM_FIM_DFC_HvMcu_UdcCheckErr_au8 "CAL_DEM_FIM_DFC_HvMcu_UdcCheckErr_au8" VAL_BLK 0x80146956 Scalar_UBYTE 0 FID_Verb 0 255 NUMBER 10 /end CHARACTERISTIC
/begin CHARACTERISTIC CAL_Vcf_CrawlDspd_f32 "CAL_Vcf_CrawlDspd_f32" VALUE 0x8014654C Scalar_FLOAT32_IEEE 0 BSW_A2L_Ident_Float -3.4E+38 3.4E+38 /end CHARACTERISTIC
/begin CHARACTERISTIC CAL_Vcf_NegDmpMaxSpeed_f32 "CAL_Vcf_NegDmpMaxSpeed_f32" VALUE 0x80146490 Scalar_FLOAT32_IEEE 0 BSW_A2L_Ident_Float -3.4E+38 3.4E+38 /end CHARACTERISTIC
/begin CHARACTERISTIC CAL_RdcRslExcFaultMax_f32 "CAL_RdcRslExcFaultMax_f32" VALUE 0x80140094 Scalar_FLOAT32_IEEE 0 BSW_A2L_Ident_Float -3.4E+38 3.4E+38 /end CHARACTERISTIC
/begin CHARACTERISTIC CAL_DEM_Disbl_DFC_IOHWAB_SttrTemp1SampFail_u8 "CAL_DEM_Disbl_DFC_IOHWAB_SttrTemp1SampFail_u8" VALUE 0x801465B0 Scalar_UBYTE 0 BSW_A2L_Ident_Int 0 255 /end CHARACTERISTIC
/begin CHARACTERISTIC CAL_DEM_Disbl_DFC_IOHWAB_SttrTemp2SampFail_u8 "CAL_DEM_Disbl_DFC_IOHWAB_SttrTemp2SampFail_u8" VALUE 0x801465AF Scalar_UBYTE 0 BSW_A2L_Ident_Int 0 255 /end CHARACTERISTIC
/begin CHARACTERISTIC CAL_DEM_Disbl_DFC_PCF_UnexpPosErr_u8 "CAL_DEM_Disbl_DFC_PCF_UnexpPosErr_u8" VALUE 0x80146596 Scalar_UBYTE 0 BSW_A2L_Ident_Int 0 255 /end CHARACTERISTIC
/begin CHARACTERISTIC CAL_DEM_Disbl_DFC_Cpld_UdcOverVolFail_u8 "CAL_DEM_Disbl_DFC_Cpld_UdcOverVolFail_u8" VALUE 0x801465DE Scalar_UBYTE 0 BSW_A2L_Ident_Int 0 255 /end CHARACTERISTIC
/begin CHARACTERISTIC CAL_DEM_Disbl_DFC_TPC_uDcLnkUnvWarn_u8 "CAL_DEM_Disbl_DFC_TPC_uDcLnkUnvWarn_u8" VALUE 0x80146571 Scalar_UBYTE 0 BSW_A2L_Ident_Int 0 255 /end CHARACTERISTIC
/begin CHARACTERISTIC CAL_DEM_FIM_DFC_RCF_FwlBwdOvTiErr_au8 "CAL_DEM_FIM_DFC_RCF_FwlBwdOvTiErr_au8" VAL_BLK 0x80146744 Scalar_UBYTE 0 FID_Verb 0 255 NUMBER 10 /end CHARACTERISTIC
/begin CHARACTERISTIC CAL_Pwm3ph_DutyMin_f32 "CAL_Pwm3ph_DutyMin_f32" VALUE 0x80140054 Scalar_FLOAT32_IEEE 0 BSW_A2L_Ident_Float -3.4E+38 3.4E+38 /end CHARACTERISTIC
/begin CHARACTERISTIC CAL_DEM_FIM_DFC_Event_NvM_ReadErr_au8 "CAL_DEM_FIM_DFC_Event_NvM_ReadErr_au8" VAL_BLK 0x801469EC Scalar_UBYTE 0 FID_Verb 0 255 NUMBER 10 /end CHARACTERISTIC
/begin CHARACTERISTIC CAL_Vcf_TrqDmpPosMax_f32 "CAL_Vcf_TrqDmpPosMax_f32" VALUE 0x8014644C Scalar_FLOAT32_IEEE 0 BSW_A2L_Ident_Float -3.4E+38 3.4E+38 /end CHARACTERISTIC
/begin CHARACTERISTIC CAL_DEM_Disbl_DFC_TPC_SpdOvHiLimFail_u8 "CAL_DEM_Disbl_DFC_TPC_SpdOvHiLimFail_u8" VALUE 0x80146588 Scalar_UBYTE 0 BSW_A2L_Ident_Int 0 255 /end CHARACTERISTIC
/begin CHARACTERISTIC CAL_DEM_FIM_DFC_IgbtDrv_UpBrgFaultBFail_au8 "CAL_DEM_FIM_DFC_IgbtDrv_UpBrgFaultBFail_au8" VAL_BLK 0x80146816 Scalar_UBYTE 0 FID_Verb 0 255 NUMBER 10 /end CHARACTERISTIC
/begin CHARACTERISTIC CAL_DEM_Disbl_DFC_TPC_TIGBTOvHiWarn_u8 "CAL_DEM_Disbl_DFC_TPC_TIGBTOvHiWarn_u8" VALUE 0x8014657B Scalar_UBYTE 0 BSW_A2L_Ident_Int 0 255 /end CHARACTERISTIC
/begin CHARACTERISTIC CAL_RDC_tiRsvlAngleSample_f32 "CAL_RDC_tiRsvlAngleSample_f32" VALUE 0x80140068 Scalar_FLOAT32_IEEE 0 BSW_A2L_Ident_Float -3.4E+38 3.4E+38 /end CHARACTERISTIC
/begin CHARACTERISTIC CAL_DEM_Disbl_DFC_TPC_TSttrOvHiLimFail_u8 "CAL_DEM_Disbl_DFC_TPC_TSttrOvHiLimFail_u8" VALUE 0x80146579 Scalar_UBYTE 0 BSW_A2L_Ident_Int 0 255 /end CHARACTERISTIC
/begin CHARACTERISTIC CAL_DEM_FIM_DFC_Cpld_AliveChkErr_au8 "CAL_DEM_FIM_DFC_Cpld_AliveChkErr_au8" VAL_BLK 0x80146AA0 Scalar_UBYTE 0 FID_Verb 0 255 NUMBER 10 /end CHARACTERISTIC
/begin CHARACTERISTIC CAL_Vcf_OvCrawlRspd_f32 "CAL_Vcf_OvCrawlRspd_f32" VALUE 0x80146480 Scalar_FLOAT32_IEEE 0 BSW_A2L_Ident_Float -3.4E+38 3.4E+38 /end CHARACTERISTIC
/begin CHARACTERISTIC CAL_Vcf_flgUseSLCal_b "CAL_Vcf_flgUseSLCal_b" VALUE 0x80146420 Scalar_BOOLEAN 0 BSW_A2L_Ident_Int 0 1 /end CHARACTERISTIC
/begin CHARACTERISTIC CAL_DEM_FIM_DFC_IOHWAB_SttrTemp2SampFail_au8 "CAL_DEM_FIM_DFC_IOHWAB_SttrTemp2SampFail_au8" VAL_BLK 0x8014685C Scalar_UBYTE 0 FID_Verb 0 255 NUMBER 10 /end CHARACTERISTIC
/begin CHARACTERISTIC CAL_Vcf_GenElecSpd_f32 "CAL_Vcf_GenElecSpd_f32" VALUE 0x801464A0 Scalar_FLOAT32_IEEE 0 BSW_A2L_Ident_Float -3.4E+38 3.4E+38 /end CHARACTERISTIC
/begin CHARACTERISTIC CAL_DMA_buffer_flag_u8 "CAL_DMA_buffer_flag_u8" VALUE 0x80140012 Scalar_UBYTE 0 BSW_A2L_Ident_Int 0 255 /end CHARACTERISTIC
/begin CHARACTERISTIC CAL_TRSP_OfstErrRst_b "CAL_TRSP_OfstErrRst_b" VALUE 0x80146340 Scalar_BOOLEAN 0 BSW_A2L_Ident_Int 0 1 /end CHARACTERISTIC
/begin CHARACTERISTIC CAL_RDC_RslRefMin_s32 "CAL_RDC_RslRefMin_s32" VALUE 0x80140088 Scalar_LONG 0 BSW_A2L_Ident_Int -2147483648 2147483647 /end CHARACTERISTIC
/begin CHARACTERISTIC CAL_RDC_RslRefMax_s32 "CAL_RDC_RslRefMax_s32" VALUE 0x8014008C Scalar_LONG 0 BSW_A2L_Ident_Int -2147483648 2147483647 /end CHARACTERISTIC
/begin CHARACTERISTIC CAL_DEM_FIM_DFC_MDF_OpenCirNoPsblErr_au8 "CAL_DEM_FIM_DFC_MDF_OpenCirNoPsblErr_au8" VAL_BLK 0x801467D0 Scalar_UBYTE 0 FID_Verb 0 255 NUMBER 10 /end CHARACTERISTIC
/begin CHARACTERISTIC CAL_DEM_Disbl_DFC_TPC_uDcLnkUnVLimFail_u8 "CAL_DEM_Disbl_DFC_TPC_uDcLnkUnVLimFail_u8" VALUE 0x80146572 Scalar_UBYTE 0 BSW_A2L_Ident_Int 0 255 /end CHARACTERISTIC
/begin CHARACTERISTIC CAL_DEM_FIM_DFC_HvMcu_UartLostFrameErr_au8 "CAL_DEM_FIM_DFC_HvMcu_UartLostFrameErr_au8" VAL_BLK 0x80146960 Scalar_UBYTE 0 FID_Verb 0 255 NUMBER 10 /end CHARACTERISTIC
/begin CHARACTERISTIC CAL_Vcf_trqSlopeCoffent_f32 "CAL_Vcf_trqSlopeCoffent_f32" VALUE 0x80146378 Scalar_FLOAT32_IEEE 0 BSW_A2L_Ident_Float -3.4E+38 3.4E+38 /end CHARACTERISTIC
/begin CHARACTERISTIC CAL_IOHWAB_AN30_IUVW_N_REF_MAX_f32 "CAL_IOHWAB_AN30_IUVW_N_REF_MAX_f32" VALUE 0x801400B0 Scalar_FLOAT32_IEEE 0 BSW_A2L_Ident_Float -3.4E+38 3.4E+38 /end CHARACTERISTIC
/begin CHARACTERISTIC CAL_DEM_Disbl_DFC_Event_NvM_WriteErr_u8 "CAL_DEM_Disbl_DFC_Event_NvM_WriteErr_u8" VALUE 0x801465D6 Scalar_UBYTE 0 BSW_A2L_Ident_Int 0 255 /end CHARACTERISTIC
/begin CHARACTERISTIC CAL_DEM_Disbl_DFC_HSPF_VerMatchFailureErr_u8 "CAL_DEM_Disbl_DFC_HSPF_VerMatchFailureErr_u8" VALUE 0x801465D2 Scalar_UBYTE 0 BSW_A2L_Ident_Int 0 255 /end CHARACTERISTIC
/begin CHARACTERISTIC CAL_DEM_FIM_DFC_IOHWAB_Cpld3v3SampFail_au8 "CAL_DEM_FIM_DFC_IOHWAB_Cpld3v3SampFail_au8" VAL_BLK 0x801468CA Scalar_UBYTE 0 FID_Verb 0 255 NUMBER 10 /end CHARACTERISTIC
/begin CHARACTERISTIC CAL_DEM_FIM_DFC_TPC_TDbcUHiLimFail_au8 "CAL_DEM_FIM_DFC_TPC_TDbcUHiLimFail_au8" VAL_BLK 0x801466A4 Scalar_UBYTE 0 FID_Verb 0 255 NUMBER 10 /end CHARACTERISTIC
/begin CHARACTERISTIC CAL_Vcf_CrawlNsetR_f32 "CAL_Vcf_CrawlNsetR_f32" VALUE 0x80146544 Scalar_FLOAT32_IEEE 0 BSW_A2L_Ident_Float -3.4E+38 3.4E+38 /end CHARACTERISTIC
/begin CHARACTERISTIC CAL_TRSP_ReqTrqCountTrh_s16 "CAL_TRSP_ReqTrqCountTrh_s16" VALUE 0x80146334 Scalar_SWORD 0 BSW_A2L_Ident_Int -32768 32767 /end CHARACTERISTIC
/begin CHARACTERISTIC CAL_Cpld_State_Fault_Debounce_Max_u8 "CAL_Cpld_State_Fault_Debounce_Max_u8" VALUE 0x80140001 Scalar_UBYTE 0 BSW_A2L_Ident_Int 0 255 /end CHARACTERISTIC
/begin CHARACTERISTIC CAL_DEM_FIM_DFC_HSPF_InvOpenErr_au8 "CAL_DEM_FIM_DFC_HSPF_InvOpenErr_au8" VAL_BLK 0x801469CE Scalar_UBYTE 0 FID_Verb 0 255 NUMBER 10 /end CHARACTERISTIC
/begin CHARACTERISTIC CAL_DEM_Disbl_DFC_TPC_uDcLnkOvWarn_u8 "CAL_DEM_Disbl_DFC_TPC_uDcLnkOvWarn_u8" VALUE 0x80146573 Scalar_UBYTE 0 BSW_A2L_Ident_Int 0 255 /end CHARACTERISTIC
/begin CHARACTERISTIC CAL_Vcf_TrqHoldOutLim_f32 "CAL_Vcf_TrqHoldOutLim_f32" VALUE 0x80146434 Scalar_FLOAT32_IEEE 0 BSW_A2L_Ident_Float -3.4E+38 3.4E+38 /end CHARACTERISTIC
/begin CHARACTERISTIC CAL_DEM_Disbl_DFC_IOHWAB_KL30UnderVolErr_u8 "CAL_DEM_Disbl_DFC_IOHWAB_KL30UnderVolErr_u8" VALUE 0x801465B3 Scalar_UBYTE 0 BSW_A2L_Ident_Int 0 255 /end CHARACTERISTIC
/begin CHARACTERISTIC CAL_DEM_FIM_DFC_IOHWAB_TCoolantSampFail_au8 "CAL_DEM_FIM_DFC_IOHWAB_TCoolantSampFail_au8" VAL_BLK 0x80146852 Scalar_UBYTE 0 FID_Verb 0 255 NUMBER 10 /end CHARACTERISTIC
/begin CHARACTERISTIC CAL_DEM_FIM_DFC_IOHWAB_SttrSenorShrFail_au8 "CAL_DEM_FIM_DFC_IOHWAB_SttrSenorShrFail_au8" VAL_BLK 0x80146870 Scalar_UBYTE 0 FID_Verb 0 255 NUMBER 10 /end CHARACTERISTIC
/begin CHARACTERISTIC CAL_DEM_FIM_DFC_IOHWAB_3V3MCU_SampFail_au8 "CAL_DEM_FIM_DFC_IOHWAB_3V3MCU_SampFail_au8" VAL_BLK 0x801468FC Scalar_UBYTE 0 FID_Verb 0 255 NUMBER 10 /end CHARACTERISTIC
/begin CHARACTERISTIC CAL_DEM_FIM_DFC_MDF_AlOfsNoPlausErr_au8 "CAL_DEM_FIM_DFC_MDF_AlOfsNoPlausErr_au8" VAL_BLK 0x8014680C Scalar_UBYTE 0 FID_Verb 0 255 NUMBER 10 /end CHARACTERISTIC
/begin CHARACTERISTIC CAL_DEM_FIM_DFC_PCF_SenClbErr_au8 "CAL_DEM_FIM_DFC_PCF_SenClbErr_au8" VAL_BLK 0x8014678A Scalar_UBYTE 0 FID_Verb 0 255 NUMBER 10 /end CHARACTERISTIC
/begin CHARACTERISTIC CAL_POWER_UBSBC_Threhold_V3_f32 "CAL_POWER_UBSBC_Threhold_V3_f32" VALUE 0x80140040 Scalar_FLOAT32_IEEE 0 BSW_A2L_Ident_Float -3.4E+38 3.4E+38 /end CHARACTERISTIC
/begin CHARACTERISTIC CAL_DEM_FIM_DFC_TPC_TCoolantOvHiWarn_au8 "CAL_DEM_FIM_DFC_TPC_TCoolantOvHiWarn_au8" VAL_BLK 0x801466C2 Scalar_UBYTE 0 FID_Verb 0 255 NUMBER 10 /end CHARACTERISTIC
/begin CHARACTERISTIC CAL_RDC_nWofltDelay_u16 "CAL_RDC_nWofltDelay_u16" VALUE 0x8014006C Scalar_UWORD 0 BSW_A2L_Ident_Int 0 65535 /end CHARACTERISTIC
/begin CHARACTERISTIC CAL_Vcf_tSlopAddMax_u16 "CAL_Vcf_tSlopAddMax_u16" VALUE 0x80146384 Scalar_UWORD 0 BSW_A2L_Ident_Int 0 65535 /end CHARACTERISTIC
/begin CHARACTERISTIC CAL_DEM_Disbl_DFC_IOHWAB_3V3MCU_SampFail_u8 "CAL_DEM_Disbl_DFC_IOHWAB_3V3MCU_SampFail_u8" VALUE 0x801465BF Scalar_UBYTE 0 BSW_A2L_Ident_Int 0 255 /end CHARACTERISTIC
/begin CHARACTERISTIC CAL_TRSP_RslvSqrtHiLim_u16 "CAL_TRSP_RslvSqrtHiLim_u16" VALUE 0x801462F6 Scalar_UWORD 0 BSW_A2L_Ident_Int 0 65535 /end CHARACTERISTIC
/begin CHARACTERISTIC CAL_DEM_Disbl_DFC_Event_NvM_ReadErr_u8 "CAL_DEM_Disbl_DFC_Event_NvM_ReadErr_u8" VALUE 0x801465D7 Scalar_UBYTE 0 BSW_A2L_Ident_Int 0 255 /end CHARACTERISTIC
/begin CHARACTERISTIC CAL_TRSP_ReqTrqLoLim_f32 "CAL_TRSP_ReqTrqLoLim_f32" VALUE 0x80146328 Scalar_FLOAT32_IEEE 0 BSW_A2L_Ident_Float -3.4E+38 3.4E+38 /end CHARACTERISTIC
/begin CHARACTERISTIC CAL_DEM_Disbl_DFC_HvMcu_DisChrgFail_u8 "CAL_DEM_Disbl_DFC_HvMcu_DisChrgFail_u8" VALUE 0x801465CD Scalar_UBYTE 0 BSW_A2L_Ident_Int 0 255 /end CHARACTERISTIC
/begin CHARACTERISTIC CAL_DEM_FIM_DFC_RCF_FwlFwdOvTiErr_au8 "CAL_DEM_FIM_DFC_RCF_FwlFwdOvTiErr_au8" VAL_BLK 0x8014673A Scalar_UBYTE 0 FID_Verb 0 255 NUMBER 10 /end CHARACTERISTIC
/begin CHARACTERISTIC CAL_DEM_Disbl_DFC_Can_Timeout_u8 "CAL_DEM_Disbl_DFC_Can_Timeout_u8" VALUE 0x801465EA Scalar_UBYTE 0 BSW_A2L_Ident_Int 0 255 /end CHARACTERISTIC
/begin CHARACTERISTIC CAL_DEM_Disbl_DFC_HvMcu_UdcOverFlagLimit_u8 "CAL_DEM_Disbl_DFC_HvMcu_UdcOverFlagLimit_u8" VALUE 0x801465C7 Scalar_UBYTE 0 BSW_A2L_Ident_Int 0 255 /end CHARACTERISTIC
/begin CHARACTERISTIC CAL_IOHWAB_AN29_IUVW_P_REF_MIN_f32 "CAL_IOHWAB_AN29_IUVW_P_REF_MIN_f32" VALUE 0x801400B4 Scalar_FLOAT32_IEEE 0 BSW_A2L_Ident_Float -3.4E+38 3.4E+38 /end CHARACTERISTIC
/begin CHARACTERISTIC CAL_DEM_Disbl_DFC_TPC_TCoolantOvHiWarn_u8 "CAL_DEM_Disbl_DFC_TPC_TCoolantOvHiWarn_u8" VALUE 0x80146586 Scalar_UBYTE 0 BSW_A2L_Ident_Int 0 255 /end CHARACTERISTIC
/begin CHARACTERISTIC CAL_DEM_FIM_DFC_PCF_UnexpPosErr_au8 "CAL_DEM_FIM_DFC_PCF_UnexpPosErr_au8" VAL_BLK 0x80146762 Scalar_UBYTE 0 FID_Verb 0 255 NUMBER 10 /end CHARACTERISTIC
/begin CHARACTERISTIC CAL_DEM_FIM_DFC_IOHWAB_SttrTemp1SampFail_au8 "CAL_DEM_FIM_DFC_IOHWAB_SttrTemp1SampFail_au8" VAL_BLK 0x80146866 Scalar_UBYTE 0 FID_Verb 0 255 NUMBER 10 /end CHARACTERISTIC
/begin CHARACTERISTIC CAL_HardComp_f32 "CAL_HardComp_f32" VALUE 0x80140020 Scalar_FLOAT32_IEEE 0 BSW_A2L_Ident_Float -3.4E+38 3.4E+38 /end CHARACTERISTIC
/begin CHARACTERISTIC CAL_Vcf_StepSlopeFunSwt_b "CAL_Vcf_StepSlopeFunSwt_b" VALUE 0x80146460 Scalar_BOOLEAN 0 BSW_A2L_Ident_Int 0 1 /end CHARACTERISTIC
/begin CHARACTERISTIC CAL_TRSP_iPhaWOffset_f32 "CAL_TRSP_iPhaWOffset_f32" VALUE 0x801462BC Scalar_FLOAT32_IEEE 0 BSW_A2L_Ident_Float -3.4E+38 3.4E+38 /end CHARACTERISTIC
/begin CHARACTERISTIC CAL_DEM_FIM_DFC_HSPF_VerMatchFailureErr_au8 "CAL_DEM_FIM_DFC_HSPF_VerMatchFailureErr_au8" VAL_BLK 0x801469BA Scalar_UBYTE 0 FID_Verb 0 255 NUMBER 10 /end CHARACTERISTIC
/begin CHARACTERISTIC CAL_DEM_Disbl_DFC_Cpld_Short_Circuit_LS_InFail_u8 "CAL_DEM_Disbl_DFC_Cpld_Short_Circuit_LS_InFail_u8" VALUE 0x801465DF Scalar_UBYTE 0 BSW_A2L_Ident_Int 0 255 /end CHARACTERISTIC
/begin CHARACTERISTIC CAL_DEM_Disbl_DFC_IOHWAB_18VLwBrgSampFail_u8 "CAL_DEM_Disbl_DFC_IOHWAB_18VLwBrgSampFail_u8" VALUE 0x801465C2 Scalar_UBYTE 0 BSW_A2L_Ident_Int 0 255 /end CHARACTERISTIC
/begin CHARACTERISTIC CAL_DEM_Disbl_DFC_IgbtDrv_LwBrgFaultBFail_u8 "CAL_DEM_Disbl_DFC_IgbtDrv_LwBrgFaultBFail_u8" VALUE 0x801465AA Scalar_UBYTE 0 BSW_A2L_Ident_Int 0 255 /end CHARACTERISTIC
/begin CHARACTERISTIC CAL_POWER_UBSBC_Threhold_V1_f32 "CAL_POWER_UBSBC_Threhold_V1_f32" VALUE 0x80140048 Scalar_FLOAT32_IEEE 0 BSW_A2L_Ident_Float -3.4E+38 3.4E+38 /end CHARACTERISTIC
/begin CHARACTERISTIC CAL_TRSP_iPhasSensVoltLoLim_u16 "CAL_TRSP_iPhasSensVoltLoLim_u16" VALUE 0x801462B0 Scalar_UWORD 0 BSW_A2L_Ident_Int 0 65535 /end CHARACTERISTIC
/begin CHARACTERISTIC CAL_DEM_FIM_DFC_FR_StorageErr_au8 "CAL_DEM_FIM_DFC_FR_StorageErr_au8" VAL_BLK 0x801469D8 Scalar_UBYTE 0 FID_Verb 0 255 NUMBER 10 /end CHARACTERISTIC
/begin CHARACTERISTIC CAL_TRSP_TorqueCtlMode_u8 "CAL_TRSP_TorqueCtlMode_u8" VALUE 0x801462F2 Scalar_UBYTE 0 BSW_A2L_Ident_Int 0 255 /end CHARACTERISTIC
/begin CHARACTERISTIC CAL_DEM_FIM_DFC_HvMcu_DisChrgFreqErr_au8 "CAL_DEM_FIM_DFC_HvMcu_DisChrgFreqErr_au8" VAL_BLK 0x8014697E Scalar_UBYTE 0 FID_Verb 0 255 NUMBER 10 /end CHARACTERISTIC
/begin CHARACTERISTIC CAL_CddEparkTEST_ManualSwitch_b "CAL_CddEparkTEST_ManualSwitch_b" VALUE 0x8014000D Scalar_BOOLEAN 0 BSW_A2L_Ident_Int 0 1 /end CHARACTERISTIC
/begin CHARACTERISTIC CAL_Vcf_NormalTrqSlope_u8 "CAL_Vcf_NormalTrqSlope_u8" VALUE 0x80146488 Scalar_UBYTE 0 BSW_A2L_Ident_Int 0 255 /end CHARACTERISTIC
/begin CHARACTERISTIC CAL_DEM_FIM_DFC_HSPF_stIphaOffCalFail_au8 "CAL_DEM_FIM_DFC_HSPF_stIphaOffCalFail_au8" VAL_BLK 0x801469B0 Scalar_UBYTE 0 FID_Verb 0 255 NUMBER 10 /end CHARACTERISTIC
/begin CHARACTERISTIC CAL_DEM_Disbl_DFC_ADC_WPhaseBISTFail_u8 "CAL_DEM_Disbl_DFC_ADC_WPhaseBISTFail_u8" VALUE 0x801465ED Scalar_UBYTE 0 BSW_A2L_Ident_Int 0 255 /end CHARACTERISTIC
/begin CHARACTERISTIC CAL_DEM_FIM_DFC_Can_Timeout_au8 "CAL_DEM_FIM_DFC_Can_Timeout_au8" VAL_BLK 0x80146AAA Scalar_UBYTE 0 FID_Verb 0 255 NUMBER 10 /end CHARACTERISTIC
/begin CHARACTERISTIC CAL_DEM_Disbl_DFC_SCF_LowPwrShtDwnOvTiFail_u8 "CAL_DEM_Disbl_DFC_SCF_LowPwrShtDwnOvTiFail_u8" VALUE 0x8014658A Scalar_UBYTE 0 BSW_A2L_Ident_Int 0 255 /end CHARACTERISTIC
/begin CHARACTERISTIC CAL_DEM_Disbl_DFC_HSPF_InvOpenErr_u8 "CAL_DEM_Disbl_DFC_HSPF_InvOpenErr_u8" VALUE 0x801465D4 Scalar_UBYTE 0 BSW_A2L_Ident_Int 0 255 /end CHARACTERISTIC
/begin CHARACTERISTIC CAL_Vcf_CrawltrqLo_f32 "CAL_Vcf_CrawltrqLo_f32" VALUE 0x80146538 Scalar_FLOAT32_IEEE 0 BSW_A2L_Ident_Float -3.4E+38 3.4E+38 /end CHARACTERISTIC
/begin CHARACTERISTIC CAL_Vcf_PosDmpMaxSpeed_f32 "CAL_Vcf_PosDmpMaxSpeed_f32" VALUE 0x80146478 Scalar_FLOAT32_IEEE 0 BSW_A2L_Ident_Float -3.4E+38 3.4E+38 /end CHARACTERISTIC
/begin CHARACTERISTIC CAL_SnapshotRam_TriggerFault_u8 "CAL_SnapshotRam_TriggerFault_u8" VALUE 0x8014009E Scalar_UBYTE 0 BSW_A2L_Ident_Int 0 255 /end CHARACTERISTIC
/begin CHARACTERISTIC CAL_DEM_Disbl_DFC_Epark_SampFail_u8 "CAL_DEM_Disbl_DFC_Epark_SampFail_u8" VALUE 0x801465D8 Scalar_UBYTE 0 BSW_A2L_Ident_Int 0 255 /end CHARACTERISTIC
/begin CHARACTERISTIC CAL_DEM_FIM_DFC_IOHWAB_5VQt1SampFail_au8 "CAL_DEM_FIM_DFC_IOHWAB_5VQt1SampFail_au8" VAL_BLK 0x801468E8 Scalar_UBYTE 0 FID_Verb 0 255 NUMBER 10 /end CHARACTERISTIC
/begin CHARACTERISTIC CAL_DEM_Disbl_DFC_RCF_AccOvTiErr_u8 "CAL_DEM_Disbl_DFC_RCF_AccOvTiErr_u8" VALUE 0x80146595 Scalar_UBYTE 0 BSW_A2L_Ident_Int 0 255 /end CHARACTERISTIC
/begin CHARACTERISTIC CAL_TRSP_iWCnvFac_f32 "CAL_TRSP_iWCnvFac_f32" VALUE 0x801462A4 Scalar_FLOAT32_IEEE 0 BSW_A2L_Ident_Float -3.4E+38 3.4E+38 /end CHARACTERISTIC
/begin CHARACTERISTIC CAL_Vcf_ActiveCnt_u8 "CAL_Vcf_ActiveCnt_u8" VALUE 0x80146564 Scalar_UBYTE 0 BSW_A2L_Ident_Int 0 255 /end CHARACTERISTIC
/begin CHARACTERISTIC CAL_DEM_Disbl_DFC_PCF_IdcOvErr_u8 "CAL_DEM_Disbl_DFC_PCF_IdcOvErr_u8" VALUE 0x8014659C Scalar_UBYTE 0 BSW_A2L_Ident_Int 0 255 /end CHARACTERISTIC
/begin CHARACTERISTIC CAL_DEM_FIM_DFC_PCF_StallWarn_au8 "CAL_DEM_FIM_DFC_PCF_StallWarn_au8" VAL_BLK 0x8014676C Scalar_UBYTE 0 FID_Verb 0 255 NUMBER 10 /end CHARACTERISTIC
/begin CHARACTERISTIC CAL_DEM_Disbl_DFC_MDF_PrfElDrvErr_u8 "CAL_DEM_Disbl_DFC_MDF_PrfElDrvErr_u8" VALUE 0x8014659E Scalar_UBYTE 0 BSW_A2L_Ident_Int 0 255 /end CHARACTERISTIC
/begin CHARACTERISTIC CAL_Vcf_ActiveCntAver_f32 "CAL_Vcf_ActiveCntAver_f32" VALUE 0x80146568 Scalar_FLOAT32_IEEE 0 BSW_A2L_Ident_Float -3.4E+38 3.4E+38 /end CHARACTERISTIC
/begin CHARACTERISTIC CAL_DEM_FIM_DFC_ADC_VPhaseBISTFail_au8 "CAL_DEM_FIM_DFC_ADC_VPhaseBISTFail_au8" VAL_BLK 0x80146AD2 Scalar_UBYTE 0 FID_Verb 0 255 NUMBER 10 /end CHARACTERISTIC
/begin CHARACTERISTIC CAL_TRSP_UB_SBCCnvFac_f32 "CAL_TRSP_UB_SBCCnvFac_f32" VALUE 0x801462E4 Scalar_FLOAT32_IEEE 0 BSW_A2L_Ident_Float -3.4E+38 3.4E+38 /end CHARACTERISTIC
/begin CHARACTERISTIC CAL_DEM_FIM_DFC_TPC_TSttrOvLoWarn_au8 "CAL_DEM_FIM_DFC_TPC_TSttrOvLoWarn_au8" VAL_BLK 0x8014662C Scalar_UBYTE 0 FID_Verb 0 255 NUMBER 10 /end CHARACTERISTIC
/begin CHARACTERISTIC CAL_DEM_Disbl_DFC_PCF_StallRetryErr_u8 "CAL_DEM_Disbl_DFC_PCF_StallRetryErr_u8" VALUE 0x80146598 Scalar_UBYTE 0 BSW_A2L_Ident_Int 0 255 /end CHARACTERISTIC
/begin CHARACTERISTIC CAL_DEM_Disbl_DFC_TPC_TIGBTOvHiLimErr_u8 "CAL_DEM_Disbl_DFC_TPC_TIGBTOvHiLimErr_u8" VALUE 0x8014657C Scalar_UBYTE 0 BSW_A2L_Ident_Int 0 255 /end CHARACTERISTIC
/begin CHARACTERISTIC CAL_Hvmcu_DClink_Gain_f32 "CAL_Hvmcu_DClink_Gain_f32" VALUE 0x8014001C Scalar_FLOAT32_IEEE 0 BSW_A2L_Ident_Float -3.4E+38 3.4E+38 /end CHARACTERISTIC
/begin CHARACTERISTIC CAL_Vcf_TrqFbkLMinNeg_f32 "CAL_Vcf_TrqFbkLMinNeg_f32" VALUE 0x8014643C Scalar_FLOAT32_IEEE 0 BSW_A2L_Ident_Float -3.4E+38 3.4E+38 /end CHARACTERISTIC
/begin CHARACTERISTIC CAL_DEM_Disbl_DFC_Cpld_Short_Circuit_HS_InFail_u8 "CAL_DEM_Disbl_DFC_Cpld_Short_Circuit_HS_InFail_u8" VALUE 0x801465E0 Scalar_UBYTE 0 BSW_A2L_Ident_Int 0 255 /end CHARACTERISTIC
/begin CHARACTERISTIC CAL_Vcf_stModeReqTabY_af32 "" CURVE 0x8014638C Lookup1D_FLOAT32_IEEE 0 SWC_VCF_CM_single -3.4E+38 3.4E+38
 /begin AXIS_DESCR COM_AXIS NO_INPUT_QUANTITY SWC_VCF_CM_single 16 -3.4E+38 3.4E+38 AXIS_PTS_REF CAL_Vcf_stModeReqTabX_af32 /end AXIS_DESCR
/end CHARACTERISTIC
/begin CHARACTERISTIC CAL_Vcf_DampingMatrixA_af32 "" VAL_BLK 0x801464E8 Scalar_FLOAT32_IEEE 0 SWC_VCF_CM_single -3.4E+38 3.4E+38 NUMBER 16 /end CHARACTERISTIC
/begin CHARACTERISTIC CAL_Vcf_DampingMatrixB_af32 "" VAL_BLK 0x801464D8 Scalar_FLOAT32_IEEE 0 SWC_VCF_CM_single -3.4E+38 3.4E+38 NUMBER 4 /end CHARACTERISTIC
/begin CHARACTERISTIC CAL_Vcf_DampingMatrixC_af32 "" VAL_BLK 0x801464C8 Scalar_FLOAT32_IEEE 0 SWC_VCF_CM_single -3.4E+38 3.4E+38 NUMBER 4 /end CHARACTERISTIC
/begin CHARACTERISTIC CAL_Vcf_DampingMatrixLp_af32 "" VAL_BLK 0x801464B8 Scalar_FLOAT32_IEEE 0 SWC_VCF_CM_single -3.4E+38 3.4E+38 NUMBER 4 /end CHARACTERISTIC
/begin AXIS_PTS CAL_Vcf_stModeReqTabX_af32 "" 0x801463CC NO_INPUT_QUANTITY Lookup1D_X_FLOAT32_IEEE 0 SWC_VCF_CM_single 16 -3.4E+38 3.4E+38 /end AXIS_PTS
/begin GROUP S1_UBRVoltChk "SWC_TRSP/SWC_TRSP_100us_sys/UBRVoltChk"
 /begin REF_CHARACTERISTIC CAL_TRSP_UBRVoltCountTrh_s16 CAL_TRSP_UBRVoltDebTrh_s16 CAL_TRSP_UBRVoltErrRst_b /end REF_CHARACTERISTIC
 /begin REF_MEASUREMENT VAR_TRSP_UBRVoltRngErr_b /end REF_MEASUREMENT
 /begin SUB_GROUP S12_UBRVoltCompChk S12_UBR_SBCVoltCalc /end SUB_GROUP
/end GROUP
/begin GROUP S1_iPhasSensVoltChk "SWC_TRSP/SWC_TRSP_100us_sys/iPhasSensVoltChk"
 /begin REF_CHARACTERISTIC CAL_TRSP_iPhasSensVoltCountTrh_s16 CAL_TRSP_iPhasSensVoltDebTrh_s16 CAL_TRSP_iPhasSensVoltErrRst_b CAL_TRSP_iPhasSensVoltHiLim_u16 CAL_TRSP_iPhasSensVoltLoLim_u16 /end REF_CHARACTERISTIC
 /begin REF_MEASUREMENT VAR_TRSP_iPhasSensVoltRngChkRslt_b VAR_TRSP_iPhasSensVoltRngErr_b /end REF_MEASUREMENT
/end GROUP
/begin GROUP S2_CANSigChk "SWC_TRSP/SWC_TRSP_10ms_sys/CANSigChk"
 /begin REF_CHARACTERISTIC CAL_TRSP_ReqTrqCountTrh_s16 CAL_TRSP_ReqTrqDebTrh_s16 CAL_TRSP_ReqTrqErrRst_b CAL_TRSP_ReqTrqHiLim_f32 CAL_TRSP_ReqTrqLoLim_f32 /end REF_CHARACTERISTIC
 /begin REF_MEASUREMENT VAR_TRSP_TrqSetPRngChkRslt_b VAR_TRSP_TrqSetPRngErr_b /end REF_MEASUREMENT
/end GROUP
/begin GROUP S3_OfstAgChk "SWC_TRSP/SWC_TRSP_1ms_sys/OfstAgChk" /begin SUB_GROUP S94_OfstChk S94_OfstChkEnable /end SUB_GROUP /end GROUP
/begin GROUP S9_CurrSumChk "SWC_TRSP/SWC_TRSP_100us_sys/CurrChk/CurrSumChk" /begin REF_CHARACTERISTIC CAL_TRSP_CurrSumLim_f32 /end REF_CHARACTERISTIC /begin REF_MEASUREMENT VAR_TRSP_CurrSumChkRslt_b VAR_TRSP_iSum_f32 /end REF_MEASUREMENT /end GROUP
/begin GROUP S9_iPhaCalc "SWC_TRSP/SWC_TRSP_100us_sys/CurrChk/iPhaCalc"
 /begin REF_CHARACTERISTIC CAL_TRSP_flgChangPha_b CAL_TRSP_iPhaUOffset_f32 CAL_TRSP_iPhaVOffset_f32 CAL_TRSP_iPhaWOffset_f32 CAL_TRSP_iUCnvFac_f32 CAL_TRSP_iVCnvFac_f32 CAL_TRSP_iWCnvFac_f32 /end REF_CHARACTERISTIC
 /begin REF_MEASUREMENT VAR_TRSP_iU_f32 VAR_TRSP_iV_f32 VAR_TRSP_iW_f32 /end REF_MEASUREMENT
/end GROUP
/begin GROUP S10_RslvSigCalc "SWC_TRSP/SWC_TRSP_100us_sys/RslvChk/RslvSigCalc" /begin REF_MEASUREMENT VAR_TRSP_RslvCos_f32 VAR_TRSP_RslvSin_f32 /end REF_MEASUREMENT /end GROUP
/begin GROUP S10_RslvSqrtChk "SWC_TRSP/SWC_TRSP_100us_sys/RslvChk/RslvSqrtChk" /begin REF_CHARACTERISTIC CAL_TRSP_RslvSqrtHiLim_u16 CAL_TRSP_RslvSqrtLoLim_u16 /end REF_CHARACTERISTIC /begin REF_MEASUREMENT VAR_TRSP_RslvSqrtChkRslt_b VAR_TRSP_RslvSqrt_f32 /end REF_MEASUREMENT /end GROUP
/begin GROUP S12_UBRVoltCompChk "SWC_TRSP/SWC_TRSP_100us_sys/UBRVoltChk/UBRVoltCompChk" /begin REF_CHARACTERISTIC CAL_TRSP_Diff_UBR_SBCLim_f32 /end REF_CHARACTERISTIC /begin REF_MEASUREMENT VAR_TRSP_Diff_UBR_SBC_f32 VAR_TRSP_UBRVoltRngChkRslt_b /end REF_MEASUREMENT /end GROUP
/begin GROUP S12_UBR_SBCVoltCalc "SWC_TRSP/SWC_TRSP_100us_sys/UBRVoltChk/UBR_SBCVoltCalc" /begin REF_CHARACTERISTIC CAL_TRSP_UBRWIDECnvFac_f32 CAL_TRSP_UB_SBCCnvFac_f32 /end REF_CHARACTERISTIC /begin REF_MEASUREMENT VAR_TRSP_UBRWIDE_f32 VAR_TRSP_UB_SBC_f32 /end REF_MEASUREMENT /end GROUP
/begin GROUP S94_OfstChk "SWC_TRSP/SWC_TRSP_1ms_sys/OfstAgChk/OfstChk"
 /begin REF_CHARACTERISTIC CAL_TRSP_OfstErrRst_b CAL_TRSP_OfstRngHiLim_f32 CAL_TRSP_OfstRngLoLim_f32 /end REF_CHARACTERISTIC
 /begin REF_MEASUREMENT VAR_TRSP_OfstRngChkRslt_b /end REF_MEASUREMENT
 /begin SUB_GROUP S97_Lock /end SUB_GROUP
/end GROUP
/begin GROUP S94_OfstChkEnable "SWC_TRSP/SWC_TRSP_1ms_sys/OfstAgChk/OfstChkEnable" /begin REF_CHARACTERISTIC CAL_TRSP_SpeedCtlMode_u8 CAL_TRSP_TorqueCtlMode_u8 /end REF_CHARACTERISTIC /end GROUP
/begin GROUP S97_Lock "SWC_TRSP/SWC_TRSP_1ms_sys/OfstAgChk/OfstChk/Lock" /begin REF_MEASUREMENT VAR_TRSP_OfstRngErr_b /end REF_MEASUREMENT /end GROUP
/begin GROUP SWC_VCF "SWC_VCF" ROOT /begin SUB_GROUP Root_RE_SWC_VCF_10ms_sys Root_RE_SWC_VCF_2ms_sys /end SUB_GROUP /end GROUP
/begin GROUP Root_RE_SWC_VCF_10ms_sys "SWC_VCF/RE_SWC_VCF_10ms_sys" /begin SUB_GROUP S1_10ms /end SUB_GROUP /end GROUP
/begin GROUP Root_RE_SWC_VCF_2ms_sys "SWC_VCF/RE_SWC_VCF_2ms_sys" /begin SUB_GROUP S2_2ms /end SUB_GROUP /end GROUP
/begin GROUP S1_10ms "SWC_VCF/RE_SWC_VCF_10ms_sys/10ms" /begin SUB_GROUP S4_10ms /end SUB_GROUP /end GROUP
/begin GROUP S2_2ms "SWC_VCF/RE_SWC_VCF_2ms_sys/2ms" /begin SUB_GROUP S28_2msSub1 S28_CanSig_MAP S28_SignalSelect S28_Subsystem /end SUB_GROUP /end GROUP
/begin GROUP S4_10ms "SWC_VCF/RE_SWC_VCF_10ms_sys/10ms/10ms" /begin SUB_GROUP S5_AutoHold S5_Crawl S5_HoldStartTrqCal /end SUB_GROUP /end GROUP
/begin GROUP S28_2msSub1 "SWC_VCF/RE_SWC_VCF_2ms_sys/2ms/2msSub1"
 /begin REF_CHARACTERISTIC CAL_Vcf_StepSlopeFunSwt_b CAL_Vcf_TrqFbkLMaxNeg_f32 CAL_Vcf_TrqFbkLMax_f32 CAL_Vcf_TrqFbkLMinNeg_f32 CAL_Vcf_TrqFbkLMin_f32 CAL_Vcf_TrqSlopAccMax_f32 CAL_Vcf_TrqSlopAccStep_f32 CAL_Vcf_tSlopAddMax_u16 /end REF_CHARACTERISTIC
 /begin REF_MEASUREMENT VAR_Vcf_SlopeReq_f32 /end REF_MEASUREMENT
 /begin SUB_GROUP S29_ASRFunction S29_Damping_2ms S29_KpCal_2ms /end SUB_GROUP
/end GROUP
/begin GROUP S28_CanSig_MAP "SWC_VCF/RE_SWC_VCF_2ms_sys/2ms/CanSig_MAP" /begin REF_CHARACTERISTIC CAL_Vcf_stModeReqTabY_af32 /end REF_CHARACTERISTIC /end GROUP
/begin GROUP S28_SignalSelect "SWC_VCF/RE_SWC_VCF_2ms_sys/2ms/SignalSelect" /begin REF_CHARACTERISTIC CAL_Vcf_AutoHoldSpd_f32 /end REF_CHARACTERISTIC /end GROUP
/begin GROUP S28_Subsystem "SWC_VCF/RE_SWC_VCF_2ms_sys/2ms/Subsystem" /begin SUB_GROUP S32_TrqSelect S32_VCF_TrqResultant /end SUB_GROUP /end GROUP
/begin GROUP S5_AutoHold "SWC_VCF/RE_SWC_VCF_10ms_sys/10ms/10ms/AutoHold" /begin SUB_GROUP S6_Subsystem /end SUB_GROUP /end GROUP
/begin GROUP S5_Crawl "SWC_VCF/RE_SWC_VCF_10ms_sys/10ms/10ms/Crawl" /begin SUB_GROUP S7_CrawlMode S7_CrawlSpdCal S7_CrawlTrqCal /end SUB_GROUP /end GROUP
/begin GROUP S5_HoldStartTrqCal "SWC_VCF/RE_SWC_VCF_10ms_sys/10ms/10ms/HoldStartTrqCal"
 /begin REF_CHARACTERISTIC CAL_Vcf_CofHoldTrq_f32 CAL_Vcf_HoldTrqInSwt_b CAL_Vcf_HoldTrqLoadSwt_b CAL_Vcf_trqHoldMax_f32 CAL_Vcf_trqHoldMin_f32 /end REF_CHARACTERISTIC
/end GROUP
/begin GROUP S29_ASRFunction "SWC_VCF/RE_SWC_VCF_2ms_sys/2ms/2msSub1/ASRFunction" /begin SUB_GROUP S33_ASRFunction S33_FuntionEnableDetermine /end SUB_GROUP /end GROUP
/begin GROUP S29_Damping_2ms "SWC_VCF/RE_SWC_VCF_2ms_sys/2ms/2msSub1/Damping_2ms" /begin SUB_GROUP S34_Vcf_DmpCtl /end SUB_GROUP /end GROUP
/begin GROUP S29_KpCal_2ms "SWC_VCF/RE_SWC_VCF_2ms_sys/2ms/2msSub1/KpCal_2ms" /begin REF_CHARACTERISTIC CAL_Vcf_cnCtlNrm_f32 /end REF_CHARACTERISTIC /begin REF_MEASUREMENT VAR_Vcf_KpNCtl_f32 /end REF_MEASUREMENT /end GROUP
/begin GROUP S32_TrqSelect "SWC_VCF/RE_SWC_VCF_2ms_sys/2ms/Subsystem/TrqSelect"
 /begin REF_CHARACTERISTIC CAL_Vcf_Drv_go_alOffsetcalReq_u8 CAL_Vcf_SLCalTrqSlp_f32 CAL_Vcf_flgUseSLCal_b CAL_Vcf_trqSlopeCoffent_f32 /end REF_CHARACTERISTIC
 /begin REF_MEASUREMENT VAR_Vcf_trqDesUnProc_f32 VAR_Vcf_trqRmp_f32 /end REF_MEASUREMENT
/end GROUP
/begin GROUP S32_VCF_TrqResultant "SWC_VCF/RE_SWC_VCF_2ms_sys/2ms/Subsystem/VCF_TrqResultant" /begin REF_MEASUREMENT VAR_Vcf_trqDesAdDmp_f32 /end REF_MEASUREMENT /end GROUP
/begin GROUP S6_Subsystem "SWC_VCF/RE_SWC_VCF_10ms_sys/10ms/10ms/AutoHold/Subsystem" /begin REF_CHARACTERISTIC CAL_Vcf_HoldTimeCount_u16 CAL_Vcf_flgOpenHoldFcn_b /end REF_CHARACTERISTIC /begin REF_MEASUREMENT VAR_VCF_flgHoldModeReq_b /end REF_MEASUREMENT /begin SUB_GROUP S9_Subsystem /end SUB_GROUP /end GROUP
/begin GROUP S7_CrawlMode "SWC_VCF/RE_SWC_VCF_10ms_sys/10ms/10ms/Crawl/CrawlMode"
 /begin REF_CHARACTERISTIC CAL_Vcf_AccPedSet_f32 CAL_Vcf_BrkLgt_b CAL_Vcf_CrawlSwt_b CAL_Vcf_GearD_u8 CAL_Vcf_GearR_u8 CAL_Vcf_OvCrawlDspd_f32 CAL_Vcf_OvCrawlRspd_f32 CAL_Vcf_SpdCtlReq_u8 CAL_Vcf_StandByReq_u8 CAL_Vcf_TrqCtlReq_u8 CAL_Vcf_flgOpenCrawlFcn_b /end REF_CHARACTERISTIC
 /begin REF_MEASUREMENT VAR_Vcf_CrawlFlg_b /end REF_MEASUREMENT
/end GROUP
/begin GROUP S7_CrawlSpdCal "SWC_VCF/RE_SWC_VCF_10ms_sys/10ms/10ms/Crawl/CrawlSpdCal"
 /begin REF_CHARACTERISTIC CAL_Vcf_CrawlNsetD_f32 CAL_Vcf_CrawlNsetR_f32 CAL_Vcf_GearD_u8 CAL_Vcf_GearR_u8 CAL_Vcf_nSetRamp_f32 /end REF_CHARACTERISTIC
/end GROUP
/begin GROUP S7_CrawlTrqCal "SWC_VCF/RE_SWC_VCF_10ms_sys/10ms/10ms/Crawl/CrawlTrqCal"
 /begin REF_CHARACTERISTIC CAL_Vcf_CrawlDspd_f32 CAL_Vcf_CrawlNsetD_f32 CAL_Vcf_CrawlNsetR_f32 CAL_Vcf_CrawlRspd_f32 CAL_Vcf_CrawltrqLo_f32 CAL_Vcf_CrawltrqUp_f32 CAL_Vcf_Crawltrqadd1_f32 CAL_Vcf_Crawltrqadd2_f32 CAL_Vcf_Crawltrqsub_f32 CAL_Vcf_GearD_u8 CAL_Vcf_GearR_u8 /end REF_CHARACTERISTIC
/end GROUP
/begin GROUP S33_ASRFunction "SWC_VCF/RE_SWC_VCF_2ms_sys/2ms/2msSub1/ASRFunction/ASRFunction"
 /begin SUB_GROUP S37_SlopeValueChange S37_SpdChangeRatio S37_TorqueCalculate /end SUB_GROUP
/end GROUP
/begin GROUP S33_FuntionEnableDetermine "SWC_VCF/RE_SWC_VCF_2ms_sys/2ms/2msSub1/ASRFunction/FuntionEnableDetermine"
 /begin REF_CHARACTERISTIC CAL_Vcf_FunctionReqSwt_b CAL_Vcf_GenElecSpd_f32 CAL_Vcf_MotorDrvSpd_f32 /end REF_CHARACTERISTIC
/end GROUP
/begin GROUP S34_Vcf_DmpCtl "SWC_VCF/RE_SWC_VCF_2ms_sys/2ms/2msSub1/Damping_2ms/Vcf_DmpCtl"
 /begin SUB_GROUP S47_Subsystem S47_Vcf_FlgDmpCalc S47_Vcf_TrqDmpCalc S47_Vcf_nVehicleObsv /end SUB_GROUP
/end GROUP
/begin GROUP S37_SlopeValueChange "SWC_VCF/RE_SWC_VCF_2ms_sys/2ms/2msSub1/ASRFunction/ASRFunction/SlopeValueChange"
 /begin REF_CHARACTERISTIC CAL_Vcf_BetLimSlope_u8 CAL_Vcf_NormalTrqSlope_u8 CAL_Vcf_OvHiLimSlope_u8 CAL_Vcf_UnLoLimSlope_u8 CAL_Vcf_nAccChgHiLim_f32 CAL_Vcf_nAccChgLoLim_f32 /end REF_CHARACTERISTIC
 /begin REF_MEASUREMENT VAR_Vcf_SlopeChangePer_u8 /end REF_MEASUREMENT
/end GROUP
/begin GROUP S37_SpdChangeRatio "SWC_VCF/RE_SWC_VCF_2ms_sys/2ms/2msSub1/ASRFunction/ASRFunction/SpdChangeRatio" /begin REF_CHARACTERISTIC CAL_Vcf_ActiveCntAver_f32 CAL_Vcf_ActiveCnt_u8 /end REF_CHARACTERISTIC /begin REF_MEASUREMENT VAR_Vcf_CntAdding_u8 VAR_Vcf_SpdChangeRatio_f32 /end REF_MEASUREMENT /end GROUP
/begin GROUP S37_TorqueCalculate "SWC_VCF/RE_SWC_VCF_2ms_sys/2ms/2msSub1/ASRFunction/ASRFunction/TorqueCalculate" /begin SUB_GROUP S42_ASRSlipFlag S42_ASRTrqDes /end SUB_GROUP /end GROUP
/begin GROUP S47_Subsystem "SWC_VCF/RE_SWC_VCF_2ms_sys/2ms/2msSub1/Damping_2ms/Vcf_DmpCtl/Subsystem"
 /begin REF_CHARACTERISTIC CAL_Vcf_TrqDmpNegMax_f32 CAL_Vcf_TrqDmpPosMax_f32 CAL_Vcf_spdThredDmpNeg_f32 CAL_Vcf_spdThredDmpPos_f32 /end REF_CHARACTERISTIC
/end GROUP
/begin GROUP S47_Vcf_FlgDmpCalc "SWC_VCF/RE_SWC_VCF_2ms_sys/2ms/2msSub1/Damping_2ms/Vcf_DmpCtl/Vcf_FlgDmpCalc"
 /begin REF_CHARACTERISTIC CAL_Vcf_NegDmpMaxSpeed_f32 CAL_Vcf_NegDmpMaxTrq_f32 CAL_Vcf_PosDmpMaxSpeed_f32 CAL_Vcf_PosDmpMaxTrq_f32 /end REF_CHARACTERISTIC
 /begin REF_MEASUREMENT VAR_Vcf_flgDmpActv_b /end REF_MEASUREMENT
/end GROUP
/begin GROUP S47_Vcf_TrqDmpCalc "SWC_VCF/RE_SWC_VCF_2ms_sys/2ms/2msSub1/Damping_2ms/Vcf_DmpCtl/Vcf_TrqDmpCalc" /begin REF_CHARACTERISTIC CAL_Vcf_TrqDmpSwt_b /end REF_CHARACTERISTIC /begin REF_MEASUREMENT VAR_Vcf_TrqDmp_f32 /end REF_MEASUREMENT /end GROUP
/begin GROUP S47_Vcf_nVehicleObsv "SWC_VCF/RE_SWC_VCF_2ms_sys/2ms/2msSub1/Damping_2ms/Vcf_DmpCtl/Vcf_nVehicleObsv"
 /begin REF_CHARACTERISTIC CAL_Vcf_DampingMatrixA_af32 CAL_Vcf_DampingMatrixB_af32 CAL_Vcf_DampingMatrixC_af32 CAL_Vcf_DampingMatrixLp_af32 CAL_Vcf_tDamping_f32 /end REF_CHARACTERISTIC
 /begin REF_MEASUREMENT VAR_Vcf_nMotorObsv_f32 VAR_Vcf_nVehicleObsv_f32 VAR_Vcf_trqLoad_f32 /end REF_MEASUREMENT
/end GROUP
/begin GROUP S11_TrastoHoldIn "SWC_VCF/RE_SWC_VCF_10ms_sys/10ms/10ms/AutoHold/Subsystem/Subsystem/TrastoHoldIn"
 /begin REF_CHARACTERISTIC CAL_Vcf_BwdHoldInSpdLim_f32 CAL_Vcf_BwdHoldOutSpdLim_f32 CAL_Vcf_FwdHoldInSpdLim_f32 CAL_Vcf_FwdHoldOutSpdLim_f32 CAL_Vcf_GearLvD_u8 CAL_Vcf_GearLvR_u8 CAL_Vcf_HoldModVcuReq_u8 /end REF_CHARACTERISTIC
 /begin REF_MEASUREMENT VAR_Vcf_TranstoHoldIn_b /end REF_MEASUREMENT
/end GROUP
/begin GROUP S11_TrastoHoldOut "SWC_VCF/RE_SWC_VCF_10ms_sys/10ms/10ms/AutoHold/Subsystem/Subsystem/TrastoHoldOut"
 /begin REF_CHARACTERISTIC CAL_Vcf_BwdHoldOutSpdLim_f32 CAL_Vcf_FwdHoldOutSpdLim_f32 CAL_Vcf_GearHoldOutSwt_b CAL_Vcf_GearLvD_u8 CAL_Vcf_GearLvN_u8 CAL_Vcf_GearLvR_u8 CAL_Vcf_HoldModVcuReq_u8 CAL_Vcf_TrqHoldOutLim_f32 /end REF_CHARACTERISTIC
 /begin REF_MEASUREMENT VAR_Vcf_TranstoHoldOut_b /end REF_MEASUREMENT
/end GROUP
/begin GROUP S42_ASRSlipFlag "SWC_VCF/RE_SWC_VCF_2ms_sys/2ms/2msSub1/ASRFunction/ASRFunction/TorqueCalculate/ASRSlipFlag" /begin REF_CHARACTERISTIC CAL_Vcf_ReqTrqMechTrqDif_f32 /end REF_CHARACTERISTIC
 /begin REF_MEASUREMENT VAR_Vcf_AsrRatioUnLolim_b VAR_Vcf_AsrSlipFlg1_b VAR_Vcf_AsrSlipFlg2_b VAR_Vcf_SlipFlag_b /end REF_MEASUREMENT
/end GROUP
/begin GROUP S42_ASRTrqDes "SWC_VCF/RE_SWC_VCF_2ms_sys/2ms/2msSub1/ASRFunction/ASRFunction/TorqueCalculate/ASRTrqDes"
 /begin REF_CHARACTERISTIC CAL_Vcf_SpdDebounce_f32 CAL_Vcf_TrqAbsDiff_f32 CAL_Vcf_TrqDecRatio_f32 CAL_Vcf_nAccChgHiLim_f32 CAL_Vcf_nAccChgLoLim_f32 /end REF_CHARACTERISTIC
 /begin REF_MEASUREMENT VAR_Vcf_AsrOvHiLim_b VAR_Vcf_AsrUnLolim_b VAR_Vcf_TrqSrtPInside_f32 VAR_Vcf_flgTrqSetPDecAsr_b /end REF_MEASUREMENT
/end GROUP
/begin MEASUREMENT VAR_Cpld_Rx_Analys_u32 "VAR_Cpld_Rx_Analys_u32" ULONG BSW_A2L_Ident_Int 1 100 0 4294967295 ECU_ADDRESS 0x70003CD8 /end MEASUREMENT
/begin MEASUREMENT VAR_Cpld_State_Fault_Debounce_u8 "VAR_Cpld_State_Fault_Debounce_u8" UBYTE BSW_A2L_Ident_Int 1 100 0 255 ECU_ADDRESS 0x70003CE9 /end MEASUREMENT
/begin MEASUREMENT VAR_AdcInitSBC_u16 "VAR_AdcInitSBC_u16" UWORD BSW_A2L_Ident_Int 1 100 0 65535 ECU_ADDRESS 0x70003EE8 /end MEASUREMENT
/begin MEASUREMENT VAR_AdcInitSBC_Res_u16 "VAR_AdcInitSBC_Res_u16" UWORD BSW_A2L_Ident_Int 1 100 0 65535 ECU_ADDRESS 0x70003EEA /end MEASUREMENT
/begin MEASUREMENT VAR_AdcInitSBC_f32 "VAR_AdcInitSBC_f32" FLOAT32_IEEE BSW_A2L_Ident_Float 1 100 -3.4E+38 3.4E+38 ECU_ADDRESS 0x70003EEC /end MEASUREMENT
/begin MEASUREMENT VAR_SS1_OC_u8 "VAR_SS1_OC_u8" UBYTE BSW_A2L_Ident_Int 1 100 0 255 ECU_ADDRESS 0x70003F14 /end MEASUREMENT
/begin MEASUREMENT VAR_Pwm_Fault_Flag_u16 "VAR_Pwm_Fault_Flag_u16" UWORD BSW_A2L_Ident_Int 1 100 0 65535 ECU_ADDRESS 0x70003F16 /end MEASUREMENT
/begin MEASUREMENT VAR_IgbtDrv_Det_ReportError_u8 "VAR_IgbtDrv_Det_ReportError_u8" UBYTE BSW_A2L_Ident_Int 1 100 0 255 ECU_ADDRESS 0x60000714 /end MEASUREMENT
/begin MEASUREMENT VAR_DEM_Event_IOHWAB_12VSampErr_Status_u8 "VAR_DEM_Event_IOHWAB_12VSampErr_Status_u8" UBYTE BSW_A2L_Ident_Int 1 100 0 255 ECU_ADDRESS 0x700061E0 /end MEASUREMENT
/begin MEASUREMENT VAR_Shut_Of_Path_State_u16 "VAR_Shut_Of_Path_State_u16" UWORD BSW_A2L_Ident_Int 1 100 0 65535 ECU_ADDRESS 0x70003D20 /end MEASUREMENT
/begin MEASUREMENT VAR_DEM_Event_IOHWAB_5VQcoSampFail_Status_u8 "VAR_DEM_Event_IOHWAB_5VQcoSampFail_Status_u8" UBYTE BSW_A2L_Ident_Int 1 100 0 255 ECU_ADDRESS 0x700061DA /end MEASUREMENT
/begin MEASUREMENT VAR_DEM_Event_IOHWAB_1V3MCU_SampFail_Status_u8 "VAR_DEM_Event_IOHWAB_1V3MCU_SampFail_Status_u8" UBYTE BSW_A2L_Ident_Int 1 100 0 255 ECU_ADDRESS 0x700061DC /end MEASUREMENT
/begin MEASUREMENT VAR_DEM_Event_RSL_ExcErr_Status_u8 "VAR_DEM_Event_RSL_ExcErr_Status_u8" UBYTE BSW_A2L_Ident_Int 1 100 0 255 ECU_ADDRESS 0x700061AA /end MEASUREMENT
/begin MEASUREMENT VAR_Rdc_Sin_s16 "VAR_Rdc_Sin_s16" SWORD BSW_A2L_Ident_Int 1 100 -32768 32767 ECU_ADDRESS 0x7000420C /end MEASUREMENT
/begin MEASUREMENT VAR_DEM_Event_MDF_ICtlRatErr_Status_u8 "VAR_DEM_Event_MDF_ICtlRatErr_Status_u8" UBYTE BSW_A2L_Ident_Int 1 100 0 255 ECU_ADDRESS 0x700061BF /end MEASUREMENT
/begin MEASUREMENT VAR_IoHwAb_Adc_Phy_5V_QUC_f32 "VAR_IoHwAb_Adc_Phy_5V_QUC_f32" FLOAT32_IEEE BSW_A2L_Ident_Float 1 100 -3.4E+38 3.4E+38 ECU_ADDRESS 0x70004574 /end MEASUREMENT
/begin MEASUREMENT VAR_DEM_Event_RSL_DOSErr_Status_u8 "VAR_DEM_Event_RSL_DOSErr_Status_u8" UBYTE BSW_A2L_Ident_Int 1 100 0 255 ECU_ADDRESS 0x700061AB /end MEASUREMENT
/begin MEASUREMENT VAR_IOControl_u8 "VAR_IOControl_u8" UBYTE BSW_A2L_Ident_Int 1 100 0 255 ECU_ADDRESS 0x70006446 /end MEASUREMENT
/begin MEASUREMENT VAR_STM1_TimeData_FS_L2_u32 "VAR_STM1_TimeData_FS_L2_u32" ULONG BSW_A2L_Ident_Int 1 100 0 4294967295 ECU_ADDRESS 0x70004A58 /end MEASUREMENT
/begin MEASUREMENT VAR_DEM_Event_PCF_SelfcheckErr_Status_u8 "VAR_DEM_Event_PCF_SelfcheckErr_Status_u8" UBYTE BSW_A2L_Ident_Int 1 100 0 255 ECU_ADDRESS 0x700061B7 /end MEASUREMENT
/begin MEASUREMENT VAR_CDD_Rslv_SinMax_f32 "VAR_CDD_Rslv_SinMax_f32" FLOAT32_IEEE BSW_A2L_Ident_Float 1 100 -3.4E+38 3.4E+38 ECU_ADDRESS 0x700040F0 /end MEASUREMENT
/begin MEASUREMENT VAR_DEM_Event_TPC_TIGBTOvLoWarn_Status_u8 "VAR_DEM_Event_TPC_TIGBTOvLoWarn_Status_u8" UBYTE BSW_A2L_Ident_Int 1 100 0 255 ECU_ADDRESS 0x70006196 /end MEASUREMENT
/begin MEASUREMENT VAR_IoHwAb_Adc_Phy_18V_LS_f32 "VAR_IoHwAb_Adc_Phy_18V_LS_f32" FLOAT32_IEEE BSW_A2L_Ident_Float 1 100 -3.4E+38 3.4E+38 ECU_ADDRESS 0x70004580 /end MEASUREMENT
/begin MEASUREMENT VAR_DEM_Event_Cpld_IphaOC_Status_u8 "VAR_DEM_Event_Cpld_IphaOC_Status_u8" UBYTE BSW_A2L_Ident_Int 1 100 0 255 ECU_ADDRESS 0x70006202 /end MEASUREMENT
/begin MEASUREMENT VAR_DEM_Event_TPC_TDbcULoLimFail_Status_u8 "VAR_DEM_Event_TPC_TDbcULoLimFail_Status_u8" UBYTE BSW_A2L_Ident_Int 1 100 0 255 ECU_ADDRESS 0x7000619E /end MEASUREMENT
/begin MEASUREMENT VAR_DEM_Event_HvMcu_UdcOverVolErr_Status_u8 "VAR_DEM_Event_HvMcu_UdcOverVolErr_Status_u8" UBYTE BSW_A2L_Ident_Int 1 100 0 255 ECU_ADDRESS 0x700061E2 /end MEASUREMENT
/begin MEASUREMENT VAR_CDD_Rslv_TimeGp_f32 "VAR_CDD_Rslv_TimeGp_f32" FLOAT32_IEEE BSW_A2L_Ident_Float 1 100 -3.4E+38 3.4E+38 ECU_ADDRESS 0x700040F4 /end MEASUREMENT
/begin MEASUREMENT VAR_DEM_Event_HSPF_InvOpenErr_Status_u8 "VAR_DEM_Event_HSPF_InvOpenErr_Status_u8" UBYTE BSW_A2L_Ident_Int 1 100 0 255 ECU_ADDRESS 0x700061F0 /end MEASUREMENT
/begin MEASUREMENT VAR_DEM_Event_CANSM_E_BUS_OFF_NETWORK_0_Status_u8 "VAR_DEM_Event_CANSM_E_BUS_OFF_NETWORK_0_Status_u8" UBYTE BSW_A2L_Ident_Int 1 100 0 255 ECU_ADDRESS 0x70006208 /end MEASUREMENT
/begin MEASUREMENT VAR_3phPWMWH_Period_f32 "VAR_3phPWMWH_Period_f32" FLOAT32_IEEE BSW_A2L_Ident_Float 1 100 -3.4E+38 3.4E+38 ECU_ADDRESS 0x70004608 /end MEASUREMENT
/begin MEASUREMENT VAR_DEM_Event_Cpld_SZTKT_InFail_Status_u8 "VAR_DEM_Event_Cpld_SZTKT_InFail_Status_u8" UBYTE BSW_A2L_Ident_Int 1 100 0 255 ECU_ADDRESS 0x700061FD /end MEASUREMENT
/begin MEASUREMENT VAR_NvM_BSW_NVM_SLFnh_au8 "VAR_NvM_BSW_NVM_SLFnh_au8" UBYTE BSW_A2L_Ident_Int 1 100 0 255 ARRAY_SIZE 1 ECU_ADDRESS 0x7000B4AC /end MEASUREMENT
/begin MEASUREMENT VAR_DEM_Event_PCF_ActOvTiErr_Status_u8 "VAR_DEM_Event_PCF_ActOvTiErr_Status_u8" UBYTE BSW_A2L_Ident_Int 1 100 0 255 ECU_ADDRESS 0x700061B9 /end MEASUREMENT
/begin MEASUREMENT VAR_DEM_Event_IOHWAB_KL30OverVolErr_Status_u8 "VAR_DEM_Event_IOHWAB_KL30OverVolErr_Status_u8" UBYTE BSW_A2L_Ident_Int 1 100 0 255 ECU_ADDRESS 0x700061D2 /end MEASUREMENT
/begin MEASUREMENT VAR_DEM_Event_RCF_PsiOvErr_Status_u8 "VAR_DEM_Event_RCF_PsiOvErr_Status_u8" UBYTE BSW_A2L_Ident_Int 1 100 0 255 ECU_ADDRESS 0x700061AC /end MEASUREMENT
/begin MEASUREMENT VAR_DEM_Event_SCF_LowPwrShtDwnOvTiFail_Status_u8 "VAR_DEM_Event_SCF_LowPwrShtDwnOvTiFail_Status_u8" UBYTE BSW_A2L_Ident_Int 1 100 0 255 ECU_ADDRESS 0x700061A6 /end MEASUREMENT
/begin MEASUREMENT VAR_DEM_FidTraceEvents_au8 "VAR_DEM_FidTraceEvents_au8" UBYTE BSW_A2L_Ident_Int 1 100 0 255 ARRAY_SIZE 127 ECU_ADDRESS 0x700062EB /end MEASUREMENT
/begin MEASUREMENT VAR_DEM_EvtFailedList_au8 "VAR_DEM_EvtFailedList_au8" UBYTE BSW_A2L_Ident_Int 1 100 0 255 ARRAY_SIZE 24 ECU_ADDRESS 0x70006402 /end MEASUREMENT
/begin MEASUREMENT VAR_TLF35584_InitFinish_Flag_b "VAR_TLF35584_InitFinish_Flag_b" UBYTE BSW_A2L_Ident_Int 1 100 0 1 ECU_ADDRESS 0x7000428F /end MEASUREMENT
/begin MEASUREMENT VAR_DEM_Event_PCF_IdcOvErr_Status_u8 "VAR_DEM_Event_PCF_IdcOvErr_Status_u8" UBYTE BSW_A2L_Ident_Int 1 100 0 255 ECU_ADDRESS 0x700061B8 /end MEASUREMENT
/begin MEASUREMENT VAR_flgRecVCU06_u8 "VAR_flgRecVCU06_u8" UBYTE BSW_A2L_Ident_Int 1 100 0 255 ECU_ADDRESS 0x700044EB /end MEASUREMENT
/begin MEASUREMENT VAR_DEM_Event_Cpld_UdcOverVolFail_Status_u8 "VAR_DEM_Event_Cpld_UdcOverVolFail_Status_u8" UBYTE BSW_A2L_Ident_Int 1 100 0 255 ECU_ADDRESS 0x700061FA /end MEASUREMENT
/begin MEASUREMENT VAR_RDC_flgLotErr_b "VAR_RDC_flgLotErr_b" UBYTE BSW_A2L_Ident_Int 1 100 0 1 ECU_ADDRESS 0x700040D0 /end MEASUREMENT
/begin MEASUREMENT VAR_CheckSumValue_u8 "VAR_CheckSumValue_u8" UBYTE BSW_A2L_Ident_Int 1 100 0 255 ECU_ADDRESS 0x700044F2 /end MEASUREMENT
/begin MEASUREMENT VAR_STM0_SWC_10ms_Task_Core0_u32 "VAR_STM0_SWC_10ms_Task_Core0_u32" ULONG BSW_A2L_Ident_Int 1 100 0 4294967295 ECU_ADDRESS 0x70004978 /end MEASUREMENT
/begin MEASUREMENT VAR_3phPWMVH_Duty_f32 "VAR_3phPWMVH_Duty_f32" FLOAT32_IEEE BSW_A2L_Ident_Float 1 100 -3.4E+38 3.4E+38 ECU_ADDRESS 0x70004628 /end MEASUREMENT
/begin MEASUREMENT VAR_DEM_Event_IOHWAB_Cpld1v8SampFail_Status_u8 "VAR_DEM_Event_IOHWAB_Cpld1v8SampFail_Status_u8" UBYTE BSW_A2L_Ident_Int 1 100 0 255 ECU_ADDRESS 0x700061D7 /end MEASUREMENT
/begin MEASUREMENT VAR_IgbtDrv_Level_NFLTB_u8 "VAR_IgbtDrv_Level_NFLTB_u8" UBYTE BSW_A2L_Ident_Int 1 100 0 255 ECU_ADDRESS 0x70003E31 /end MEASUREMENT
/begin MEASUREMENT VAR_IoHwAb_Adc_Phy_5V_Qt1_f32 "VAR_IoHwAb_Adc_Phy_5V_Qt1_f32" FLOAT32_IEEE BSW_A2L_Ident_Float 1 100 -3.4E+38 3.4E+38 ECU_ADDRESS 0x70004598 /end MEASUREMENT
/begin MEASUREMENT VAR_flgRecVCU07_u8 "VAR_flgRecVCU07_u8" UBYTE BSW_A2L_Ident_Int 1 100 0 255 ECU_ADDRESS 0x700044EA /end MEASUREMENT
/begin MEASUREMENT VAR_Rdc_Cos_s16 "VAR_Rdc_Cos_s16" SWORD BSW_A2L_Ident_Int 1 100 -32768 32767 ECU_ADDRESS 0x7000420A /end MEASUREMENT
/begin MEASUREMENT VAR_TLF35584_SelfTestFinish_Flag_b "VAR_TLF35584_SelfTestFinish_Flag_b" UBYTE BSW_A2L_Ident_Int 1 100 0 1 ECU_ADDRESS 0x7000428E /end MEASUREMENT
/begin MEASUREMENT VAR_FS_RDC_Quadrant_u8 "VAR_FS_RDC_Quadrant_u8" UBYTE BSW_A2L_Ident_Int 1 100 0 255 ECU_ADDRESS 0x6000028E /end MEASUREMENT
/begin MEASUREMENT VAR_PWM3phWDuty_ERR_u8 "VAR_PWM3phWDuty_ERR_u8" UBYTE BSW_A2L_Ident_Int 1 100 0 255 ECU_ADDRESS 0x50009C6C /end MEASUREMENT
/begin MEASUREMENT VAR_DEM_Event_SCF_DisChgOvTiFail_Status_u8 "VAR_DEM_Event_SCF_DisChgOvTiFail_Status_u8" UBYTE BSW_A2L_Ident_Int 1 100 0 255 ECU_ADDRESS 0x700061A7 /end MEASUREMENT
/begin MEASUREMENT VAR_DEM_Event_Cpld_ParityChkErr_Status_u8 "VAR_DEM_Event_Cpld_ParityChkErr_Status_u8" UBYTE BSW_A2L_Ident_Int 1 100 0 255 ECU_ADDRESS 0x70006200 /end MEASUREMENT
/begin MEASUREMENT VAR_DEM_Event_PCF_StallWarn_Status_u8 "VAR_DEM_Event_PCF_StallWarn_Status_u8" UBYTE BSW_A2L_Ident_Int 1 100 0 255 ECU_ADDRESS 0x700061B3 /end MEASUREMENT
/begin MEASUREMENT VAR_STM0_SWC_100ms_Task_Core0_u32 "VAR_STM0_SWC_100ms_Task_Core0_u32" ULONG BSW_A2L_Ident_Int 1 100 0 4294967295 ECU_ADDRESS 0x70004970 /end MEASUREMENT
/begin MEASUREMENT VAR_DEM_Event_HSPF_tDBCTempCmpErr_Status_u8 "VAR_DEM_Event_HSPF_tDBCTempCmpErr_Status_u8" UBYTE BSW_A2L_Ident_Int 1 100 0 255 ECU_ADDRESS 0x700061EC /end MEASUREMENT
/begin MEASUREMENT VAR_DEM_Event_Cpld_UnderVol_HS_InFail_Status_u8 "VAR_DEM_Event_Cpld_UnderVol_HS_InFail_Status_u8" UBYTE BSW_A2L_Ident_Int 1 100 0 255 ECU_ADDRESS 0x700061F9 /end MEASUREMENT
/begin MEASUREMENT VAR_DEM_Event_IgbtDrv_UpBrgFaultAFail_Status_u8 "VAR_DEM_Event_IgbtDrv_UpBrgFaultAFail_Status_u8" UBYTE BSW_A2L_Ident_Int 1 100 0 255 ECU_ADDRESS 0x700061C5 /end MEASUREMENT
/begin MEASUREMENT VAR_IgbtDrv_Level_NFLTA_L_u8 "VAR_IgbtDrv_Level_NFLTA_L_u8" UBYTE BSW_A2L_Ident_Int 1 100 0 255 ECU_ADDRESS 0x70003E32 /end MEASUREMENT
/begin MEASUREMENT VAR_DEM_Event_ADC_WPhaseBISTFail_Status_u8 "VAR_DEM_Event_ADC_WPhaseBISTFail_Status_u8" UBYTE BSW_A2L_Ident_Int 1 100 0 255 ECU_ADDRESS 0x70006209 /end MEASUREMENT
/begin MEASUREMENT VAR_DEM_Event_Cpld_Short_Circuit_HS_InFail_Status_u8 "VAR_DEM_Event_Cpld_Short_Circuit_HS_InFail_Status_u8" UBYTE BSW_A2L_Ident_Int 1 100 0 255 ECU_ADDRESS 0x700061FC /end MEASUREMENT
/begin MEASUREMENT VAR_DEM_Event_RCF_OfsClbFail_Status_u8 "VAR_DEM_Event_RCF_OfsClbFail_Status_u8" UBYTE BSW_A2L_Ident_Int 1 100 0 255 ECU_ADDRESS 0x700061AD /end MEASUREMENT
/begin MEASUREMENT VAR_DEM_Event_IOHWAB_CrashFail_Status_u8 "VAR_DEM_Event_IOHWAB_CrashFail_Status_u8" UBYTE BSW_A2L_Ident_Int 1 100 0 255 ECU_ADDRESS 0x700061D5 /end MEASUREMENT
/begin MEASUREMENT VAR_ComRecNmFlag_u8 "VAR_ComRecNmFlag_u8" UBYTE BSW_A2L_Ident_Int 1 100 0 255 ECU_ADDRESS 0x700044E9 /end MEASUREMENT
/begin MEASUREMENT VAR_PWM3phUDuty_ERR_u8 "VAR_PWM3phUDuty_ERR_u8" UBYTE BSW_A2L_Ident_Int 1 100 0 255 ECU_ADDRESS 0x50009C74 /end MEASUREMENT
/begin MEASUREMENT VAR_RDC_flg_u16 "VAR_RDC_flg_u16" UWORD BSW_A2L_Ident_Int 1 100 0 65535 ECU_ADDRESS 0x70004208 /end MEASUREMENT
/begin MEASUREMENT VAR_DEM_Event_TPC_TDbcWHiLimFail_Status_u8 "VAR_DEM_Event_TPC_TDbcWHiLimFail_Status_u8" UBYTE BSW_A2L_Ident_Int 1 100 0 255 ECU_ADDRESS 0x7000619B /end MEASUREMENT
/begin MEASUREMENT VAR_DEM_Event_TPC_SpdOvHiLimFail_Status_u8 "VAR_DEM_Event_TPC_SpdOvHiLimFail_Status_u8" UBYTE BSW_A2L_Ident_Int 1 100 0 255 ECU_ADDRESS 0x700061A4 /end MEASUREMENT
/begin MEASUREMENT VAR_DEM_Event_HvMcu_DisChrgFreqErr_Status_u8 "VAR_DEM_Event_HvMcu_DisChrgFreqErr_Status_u8" UBYTE BSW_A2L_Ident_Int 1 100 0 255 ECU_ADDRESS 0x700061E8 /end MEASUREMENT
/begin MEASUREMENT VAR_IgbtDrv_Level_NRST_RDY_L_u8 "VAR_IgbtDrv_Level_NRST_RDY_L_u8" UBYTE BSW_A2L_Ident_Int 1 100 0 255 ECU_ADDRESS 0x70003E34 /end MEASUREMENT
/begin MEASUREMENT VAR_DEM_Event_TPC_TDrvBoardOvHiWarn_Status_u8 "VAR_DEM_Event_TPC_TDrvBoardOvHiWarn_Status_u8" UBYTE BSW_A2L_Ident_Int 1 100 0 255 ECU_ADDRESS 0x70006199 /end MEASUREMENT
/begin MEASUREMENT VAR_DEM_Event_IOHWAB_18VLwBrgSampFail_Status_u8 "VAR_DEM_Event_IOHWAB_18VLwBrgSampFail_Status_u8" UBYTE BSW_A2L_Ident_Int 1 100 0 255 ECU_ADDRESS 0x700061DE /end MEASUREMENT
/begin MEASUREMENT VAR_IoHwAb_Adc_Phy_3V3_MCU_f32 "VAR_IoHwAb_Adc_Phy_3V3_MCU_f32" FLOAT32_IEEE BSW_A2L_Ident_Float 1 100 -3.4E+38 3.4E+38 ECU_ADDRESS 0x70004578 /end MEASUREMENT
/begin MEASUREMENT VAR_CDD_Rslv_SinMin_f32 "VAR_CDD_Rslv_SinMin_f32" FLOAT32_IEEE BSW_A2L_Ident_Float 1 100 -3.4E+38 3.4E+38 ECU_ADDRESS 0x700040EC /end MEASUREMENT
/begin MEASUREMENT VAR_DEM_Event_RSL_LOSErr_Status_u8 "VAR_DEM_Event_RSL_LOSErr_Status_u8" UBYTE BSW_A2L_Ident_Int 1 100 0 255 ECU_ADDRESS 0x700061A9 /end MEASUREMENT
/begin MEASUREMENT VAR_DEM_Event_Cpld_NEN_InFail_Status_u8 "VAR_DEM_Event_Cpld_NEN_InFail_Status_u8" UBYTE BSW_A2L_Ident_Int 1 100 0 255 ECU_ADDRESS 0x70006201 /end MEASUREMENT
/begin MEASUREMENT VAR_DEM_Event_RCF_FwlFwdOvTiErr_Status_u8 "VAR_DEM_Event_RCF_FwlFwdOvTiErr_Status_u8" UBYTE BSW_A2L_Ident_Int 1 100 0 255 ECU_ADDRESS 0x700061AE /end MEASUREMENT
/begin MEASUREMENT VAR_DEM_Event_HvMcu_UartLostFrameErr_Status_u8 "VAR_DEM_Event_HvMcu_UartLostFrameErr_Status_u8" UBYTE BSW_A2L_Ident_Int 1 100 0 255 ECU_ADDRESS 0x700061E5 /end MEASUREMENT
/begin MEASUREMENT VAR_3phPWMUH_Duty_f32 "VAR_3phPWMUH_Duty_f32" FLOAT32_IEEE BSW_A2L_Ident_Float 1 100 -3.4E+38 3.4E+38 ECU_ADDRESS 0x70004630 /end MEASUREMENT
/begin MEASUREMENT VAR_DEM_Event_Cpld_SPIComFail_Status_u8 "VAR_DEM_Event_Cpld_SPIComFail_Status_u8" UBYTE BSW_A2L_Ident_Int 1 100 0 255 ECU_ADDRESS 0x700061FE /end MEASUREMENT
/begin MEASUREMENT VAR_DEM_Event_TPC_uDcLnkUnvWarn_Status_u8 "VAR_DEM_Event_TPC_uDcLnkUnvWarn_Status_u8" UBYTE BSW_A2L_Ident_Int 1 100 0 255 ECU_ADDRESS 0x7000618D /end MEASUREMENT
/begin MEASUREMENT VAR_DEM_Event_Cpld_DI_ExdClk_InFail_Status_u8 "VAR_DEM_Event_Cpld_DI_ExdClk_InFail_Status_u8" UBYTE BSW_A2L_Ident_Int 1 100 0 255 ECU_ADDRESS 0x70006204 /end MEASUREMENT
/begin MEASUREMENT VAR_flgRecVCU01_u8 "VAR_flgRecVCU01_u8" UBYTE BSW_A2L_Ident_Int 1 100 0 255 ECU_ADDRESS 0x700044F0 /end MEASUREMENT
/begin MEASUREMENT VAR_CDD_RslvTimeStamp_f32 "VAR_CDD_RslvTimeStamp_f32" FLOAT32_IEEE BSW_A2L_Ident_Float 1 100 -3.4E+38 3.4E+38 ECU_ADDRESS 0x700040F8 /end MEASUREMENT
/begin MEASUREMENT VAR_DEM_Event_TPC_TDbcOvHiWarn_Status_u8 "VAR_DEM_Event_TPC_TDbcOvHiWarn_Status_u8" UBYTE BSW_A2L_Ident_Int 1 100 0 255 ECU_ADDRESS 0x700061A1 /end MEASUREMENT
/begin MEASUREMENT VAR_FS_RDC_Counter_u8 "VAR_FS_RDC_Counter_u8" UBYTE BSW_A2L_Ident_Int 1 100 0 255 ECU_ADDRESS 0x6000028F /end MEASUREMENT
/begin MEASUREMENT VAR_DEM_Event_IOHWAB_KL30SevUnderVolFail_Status_u8 "VAR_DEM_Event_IOHWAB_KL30SevUnderVolFail_Status_u8" UBYTE BSW_A2L_Ident_Int 1 100 0 255 ECU_ADDRESS 0x700061D0 /end MEASUREMENT
/begin MEASUREMENT VAR_DEM_Event_MDF_AlOfsNoPlausErr_Status_u8 "VAR_DEM_Event_MDF_AlOfsNoPlausErr_Status_u8" UBYTE BSW_A2L_Ident_Int 1 100 0 255 ECU_ADDRESS 0x700061C3 /end MEASUREMENT
/begin MEASUREMENT VAR_DEM_Event_MDF_PrfElDrvErr_Status_u8 "VAR_DEM_Event_MDF_PrfElDrvErr_Status_u8" UBYTE BSW_A2L_Ident_Int 1 100 0 255 ECU_ADDRESS 0x700061BA /end MEASUREMENT
/begin MEASUREMENT VAR_CDD_Rslv_Sin_f32 "VAR_CDD_Rslv_Sin_f32" FLOAT32_IEEE BSW_A2L_Ident_Float 1 100 -3.4E+38 3.4E+38 ECU_ADDRESS 0x70004100 /end MEASUREMENT
/begin MEASUREMENT VAR_DMA_Cos_Max_u16 "VAR_DMA_Cos_Max_u16" UWORD BSW_A2L_Ident_Int 1 100 0 65535 ECU_ADDRESS 0x60000564 /end MEASUREMENT
/begin MEASUREMENT VAR_DEM_Event_Can_Timeout_Status_u8 "VAR_DEM_Event_Can_Timeout_Status_u8" UBYTE BSW_A2L_Ident_Int 1 100 0 255 ECU_ADDRESS 0x70006206 /end MEASUREMENT
/begin MEASUREMENT VAR_DEM_Event_CANSM_E_BUS_OFF_NETWORK_1_Status_u8 "VAR_DEM_Event_CANSM_E_BUS_OFF_NETWORK_1_Status_u8" UBYTE BSW_A2L_Ident_Int 1 100 0 255 ECU_ADDRESS 0x70006207 /end MEASUREMENT
/begin MEASUREMENT VAR_Pwm_Freq_u16 "VAR_Pwm_Freq_u16" UWORD BSW_A2L_Ident_Int 1 100 0 65535 ECU_ADDRESS 0x50009C90 /end MEASUREMENT
/begin MEASUREMENT VAR_STM0_BSW_10ms_Task_Core0_u32 "VAR_STM0_BSW_10ms_Task_Core0_u32" ULONG BSW_A2L_Ident_Int 1 100 0 4294967295 ECU_ADDRESS 0x7000497C /end MEASUREMENT
/begin MEASUREMENT VAR_DEM_Event_Epark_PosSampFail_Status_u8 "VAR_DEM_Event_Epark_PosSampFail_Status_u8" UBYTE BSW_A2L_Ident_Int 1 100 0 255 ECU_ADDRESS 0x700061F5 /end MEASUREMENT
/begin MEASUREMENT VAR_FS_DycW_f32 "VAR_FS_DycW_f32" FLOAT32_IEEE BSW_A2L_Ident_Float 1 100 -3.4E+38 3.4E+38 ECU_ADDRESS 0x60000038 /end MEASUREMENT
/begin MEASUREMENT VAR_DEM_Event_TPC_iDcLnkOvcWarn_Status_u8 "VAR_DEM_Event_TPC_iDcLnkOvcWarn_Status_u8" UBYTE BSW_A2L_Ident_Int 1 100 0 255 ECU_ADDRESS 0x70006191 /end MEASUREMENT
/begin MEASUREMENT VAR_DEM_Event_HSPF_VerMatchFailureErr_Status_u8 "VAR_DEM_Event_HSPF_VerMatchFailureErr_Status_u8" UBYTE BSW_A2L_Ident_Int 1 100 0 255 ECU_ADDRESS 0x700061EE /end MEASUREMENT
/begin MEASUREMENT VAR_DEM_Event_HSPF_MotorOpenErr_Status_u8 "VAR_DEM_Event_HSPF_MotorOpenErr_Status_u8" UBYTE BSW_A2L_Ident_Int 1 100 0 255 ECU_ADDRESS 0x700061EF /end MEASUREMENT
/begin MEASUREMENT VAR_DEM_Event_HvMcu_UdcOverFlagLimit_Status_u8 "VAR_DEM_Event_HvMcu_UdcOverFlagLimit_Status_u8" UBYTE BSW_A2L_Ident_Int 1 100 0 255 ECU_ADDRESS 0x700061E3 /end MEASUREMENT
/begin MEASUREMENT VAR_DEM_Event_IOHWAB_KL30UnderVolErr_Status_u8 "VAR_DEM_Event_IOHWAB_KL30UnderVolErr_Status_u8" UBYTE BSW_A2L_Ident_Int 1 100 0 255 ECU_ADDRESS 0x700061CF /end MEASUREMENT
/begin MEASUREMENT VAR_IoHwAb_Adc_Phy_12V_Wide_f32 "VAR_IoHwAb_Adc_Phy_12V_Wide_f32" FLOAT32_IEEE BSW_A2L_Ident_Float 1 100 -3.4E+38 3.4E+38 ECU_ADDRESS 0x7000459C /end MEASUREMENT
/begin MEASUREMENT VAR_CheckSumTx_MCU_430_u8 "VAR_CheckSumTx_MCU_430_u8" UBYTE BSW_A2L_Ident_Int 1 100 0 255 ECU_ADDRESS 0x70003D1A /end MEASUREMENT
/begin MEASUREMENT VAR_NvM_BSW_NVM_AimOutP_au8 "VAR_NvM_BSW_NVM_AimOutP_au8" UBYTE BSW_A2L_Ident_Int 1 100 0 255 ARRAY_SIZE 8 ECU_ADDRESS 0x7000B4A4 /end MEASUREMENT
/begin MEASUREMENT VAR_DEM_Event_Event_NvM_ReadErr_Status_u8 "VAR_DEM_Event_Event_NvM_ReadErr_Status_u8" UBYTE BSW_A2L_Ident_Int 1 100 0 255 ECU_ADDRESS 0x700061F3 /end MEASUREMENT
/begin MEASUREMENT VAR_FS_VADC_RSLVEXC_u16 "VAR_FS_VADC_RSLVEXC_u16" UWORD BSW_A2L_Ident_Int 1 100 0 65535 ECU_ADDRESS 0x60000294 /end MEASUREMENT
/begin MEASUREMENT VAR_DEM_Event_IOHWAB_SttrSenorShrFail_Status_u8 "VAR_DEM_Event_IOHWAB_SttrSenorShrFail_Status_u8" UBYTE BSW_A2L_Ident_Int 1 100 0 255 ECU_ADDRESS 0x700061CD /end MEASUREMENT
/begin MEASUREMENT VAR_DEM_Event_TPC_TDbcWLoLimFail_Status_u8 "VAR_DEM_Event_TPC_TDbcWLoLimFail_Status_u8" UBYTE BSW_A2L_Ident_Int 1 100 0 255 ECU_ADDRESS 0x7000619A /end MEASUREMENT
/begin MEASUREMENT VAR_DEM_Event_IOHWAB_18VUpBrgSampFail_Status_u8 "VAR_DEM_Event_IOHWAB_18VUpBrgSampFail_Status_u8" UBYTE BSW_A2L_Ident_Int 1 100 0 255 ECU_ADDRESS 0x700061DD /end MEASUREMENT
/begin MEASUREMENT VAR_FS_DycV_f32 "VAR_FS_DycV_f32" FLOAT32_IEEE BSW_A2L_Ident_Float 1 100 -3.4E+38 3.4E+38 ECU_ADDRESS 0x6000003C /end MEASUREMENT
/begin MEASUREMENT VAR_DEM_Event_Cpld_Rx_SelfTest_Fail_Status_u8 "VAR_DEM_Event_Cpld_Rx_SelfTest_Fail_Status_u8" UBYTE BSW_A2L_Ident_Int 1 100 0 255 ECU_ADDRESS 0x700061FF /end MEASUREMENT
/begin MEASUREMENT VAR_DEM_Event_TPC_uDcLnkOvWarn_Status_u8 "VAR_DEM_Event_TPC_uDcLnkOvWarn_Status_u8" UBYTE BSW_A2L_Ident_Int 1 100 0 255 ECU_ADDRESS 0x7000618F /end MEASUREMENT
/begin MEASUREMENT VAR_IgbtDrv_Level_NRST_RDY_u8 "VAR_IgbtDrv_Level_NRST_RDY_u8" UBYTE BSW_A2L_Ident_Int 1 100 0 255 ECU_ADDRESS 0x70003E35 /end MEASUREMENT
/begin MEASUREMENT VAR_STM1_TimeData_VADC_RDC_u32 "VAR_STM1_TimeData_VADC_RDC_u32" ULONG BSW_A2L_Ident_Int 1 100 0 4294967295 ECU_ADDRESS 0x70004A54 /end MEASUREMENT
/begin MEASUREMENT VAR_DEM_HisEvtFailedList_au8 "VAR_DEM_HisEvtFailedList_au8" UBYTE BSW_A2L_Ident_Int 1 100 0 255 ARRAY_SIZE 24 ECU_ADDRESS 0x700062D3 /end MEASUREMENT
/begin MEASUREMENT VAR_DEM_Event_FR_StorageErr_Status_u8 "VAR_DEM_Event_FR_StorageErr_Status_u8" UBYTE BSW_A2L_Ident_Int 1 100 0 255 ECU_ADDRESS 0x700061F1 /end MEASUREMENT
/begin MEASUREMENT VAR_DEM_Event_IOHWAB_Nen33Fail_Status_u8 "VAR_DEM_Event_IOHWAB_Nen33Fail_Status_u8" UBYTE BSW_A2L_Ident_Int 1 100 0 255 ECU_ADDRESS 0x700061CE /end MEASUREMENT
/begin MEASUREMENT VAR_DEM_Event_IOHWAB_SttrTemp2SampFail_Status_u8 "VAR_DEM_Event_IOHWAB_SttrTemp2SampFail_Status_u8" UBYTE BSW_A2L_Ident_Int 1 100 0 255 ECU_ADDRESS 0x700061CB /end MEASUREMENT
/begin MEASUREMENT VAR_DEM_DiagEvtHistList_au8 "VAR_DEM_DiagEvtHistList_au8" UBYTE BSW_A2L_Ident_Int 1 100 0 255 ARRAY_SIZE 24 ECU_ADDRESS 0x7000B4C0 /end MEASUREMENT
/begin MEASUREMENT VAR_RDC_nWoFlt_f32 "VAR_RDC_nWoFlt_f32" FLOAT32_IEEE BSW_A2L_Ident_Float 1 100 -3.4E+38 3.4E+38 ECU_ADDRESS 0x700040D8 /end MEASUREMENT
/begin MEASUREMENT VAR_flgRecVCU02_u8 "VAR_flgRecVCU02_u8" UBYTE BSW_A2L_Ident_Int 1 100 0 255 ECU_ADDRESS 0x700044EF /end MEASUREMENT
/begin MEASUREMENT VAR_3phPWMWL_Period_f32 "VAR_3phPWMWL_Period_f32" FLOAT32_IEEE BSW_A2L_Ident_Float 1 100 -3.4E+38 3.4E+38 ECU_ADDRESS 0x70004604 /end MEASUREMENT
/begin MEASUREMENT VAR_Adc_RES_Buffer_CUR_MCU_u16 "VAR_Adc_RES_Buffer_CUR_MCU_u16" UWORD BSW_A2L_Ident_Int 1 100 0 65535 ECU_ADDRESS 0x70003F02 /end MEASUREMENT
/begin MEASUREMENT VAR_DEM_Event_TPC_TIGBTOvHiWarn_Status_u8 "VAR_DEM_Event_TPC_TIGBTOvHiWarn_Status_u8" UBYTE BSW_A2L_Ident_Int 1 100 0 255 ECU_ADDRESS 0x70006197 /end MEASUREMENT
/begin MEASUREMENT VAR_NvM_TLC_TrqReason_au8 "VAR_NvM_TLC_TrqReason_au8" UBYTE BSW_A2L_Ident_Int 1 100 0 255 ARRAY_SIZE 6 ECU_ADDRESS 0x7000B4B0 /end MEASUREMENT
/begin MEASUREMENT VAR_CDD_Rslv_CosMin_f32 "VAR_CDD_Rslv_CosMin_f32" FLOAT32_IEEE BSW_A2L_Ident_Float 1 100 -3.4E+38 3.4E+38 ECU_ADDRESS 0x700040E4 /end MEASUREMENT
/begin MEASUREMENT VAR_RDC_flgSpdHorL_b "VAR_RDC_flgSpdHorL_b" UBYTE BSW_A2L_Ident_Int 1 100 0 1 ECU_ADDRESS 0x700040D1 /end MEASUREMENT
/begin MEASUREMENT VAR_STM0_SWC_20ms_Task_Core0_u32 "VAR_STM0_SWC_20ms_Task_Core0_u32" ULONG BSW_A2L_Ident_Int 1 100 0 4294967295 ECU_ADDRESS 0x70004974 /end MEASUREMENT
/begin MEASUREMENT VAR_DEM_Event_MDF_OpenCirNoPsblErr_Status_u8 "VAR_DEM_Event_MDF_OpenCirNoPsblErr_Status_u8" UBYTE BSW_A2L_Ident_Int 1 100 0 255 ECU_ADDRESS 0x700061BD /end MEASUREMENT
/begin MEASUREMENT VAR_flgRecBMS01_u8 "VAR_flgRecBMS01_u8" UBYTE BSW_A2L_Ident_Int 1 100 0 255 ECU_ADDRESS 0x700044F1 /end MEASUREMENT
/begin MEASUREMENT VAR_NvM_EPC_flgSLWD_au8 "VAR_NvM_EPC_flgSLWD_au8" UBYTE BSW_A2L_Ident_Int 1 100 0 255 ARRAY_SIZE 4 ECU_ADDRESS 0x7000B498 /end MEASUREMENT
/begin MEASUREMENT VAR_flgRecVCU04_u8 "VAR_flgRecVCU04_u8" UBYTE BSW_A2L_Ident_Int 1 100 0 255 ECU_ADDRESS 0x700044ED /end MEASUREMENT
/begin MEASUREMENT VAR_DEM_Event_HvMcu_UartCheckFailErr_Status_u8 "VAR_DEM_Event_HvMcu_UartCheckFailErr_Status_u8" UBYTE BSW_A2L_Ident_Int 1 100 0 255 ECU_ADDRESS 0x700061E6 /end MEASUREMENT
/begin MEASUREMENT VAR_DEM_Event_SCF_RunToDischarErr_Status_u8 "VAR_DEM_Event_SCF_RunToDischarErr_Status_u8" UBYTE BSW_A2L_Ident_Int 1 100 0 255 ECU_ADDRESS 0x700061A5 /end MEASUREMENT
/begin MEASUREMENT VAR_DEM_Event_TPC_SpdOvHiWarn_Status_u8 "VAR_DEM_Event_TPC_SpdOvHiWarn_Status_u8" UBYTE BSW_A2L_Ident_Int 1 100 0 255 ECU_ADDRESS 0x700061A3 /end MEASUREMENT
/begin MEASUREMENT VAR_TCF_FSEstTrq_u16 "VAR_TCF_FSEstTrq_u16" UWORD BSW_A2L_Ident_Int 1 100 0 65535 ECU_ADDRESS 0x70003D18 /end MEASUREMENT
/begin MEASUREMENT VAR_IoHwAb_Adc_Phy_IUVW_P_REF_f32 "VAR_IoHwAb_Adc_Phy_IUVW_P_REF_f32" FLOAT32_IEEE BSW_A2L_Ident_Float 1 100 -3.4E+38 3.4E+38 ECU_ADDRESS 0x70004570 /end MEASUREMENT
/begin MEASUREMENT VAR_VADC_RDC_ISR_offset_u16 "VAR_VADC_RDC_ISR_offset_u16" UWORD BSW_A2L_Ident_Int 1 100 0 65535 ECU_ADDRESS 0x6000018C /end MEASUREMENT
/begin MEASUREMENT VAR_DEM_Event_RCF_FwlBwdOvTiErr_Status_u8 "VAR_DEM_Event_RCF_FwlBwdOvTiErr_Status_u8" UBYTE BSW_A2L_Ident_Int 1 100 0 255 ECU_ADDRESS 0x700061AF /end MEASUREMENT
/begin MEASUREMENT VAR_DEM_Event_MDF_EmacBlkdErr_Status_u8 "VAR_DEM_Event_MDF_EmacBlkdErr_Status_u8" UBYTE BSW_A2L_Ident_Int 1 100 0 255 ECU_ADDRESS 0x700061C1 /end MEASUREMENT
/begin MEASUREMENT VAR_RESET_Reason_List_au8 "VAR_RESET_Reason_List_au8" UBYTE BSW_A2L_Ident_Int 1 100 0 255 ARRAY_SIZE 16 ECU_ADDRESS 0x70008185 /end MEASUREMENT
/begin MEASUREMENT VAR_DEM_Event_MDF_EmacBlkdWarn_Status_u8 "VAR_DEM_Event_MDF_EmacBlkdWarn_Status_u8" UBYTE BSW_A2L_Ident_Int 1 100 0 255 ECU_ADDRESS 0x700061C0 /end MEASUREMENT
/begin MEASUREMENT VAR_DEM_Event_IOHWAB_VDD5_D_SampFail_Status_u8 "VAR_DEM_Event_IOHWAB_VDD5_D_SampFail_Status_u8" UBYTE BSW_A2L_Ident_Int 1 100 0 255 ECU_ADDRESS 0x700061C9 /end MEASUREMENT
/begin MEASUREMENT VAR_DEM_EventList_au8 "VAR_DEM_EventList_au8" UBYTE DFC_Verb 1 100 0 255 ARRAY_SIZE 24 ECU_ADDRESS 0x700063EA /end MEASUREMENT
/begin MEASUREMENT VAR_DEM_Event_TPC_TDbcVLoLimFail_Status_u8 "VAR_DEM_Event_TPC_TDbcVLoLimFail_Status_u8" UBYTE BSW_A2L_Ident_Int 1 100 0 255 ECU_ADDRESS 0x7000619C /end MEASUREMENT
/begin MEASUREMENT VAR_DEM_EvtFailed_and_Passed_TOPC_au8 "VAR_DEM_EvtFailed_and_Passed_TOPC_au8" UBYTE BSW_A2L_Ident_Int 1 100 0 255 ARRAY_SIZE 24 ECU_ADDRESS 0x70006218 /end MEASUREMENT
/begin MEASUREMENT VAR_DEM_Event_IOHWAB_TCoolantSampFail_Status_u8 "VAR_DEM_Event_IOHWAB_TCoolantSampFail_Status_u8" UBYTE BSW_A2L_Ident_Int 1 100 0 255 ECU_ADDRESS 0x700061CA /end MEASUREMENT
/begin MEASUREMENT VAR_STM0_TimeData_AdcISR_u32 "VAR_STM0_TimeData_AdcISR_u32" ULONG BSW_A2L_Ident_Int 1 100 0 4294967295 ECU_ADDRESS 0x70004A64 /end MEASUREMENT
/begin MEASUREMENT VAR_DEM_Event_IgbtDrv_UpBrgFaultBFail_Status_u8 "VAR_DEM_Event_IgbtDrv_UpBrgFaultBFail_Status_u8" UBYTE BSW_A2L_Ident_Int 1 100 0 255 ECU_ADDRESS 0x700061C4 /end MEASUREMENT
/begin MEASUREMENT VAR_flgRecVCU05_u8 "VAR_flgRecVCU05_u8" UBYTE BSW_A2L_Ident_Int 1 100 0 255 ECU_ADDRESS 0x700044EC /end MEASUREMENT
/begin MEASUREMENT VAR_DEM_Event_HvMcu_DisChrgDutyErr_Status_u8 "VAR_DEM_Event_HvMcu_DisChrgDutyErr_Status_u8" UBYTE BSW_A2L_Ident_Int 1 100 0 255 ECU_ADDRESS 0x700061EA /end MEASUREMENT
/begin MEASUREMENT VAR_DEM_Event_PCF_SenOvErr_Status_u8 "VAR_DEM_Event_PCF_SenOvErr_Status_u8" UBYTE BSW_A2L_Ident_Int 1 100 0 255 ECU_ADDRESS 0x700061B5 /end MEASUREMENT
/begin MEASUREMENT VAR_DEM_Event_MDF_OperOutdRngErr_Status_u8 "VAR_DEM_Event_MDF_OperOutdRngErr_Status_u8" UBYTE BSW_A2L_Ident_Int 1 100 0 255 ECU_ADDRESS 0x700061BC /end MEASUREMENT
/begin MEASUREMENT VAR_DEM_Event_IOHWAB_DcLnkOverVolFail_Status_u8 "VAR_DEM_Event_IOHWAB_DcLnkOverVolFail_Status_u8" UBYTE BSW_A2L_Ident_Int 1 100 0 255 ECU_ADDRESS 0x700061D4 /end MEASUREMENT
/begin MEASUREMENT VAR_DEM_Event_HvMcu_ComErr_Status_u8 "VAR_DEM_Event_HvMcu_ComErr_Status_u8" UBYTE BSW_A2L_Ident_Int 1 100 0 255 ECU_ADDRESS 0x700061EB /end MEASUREMENT
/begin MEASUREMENT VAR_DEM_Event_TPC_uDcLnkUnVLimFail_Status_u8 "VAR_DEM_Event_TPC_uDcLnkUnVLimFail_Status_u8" UBYTE BSW_A2L_Ident_Int 1 100 0 255 ECU_ADDRESS 0x7000618E /end MEASUREMENT
/begin MEASUREMENT VAR_DEM_Event_IgbtDrv_ComErr_Status_u8 "VAR_DEM_Event_IgbtDrv_ComErr_Status_u8" UBYTE BSW_A2L_Ident_Int 1 100 0 255 ECU_ADDRESS 0x700061C8 /end MEASUREMENT
/begin MEASUREMENT VAR_DEM_AllEvtFailedList_au8 "VAR_DEM_AllEvtFailedList_au8" UBYTE BSW_A2L_Ident_Int 1 100 0 255 ARRAY_SIZE 128 ECU_ADDRESS 0x7000636A /end MEASUREMENT
/begin MEASUREMENT VAR_DMA_Sin_Max_u16 "VAR_DMA_Sin_Max_u16" UWORD BSW_A2L_Ident_Int 1 100 0 65535 ECU_ADDRESS 0x60000364 /end MEASUREMENT
/begin MEASUREMENT VAR_STM0_SWC_1000ms_Task_Core0_u32 "VAR_STM0_SWC_1000ms_Task_Core0_u32" ULONG BSW_A2L_Ident_Int 1 100 0 4294967295 ECU_ADDRESS 0x7000496C /end MEASUREMENT
/begin MEASUREMENT VAR_FS_BswFaultInfo_u32 "VAR_FS_BswFaultInfo_u32" ULONG BSW_A2L_Ident_Int 1 100 0 4294967295 ECU_ADDRESS 0x70003D10 /end MEASUREMENT
/begin MEASUREMENT VAR_DEM_Event_PCF_UnexpPosErr_Status_u8 "VAR_DEM_Event_PCF_UnexpPosErr_Status_u8" UBYTE BSW_A2L_Ident_Int 1 100 0 255 ECU_ADDRESS 0x700061B2 /end MEASUREMENT
/begin MEASUREMENT VAR_Cpu_LoadCalc_f32 "VAR_Cpu_LoadCalc_f32" FLOAT32_IEEE BSW_A2L_Ident_Float 1 100 -3.4E+38 3.4E+38 ECU_ADDRESS 0x70004C70 /end MEASUREMENT
/begin MEASUREMENT VAR_DEM_Event_TPC_iDcLnkOvCLimFail_Status_u8 "VAR_DEM_Event_TPC_iDcLnkOvCLimFail_Status_u8" UBYTE BSW_A2L_Ident_Int 1 100 0 255 ECU_ADDRESS 0x70006192 /end MEASUREMENT
/begin MEASUREMENT VAR_DEM_Event_Cpld_ExdClkInFail_Status_u8 "VAR_DEM_Event_Cpld_ExdClkInFail_Status_u8" UBYTE BSW_A2L_Ident_Int 1 100 0 255 ECU_ADDRESS 0x70006203 /end MEASUREMENT
/begin MEASUREMENT VAR_STM0_BSW_2ms_Task_Core0_u32 "VAR_STM0_BSW_2ms_Task_Core0_u32" ULONG BSW_A2L_Ident_Int 1 100 0 4294967295 ECU_ADDRESS 0x70004980 /end MEASUREMENT
/begin MEASUREMENT VAR_DEM_AllFID_Statues_au8 "VAR_DEM_AllFID_Statues_au8" UBYTE BSW_A2L_Ident_Int 1 100 0 255 ARRAY_SIZE 163 ECU_ADDRESS 0x70006230 /end MEASUREMENT
/begin MEASUREMENT VAR_DEM_Event_RCF_EstOfsErr_Status_u8 "VAR_DEM_Event_RCF_EstOfsErr_Status_u8" UBYTE BSW_A2L_Ident_Int 1 100 0 255 ECU_ADDRESS 0x700061B0 /end MEASUREMENT
/begin MEASUREMENT VAR_IoHwAb_Adc_Phy_12V_Narr_f32 "VAR_IoHwAb_Adc_Phy_12V_Narr_f32" FLOAT32_IEEE BSW_A2L_Ident_Float 1 100 -3.4E+38 3.4E+38 ECU_ADDRESS 0x700045A0 /end MEASUREMENT
/begin MEASUREMENT VAR_DEM_Event_Epark_SampFail_Status_u8 "VAR_DEM_Event_Epark_SampFail_Status_u8" UBYTE BSW_A2L_Ident_Int 1 100 0 255 ECU_ADDRESS 0x700061F4 /end MEASUREMENT
/begin MEASUREMENT VAR_DEM_Event_ADC_UPhaseBISTFail_Status_u8 "VAR_DEM_Event_ADC_UPhaseBISTFail_Status_u8" UBYTE BSW_A2L_Ident_Int 1 100 0 255 ECU_ADDRESS 0x7000620B /end MEASUREMENT
/begin MEASUREMENT VAR_DEM_Event_IOHWAB_3V3MCU_SampFail_Status_u8 "VAR_DEM_Event_IOHWAB_3V3MCU_SampFail_Status_u8" UBYTE BSW_A2L_Ident_Int 1 100 0 255 ECU_ADDRESS 0x700061DB /end MEASUREMENT
/begin MEASUREMENT VAR_DEM_Event_TPC_TSttrOvLoWarn_Status_u8 "VAR_DEM_Event_TPC_TSttrOvLoWarn_Status_u8" UBYTE BSW_A2L_Ident_Int 1 100 0 255 ECU_ADDRESS 0x70006193 /end MEASUREMENT
/begin MEASUREMENT VAR_FRP_AppFaultInfo_u32 "VAR_FRP_AppFaultInfo_u32" ULONG BSW_A2L_Ident_Int 1 100 0 4294967295 ECU_ADDRESS 0x70003D14 /end MEASUREMENT
/begin MEASUREMENT VAR_IoHwAb_Adc_Phy_IUVW_N_REF_f32 "VAR_IoHwAb_Adc_Phy_IUVW_N_REF_f32" FLOAT32_IEEE BSW_A2L_Ident_Float 1 100 -3.4E+38 3.4E+38 ECU_ADDRESS 0x7000456C /end MEASUREMENT
/begin MEASUREMENT VAR_PwmDutyCyclePhaseV_f32 "VAR_PwmDutyCyclePhaseV_f32" FLOAT32_IEEE BSW_A2L_Ident_Float 1 100 -3.4E+38 3.4E+38 ECU_ADDRESS 0x50009C84 /end MEASUREMENT
/begin MEASUREMENT VAR_3phPWMUL_Period_f32 "VAR_3phPWMUL_Period_f32" FLOAT32_IEEE BSW_A2L_Ident_Float 1 100 -3.4E+38 3.4E+38 ECU_ADDRESS 0x70004614 /end MEASUREMENT
/begin MEASUREMENT VAR_DEM_Event_Event_NvM_WriteErr_Status_u8 "VAR_DEM_Event_Event_NvM_WriteErr_Status_u8" UBYTE BSW_A2L_Ident_Int 1 100 0 255 ECU_ADDRESS 0x700061F2 /end MEASUREMENT
/begin MEASUREMENT VAR_RDC_ArctanAgRtr_f32 "VAR_RDC_ArctanAgRtr_f32" FLOAT32_IEEE BSW_A2L_Ident_Float 1 100 -3.4E+38 3.4E+38 ECU_ADDRESS 0x700040D4 /end MEASUREMENT
/begin MEASUREMENT VAR_DEM_Event_TPC_TDbcOvLoWarn_Status_u8 "VAR_DEM_Event_TPC_TDbcOvLoWarn_Status_u8" UBYTE BSW_A2L_Ident_Int 1 100 0 255 ECU_ADDRESS 0x700061A0 /end MEASUREMENT
/begin MEASUREMENT VAR_IoHwAb_Adc_Phy_5V_Qco_f32 "VAR_IoHwAb_Adc_Phy_5V_Qco_f32" FLOAT32_IEEE BSW_A2L_Ident_Float 1 100 -3.4E+38 3.4E+38 ECU_ADDRESS 0x70004588 /end MEASUREMENT
/begin MEASUREMENT VAR_IgbtDrv_Level_NFLTA_u8 "VAR_IgbtDrv_Level_NFLTA_u8" UBYTE BSW_A2L_Ident_Int 1 100 0 255 ECU_ADDRESS 0x70003E33 /end MEASUREMENT
/begin MEASUREMENT VAR_DEM_Event_HSPF_stIphaOffCalFail_Status_u8 "VAR_DEM_Event_HSPF_stIphaOffCalFail_Status_u8" UBYTE BSW_A2L_Ident_Int 1 100 0 255 ECU_ADDRESS 0x700061ED /end MEASUREMENT
/begin MEASUREMENT VAR_flgRecVCU03_u8 "VAR_flgRecVCU03_u8" UBYTE BSW_A2L_Ident_Int 1 100 0 255 ECU_ADDRESS 0x700044EE /end MEASUREMENT
/begin MEASUREMENT VAR_DSADC_Rdc_Sin_s16 "VAR_DSADC_Rdc_Sin_s16" SWORD BSW_A2L_Ident_Int 1 100 -32768 32767 ECU_ADDRESS 0x70004184 /end MEASUREMENT
/begin MEASUREMENT VAR_IoHwAb_Adc_Phy_1V3_MCU_f32 "VAR_IoHwAb_Adc_Phy_1V3_MCU_f32" FLOAT32_IEEE BSW_A2L_Ident_Float 1 100 -3.4E+38 3.4E+38 ECU_ADDRESS 0x7000457C /end MEASUREMENT
/begin MEASUREMENT VAR_NvM_EEP_Study_au8 "VAR_NvM_EEP_Study_au8" UBYTE BSW_A2L_Ident_Int 1 100 0 255 ARRAY_SIZE 8 ECU_ADDRESS 0x7000B4B8 /end MEASUREMENT
/begin MEASUREMENT VAR_IoHwAb_Adc_Phy_18V_HS_f32 "VAR_IoHwAb_Adc_Phy_18V_HS_f32" FLOAT32_IEEE BSW_A2L_Ident_Float 1 100 -3.4E+38 3.4E+38 ECU_ADDRESS 0x70004584 /end MEASUREMENT
/begin MEASUREMENT VAR_IoHwAb_Adc_Phy_5V_Qt2_f32 "VAR_IoHwAb_Adc_Phy_5V_Qt2_f32" FLOAT32_IEEE BSW_A2L_Ident_Float 1 100 -3.4E+38 3.4E+38 ECU_ADDRESS 0x70004590 /end MEASUREMENT
/begin MEASUREMENT VAR_DEM_Event_IOHWAB_12VNarrSampErr_Status_u8 "VAR_DEM_Event_IOHWAB_12VNarrSampErr_Status_u8" UBYTE BSW_A2L_Ident_Int 1 100 0 255 ECU_ADDRESS 0x700061E1 /end MEASUREMENT
/begin MEASUREMENT VAR_DEM_Event_TPC_TDbcVHiLimFail_Status_u8 "VAR_DEM_Event_TPC_TDbcVHiLimFail_Status_u8" UBYTE BSW_A2L_Ident_Int 1 100 0 255 ECU_ADDRESS 0x7000619D /end MEASUREMENT
/begin MEASUREMENT VAR_DEM_Event_RCF_AccOvTiErr_Status_u8 "VAR_DEM_Event_RCF_AccOvTiErr_Status_u8" UBYTE BSW_A2L_Ident_Int 1 100 0 255 ECU_ADDRESS 0x700061B1 /end MEASUREMENT
/begin MEASUREMENT VAR_STM2_TimeData_Pwm3ph_EdgeISR_u32 "VAR_STM2_TimeData_Pwm3ph_EdgeISR_u32" ULONG BSW_A2L_Ident_Int 1 100 0 4294967295 ECU_ADDRESS 0x70004A5C /end MEASUREMENT
/begin MEASUREMENT VAR_PwmDutyCyclePhaseU_f32 "VAR_PwmDutyCyclePhaseU_f32" FLOAT32_IEEE BSW_A2L_Ident_Float 1 100 -3.4E+38 3.4E+38 ECU_ADDRESS 0x50009C88 /end MEASUREMENT
/begin MEASUREMENT VAR_IgbtDrv_Level_NFLTB_L_u8 "VAR_IgbtDrv_Level_NFLTB_L_u8" UBYTE BSW_A2L_Ident_Int 1 100 0 255 ECU_ADDRESS 0x70003E30 /end MEASUREMENT
/begin MEASUREMENT VAR_FS_DycU_f32 "VAR_FS_DycU_f32" FLOAT32_IEEE BSW_A2L_Ident_Float 1 100 -3.4E+38 3.4E+38 ECU_ADDRESS 0x60000040 /end MEASUREMENT
/begin MEASUREMENT VAR_DEM_Event_MDF_IsOvHiErr_Status_u8 "VAR_DEM_Event_MDF_IsOvHiErr_Status_u8" UBYTE BSW_A2L_Ident_Int 1 100 0 255 ECU_ADDRESS 0x700061BE /end MEASUREMENT
/begin MEASUREMENT VAR_DEM_Event_TPC_TIGBTOvHiLimErr_Status_u8 "VAR_DEM_Event_TPC_TIGBTOvHiLimErr_Status_u8" UBYTE BSW_A2L_Ident_Int 1 100 0 255 ECU_ADDRESS 0x70006198 /end MEASUREMENT
/begin MEASUREMENT VAR_Pwm_Mode_u8 "VAR_Pwm_Mode_u8" UBYTE BSW_A2L_Ident_Int 1 100 0 255 ECU_ADDRESS 0x50009C94 /end MEASUREMENT
/begin MEASUREMENT VAR_3phPWMVL_Duty_f32 "VAR_3phPWMVL_Duty_f32" FLOAT32_IEEE BSW_A2L_Ident_Float 1 100 -3.4E+38 3.4E+38 ECU_ADDRESS 0x70004624 /end MEASUREMENT
/begin MEASUREMENT VAR_3phPWMWL_Duty_f32 "VAR_3phPWMWL_Duty_f32" FLOAT32_IEEE BSW_A2L_Ident_Float 1 100 -3.4E+38 3.4E+38 ECU_ADDRESS 0x7000461C /end MEASUREMENT
/begin MEASUREMENT VAR_DEM_Event_RSL_LOTErr_Status_u8 "VAR_DEM_Event_RSL_LOTErr_Status_u8" UBYTE BSW_A2L_Ident_Int 1 100 0 255 ECU_ADDRESS 0x700061A8 /end MEASUREMENT
/begin MEASUREMENT VAR_DEM_Event_TPC_uDcLnkOvVLimFail_Status_u8 "VAR_DEM_Event_TPC_uDcLnkOvVLimFail_Status_u8" UBYTE BSW_A2L_Ident_Int 1 100 0 255 ECU_ADDRESS 0x70006190 /end MEASUREMENT
/begin MEASUREMENT VAR_CDD_Rslv_Cos_f32 "VAR_CDD_Rslv_Cos_f32" FLOAT32_IEEE BSW_A2L_Ident_Float 1 100 -3.4E+38 3.4E+38 ECU_ADDRESS 0x700040FC /end MEASUREMENT
/begin MEASUREMENT VAR_DEM_Event_IOHWAB_12VWideSampErr_Status_u8 "VAR_DEM_Event_IOHWAB_12VWideSampErr_Status_u8" UBYTE BSW_A2L_Ident_Int 1 100 0 255 ECU_ADDRESS 0x700061DF /end MEASUREMENT
/begin MEASUREMENT VAR_PWM3phVDuty_ERR_u8 "VAR_PWM3phVDuty_ERR_u8" UBYTE BSW_A2L_Ident_Int 1 100 0 255 ECU_ADDRESS 0x50009C70 /end MEASUREMENT
/begin MEASUREMENT VAR_MCF_cofFrqPwm_f32 "VAR_MCF_cofFrqPwm_f32" FLOAT32_IEEE BSW_A2L_Ident_Float 1 100 -3.4E+38 3.4E+38 ECU_ADDRESS 0x700040E0 /end MEASUREMENT
/begin MEASUREMENT VAR_DSADC_Rdc_Cos_s16 "VAR_DSADC_Rdc_Cos_s16" SWORD BSW_A2L_Ident_Int 1 100 -32768 32767 ECU_ADDRESS 0x70004104 /end MEASUREMENT
/begin MEASUREMENT VAR_FS_React_u8 "VAR_FS_React_u8" UBYTE BSW_A2L_Ident_Int 1 100 0 255 ECU_ADDRESS 0x60000292 /end MEASUREMENT
/begin MEASUREMENT VAR_DEM_Event_IOHWAB_5VQt2SampFail_Status_u8 "VAR_DEM_Event_IOHWAB_5VQt2SampFail_Status_u8" UBYTE BSW_A2L_Ident_Int 1 100 0 255 ECU_ADDRESS 0x700061D8 /end MEASUREMENT
/begin MEASUREMENT VAR_RESET_McuReason_u8 "VAR_RESET_McuReason_u8" UBYTE BSW_A2L_Ident_Int 1 100 0 255 ECU_ADDRESS 0x70008195 /end MEASUREMENT
/begin MEASUREMENT VAR_Rdc_tisamp_f32 "VAR_Rdc_tisamp_f32" FLOAT32_IEEE BSW_A2L_Ident_Float 1 100 -3.4E+38 3.4E+38 ECU_ADDRESS 0x70004204 /end MEASUREMENT
/begin MEASUREMENT VAR_FS_DMA_Sin_u16 "VAR_FS_DMA_Sin_u16" UWORD BSW_A2L_Ident_Int 1 100 0 65535 ECU_ADDRESS 0x600002E0 /end MEASUREMENT
/begin MEASUREMENT VAR_IoHwAb_Adc_Phy_5V_LEM_f32 "VAR_IoHwAb_Adc_Phy_5V_LEM_f32" FLOAT32_IEEE BSW_A2L_Ident_Float 1 100 -3.4E+38 3.4E+38 ECU_ADDRESS 0x70004568 /end MEASUREMENT
/begin MEASUREMENT VAR_NvM_EPC_NVMPosAimUpLimt_au8 "VAR_NvM_EPC_NVMPosAimUpLimt_au8" UBYTE BSW_A2L_Ident_Int 1 100 0 255 ARRAY_SIZE 8 ECU_ADDRESS 0x7000B49C /end MEASUREMENT
/begin MEASUREMENT VAR_3phPWMWH_Duty_f32 "VAR_3phPWMWH_Duty_f32" FLOAT32_IEEE BSW_A2L_Ident_Float 1 100 -3.4E+38 3.4E+38 ECU_ADDRESS 0x70004620 /end MEASUREMENT
/begin MEASUREMENT VAR_DEM_Event_Cpld_UnderVol_LS_InFail_Status_u8 "VAR_DEM_Event_Cpld_UnderVol_LS_InFail_Status_u8" UBYTE BSW_A2L_Ident_Int 1 100 0 255 ECU_ADDRESS 0x700061F8 /end MEASUREMENT
/begin MEASUREMENT VAR_DEM_Event_ADC_VPhaseBISTFail_Status_u8 "VAR_DEM_Event_ADC_VPhaseBISTFail_Status_u8" UBYTE BSW_A2L_Ident_Int 1 100 0 255 ECU_ADDRESS 0x7000620A /end MEASUREMENT
/begin MEASUREMENT VAR_FS_DMA_Cos_u16 "VAR_FS_DMA_Cos_u16" UWORD BSW_A2L_Ident_Int 1 100 0 65535 ECU_ADDRESS 0x600002E2 /end MEASUREMENT
/begin MEASUREMENT VAR_DEM_Event_PCF_SenClbErr_Status_u8 "VAR_DEM_Event_PCF_SenClbErr_Status_u8" UBYTE BSW_A2L_Ident_Int 1 100 0 255 ECU_ADDRESS 0x700061B6 /end MEASUREMENT
/begin MEASUREMENT VAR_STM0_TimeData_DsAdcISR_u32 "VAR_STM0_TimeData_DsAdcISR_u32" ULONG BSW_A2L_Ident_Int 1 100 0 4294967295 ECU_ADDRESS 0x70004A60 /end MEASUREMENT
/begin MEASUREMENT VAR_DEM_Event_TPC_TCoolantOvHiWarn_Status_u8 "VAR_DEM_Event_TPC_TCoolantOvHiWarn_Status_u8" UBYTE BSW_A2L_Ident_Int 1 100 0 255 ECU_ADDRESS 0x700061A2 /end MEASUREMENT
/begin MEASUREMENT VAR_IoHwAb_Adc_Phy_CPLD_3_3V_f32 "VAR_IoHwAb_Adc_Phy_CPLD_3_3V_f32" FLOAT32_IEEE BSW_A2L_Ident_Float 1 100 -3.4E+38 3.4E+38 ECU_ADDRESS 0x70004594 /end MEASUREMENT
/begin MEASUREMENT VAR_3phPWMVL_Period_f32 "VAR_3phPWMVL_Period_f32" FLOAT32_IEEE BSW_A2L_Ident_Float 1 100 -3.4E+38 3.4E+38 ECU_ADDRESS 0x7000460C /end MEASUREMENT
/begin MEASUREMENT VAR_DEM_Event_Cpld_AliveChkErr_Status_u8 "VAR_DEM_Event_Cpld_AliveChkErr_Status_u8" UBYTE BSW_A2L_Ident_Int 1 100 0 255 ECU_ADDRESS 0x70006205 /end MEASUREMENT
/begin MEASUREMENT VAR_TCF_PinputDc_f32 "VAR_TCF_PinputDc_f32" FLOAT32_IEEE BSW_A2L_Ident_Float 1 100 -3.4E+38 3.4E+38 ECU_ADDRESS 0x70005A7C /end MEASUREMENT
/begin MEASUREMENT VAR_DEM_Event_PCF_StallRetryErr_Status_u8 "VAR_DEM_Event_PCF_StallRetryErr_Status_u8" UBYTE BSW_A2L_Ident_Int 1 100 0 255 ECU_ADDRESS 0x700061B4 /end MEASUREMENT
/begin MEASUREMENT VAR_3phPWMUL_Duty_f32 "VAR_3phPWMUL_Duty_f32" FLOAT32_IEEE BSW_A2L_Ident_Float 1 100 -3.4E+38 3.4E+38 ECU_ADDRESS 0x7000462C /end MEASUREMENT
/begin MEASUREMENT VAR_DEM_Event_HvMcu_EmerPowerSapErr_Status_u8 "VAR_DEM_Event_HvMcu_EmerPowerSapErr_Status_u8" UBYTE BSW_A2L_Ident_Int 1 100 0 255 ECU_ADDRESS 0x700061E7 /end MEASUREMENT
/begin MEASUREMENT VAR_DEM_Event_IOHWAB_5VQt1SampFail_Status_u8 "VAR_DEM_Event_IOHWAB_5VQt1SampFail_Status_u8" UBYTE BSW_A2L_Ident_Int 1 100 0 255 ECU_ADDRESS 0x700061D9 /end MEASUREMENT
/begin MEASUREMENT VAR_DEM_Event_IOHWAB_Cpld3v3SampFail_Status_u8 "VAR_DEM_Event_IOHWAB_Cpld3v3SampFail_Status_u8" UBYTE BSW_A2L_Ident_Int 1 100 0 255 ECU_ADDRESS 0x700061D6 /end MEASUREMENT
/begin MEASUREMENT VAR_DEM_Event_IgbtDrv_LwBrgFaultBFail_Status_u8 "VAR_DEM_Event_IgbtDrv_LwBrgFaultBFail_Status_u8" UBYTE BSW_A2L_Ident_Int 1 100 0 255 ECU_ADDRESS 0x700061C6 /end MEASUREMENT
/begin MEASUREMENT VAR_DEM_Event_Epark_PosMonSampFail_Status_u8 "VAR_DEM_Event_Epark_PosMonSampFail_Status_u8" UBYTE BSW_A2L_Ident_Int 1 100 0 255 ECU_ADDRESS 0x700061F6 /end MEASUREMENT
/begin MEASUREMENT VAR_L2_Sample_flag_b "VAR_L2_Sample_flag_b" UBYTE BSW_A2L_Ident_Int 1 100 0 1 ECU_ADDRESS 0x600006E5 /end MEASUREMENT
/begin MEASUREMENT VAR_Igbt_Normal_State_u16 "VAR_Igbt_Normal_State_u16" UWORD BSW_A2L_Ident_Int 1 100 0 65535 ECU_ADDRESS 0x600006F8 /end MEASUREMENT
/begin MEASUREMENT VAR_CddEpark_Direction_b "VAR_CddEpark_Direction_b" UBYTE BSW_A2L_Ident_Int 1 100 0 1 ECU_ADDRESS 0x70003D04 /end MEASUREMENT
/begin MEASUREMENT VAR_DEM_Event_TPC_TSttrOvHiWarn_Status_u8 "VAR_DEM_Event_TPC_TSttrOvHiWarn_Status_u8" UBYTE BSW_A2L_Ident_Int 1 100 0 255 ECU_ADDRESS 0x70006194 /end MEASUREMENT
/begin MEASUREMENT VAR_CddEpark_Con_Duty_f32 "VAR_CddEpark_Con_Duty_f32" FLOAT32_IEEE BSW_A2L_Ident_Float 1 100 -3.4E+38 3.4E+38 ECU_ADDRESS 0x70003D00 /end MEASUREMENT
/begin MEASUREMENT VAR_DEM_Event_MDF_PhaseLossFaultErr_Status_u8 "VAR_DEM_Event_MDF_PhaseLossFaultErr_Status_u8" UBYTE BSW_A2L_Ident_Int 1 100 0 255 ECU_ADDRESS 0x700061BB /end MEASUREMENT
/begin MEASUREMENT VAR_DEM_Event_TPC_TSttrOvHiLimFail_Status_u8 "VAR_DEM_Event_TPC_TSttrOvHiLimFail_Status_u8" UBYTE BSW_A2L_Ident_Int 1 100 0 255 ECU_ADDRESS 0x70006195 /end MEASUREMENT
/begin MEASUREMENT VAR_DEM_Event_MDF_DiashCirNoPsblErr_Status_u8 "VAR_DEM_Event_MDF_DiashCirNoPsblErr_Status_u8" UBYTE BSW_A2L_Ident_Int 1 100 0 255 ECU_ADDRESS 0x700061C2 /end MEASUREMENT
/begin MEASUREMENT VAR_DEM_Event_Cpld_Short_Circuit_LS_InFail_Status_u8 "VAR_DEM_Event_Cpld_Short_Circuit_LS_InFail_Status_u8" UBYTE BSW_A2L_Ident_Int 1 100 0 255 ECU_ADDRESS 0x700061FB /end MEASUREMENT
/begin MEASUREMENT VAR_DEM_Event_HvMcu_DisChrgFail_Status_u8 "VAR_DEM_Event_HvMcu_DisChrgFail_Status_u8" UBYTE BSW_A2L_Ident_Int 1 100 0 255 ECU_ADDRESS 0x700061E9 /end MEASUREMENT
/begin MEASUREMENT VAR_PwmDutyCyclePhaseW_f32 "VAR_PwmDutyCyclePhaseW_f32" FLOAT32_IEEE BSW_A2L_Ident_Float 1 100 -3.4E+38 3.4E+38 ECU_ADDRESS 0x50009C80 /end MEASUREMENT
/begin MEASUREMENT VAR_FS_ISR_10ms_Cntr_u32 "VAR_FS_ISR_10ms_Cntr_u32" ULONG BSW_A2L_Ident_Int 1 100 0 4294967295 ECU_ADDRESS 0x70004A4C /end MEASUREMENT
/begin MEASUREMENT VAR_CDD_Rslv_CosMax_f32 "VAR_CDD_Rslv_CosMax_f32" FLOAT32_IEEE BSW_A2L_Ident_Float 1 100 -3.4E+38 3.4E+38 ECU_ADDRESS 0x700040E8 /end MEASUREMENT
/begin MEASUREMENT VAR_RollCntRx_MCU_430_u8 "VAR_RollCntRx_MCU_430_u8" UBYTE BSW_A2L_Ident_Int 1 100 0 255 ECU_ADDRESS 0x70003D1B /end MEASUREMENT
/begin MEASUREMENT VAR_DEM_Event_HvMcu_UdcCheckErr_Status_u8 "VAR_DEM_Event_HvMcu_UdcCheckErr_Status_u8" UBYTE BSW_A2L_Ident_Int 1 100 0 255 ECU_ADDRESS 0x700061E4 /end MEASUREMENT
/begin MEASUREMENT VAR_3phPWMUH_Period_f32 "VAR_3phPWMUH_Period_f32" FLOAT32_IEEE BSW_A2L_Ident_Float 1 100 -3.4E+38 3.4E+38 ECU_ADDRESS 0x70004618 /end MEASUREMENT
/begin MEASUREMENT VAR_DEM_Event_IOHWAB_KL30SevOverVolFail_Status_u8 "VAR_DEM_Event_IOHWAB_KL30SevOverVolFail_Status_u8" UBYTE BSW_A2L_Ident_Int 1 100 0 255 ECU_ADDRESS 0x700061D1 /end MEASUREMENT
/begin MEASUREMENT VAR_DEM_Event_IOHWAB_SttrTemp1SampFail_Status_u8 "VAR_DEM_Event_IOHWAB_SttrTemp1SampFail_Status_u8" UBYTE BSW_A2L_Ident_Int 1 100 0 255 ECU_ADDRESS 0x700061CC /end MEASUREMENT
/begin MEASUREMENT VAR_DEM_Event_IOHWAB_IphaOCFail_Status_u8 "VAR_DEM_Event_IOHWAB_IphaOCFail_Status_u8" UBYTE BSW_A2L_Ident_Int 1 100 0 255 ECU_ADDRESS 0x700061D3 /end MEASUREMENT
/begin MEASUREMENT VAR_RESET_AllReason_u8 "VAR_RESET_AllReason_u8" UBYTE BSW_A2L_Ident_Int 1 100 0 255 ECU_ADDRESS 0x70008196 /end MEASUREMENT
/begin MEASUREMENT VAR_LvPower_PowerUpFnh_u8 "VAR_LvPower_PowerUpFnh_u8" UBYTE BSW_A2L_Ident_Int 1 100 0 255 ECU_ADDRESS 0x700040DC /end MEASUREMENT
/begin MEASUREMENT VAR_DEM_Event_TPC_TDbcUHiLimFail_Status_u8 "VAR_DEM_Event_TPC_TDbcUHiLimFail_Status_u8" UBYTE BSW_A2L_Ident_Int 1 100 0 255 ECU_ADDRESS 0x7000619F /end MEASUREMENT
/begin MEASUREMENT VAR_IoHwAb_Adc_Phy_KL30_f32 "VAR_IoHwAb_Adc_Phy_KL30_f32" FLOAT32_IEEE BSW_A2L_Ident_Float 1 100 -3.4E+38 3.4E+38 ECU_ADDRESS 0x70004564 /end MEASUREMENT
/begin MEASUREMENT VAR_IoHwAb_Adc_Phy_CPLD_1_8V_f32 "VAR_IoHwAb_Adc_Phy_CPLD_1_8V_f32" FLOAT32_IEEE BSW_A2L_Ident_Float 1 100 -3.4E+38 3.4E+38 ECU_ADDRESS 0x7000458C /end MEASUREMENT
/begin MEASUREMENT VAR_Cpld_Normal_Work_u8 "VAR_Cpld_Normal_Work_u8" UBYTE BSW_A2L_Ident_Int 1 100 0 255 ECU_ADDRESS 0x70003CC8 /end MEASUREMENT
/begin MEASUREMENT VAR_FS_ISR_1ms_Cntr_u32 "VAR_FS_ISR_1ms_Cntr_u32" ULONG BSW_A2L_Ident_Int 1 100 0 4294967295 ECU_ADDRESS 0x70004A50 /end MEASUREMENT
/begin MEASUREMENT VAR_DEM_Event_Epark_OverCurFail_Status_u8 "VAR_DEM_Event_Epark_OverCurFail_Status_u8" UBYTE BSW_A2L_Ident_Int 1 100 0 255 ECU_ADDRESS 0x700061F7 /end MEASUREMENT
/begin MEASUREMENT VAR_Pwm_DeadTime_In_f32 "VAR_Pwm_DeadTime_In_f32" FLOAT32_IEEE BSW_A2L_Ident_Float 1 100 -3.4E+38 3.4E+38 ECU_ADDRESS 0x50009C8C /end MEASUREMENT
/begin MEASUREMENT VAR_DEM_Event_IgbtDrv_LwBrgFaultAFail_Status_u8 "VAR_DEM_Event_IgbtDrv_LwBrgFaultAFail_Status_u8" UBYTE BSW_A2L_Ident_Int 1 100 0 255 ECU_ADDRESS 0x700061C7 /end MEASUREMENT
/begin MEASUREMENT VAR_3phPWMVH_Period_f32 "VAR_3phPWMVH_Period_f32" FLOAT32_IEEE BSW_A2L_Ident_Float 1 100 -3.4E+38 3.4E+38 ECU_ADDRESS 0x70004610 /end MEASUREMENT
/begin MEASUREMENT VAR_STM0_BSW_1ms_Task_Core0_u32 "VAR_STM0_BSW_1ms_Task_Core0_u32" ULONG BSW_A2L_Ident_Int 1 100 0 4294967295 ECU_ADDRESS 0x70004984 /end MEASUREMENT
/begin MEASUREMENT Rte_Rx_000194_CSPF_RecTrqDmpMax "Rte_Rx_000194_CSPF_RecTrqDmpMax" FLOAT32_IEEE RTE_A2L_Ident_Float 1 100 -3.4E+38 3.4E+38 ECU_ADDRESS 0x7000CF20 /end MEASUREMENT
/begin MEASUREMENT Rte_Rx_000063_HSPF_tStrrTemp2Flt "Rte_Rx_000063_HSPF_tStrrTemp2Flt" FLOAT32_IEEE RTE_A2L_Ident_Float 1 100 -3.4E+38 3.4E+38 ECU_ADDRESS 0x7000CF94 /end MEASUREMENT
/begin MEASUREMENT Rte_Rx_000241_TPC_bDernOvrUdc "Rte_Rx_000241_TPC_bDernOvrUdc" UBYTE RTE_A2L_Ident_Int 1 100 0 1 ECU_ADDRESS 0x7000C9AB /end MEASUREMENT
/begin MEASUREMENT Rte_Rx_000081_LvPower_stLowpowerUp "Rte_Rx_000081_LvPower_stLowpowerUp" UBYTE RTE_A2L_Ident_Int 1 100 0 255 ECU_ADDRESS 0x7000CB8B /end MEASUREMENT
/begin MEASUREMENT Rte_Rx_000031_Com_VCU06_stDoor "Rte_Rx_000031_Com_VCU06_stDoor" UBYTE RTE_A2L_Ident_Int 1 100 0 255 ECU_ADDRESS 0x7000CBA7 /end MEASUREMENT
/begin MEASUREMENT Rte_Rx_000243_TPC_bDernUndrUdc "Rte_Rx_000243_TPC_bDernUndrUdc" UBYTE RTE_A2L_Ident_Int 1 100 0 1 ECU_ADDRESS 0x7000C9A9 /end MEASUREMENT
/begin MEASUREMENT Rte_Rx_000061_HSPF_tIgbtTjFlt "Rte_Rx_000061_HSPF_tIgbtTjFlt" FLOAT32_IEEE RTE_A2L_Ident_Float 1 100 -3.4E+38 3.4E+38 ECU_ADDRESS 0x7000CF9C /end MEASUREMENT
/begin MEASUREMENT Rte_Rx_000177_SCF_stDrvCtl "Rte_Rx_000177_SCF_stDrvCtl" UBYTE RTE_A2L_Ident_Int 1 100 0 255 ECU_ADDRESS 0x7000CB84 /end MEASUREMENT
/begin MEASUREMENT Rte_Rx_000213_Cpld_CpldSwVer "Rte_Rx_000213_Cpld_CpldSwVer" UBYTE RTE_A2L_Ident_Int 1 100 0 255 ECU_ADDRESS 0x7000CB7B /end MEASUREMENT
/begin MEASUREMENT Rte_Rx_000004_Com_VCU01_idcMin "Rte_Rx_000004_Com_VCU01_idcMin" FLOAT32_IEEE RTE_A2L_Ident_Float 1 100 -3.4E+38 3.4E+38 ECU_ADDRESS 0x7000D014 /end MEASUREMENT
/begin MEASUREMENT Rte_Rx_000027_Com_VCU06_Park "Rte_Rx_000027_Com_VCU06_Park" UBYTE RTE_A2L_Ident_Int 1 100 0 1 ECU_ADDRESS 0x7000C9CA /end MEASUREMENT
/begin MEASUREMENT Rte_Rx_000143_PCF_dycPWM "Rte_Rx_000143_PCF_dycPWM" FLOAT32_IEEE RTE_A2L_Ident_Float 1 100 -3.4E+38 3.4E+38 ECU_ADDRESS 0x7000CF4C /end MEASUREMENT
/begin MEASUREMENT Rte_Rx_000165_RCF_stEstAlRtrOfs "Rte_Rx_000165_RCF_stEstAlRtrOfs" UBYTE RTE_A2L_Ident_Int 1 100 0 255 ECU_ADDRESS 0x7000CB86 /end MEASUREMENT
/begin MEASUREMENT Rte_Rx_000195_CSPF_RecTrqDmpMin "Rte_Rx_000195_CSPF_RecTrqDmpMin" FLOAT32_IEEE RTE_A2L_Ident_Float 1 100 -3.4E+38 3.4E+38 ECU_ADDRESS 0x7000CF1C /end MEASUREMENT
/begin MEASUREMENT Rte_Rx_000026_Com_VCU05_stDmpCtLReq "Rte_Rx_000026_Com_VCU05_stDmpCtLReq" UBYTE RTE_A2L_Ident_Int 1 100 0 255 ECU_ADDRESS 0x7000CBAA /end MEASUREMENT
/begin MEASUREMENT Rte_Rx_000160_RCF_cTrqSlpOfsClb "Rte_Rx_000160_RCF_cTrqSlpOfsClb" FLOAT32_IEEE RTE_A2L_Ident_Float 1 100 -3.4E+38 3.4E+38 ECU_ADDRESS 0x7000CF40 /end MEASUREMENT
/begin MEASUREMENT Rte_Rx_000206_CSPF_RecidcMax "Rte_Rx_000206_CSPF_RecidcMax" FLOAT32_IEEE RTE_A2L_Ident_Float 1 100 -3.4E+38 3.4E+38 ECU_ADDRESS 0x7000CEF8 /end MEASUREMENT
/begin MEASUREMENT Rte_Rx_000102_MCF_stPwmMode "Rte_Rx_000102_MCF_stPwmMode" UBYTE RTE_A2L_Ident_Int 1 100 0 255 ECU_ADDRESS 0x70004E2C /end MEASUREMENT
/begin MEASUREMENT Rte_Rx_000202_CSPF_RecUdcMax "Rte_Rx_000202_CSPF_RecUdcMax" FLOAT32_IEEE RTE_A2L_Ident_Float 1 100 -3.4E+38 3.4E+38 ECU_ADDRESS 0x7000CF00 /end MEASUREMENT
/begin MEASUREMENT Rte_Rx_000252_VCF_TrqDes "Rte_Rx_000252_VCF_TrqDes" FLOAT32_IEEE RTE_A2L_Ident_Float 1 100 -3.4E+38 3.4E+38 ECU_ADDRESS 0x7000CED8 /end MEASUREMENT
/begin MEASUREMENT Rte_Rx_000224_Snapshot_flgPostDrvDone "Rte_Rx_000224_Snapshot_flgPostDrvDone" UBYTE RTE_A2L_Ident_Int 1 100 0 1 ECU_ADDRESS 0x7000C9B5 /end MEASUREMENT
/begin MEASUREMENT Rte_Rx_000214_Cpld_IgbtState "Rte_Rx_000214_Cpld_IgbtState" UBYTE RTE_A2L_Ident_Int 1 100 0 255 ECU_ADDRESS 0x7000CB7A /end MEASUREMENT
/begin MEASUREMENT Rte_Rx_000208_CSPF_RecstDmpCtLReq "Rte_Rx_000208_CSPF_RecstDmpCtLReq" UBYTE RTE_A2L_Ident_Int 1 100 0 255 ECU_ADDRESS 0x7000CB7E /end MEASUREMENT
/begin MEASUREMENT Rte_Rx_000150_PhC_iVNoOff "Rte_Rx_000150_PhC_iVNoOff" UWORD RTE_A2L_Ident_Int 1 100 0 65535 ECU_ADDRESS 0x7000CC08 /end MEASUREMENT
/begin MEASUREMENT Rte_Rx_000199_CSPF_RecTrqMinNCtL "Rte_Rx_000199_CSPF_RecTrqMinNCtL" FLOAT32_IEEE RTE_A2L_Ident_Float 1 100 -3.4E+38 3.4E+38 ECU_ADDRESS 0x7000CF0C /end MEASUREMENT
/begin MEASUREMENT Rte_Rx_000240_TPC_bDernOvrIdc "Rte_Rx_000240_TPC_bDernOvrIdc" UBYTE RTE_A2L_Ident_Int 1 100 0 1 ECU_ADDRESS 0x7000C9AC /end MEASUREMENT
/begin MEASUREMENT Rte_Rx_000162_RCF_flgOfsClbSucToNVM "Rte_Rx_000162_RCF_flgOfsClbSucToNVM" UBYTE RTE_A2L_Ident_Int 1 100 0 1 ECU_ADDRESS 0x7000C9BB /end MEASUREMENT
/begin MEASUREMENT Rte_Rx_000125_MPC_TrqMechFlt "Rte_Rx_000125_MPC_TrqMechFlt" FLOAT32_IEEE RTE_A2L_Ident_Float 1 100 -3.4E+38 3.4E+38 ECU_ADDRESS 0x7000CF64 /end MEASUREMENT
/begin MEASUREMENT Rte_Rx_000082_MCF_DycU "Rte_Rx_000082_MCF_DycU" FLOAT32_IEEE RTE_A2L_Ident_Float 1 100 -3.4E+38 3.4E+38 ECU_ADDRESS 0x70004E4C /end MEASUREMENT
/begin MEASUREMENT Rte_Rx_000005_Com_VCU01_UdcMax "Rte_Rx_000005_Com_VCU01_UdcMax" FLOAT32_IEEE RTE_A2L_Ident_Float 1 100 -3.4E+38 3.4E+38 ECU_ADDRESS 0x7000D010 /end MEASUREMENT
/begin MEASUREMENT Rte_Rx_000220_DiagCalib_FailCode5 "Rte_Rx_000220_DiagCalib_FailCode5" UBYTE RTE_A2L_Ident_Int 1 100 0 255 ECU_ADDRESS 0x7000CB74 /end MEASUREMENT
/begin MEASUREMENT Rte_Rx_000040_HSPF_PwrDcLnk "Rte_Rx_000040_HSPF_PwrDcLnk" FLOAT32_IEEE RTE_A2L_Ident_Float 1 100 -3.4E+38 3.4E+38 ECU_ADDRESS 0x7000CFC0 /end MEASUREMENT
/begin MEASUREMENT Rte_Rx_000233_TPC_bDernCAN "Rte_Rx_000233_TPC_bDernCAN" UBYTE RTE_A2L_Ident_Int 1 100 0 1 ECU_ADDRESS 0x7000C9B3 /end MEASUREMENT
/begin MEASUREMENT Rte_Rx_000006_Com_VCU01_UdcMin "Rte_Rx_000006_Com_VCU01_UdcMin" FLOAT32_IEEE RTE_A2L_Ident_Float 1 100 -3.4E+38 3.4E+38 ECU_ADDRESS 0x7000D00C /end MEASUREMENT
/begin MEASUREMENT Rte_Rx_000204_CSPF_RecflgCrash "Rte_Rx_000204_CSPF_RecflgCrash" UBYTE RTE_A2L_Ident_Int 1 100 0 1 ECU_ADDRESS 0x7000C9B7 /end MEASUREMENT
/begin MEASUREMENT Rte_Rx_000141_PCF_SLtrqDes "Rte_Rx_000141_PCF_SLtrqDes" FLOAT32_IEEE RTE_A2L_Ident_Float 1 100 -3.4E+38 3.4E+38 ECU_ADDRESS 0x7000CF50 /end MEASUREMENT
/begin MEASUREMENT Rte_Rx_000209_CSPF_RecstMainReLay "Rte_Rx_000209_CSPF_RecstMainReLay" UBYTE RTE_A2L_Ident_Int 1 100 0 255 ECU_ADDRESS 0x7000CB7D /end MEASUREMENT
/begin MEASUREMENT Rte_Rx_000086_MCF_Is "Rte_Rx_000086_MCF_Is" FLOAT32_IEEE RTE_A2L_Ident_Float 1 100 -3.4E+38 3.4E+38 ECU_ADDRESS 0x70004E40 /end MEASUREMENT
/begin MEASUREMENT Rte_Rx_000071_HvMcu_VDD15L_Vol "Rte_Rx_000071_HvMcu_VDD15L_Vol" UWORD RTE_A2L_Ident_Int 1 100 0 65535 ECU_ADDRESS 0x7000CC16 /end MEASUREMENT
/begin MEASUREMENT Rte_Rx_000236_TPC_bDernDrvBoardTemp "Rte_Rx_000236_TPC_bDernDrvBoardTemp" UBYTE RTE_A2L_Ident_Int 1 100 0 1 ECU_ADDRESS 0x7000C9B0 /end MEASUREMENT
/begin MEASUREMENT Rte_Rx_000251_VCF_NsetPReq "Rte_Rx_000251_VCF_NsetPReq" FLOAT32_IEEE RTE_A2L_Ident_Float 1 100 -3.4E+38 3.4E+38 ECU_ADDRESS 0x7000CEDC /end MEASUREMENT
/begin MEASUREMENT Rte_Rx_000145_PCF_flgSLWD "Rte_Rx_000145_PCF_flgSLWD" UBYTE RTE_A2L_Ident_Int 1 100 0 1 ECU_ADDRESS 0x7000C9BE /end MEASUREMENT
/begin MEASUREMENT Rte_Rx_000186_BCC_iDcLnkEstFlt "Rte_Rx_000186_BCC_iDcLnkEstFlt" FLOAT32_IEEE RTE_A2L_Ident_Float 1 100 -3.4E+38 3.4E+38 ECU_ADDRESS 0x70004E24 /end MEASUREMENT
/begin MEASUREMENT Rte_Rx_000024_Com_VCU05_bSetOfsAL "Rte_Rx_000024_Com_VCU05_bSetOfsAL" UBYTE RTE_A2L_Ident_Int 1 100 0 255 ECU_ADDRESS 0x7000CBAB /end MEASUREMENT
/begin MEASUREMENT Rte_Rx_000050_HSPF_stIphaOffCal "Rte_Rx_000050_HSPF_stIphaOffCal" UBYTE RTE_A2L_Ident_Int 1 100 0 255 ECU_ADDRESS 0x7000CB8C /end MEASUREMENT
/begin MEASUREMENT Rte_Rx_000227_TDC_flgTrqLmtActv "Rte_Rx_000227_TDC_flgTrqLmtActv" UBYTE RTE_A2L_Ident_Int 1 100 0 1 ECU_ADDRESS 0x7000C9B4 /end MEASUREMENT
/begin MEASUREMENT Rte_Rx_000074_HvMcu_tDBCTempV "Rte_Rx_000074_HvMcu_tDBCTempV" UWORD RTE_A2L_Ident_Int 1 100 0 65535 ECU_ADDRESS 0x7000CC12 /end MEASUREMENT
/begin MEASUREMENT Rte_Rx_000178_SCF_stFFAction "Rte_Rx_000178_SCF_stFFAction" UBYTE RTE_A2L_Ident_Int 1 100 0 255 ECU_ADDRESS 0x7000CB83 /end MEASUREMENT
/begin MEASUREMENT Rte_Rx_000000_Com_BMS01_BattCurr "Rte_Rx_000000_Com_BMS01_BattCurr" FLOAT32_IEEE RTE_A2L_Ident_Float 1 100 -3.4E+38 3.4E+38 ECU_ADDRESS 0x7000D01C /end MEASUREMENT
/begin MEASUREMENT Rte_Rx_000016_Com_VCU04_MotDir "Rte_Rx_000016_Com_VCU04_MotDir" UBYTE RTE_A2L_Ident_Int 1 100 0 255 ECU_ADDRESS 0x7000CBAD /end MEASUREMENT
/begin MEASUREMENT Rte_Rx_000138_PCF_MotDir "Rte_Rx_000138_PCF_MotDir" UBYTE RTE_A2L_Ident_Int 1 100 0 1 ECU_ADDRESS 0x7000C9C1 /end MEASUREMENT
/begin MEASUREMENT Rte_Rx_000022_Com_VCU05_TrqDmpMin "Rte_Rx_000022_Com_VCU05_TrqDmpMin" FLOAT32_IEEE RTE_A2L_Ident_Float 1 100 -3.4E+38 3.4E+38 ECU_ADDRESS 0x7000CFDC /end MEASUREMENT
/begin MEASUREMENT Rte_Rx_000062_HSPF_tStrrTemp1Flt "Rte_Rx_000062_HSPF_tStrrTemp1Flt" FLOAT32_IEEE RTE_A2L_Ident_Float 1 100 -3.4E+38 3.4E+38 ECU_ADDRESS 0x7000CF98 /end MEASUREMENT
/begin MEASUREMENT Rte_Rx_000096_MCF_iW "Rte_Rx_000096_MCF_iW" FLOAT32_IEEE RTE_A2L_Ident_Float 1 100 -3.4E+38 3.4E+38 ECU_ADDRESS 0x70004E30 /end MEASUREMENT
/begin MEASUREMENT Rte_Rx_000148_PhC_iUNoOff "Rte_Rx_000148_PhC_iUNoOff" UWORD RTE_A2L_Ident_Int 1 100 0 65535 ECU_ADDRESS 0x7000CC0A /end MEASUREMENT
/begin MEASUREMENT Rte_Rx_000234_TPC_bDernCoolantTemp "Rte_Rx_000234_TPC_bDernCoolantTemp" UBYTE RTE_A2L_Ident_Int 1 100 0 1 ECU_ADDRESS 0x7000C9B2 /end MEASUREMENT
/begin MEASUREMENT Rte_Rx_000060_HSPF_tDrvBoardTempFlt "Rte_Rx_000060_HSPF_tDrvBoardTempFlt" FLOAT32_IEEE RTE_A2L_Ident_Float 1 100 -3.4E+38 3.4E+38 ECU_ADDRESS 0x7000CFA0 /end MEASUREMENT
/begin MEASUREMENT Rte_Rx_000053_HSPF_tCoolantTjFlt "Rte_Rx_000053_HSPF_tCoolantTjFlt" FLOAT32_IEEE RTE_A2L_Ident_Float 1 100 -3.4E+38 3.4E+38 ECU_ADDRESS 0x7000CFB0 /end MEASUREMENT
/begin MEASUREMENT Rte_Rx_000014_Com_VCU03_TrqMin "Rte_Rx_000014_Com_VCU03_TrqMin" FLOAT32_IEEE RTE_A2L_Ident_Float 1 100 -3.4E+38 3.4E+38 ECU_ADDRESS 0x7000CFF0 /end MEASUREMENT
/begin MEASUREMENT Rte_Rx_000232_TPC_TrqMin "Rte_Rx_000232_TPC_TrqMin" FLOAT32_IEEE RTE_A2L_Ident_Float 1 100 -3.4E+38 3.4E+38 ECU_ADDRESS 0x7000CEE8 /end MEASUREMENT
/begin MEASUREMENT Rte_Rx_000137_NvM_flgAngAutoClbOffset "Rte_Rx_000137_NvM_flgAngAutoClbOffset" UBYTE RTE_A2L_Ident_Int 1 100 0 1 ECU_ADDRESS 0x7000C9C2 /end MEASUREMENT
/begin MEASUREMENT Rte_Rx_000172_SCF_flgEmgReqInvDcha "Rte_Rx_000172_SCF_flgEmgReqInvDcha" UBYTE RTE_A2L_Ident_Int 1 100 0 1 ECU_ADDRESS 0x7000C9B9 /end MEASUREMENT
/begin MEASUREMENT Rte_Rx_000176_SCF_stDisChg "Rte_Rx_000176_SCF_stDisChg" UBYTE RTE_A2L_Ident_Int 1 100 0 255 ECU_ADDRESS 0x7000CB85 /end MEASUREMENT
/begin MEASUREMENT Rte_Rx_000019_Com_VCU04_bKL15 "Rte_Rx_000019_Com_VCU04_bKL15" UBYTE RTE_A2L_Ident_Int 1 100 0 1 ECU_ADDRESS 0x7000C9CB /end MEASUREMENT
/begin MEASUREMENT Rte_Rx_000147_PCF_stParkCtl "Rte_Rx_000147_PCF_stParkCtl" UBYTE RTE_A2L_Ident_Int 1 100 0 255 ECU_ADDRESS 0x7000CB88 /end MEASUREMENT
/begin MEASUREMENT Rte_Rx_000219_DiagCalib_FailCode4 "Rte_Rx_000219_DiagCalib_FailCode4" UBYTE RTE_A2L_Ident_Int 1 100 0 255 ECU_ADDRESS 0x7000CB75 /end MEASUREMENT
/begin MEASUREMENT Rte_Rx_000168_Rdc_nWoFlt "Rte_Rx_000168_Rdc_nWoFlt" FLOAT32_IEEE RTE_A2L_Ident_Float 1 100 -3.4E+38 3.4E+38 ECU_ADDRESS 0x7000CF38 /end MEASUREMENT
/begin MEASUREMENT Rte_Rx_000161_RCF_flgOfsClbSuc "Rte_Rx_000161_RCF_flgOfsClbSuc" UBYTE RTE_A2L_Ident_Int 1 100 0 1 ECU_ADDRESS 0x7000C9BC /end MEASUREMENT
/begin MEASUREMENT Rte_Rx_000070_HvMcu_HvMcuVer "Rte_Rx_000070_HvMcu_HvMcuVer" UWORD RTE_A2L_Ident_Int 1 100 0 65535 ECU_ADDRESS 0x7000CC18 /end MEASUREMENT
/begin MEASUREMENT Rte_Rx_000197_CSPF_RecTrqMaxNCtL "Rte_Rx_000197_CSPF_RecTrqMaxNCtL" FLOAT32_IEEE RTE_A2L_Ident_Float 1 100 -3.4E+38 3.4E+38 ECU_ADDRESS 0x7000CF14 /end MEASUREMENT
/begin MEASUREMENT Rte_Rx_000090_MCF_frqPwm "Rte_Rx_000090_MCF_frqPwm" FLOAT32_IEEE RTE_A2L_Ident_Float 1 100 -3.4E+38 3.4E+38 ECU_ADDRESS 0x70004E3C /end MEASUREMENT
/begin MEASUREMENT Rte_Rx_000207_CSPF_RecidcMin "Rte_Rx_000207_CSPF_RecidcMin" FLOAT32_IEEE RTE_A2L_Ident_Float 1 100 -3.4E+38 3.4E+38 ECU_ADDRESS 0x7000CEF4 /end MEASUREMENT
/begin MEASUREMENT Rte_Rx_000010_Com_VCU02_NDiffMax "Rte_Rx_000010_Com_VCU02_NDiffMax" FLOAT32_IEEE RTE_A2L_Ident_Float 1 100 -3.4E+38 3.4E+38 ECU_ADDRESS 0x7000D000 /end MEASUREMENT
/begin MEASUREMENT Rte_Rx_000069_HvMcu_AlOfsClb_TimeStamp "Rte_Rx_000069_HvMcu_AlOfsClb_TimeStamp" FLOAT32_IEEE RTE_A2L_Ident_Float 1 100 -3.4E+38 3.4E+38 ECU_ADDRESS 0x7000CF84 /end MEASUREMENT
/begin MEASUREMENT Rte_Rx_000078_HvMcu_uDcLnkHvMcu "Rte_Rx_000078_HvMcu_uDcLnkHvMcu" FLOAT32_IEEE RTE_A2L_Ident_Float 1 100 -3.4E+38 3.4E+38 ECU_ADDRESS 0x7000CF80 /end MEASUREMENT
/begin MEASUREMENT Rte_Rx_000155_RCF_AutoClbOffset "Rte_Rx_000155_RCF_AutoClbOffset" FLOAT32_IEEE RTE_A2L_Ident_Float 1 100 -3.4E+38 3.4E+38 ECU_ADDRESS 0x7000CF48 /end MEASUREMENT
/begin MEASUREMENT Rte_Rx_000167_Rdc_ArctanAgRtr "Rte_Rx_000167_Rdc_ArctanAgRtr" FLOAT32_IEEE RTE_A2L_Ident_Float 1 100 -3.4E+38 3.4E+38 ECU_ADDRESS 0x7000CF3C /end MEASUREMENT
/begin MEASUREMENT Rte_Rx_000073_HvMcu_tDBCTempU "Rte_Rx_000073_HvMcu_tDBCTempU" UWORD RTE_A2L_Ident_Int 1 100 0 65535 ECU_ADDRESS 0x7000CC14 /end MEASUREMENT
/begin MEASUREMENT Rte_Rx_000083_MCF_DycV "Rte_Rx_000083_MCF_DycV" FLOAT32_IEEE RTE_A2L_Ident_Float 1 100 -3.4E+38 3.4E+38 ECU_ADDRESS 0x70004E48 /end MEASUREMENT
/begin MEASUREMENT Rte_Rx_000079_Igbt_flgGateDrvRdyHs "Rte_Rx_000079_Igbt_flgGateDrvRdyHs" UBYTE RTE_A2L_Ident_Int 1 100 0 1 ECU_ADDRESS 0x7000C9C5 /end MEASUREMENT
/begin MEASUREMENT Rte_Rx_000051_HSPF_tCoolantTempFlt "Rte_Rx_000051_HSPF_tCoolantTempFlt" FLOAT32_IEEE RTE_A2L_Ident_Float 1 100 -3.4E+38 3.4E+38 ECU_ADDRESS 0x7000CFB4 /end MEASUREMENT
/begin MEASUREMENT Rte_Rx_000013_Com_VCU03_TrqMax "Rte_Rx_000013_Com_VCU03_TrqMax" FLOAT32_IEEE RTE_A2L_Ident_Float 1 100 -3.4E+38 3.4E+38 ECU_ADDRESS 0x7000CFF4 /end MEASUREMENT
/begin MEASUREMENT Rte_Rx_000042_HSPF_bt15 "Rte_Rx_000042_HSPF_bt15" UBYTE RTE_A2L_Ident_Int 1 100 0 1 ECU_ADDRESS 0x7000C9C8 /end MEASUREMENT
/begin MEASUREMENT Rte_Rx_000244_TPC_stMotorMod "Rte_Rx_000244_TPC_stMotorMod" UBYTE RTE_A2L_Ident_Int 1 100 0 255 ECU_ADDRESS 0x7000CB6E /end MEASUREMENT
/begin MEASUREMENT Rte_Rx_000203_CSPF_RecUdcMin "Rte_Rx_000203_CSPF_RecUdcMin" FLOAT32_IEEE RTE_A2L_Ident_Float 1 100 -3.4E+38 3.4E+38 ECU_ADDRESS 0x7000CEFC /end MEASUREMENT
/begin MEASUREMENT Rte_Rx_000028_Com_VCU06_VehGrad "Rte_Rx_000028_Com_VCU06_VehGrad" FLOAT32_IEEE RTE_A2L_Ident_Float 1 100 -3.4E+38 3.4E+38 ECU_ADDRESS 0x7000CFD0 /end MEASUREMENT
/begin MEASUREMENT Rte_Rx_000249_VCF_HoldStartTrq "Rte_Rx_000249_VCF_HoldStartTrq" FLOAT32_IEEE RTE_A2L_Ident_Float 1 100 -3.4E+38 3.4E+38 ECU_ADDRESS 0x7000CEE4 /end MEASUREMENT
/begin MEASUREMENT Rte_Rx_000174_SCF_flgUdcLowToTpc "Rte_Rx_000174_SCF_flgUdcLowToTpc" UBYTE RTE_A2L_Ident_Int 1 100 0 1 ECU_ADDRESS 0x7000C9B8 /end MEASUREMENT
/begin MEASUREMENT Rte_Rx_000043_HSPF_flgCrash "Rte_Rx_000043_HSPF_flgCrash" UBYTE RTE_A2L_Ident_Int 1 100 0 1 ECU_ADDRESS 0x7000C9C7 /end MEASUREMENT
/begin MEASUREMENT Rte_Rx_000229_TPC_SgnTrqMechDir "Rte_Rx_000229_TPC_SgnTrqMechDir" UBYTE RTE_A2L_Ident_Int 1 100 0 255 ECU_ADDRESS 0x7000CB6F /end MEASUREMENT
/begin MEASUREMENT Rte_Rx_000180_SCF_stGateDrv "Rte_Rx_000180_SCF_stGateDrv" UBYTE RTE_A2L_Ident_Int 1 100 0 255 ECU_ADDRESS 0x7000CB82 /end MEASUREMENT
/begin MEASUREMENT Rte_Rx_000021_Com_VCU05_OfsAL "Rte_Rx_000021_Com_VCU05_OfsAL" FLOAT32_IEEE RTE_A2L_Ident_Float 1 100 -3.4E+38 3.4E+38 ECU_ADDRESS 0x7000CFE0 /end MEASUREMENT
/begin MEASUREMENT Rte_Rx_000193_CSPF_RecNSetP "Rte_Rx_000193_CSPF_RecNSetP" FLOAT32_IEEE RTE_A2L_Ident_Float 1 100 -3.4E+38 3.4E+38 ECU_ADDRESS 0x7000CF24 /end MEASUREMENT
/begin MEASUREMENT Rte_Rx_000121_MPC_Rs "Rte_Rx_000121_MPC_Rs" FLOAT32_IEEE RTE_A2L_Ident_Float 1 100 -3.4E+38 3.4E+38 ECU_ADDRESS 0x7000CF6C /end MEASUREMENT
/begin MEASUREMENT Rte_Rx_000017_Com_VCU04_NSetP "Rte_Rx_000017_Com_VCU04_NSetP" FLOAT32_IEEE RTE_A2L_Ident_Float 1 100 -3.4E+38 3.4E+38 ECU_ADDRESS 0x7000CFE8 /end MEASUREMENT
/begin MEASUREMENT Rte_Rx_000200_CSPF_RecTrqSLope "Rte_Rx_000200_CSPF_RecTrqSLope" FLOAT32_IEEE RTE_A2L_Ident_Float 1 100 -3.4E+38 3.4E+38 ECU_ADDRESS 0x7000CF08 /end MEASUREMENT
/begin MEASUREMENT Rte_Rx_000119_MPC_Psi "Rte_Rx_000119_MPC_Psi" FLOAT32_IEEE RTE_A2L_Ident_Float 1 100 -3.4E+38 3.4E+38 ECU_ADDRESS 0x7000CF70 /end MEASUREMENT
/begin MEASUREMENT Rte_Rx_000242_TPC_bDernStrTemp "Rte_Rx_000242_TPC_bDernStrTemp" UBYTE RTE_A2L_Ident_Int 1 100 0 1 ECU_ADDRESS 0x7000C9AA /end MEASUREMENT
/begin MEASUREMENT Rte_Rx_000041_HSPF_Wake "Rte_Rx_000041_HSPF_Wake" UBYTE RTE_A2L_Ident_Int 1 100 0 1 ECU_ADDRESS 0x7000C9C9 /end MEASUREMENT
/begin MEASUREMENT Rte_Rx_000152_PhC_iWNoOff "Rte_Rx_000152_PhC_iWNoOff" UWORD RTE_A2L_Ident_Int 1 100 0 65535 ECU_ADDRESS 0x7000CC06 /end MEASUREMENT
/begin MEASUREMENT Rte_Rx_000156_RCF_TrqEmDesOfsClb "Rte_Rx_000156_RCF_TrqEmDesOfsClb" FLOAT32_IEEE RTE_A2L_Ident_Float 1 100 -3.4E+38 3.4E+38 ECU_ADDRESS 0x7000CF44 /end MEASUREMENT
/begin MEASUREMENT Rte_Rx_000109_MDF_stFrwhl "Rte_Rx_000109_MDF_stFrwhl" UBYTE RTE_A2L_Ident_Int 1 100 0 255 ECU_ADDRESS 0x7000CB89 /end MEASUREMENT
/begin MEASUREMENT Rte_Rx_000129_MPC_isdFlt "Rte_Rx_000129_MPC_isdFlt" FLOAT32_IEEE RTE_A2L_Ident_Float 1 100 -3.4E+38 3.4E+38 ECU_ADDRESS 0x7000CF60 /end MEASUREMENT
/begin MEASUREMENT Rte_Rx_000030_Com_VCU06_stBreak "Rte_Rx_000030_Com_VCU06_stBreak" UBYTE RTE_A2L_Ident_Int 1 100 0 255 ECU_ADDRESS 0x7000CBA8 /end MEASUREMENT
/begin MEASUREMENT Rte_Rx_000072_HvMcu_flgUphaEdgeRiseCo "Rte_Rx_000072_HvMcu_flgUphaEdgeRiseCo" UBYTE RTE_A2L_Ident_Int 1 100 0 1 ECU_ADDRESS 0x7000C9C6 /end MEASUREMENT
/begin MEASUREMENT Rte_Rx_000146_PCF_flgShtDwnReq "Rte_Rx_000146_PCF_flgShtDwnReq" UBYTE RTE_A2L_Ident_Int 1 100 0 1 ECU_ADDRESS 0x7000C9BD /end MEASUREMENT
/begin MEASUREMENT Rte_Rx_000164_RCF_stAgRtrOfsCal "Rte_Rx_000164_RCF_stAgRtrOfsCal" UBYTE RTE_A2L_Ident_Int 1 100 0 255 ECU_ADDRESS 0x7000CB87 /end MEASUREMENT
/begin MEASUREMENT Rte_Rx_000094_MCF_iV "Rte_Rx_000094_MCF_iV" FLOAT32_IEEE RTE_A2L_Ident_Float 1 100 -3.4E+38 3.4E+38 ECU_ADDRESS 0x70004E34 /end MEASUREMENT
/begin MEASUREMENT Rte_Rx_000181_SCF_stModeReqToTdc "Rte_Rx_000181_SCF_stModeReqToTdc" UBYTE RTE_A2L_Ident_Int 1 100 0 255 ECU_ADDRESS 0x7000CB81 /end MEASUREMENT
/begin MEASUREMENT Rte_Rx_000237_TPC_bDernExcMax "Rte_Rx_000237_TPC_bDernExcMax" UBYTE RTE_A2L_Ident_Int 1 100 0 1 ECU_ADDRESS 0x7000C9AF /end MEASUREMENT
/begin MEASUREMENT Rte_Rx_000002_Com_BMS01_stMainReLay "Rte_Rx_000002_Com_BMS01_stMainReLay" UBYTE RTE_A2L_Ident_Int 1 100 0 255 ECU_ADDRESS 0x7000CBAF /end MEASUREMENT
/begin MEASUREMENT Rte_Rx_000196_CSPF_RecTrqMax "Rte_Rx_000196_CSPF_RecTrqMax" FLOAT32_IEEE RTE_A2L_Ident_Float 1 100 -3.4E+38 3.4E+38 ECU_ADDRESS 0x7000CF18 /end MEASUREMENT
/begin MEASUREMENT Rte_Rx_000228_TPC_SgnRotDir "Rte_Rx_000228_TPC_SgnRotDir" UBYTE RTE_A2L_Ident_Int 1 100 0 255 ECU_ADDRESS 0x7000CB70 /end MEASUREMENT
/begin MEASUREMENT Rte_Rx_000132_MPC_isqFlt "Rte_Rx_000132_MPC_isqFlt" FLOAT32_IEEE RTE_A2L_Ident_Float 1 100 -3.4E+38 3.4E+38 ECU_ADDRESS 0x7000CF5C /end MEASUREMENT
/begin MEASUREMENT Rte_Rx_000092_MCF_iU "Rte_Rx_000092_MCF_iU" FLOAT32_IEEE RTE_A2L_Ident_Float 1 100 -3.4E+38 3.4E+38 ECU_ADDRESS 0x70004E38 /end MEASUREMENT
/begin MEASUREMENT Rte_Rx_000044_HSPF_iDcLnkEstFlt "Rte_Rx_000044_HSPF_iDcLnkEstFlt" FLOAT32_IEEE RTE_A2L_Ident_Float 1 100 -3.4E+38 3.4E+38 ECU_ADDRESS 0x7000CFBC /end MEASUREMENT
/begin MEASUREMENT Rte_Rx_000007_Com_VCU01_stHvbMaiRly "Rte_Rx_000007_Com_VCU01_stHvbMaiRly" UBYTE RTE_A2L_Ident_Int 1 100 0 255 ECU_ADDRESS 0x7000CBAE /end MEASUREMENT
/begin MEASUREMENT Rte_Rx_000107_MDF_bFaultEMBlkWarnSt "Rte_Rx_000107_MDF_bFaultEMBlkWarnSt" UBYTE RTE_A2L_Ident_Int 1 100 0 255 ECU_ADDRESS 0x7000CB8A /end MEASUREMENT
/begin MEASUREMENT Rte_Rx_000217_DiagCalib_FailCode2 "Rte_Rx_000217_DiagCalib_FailCode2" UBYTE RTE_A2L_Ident_Int 1 100 0 255 ECU_ADDRESS 0x7000CB77 /end MEASUREMENT
/begin MEASUREMENT Rte_Rx_000023_Com_VCU05_TrqDmpMax "Rte_Rx_000023_Com_VCU05_TrqDmpMax" FLOAT32_IEEE RTE_A2L_Ident_Float 1 100 -3.4E+38 3.4E+38 ECU_ADDRESS 0x7000CFD8 /end MEASUREMENT
/begin MEASUREMENT Rte_Rx_000190_CSPF_RecKpHighNCtL "Rte_Rx_000190_CSPF_RecKpHighNCtL" FLOAT32_IEEE RTE_A2L_Ident_Float 1 100 -3.4E+38 3.4E+38 ECU_ADDRESS 0x7000CF30 /end MEASUREMENT
/begin MEASUREMENT Rte_Rx_000239_TPC_bDernMtrSpd "Rte_Rx_000239_TPC_bDernMtrSpd" UBYTE RTE_A2L_Ident_Int 1 100 0 1 ECU_ADDRESS 0x7000C9AD /end MEASUREMENT
/begin MEASUREMENT Rte_Rx_000123_MPC_TrqMech "Rte_Rx_000123_MPC_TrqMech" FLOAT32_IEEE RTE_A2L_Ident_Float 1 100 -3.4E+38 3.4E+38 ECU_ADDRESS 0x7000CF68 /end MEASUREMENT
/begin MEASUREMENT Rte_Rx_000215_Cpld_ProjectNum "Rte_Rx_000215_Cpld_ProjectNum" UBYTE RTE_A2L_Ident_Int 1 100 0 255 ECU_ADDRESS 0x7000CB79 /end MEASUREMENT
/begin MEASUREMENT Rte_Rx_000038_Epark_posPcf "Rte_Rx_000038_Epark_posPcf" FLOAT32_IEEE RTE_A2L_Ident_Float 1 100 -3.4E+38 3.4E+38 ECU_ADDRESS 0x7000CFC8 /end MEASUREMENT
/begin MEASUREMENT Rte_Rx_000048_HSPF_nSlowFlt "Rte_Rx_000048_HSPF_nSlowFlt" FLOAT32_IEEE RTE_A2L_Ident_Float 1 100 -3.4E+38 3.4E+38 ECU_ADDRESS 0x7000CFB8 /end MEASUREMENT
/begin MEASUREMENT Rte_Rx_000140_PCF_SLInPLimt "Rte_Rx_000140_PCF_SLInPLimt" FLOAT32_IEEE RTE_A2L_Ident_Float 1 100 -3.4E+38 3.4E+38 ECU_ADDRESS 0x7000CF54 /end MEASUREMENT
/begin MEASUREMENT Rte_Rx_000039_Epark_posPcfMon "Rte_Rx_000039_Epark_posPcfMon" FLOAT32_IEEE RTE_A2L_Ident_Float 1 100 -3.4E+38 3.4E+38 ECU_ADDRESS 0x7000CFC4 /end MEASUREMENT
/begin MEASUREMENT Rte_Rx_000184_SCF_stSysCtl "Rte_Rx_000184_SCF_stSysCtl" UBYTE RTE_A2L_Ident_Int 1 100 0 255 ECU_ADDRESS 0x7000CB7F /end MEASUREMENT
/begin MEASUREMENT Rte_Rx_000139_PCF_SLEnMotorAcc "Rte_Rx_000139_PCF_SLEnMotorAcc" UBYTE RTE_A2L_Ident_Int 1 100 0 1 ECU_ADDRESS 0x7000C9C0 /end MEASUREMENT
/begin MEASUREMENT Rte_Rx_000210_CSPF_RecstModeReq "Rte_Rx_000210_CSPF_RecstModeReq" UBYTE RTE_A2L_Ident_Int 1 100 0 255 ECU_ADDRESS 0x7000CB7C /end MEASUREMENT
/begin MEASUREMENT Rte_Rx_000103_MCF_tiLock "Rte_Rx_000103_MCF_tiLock" FLOAT32_IEEE RTE_A2L_Ident_Float 1 100 -3.4E+38 3.4E+38 ECU_ADDRESS 0x70004E28 /end MEASUREMENT
/begin MEASUREMENT Rte_Rx_000248_Tja1043_flgCAN_WakeUp "Rte_Rx_000248_Tja1043_flgCAN_WakeUp" UBYTE RTE_A2L_Ident_Int 1 100 0 1 ECU_ADDRESS 0x7000C9A8 /end MEASUREMENT
/begin MEASUREMENT Rte_Rx_000198_CSPF_RecTrqMin "Rte_Rx_000198_CSPF_RecTrqMin" FLOAT32_IEEE RTE_A2L_Ident_Float 1 100 -3.4E+38 3.4E+38 ECU_ADDRESS 0x7000CF10 /end MEASUREMENT
/begin MEASUREMENT Rte_Rx_000075_HvMcu_tDBCTempW "Rte_Rx_000075_HvMcu_tDBCTempW" UWORD RTE_A2L_Ident_Int 1 100 0 65535 ECU_ADDRESS 0x7000CC10 /end MEASUREMENT
/begin MEASUREMENT Rte_Rx_000235_TPC_bDernDbcTemp "Rte_Rx_000235_TPC_bDernDbcTemp" UBYTE RTE_A2L_Ident_Int 1 100 0 1 ECU_ADDRESS 0x7000C9B1 /end MEASUREMENT
/begin MEASUREMENT Rte_Rx_000066_HSPF_uDcLnkSlowFlt "Rte_Rx_000066_HSPF_uDcLnkSlowFlt" FLOAT32_IEEE RTE_A2L_Ident_Float 1 100 -3.4E+38 3.4E+38 ECU_ADDRESS 0x7000CF8C /end MEASUREMENT
/begin MEASUREMENT Rte_Rx_000001_Com_BMS01_BattVoLt "Rte_Rx_000001_Com_BMS01_BattVoLt" UWORD RTE_A2L_Ident_Int 1 100 0 65535 ECU_ADDRESS 0x7000CC1A /end MEASUREMENT
/begin MEASUREMENT Rte_Rx_000254_VCF_trqRamp "Rte_Rx_000254_VCF_trqRamp" FLOAT32_IEEE RTE_A2L_Ident_Float 1 100 -3.4E+38 3.4E+38 ECU_ADDRESS 0x7000CED4 /end MEASUREMENT
/begin MEASUREMENT Rte_Rx_000238_TPC_bDernExcMin "Rte_Rx_000238_TPC_bDernExcMin" UBYTE RTE_A2L_Ident_Int 1 100 0 1 ECU_ADDRESS 0x7000C9AE /end MEASUREMENT
/begin MEASUREMENT Rte_Rx_000222_DiagCalib_FailCode7 "Rte_Rx_000222_DiagCalib_FailCode7" UBYTE RTE_A2L_Ident_Int 1 100 0 255 ECU_ADDRESS 0x7000CB72 /end MEASUREMENT
/begin MEASUREMENT Rte_Rx_000250_VCF_KpNCtl "Rte_Rx_000250_VCF_KpNCtl" FLOAT32_IEEE RTE_A2L_Ident_Float 1 100 -3.4E+38 3.4E+38 ECU_ADDRESS 0x7000CEE0 /end MEASUREMENT
/begin MEASUREMENT Rte_Rx_000113_MPC_Ld "Rte_Rx_000113_MPC_Ld" FLOAT32_IEEE RTE_A2L_Ident_Float 1 100 -3.4E+38 3.4E+38 ECU_ADDRESS 0x7000CF78 /end MEASUREMENT
/begin MEASUREMENT Rte_Rx_000226_TDC_TrqDes "Rte_Rx_000226_TDC_TrqDes" FLOAT32_IEEE RTE_A2L_Ident_Float 1 100 -3.4E+38 3.4E+38 ECU_ADDRESS 0x7000CEF0 /end MEASUREMENT
/begin MEASUREMENT Rte_Rx_000171_SCF_bHvReady "Rte_Rx_000171_SCF_bHvReady" UBYTE RTE_A2L_Ident_Int 1 100 0 1 ECU_ADDRESS 0x7000C9BA /end MEASUREMENT
/begin MEASUREMENT Rte_Rx_000065_HSPF_tStrrTempFlt "Rte_Rx_000065_HSPF_tStrrTempFlt" FLOAT32_IEEE RTE_A2L_Ident_Float 1 100 -3.4E+38 3.4E+38 ECU_ADDRESS 0x7000CF90 /end MEASUREMENT
/begin MEASUREMENT Rte_Rx_000008_Com_VCU02_KpHighNCtL "Rte_Rx_000008_Com_VCU02_KpHighNCtL" FLOAT32_IEEE RTE_A2L_Ident_Float 1 100 -3.4E+38 3.4E+38 ECU_ADDRESS 0x7000D008 /end MEASUREMENT
/begin MEASUREMENT Rte_Rx_000015_Com_VCU03_cTrqSlopeMax "Rte_Rx_000015_Com_VCU03_cTrqSlopeMax" FLOAT32_IEEE RTE_A2L_Ident_Float 1 100 -3.4E+38 3.4E+38 ECU_ADDRESS 0x7000CFEC /end MEASUREMENT
/begin MEASUREMENT Rte_Rx_000003_Com_VCU01_idcMax "Rte_Rx_000003_Com_VCU01_idcMax" FLOAT32_IEEE RTE_A2L_Ident_Float 1 100 -3.4E+38 3.4E+38 ECU_ADDRESS 0x7000D018 /end MEASUREMENT
/begin MEASUREMENT Rte_Rx_000111_MPC_IsFlt "Rte_Rx_000111_MPC_IsFlt" FLOAT32_IEEE RTE_A2L_Ident_Float 1 100 -3.4E+38 3.4E+38 ECU_ADDRESS 0x7000CF7C /end MEASUREMENT
/begin MEASUREMENT Rte_Rx_000247_TPC_stTrqEmMin "Rte_Rx_000247_TPC_stTrqEmMin" UBYTE RTE_A2L_Ident_Int 1 100 0 255 ECU_ADDRESS 0x7000CB6C /end MEASUREMENT
/begin MEASUREMENT Rte_Rx_000020_Com_VCU04_stModeReq "Rte_Rx_000020_Com_VCU04_stModeReq" UBYTE RTE_A2L_Ident_Int 1 100 0 255 ECU_ADDRESS 0x7000CBAC /end MEASUREMENT
/begin MEASUREMENT Rte_Rx_000011_Com_VCU02_TrqMaxNCtL "Rte_Rx_000011_Com_VCU02_TrqMaxNCtL" FLOAT32_IEEE RTE_A2L_Ident_Float 1 100 -3.4E+38 3.4E+38 ECU_ADDRESS 0x7000CFFC /end MEASUREMENT
/begin MEASUREMENT Rte_Rx_000134_NvM_SLFnh "Rte_Rx_000134_NvM_SLFnh" UBYTE RTE_A2L_Ident_Int 1 100 0 1 ECU_ADDRESS 0x7000C9C3 /end MEASUREMENT
/begin MEASUREMENT Rte_Rx_000101_MCF_secVolt "Rte_Rx_000101_MCF_secVolt" UBYTE RTE_A2L_Ident_Int 1 100 0 255 ECU_ADDRESS 0x70004E2D /end MEASUREMENT
/begin MEASUREMENT Rte_Rx_000029_Com_VCU06_stBelt "Rte_Rx_000029_Com_VCU06_stBelt" UBYTE RTE_A2L_Ident_Int 1 100 0 255 ECU_ADDRESS 0x7000CBA9 /end MEASUREMENT
/begin MEASUREMENT Rte_Rx_000205_CSPF_RecflgDchaReq "Rte_Rx_000205_CSPF_RecflgDchaReq" UBYTE RTE_A2L_Ident_Int 1 100 0 1 ECU_ADDRESS 0x7000C9B6 /end MEASUREMENT
/begin MEASUREMENT Rte_Rx_000182_SCF_stPreDrvCtl "Rte_Rx_000182_SCF_stPreDrvCtl" UBYTE RTE_A2L_Ident_Int 1 100 0 255 ECU_ADDRESS 0x7000CB80 /end MEASUREMENT
/begin MEASUREMENT Rte_Rx_000135_NvM_SLInPLimt "Rte_Rx_000135_NvM_SLInPLimt" FLOAT32_IEEE RTE_A2L_Ident_Float 1 100 -3.4E+38 3.4E+38 ECU_ADDRESS 0x7000CF58 /end MEASUREMENT
/begin MEASUREMENT Rte_Rx_000076_HvMcu_tDrvBoardTemp "Rte_Rx_000076_HvMcu_tDrvBoardTemp" UWORD RTE_A2L_Ident_Int 1 100 0 65535 ECU_ADDRESS 0x7000CC0E /end MEASUREMENT
/begin MEASUREMENT Rte_Rx_000216_DiagCalib_FailCode1 "Rte_Rx_000216_DiagCalib_FailCode1" UBYTE RTE_A2L_Ident_Int 1 100 0 255 ECU_ADDRESS 0x7000CB78 /end MEASUREMENT
/begin MEASUREMENT Rte_Rx_000189_CSPF_RecKpDmp "Rte_Rx_000189_CSPF_RecKpDmp" FLOAT32_IEEE RTE_A2L_Ident_Float 1 100 -3.4E+38 3.4E+38 ECU_ADDRESS 0x7000CF34 /end MEASUREMENT
/begin MEASUREMENT Rte_Rx_000037_Epark_iPcf "Rte_Rx_000037_Epark_iPcf" FLOAT32_IEEE RTE_A2L_Ident_Float 1 100 -3.4E+38 3.4E+38 ECU_ADDRESS 0x7000CFCC /end MEASUREMENT
/begin MEASUREMENT Rte_Rx_000009_Com_VCU02_KpLowNCtL "Rte_Rx_000009_Com_VCU02_KpLowNCtL" FLOAT32_IEEE RTE_A2L_Ident_Float 1 100 -3.4E+38 3.4E+38 ECU_ADDRESS 0x7000D004 /end MEASUREMENT
/begin MEASUREMENT Rte_Rx_000012_Com_VCU02_TrqMinNCtL "Rte_Rx_000012_Com_VCU02_TrqMinNCtL" FLOAT32_IEEE RTE_A2L_Ident_Float 1 100 -3.4E+38 3.4E+38 ECU_ADDRESS 0x7000CFF8 /end MEASUREMENT
/begin MEASUREMENT Rte_Rx_000218_DiagCalib_FailCode3 "Rte_Rx_000218_DiagCalib_FailCode3" UBYTE RTE_A2L_Ident_Int 1 100 0 255 ECU_ADDRESS 0x7000CB76 /end MEASUREMENT
/begin MEASUREMENT Rte_Rx_000116_MPC_Lq "Rte_Rx_000116_MPC_Lq" FLOAT32_IEEE RTE_A2L_Ident_Float 1 100 -3.4E+38 3.4E+38 ECU_ADDRESS 0x7000CF74 /end MEASUREMENT
/begin MEASUREMENT Rte_Rx_000246_TPC_stTrqEmMax "Rte_Rx_000246_TPC_stTrqEmMax" UBYTE RTE_A2L_Ident_Int 1 100 0 255 ECU_ADDRESS 0x7000CB6D /end MEASUREMENT
/begin MEASUREMENT Rte_Rx_000068_HSPF_uKl30Flt "Rte_Rx_000068_HSPF_uKl30Flt" FLOAT32_IEEE RTE_A2L_Ident_Float 1 100 -3.4E+38 3.4E+38 ECU_ADDRESS 0x7000CF88 /end MEASUREMENT
/begin MEASUREMENT Rte_Rx_000025_Com_VCU05_kDmp "Rte_Rx_000025_Com_VCU05_kDmp" FLOAT32_IEEE RTE_A2L_Ident_Float 1 100 -3.4E+38 3.4E+38 ECU_ADDRESS 0x7000CFD4 /end MEASUREMENT
/begin MEASUREMENT Rte_Rx_000144_PCF_flgAllowPwmRun "Rte_Rx_000144_PCF_flgAllowPwmRun" UBYTE RTE_A2L_Ident_Int 1 100 0 1 ECU_ADDRESS 0x7000C9BF /end MEASUREMENT
/begin MEASUREMENT Rte_Rx_000253_VCF_stModeReq "Rte_Rx_000253_VCF_stModeReq" UBYTE RTE_A2L_Ident_Int 1 100 0 255 ECU_ADDRESS 0x7000CB6B /end MEASUREMENT
/begin MEASUREMENT Rte_Rx_000058_HSPF_tDBCTempWFlt "Rte_Rx_000058_HSPF_tDBCTempWFlt" FLOAT32_IEEE RTE_A2L_Ident_Float 1 100 -3.4E+38 3.4E+38 ECU_ADDRESS 0x7000CFA4 /end MEASUREMENT
/begin MEASUREMENT Rte_Rx_000231_TPC_TrqMax "Rte_Rx_000231_TPC_TrqMax" FLOAT32_IEEE RTE_A2L_Ident_Float 1 100 -3.4E+38 3.4E+38 ECU_ADDRESS 0x7000CEEC /end MEASUREMENT
/begin MEASUREMENT Rte_Rx_000223_DiagCalib_FailCode8 "Rte_Rx_000223_DiagCalib_FailCode8" UBYTE RTE_A2L_Ident_Int 1 100 0 255 ECU_ADDRESS 0x7000CB71 /end MEASUREMENT
/begin MEASUREMENT Rte_Rx_000080_Igbt_flgGateDrvRdyLs "Rte_Rx_000080_Igbt_flgGateDrvRdyLs" UBYTE RTE_A2L_Ident_Int 1 100 0 1 ECU_ADDRESS 0x7000C9C4 /end MEASUREMENT
/begin MEASUREMENT Rte_Rx_000056_HSPF_tDBCTempVFlt "Rte_Rx_000056_HSPF_tDBCTempVFlt" FLOAT32_IEEE RTE_A2L_Ident_Float 1 100 -3.4E+38 3.4E+38 ECU_ADDRESS 0x7000CFA8 /end MEASUREMENT
/begin MEASUREMENT Rte_Rx_000221_DiagCalib_FailCode6 "Rte_Rx_000221_DiagCalib_FailCode6" UBYTE RTE_A2L_Ident_Int 1 100 0 255 ECU_ADDRESS 0x7000CB73 /end MEASUREMENT
/begin MEASUREMENT Rte_Rx_000201_CSPF_RecTrqSetP "Rte_Rx_000201_CSPF_RecTrqSetP" FLOAT32_IEEE RTE_A2L_Ident_Float 1 100 -3.4E+38 3.4E+38 ECU_ADDRESS 0x7000CF04 /end MEASUREMENT
/begin MEASUREMENT Rte_Rx_000084_MCF_DycW "Rte_Rx_000084_MCF_DycW" FLOAT32_IEEE RTE_A2L_Ident_Float 1 100 -3.4E+38 3.4E+38 ECU_ADDRESS 0x70004E44 /end MEASUREMENT
/begin MEASUREMENT Rte_Rx_000018_Com_VCU04_TrqSetP "Rte_Rx_000018_Com_VCU04_TrqSetP" FLOAT32_IEEE RTE_A2L_Ident_Float 1 100 -3.4E+38 3.4E+38 ECU_ADDRESS 0x7000CFE4 /end MEASUREMENT
/begin MEASUREMENT Rte_Rx_000192_CSPF_RecNDiffMax "Rte_Rx_000192_CSPF_RecNDiffMax" FLOAT32_IEEE RTE_A2L_Ident_Float 1 100 -3.4E+38 3.4E+38 ECU_ADDRESS 0x7000CF28 /end MEASUREMENT
/begin MEASUREMENT Rte_Rx_000142_PCF_Status "Rte_Rx_000142_PCF_Status" UWORD RTE_A2L_Ident_Int 1 100 0 65535 ECU_ADDRESS 0x7000CC0C /end MEASUREMENT
/begin MEASUREMENT Rte_Rx_000191_CSPF_RecKpLowNCtL "Rte_Rx_000191_CSPF_RecKpLowNCtL" FLOAT32_IEEE RTE_A2L_Ident_Float 1 100 -3.4E+38 3.4E+38 ECU_ADDRESS 0x7000CF2C /end MEASUREMENT
/begin MEASUREMENT Rte_Rx_000054_HSPF_tDBCTempUFlt "Rte_Rx_000054_HSPF_tDBCTempUFlt" FLOAT32_IEEE RTE_A2L_Ident_Float 1 100 -3.4E+38 3.4E+38 ECU_ADDRESS 0x7000CFAC /end MEASUREMENT
/begin MEASUREMENT VAR_RCF_flg360Edge_b "" UBYTE SWC_RCF_CM_boolean 0 0 0 1 ECU_ADDRESS 0x70005948 /end MEASUREMENT
/begin MEASUREMENT VAR_TRSP_CurrSumChkRslt_b "" UBYTE SWC_TRSP_CM_boolean 0 0 0.0 1.0 ECU_ADDRESS 0x70005E60 /end MEASUREMENT
/begin MEASUREMENT VAR_TRSP_Diff_UBR_SBC_f32 "" FLOAT32_IEEE SWC_TRSP_CM_single 0 0 0.0 1.0 ECU_ADDRESS 0x70005FD8 /end MEASUREMENT
/begin MEASUREMENT VAR_TRSP_UBRWIDE_f32 "" FLOAT32_IEEE SWC_TRSP_CM_single 0 0 0.0 1.0 ECU_ADDRESS 0x70005FE0 /end MEASUREMENT
/begin MEASUREMENT VAR_TRSP_UBRVoltRngChkRslt_b "" UBYTE SWC_TRSP_CM_boolean 0 0 0.0 1.0 ECU_ADDRESS 0x70005E62 /end MEASUREMENT
/begin MEASUREMENT VAR_TRSP_RslvCos_f32 "" FLOAT32_IEEE SWC_TRSP_CM_single 0 0 -10000.0 10000.0 ECU_ADDRESS 0x70005FCC /end MEASUREMENT
/begin MEASUREMENT VAR_TRSP_iPhasSensVoltRngErr_b "" UBYTE SWC_TRSP_CM_boolean 0 0 0.0 1.0 ECU_ADDRESS 0x70005E6A /end MEASUREMENT
/begin MEASUREMENT VAR_TRSP_iSum_f32 "" FLOAT32_IEEE SWC_TRSP_CM_single 0 0 0.0 1.0 ECU_ADDRESS 0x70005FBC /end MEASUREMENT
/begin MEASUREMENT VAR_TRSP_UB_SBC_f32 "" FLOAT32_IEEE SWC_TRSP_CM_single 0 0 0.0 1.0 ECU_ADDRESS 0x70005FDC /end MEASUREMENT
/begin MEASUREMENT VAR_TRSP_RslvSqrt_f32 "" FLOAT32_IEEE SWC_TRSP_CM_single 0 0 0.0 1.0 ECU_ADDRESS 0x70005FD4 /end MEASUREMENT
/begin MEASUREMENT VAR_TRSP_iPhasSensVoltRngChkRslt_b "" UBYTE SWC_TRSP_CM_boolean 0 0 0.0 1.0 ECU_ADDRESS 0x70005E6B /end MEASUREMENT
/begin MEASUREMENT VAR_TRSP_TrqSetPRngErr_b "" UBYTE SWC_TRSP_CM_boolean 0 0 0.0 1.0 ECU_ADDRESS 0x70005E85 /end MEASUREMENT
/begin MEASUREMENT VAR_TRSP_RslvSqrtChkRslt_b "" UBYTE SWC_TRSP_CM_boolean 0 0 0.0 1.0 ECU_ADDRESS 0x70005E61 /end MEASUREMENT
/begin MEASUREMENT VAR_TRSP_OfstRngErr_b "" UBYTE SWC_TRSP_CM_boolean 0 0 0.0 1.0 ECU_ADDRESS 0x70005E87 /end MEASUREMENT
/begin MEASUREMENT VAR_TRSP_TrqSetPRngChkRslt_b "" UBYTE SWC_TRSP_CM_boolean 0 0 0.0 1.0 ECU_ADDRESS 0x70005E86 /end MEASUREMENT
/begin MEASUREMENT VAR_TRSP_iU_f32 "" FLOAT32_IEEE SWC_TRSP_CM_single 0 0 -1200.0 1200.0 ECU_ADDRESS 0x70005FC8 /end MEASUREMENT
/begin MEASUREMENT VAR_TRSP_iV_f32 "" FLOAT32_IEEE SWC_TRSP_CM_single 0 0 -1200.0 1200.0 ECU_ADDRESS 0x70005FC0 /end MEASUREMENT
/begin MEASUREMENT VAR_TRSP_iW_f32 "" FLOAT32_IEEE SWC_TRSP_CM_single 0 0 -1200.0 1200.0 ECU_ADDRESS 0x70005FC4 /end MEASUREMENT
/begin MEASUREMENT VAR_TRSP_OfstRngChkRslt_b "" UBYTE SWC_TRSP_CM_boolean 0 0 0.0 1.0 ECU_ADDRESS 0x70005E88 /end MEASUREMENT
/begin MEASUREMENT VAR_TRSP_UBRVoltRngErr_b "" UBYTE SWC_TRSP_CM_boolean 0 0 0.0 1.0 ECU_ADDRESS 0x70005E69 /end MEASUREMENT
/begin MEASUREMENT VAR_TRSP_RslvSin_f32 "" FLOAT32_IEEE SWC_TRSP_CM_single 0 0 -10000.0 10000.0 ECU_ADDRESS 0x70005FD0 /end MEASUREMENT
/begin MEASUREMENT VAR_Vcf_AsrUnLolim_b "" UBYTE SWC_VCF_CM_boolean 0 0 0 1 ECU_ADDRESS 0x70006055 /end MEASUREMENT
/begin MEASUREMENT VAR_Vcf_TrqSrtPInside_f32 "" FLOAT32_IEEE SWC_VCF_CM_single 0 0 -65535.0 65535.0 ECU_ADDRESS 0x70006074 /end MEASUREMENT
/begin MEASUREMENT VAR_Vcf_KpNCtl_f32 "" FLOAT32_IEEE SWC_VCF_CM_single 0 0 -3.4E+38 3.4E+38 ECU_ADDRESS 0x70006068 /end MEASUREMENT
/begin MEASUREMENT VAR_Vcf_trqRmp_f32 "" FLOAT32_IEEE SWC_VCF_CM_single 0 0 -3.4E+38 3.4E+38 ECU_ADDRESS 0x7000605C /end MEASUREMENT
/begin MEASUREMENT VAR_Vcf_trqLoad_f32 "" FLOAT32_IEEE SWC_VCF_CM_single 0 0 -3.4E+38 3.4E+38 ECU_ADDRESS 0x70006064 /end MEASUREMENT
/begin MEASUREMENT VAR_Vcf_TranstoHoldOut_b "" UBYTE SWC_VCF_CM_boolean 0 0 0 1 ECU_ADDRESS 0x7000604E /end MEASUREMENT
/begin MEASUREMENT VAR_Vcf_flgDmpActv_b "" UBYTE SWC_VCF_CM_boolean 0 0 0 1 ECU_ADDRESS 0x70006057 /end MEASUREMENT
/begin MEASUREMENT VAR_Vcf_SpdChangeRatio_f32 "" FLOAT32_IEEE SWC_VCF_CM_single 0 0 -65535.0 65535.0 ECU_ADDRESS 0x70006078 /end MEASUREMENT
/begin MEASUREMENT VAR_Vcf_trqDesAdDmp_f32 "" FLOAT32_IEEE SWC_VCF_CM_single 0 0 -3.4E+38 3.4E+38 ECU_ADDRESS 0x7000606C /end MEASUREMENT
/begin MEASUREMENT VAR_Vcf_AsrSlipFlg2_b "" UBYTE SWC_VCF_CM_boolean 0 0 0 1 ECU_ADDRESS 0x70006053 /end MEASUREMENT
/begin MEASUREMENT VAR_Vcf_SlopeReq_f32 "" FLOAT32_IEEE SWC_VCF_CM_single 0 0 -3.4E+38 3.4E+38 ECU_ADDRESS 0x70006070 /end MEASUREMENT
/begin MEASUREMENT VAR_Vcf_flgTrqSetPDecAsr_b "" UBYTE SWC_VCF_CM_boolean 0 0 0 1 ECU_ADDRESS 0x70006054 /end MEASUREMENT
/begin MEASUREMENT VAR_Vcf_TrqDmp_f32 "" FLOAT32_IEEE SWC_VCF_CM_single 0 0 -3.4E+38 3.4E+38 ECU_ADDRESS 0x7000607C /end MEASUREMENT
/begin MEASUREMENT VAR_VCF_flgHoldModeReq_b "" UBYTE SWC_VCF_CM_boolean 0 0 0 1 ECU_ADDRESS 0x7000604D /end MEASUREMENT
/begin MEASUREMENT VAR_Vcf_SlipFlag_b "" UBYTE SWC_VCF_CM_boolean 0 0 0.0 1.0 ECU_ADDRESS 0x70006050 /end MEASUREMENT
/begin MEASUREMENT VAR_Vcf_CrawlFlg_b "" UBYTE SWC_VCF_CM_boolean 0 0 0 1 ECU_ADDRESS 0x7000604C /end MEASUREMENT
/begin MEASUREMENT VAR_Vcf_nVehicleObsv_f32 "" FLOAT32_IEEE SWC_VCF_CM_single 0 0 -3.4E+38 3.4E+38 ECU_ADDRESS 0x70006080 /end MEASUREMENT
/begin MEASUREMENT VAR_Vcf_TranstoHoldIn_b "" UBYTE SWC_VCF_CM_boolean 0 0 0 1 ECU_ADDRESS 0x7000604F /end MEASUREMENT
/begin MEASUREMENT VAR_Vcf_AsrOvHiLim_b "" UBYTE SWC_VCF_CM_boolean 0 0 0 1 ECU_ADDRESS 0x70006056 /end MEASUREMENT
/begin MEASUREMENT VAR_Vcf_AsrSlipFlg1_b "" UBYTE SWC_VCF_CM_boolean 0 0 0 1 ECU_ADDRESS 0x70006052 /end MEASUREMENT
/begin MEASUREMENT VAR_Vcf_trqDesUnProc_f32 "" FLOAT32_IEEE SWC_VCF_CM_single 0 0 -3.4E+38 3.4E+38 ECU_ADDRESS 0x70006060 /end MEASUREMENT
/begin MEASUREMENT VAR_Vcf_SlopeChangePer_u8 "" UBYTE SWC_VCF_CM_uint8 0 0 0.0 255.0 ECU_ADDRESS 0x70006058 /end MEASUREMENT
/begin MEASUREMENT VAR_Vcf_CntAdding_u8 "" UBYTE SWC_VCF_CM_uint8 0 0 0 255 ECU_ADDRESS 0x70006059 /end MEASUREMENT
/begin MEASUREMENT VAR_Vcf_nMotorObsv_f32 "" FLOAT32_IEEE SWC_VCF_CM_single 0 0 -3.4E+38 3.4E+38 ECU_ADDRESS 0x70006084 /end MEASUREMENT
/begin MEASUREMENT VAR_Vcf_AsrRatioUnLolim_b "" UBYTE SWC_VCF_CM_boolean 0 0 0 1 ECU_ADDRESS 0x70006051 /end MEASUREMENT
/end MODULE
/end PROJECT
