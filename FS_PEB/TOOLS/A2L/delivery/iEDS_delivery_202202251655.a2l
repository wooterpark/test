ASAP2_VERSION 1 60
/begin PROJECT ETAS_AUTOSAR "XCP on CAN"
/begin HEADER "" VERSION "1.0.0.0" PROJECT_NO ETAS_AUTOSAR /end HEADER
/begin MODULE ETAS_AUTOSAR ""
/begin MOD_COMMON "" DEPOSIT ABSOLUTE BYTE_ORDER MSB_LAST /end MOD_COMMON
/begin COMPU_METHOD BSW_A2L_Ident_Float "Q = V" RAT_FUNC "%8.6" "" COEFFS 0 1 0 0 0 1 /end COMPU_METHOD
/begin COMPU_METHOD BSW_A2L_Ident_Int "Q = V" RAT_FUNC "%8.0" "" COEFFS 0 1 0 0 0 1 /end COMPU_METHOD
/begin COMPU_METHOD SWC_SCF_CM_boolean "Q = V" RAT_FUNC "%1.0" "" COEFFS 0 1 0 0 0 1 /end COMPU_METHOD
/begin COMPU_METHOD SWC_SCF_CM_uint8 "Q = V" RAT_FUNC "%3.0" "" COEFFS 0 1 0 0 0 1 /end COMPU_METHOD
/begin COMPU_METHOD SWC_STM_CM_boolean "Q = V" RAT_FUNC "%1.0" "" COEFFS 0 1 0 0 0 1 /end COMPU_METHOD
/begin COMPU_METHOD SWC_SWD_CM_single "Q = V" RAT_FUNC "%8.6" "" COEFFS 0 1 0 0 0 1 /end COMPU_METHOD
/begin COMPU_METHOD SWC_TCF_CM_single "Q = V" RAT_FUNC "%8.6" "" COEFFS 0 1 0 0 0 1 /end COMPU_METHOD
/begin COMPU_METHOD SWC_TCF_CM_uint16 "Q = V" RAT_FUNC "%5.0" "" COEFFS 0 1 0 0 0 1 /end COMPU_METHOD
/begin COMPU_METHOD SWC_TCF_CM_boolean "Q = V" RAT_FUNC "%1.0" "" COEFFS 0 1 0 0 0 1 /end COMPU_METHOD
/begin COMPU_METHOD SWC_TCF_CM_uint8 "Q = V" RAT_FUNC "%3.0" "" COEFFS 0 1 0 0 0 1 /end COMPU_METHOD
/begin COMPU_METHOD SWC_TDC_CM_single "Q = V" RAT_FUNC "%8.6" "" COEFFS 0 1 0 0 0 1 /end COMPU_METHOD
/begin COMPU_METHOD SWC_TPC_CM_single "Q = V" RAT_FUNC "%8.6" "" COEFFS 0 1 0 0 0 1 /end COMPU_METHOD
/begin COMPU_METHOD SWC_TPC_CM_boolean "Q = V" RAT_FUNC "%1.0" "" COEFFS 0 1 0 0 0 1 /end COMPU_METHOD
/begin COMPU_METHOD SWC_TPC_CM_uint8 "Q = V" RAT_FUNC "%3.0" "" COEFFS 0 1 0 0 0 1 /end COMPU_METHOD
/begin COMPU_METHOD SWC_TPC_CM_single__ "Q = V" RAT_FUNC "%8.6" "¡æ" COEFFS 0 1 0 0 0 1 /end COMPU_METHOD
/begin COMPU_METHOD SWC_TPC_CM_single_A "Q = V" RAT_FUNC "%8.6" "A" COEFFS 0 1 0 0 0 1 /end COMPU_METHOD
/begin COMPU_METHOD SWC_TPC_CM_single_KW "Q = V" RAT_FUNC "%8.6" "KW" COEFFS 0 1 0 0 0 1 /end COMPU_METHOD
/begin COMPU_METHOD SWC_TPC_CM_single_V "Q = V" RAT_FUNC "%8.6" "V" COEFFS 0 1 0 0 0 1 /end COMPU_METHOD
/begin COMPU_METHOD SWC_TPC_CM_single_Nm "Q = V" RAT_FUNC "%8.6" "Nm" COEFFS 0 1 0 0 0 1 /end COMPU_METHOD
/begin COMPU_METHOD SWC_TPC_CM_int16 "Q = V" RAT_FUNC "%5.0" "" COEFFS 0 1 0 0 0 1 /end COMPU_METHOD
/begin COMPU_METHOD SWC_TRSP_CM_single "Q = V" RAT_FUNC "%8.6" "" COEFFS 0 1 0 0 0 1 /end COMPU_METHOD
/begin COMPU_METHOD SWC_TRSP_CM_uint16 "Q = V" RAT_FUNC "%5.0" "" COEFFS 0 1 0 0 0 1 /end COMPU_METHOD
/begin COMPU_METHOD SWC_TRSP_CM_boolean "Q = V" RAT_FUNC "%1.0" "" COEFFS 0 1 0 0 0 1 /end COMPU_METHOD
/begin COMPU_METHOD SWC_TRSP_CM_int32 "Q = V" RAT_FUNC "%10.0" "" COEFFS 0 1 0 0 0 1 /end COMPU_METHOD
/begin COMPU_METHOD stSysCtl_Verb "" TAB_VERB "%2.1" "-" COMPU_TAB_REF stSysCtl_List /end COMPU_METHOD
/begin COMPU_METHOD stDern_Verb "" TAB_VERB "%2.1" "-" COMPU_TAB_REF stDern_List /end COMPU_METHOD
/begin COMPU_VTAB stSysCtl_List "" TAB_VERB 5 0 "PreDriveMod" 1 "DriveMod" 2 "PostDriveMod" 3 "ShutDownMod" 4 "FaultMod" DEFAULT_VALUE "---" /end COMPU_VTAB
/begin COMPU_VTAB stDern_List "" TAB_VERB 9 0 "bDern_Inactive" 1 "bDern_ExCTrq" 2 "bDern_StrTemp" 3 "bDern_TempIGBT" 4 "bDern_N" 5 "bDern_OvrIdc" 6 "bDern_UndrUdc" 7 "bDern_OvrUdc" 8 "bDern_CAN" DEFAULT_VALUE "---" /end COMPU_VTAB
/begin RECORD_LAYOUT Scalar_BOOLEAN FNC_VALUES 1 UBYTE COLUMN_DIR DIRECT /end RECORD_LAYOUT
/begin RECORD_LAYOUT Scalar_UBYTE FNC_VALUES 1 UBYTE COLUMN_DIR DIRECT /end RECORD_LAYOUT
/begin RECORD_LAYOUT Scalar_UWORD FNC_VALUES 1 UWORD COLUMN_DIR DIRECT /end RECORD_LAYOUT
/begin RECORD_LAYOUT Scalar_SWORD FNC_VALUES 1 SWORD COLUMN_DIR DIRECT /end RECORD_LAYOUT
/begin RECORD_LAYOUT Scalar_FLOAT32_IEEE FNC_VALUES 1 FLOAT32_IEEE COLUMN_DIR DIRECT /end RECORD_LAYOUT
/begin RECORD_LAYOUT Scalar_FLOAT64_IEEE FNC_VALUES 1 FLOAT64_IEEE COLUMN_DIR DIRECT /end RECORD_LAYOUT
/begin RECORD_LAYOUT Lookup1D_BOOLEAN FNC_VALUES 1 UBYTE COLUMN_DIR DIRECT /end RECORD_LAYOUT
/begin RECORD_LAYOUT Lookup1D_X_BOOLEAN AXIS_PTS_X 1 UBYTE INDEX_INCR DIRECT /end RECORD_LAYOUT
/begin RECORD_LAYOUT Lookup1D_BYTE FNC_VALUES 1 SBYTE COLUMN_DIR DIRECT /end RECORD_LAYOUT
/begin RECORD_LAYOUT Lookup1D_X_BYTE AXIS_PTS_X 1 SBYTE INDEX_INCR DIRECT /end RECORD_LAYOUT
/begin RECORD_LAYOUT Lookup1D_UBYTE FNC_VALUES 1 UBYTE COLUMN_DIR DIRECT /end RECORD_LAYOUT
/begin RECORD_LAYOUT Lookup1D_FLOAT32_IEEE FNC_VALUES 1 FLOAT32_IEEE COLUMN_DIR DIRECT /end RECORD_LAYOUT
/begin RECORD_LAYOUT Lookup1D_X_FLOAT32_IEEE AXIS_PTS_X 1 FLOAT32_IEEE INDEX_INCR DIRECT /end RECORD_LAYOUT
/begin RECORD_LAYOUT Lookup2D_FLOAT32_IEEE FNC_VALUES 1 FLOAT32_IEEE COLUMN_DIR DIRECT /end RECORD_LAYOUT
/begin RECORD_LAYOUT Lookup2D_X_FLOAT32_IEEE AXIS_PTS_X 1 FLOAT32_IEEE INDEX_INCR DIRECT /end RECORD_LAYOUT
/begin CHARACTERISTIC CAL_TRSP_RslvRngCosPHiLim_u16 "CAL_TRSP_RslvRngCosPHiLim_u16" VALUE 0x8014631C Scalar_UWORD 0 BSW_A2L_Ident_Int 0 65535 /end CHARACTERISTIC
/begin CHARACTERISTIC CAL_TpcSmp_CurtModeSelc_b "CAL_TpcSmp_CurtModeSelc_b" VALUE 0x80145818 Scalar_BOOLEAN 0 BSW_A2L_Ident_Int 0 1 /end CHARACTERISTIC
/begin CHARACTERISTIC CAL_TpcTmp_DBCRiseTempMinus_f32 "CAL_TpcTmp_DBCRiseTempMinus_f32" VALUE 0x801455DC Scalar_FLOAT32_IEEE 0 BSW_A2L_Ident_Float -3.4E+38 3.4E+38 /end CHARACTERISTIC
/begin CHARACTERISTIC CAL_TpcSmp_flgUsePwrLossGen_b "CAL_TpcSmp_flgUsePwrLossGen_b" VALUE 0x8014563D Scalar_BOOLEAN 0 BSW_A2L_Ident_Int 0 1 /end CHARACTERISTIC
/begin CHARACTERISTIC CAL_Tpcmot_TrqDiffExc_f32 "CAL_Tpcmot_TrqDiffExc_f32" VALUE 0x801451D0 Scalar_FLOAT32_IEEE 0 BSW_A2L_Ident_Float -3.4E+38 3.4E+38 /end CHARACTERISTIC
/begin CHARACTERISTIC CAL_TRSP_CurrSumErrRst_b "CAL_TRSP_CurrSumErrRst_b" VALUE 0x8014634C Scalar_BOOLEAN 0 BSW_A2L_Ident_Int 0 1 /end CHARACTERISTIC
/begin CHARACTERISTIC CAL_TpcSmp_iDcLnkOvCElecLim_f32 "CAL_TpcSmp_iDcLnkOvCElecLim_f32" VALUE 0x80145628 Scalar_FLOAT32_IEEE 0 BSW_A2L_Ident_Float -3.4E+38 3.4E+38 /end CHARACTERISTIC
/begin CHARACTERISTIC CAL_TpcSmp_FacGenOvrVolt_u8 "CAL_TpcSmp_FacGenOvrVolt_u8" VALUE 0x801457FC Scalar_UBYTE 0 BSW_A2L_Ident_Int 0 255 /end CHARACTERISTIC
/begin CHARACTERISTIC CAL_TpcTmp_CoolTempDecDiff_f32 "CAL_TpcTmp_CoolTempDecDiff_f32" VALUE 0x801455F8 Scalar_FLOAT32_IEEE 0 BSW_A2L_Ident_Float -3.4E+38 3.4E+38 /end CHARACTERISTIC
/begin CHARACTERISTIC CAL_TRSP_CurrSumDebTrh_s16 "CAL_TRSP_CurrSumDebTrh_s16" VALUE 0x8014634E Scalar_SWORD 0 BSW_A2L_Ident_Int -32768 32767 /end CHARACTERISTIC
/begin CHARACTERISTIC CAL_TRSP_RslvRngSinPLoLim_u16 "CAL_TRSP_RslvRngSinPLoLim_u16" VALUE 0x80146308 Scalar_UWORD 0 BSW_A2L_Ident_Int 0 65535 /end CHARACTERISTIC
/begin CHARACTERISTIC CAL_Tpcmot_CofuDclnk_u8 "CAL_Tpcmot_CofuDclnk_u8" VALUE 0x801451D4 Scalar_UBYTE 0 BSW_A2L_Ident_Int 0 255 /end CHARACTERISTIC
/begin CHARACTERISTIC CAL_Tpc_OverheatingMode_u8 "CAL_Tpc_OverheatingMode_u8" VALUE 0x801451E6 Scalar_UBYTE 0 BSW_A2L_Ident_Int 0 255 /end CHARACTERISTIC
/begin CHARACTERISTIC CAL_TpcTmp_tRiseIGBTTraSave1ToNormal_f32 "CAL_TpcTmp_tRiseIGBTTraSave1ToNormal_f32" VALUE 0x801451F0 Scalar_FLOAT32_IEEE 0 BSW_A2L_Ident_Float -3.4E+38 3.4E+38 /end CHARACTERISTIC
/begin CHARACTERISTIC CAL_TpcCod_TrqRelay_f32 "CAL_TpcCod_TrqRelay_f32" VALUE 0x80145FD4 Scalar_FLOAT32_IEEE 0 BSW_A2L_Ident_Float -3.4E+38 3.4E+38 /end CHARACTERISTIC
/begin CHARACTERISTIC CAL_TpcFuv_CofTrqLimLv3_f32 "CAL_TpcFuv_CofTrqLimLv3_f32" VALUE 0x80145FB8 Scalar_FLOAT32_IEEE 0 BSW_A2L_Ident_Float -3.4E+38 3.4E+38 /end CHARACTERISTIC
/begin CHARACTERISTIC CAL_TpcTmp_IGBTTempMinus_f32 "CAL_TpcTmp_IGBTTempMinus_f32" VALUE 0x80145590 Scalar_FLOAT32_IEEE 0 BSW_A2L_Ident_Float -3.4E+38 3.4E+38 /end CHARACTERISTIC
/begin CHARACTERISTIC CAL_TCF_LoSpdDirStop_f32 "CAL_TCF_LoSpdDirStop_f32" VALUE 0x80144728 Scalar_FLOAT32_IEEE 0 BSW_A2L_Ident_Float -3.4E+38 3.4E+38 /end CHARACTERISTIC
/begin CHARACTERISTIC CAL_TpcTmp_tCoolantTraSave1ToNormal_f32 "CAL_TpcTmp_tCoolantTraSave1ToNormal_f32" VALUE 0x801454E4 Scalar_FLOAT32_IEEE 0 BSW_A2L_Ident_Float -3.4E+38 3.4E+38 /end CHARACTERISTIC
/begin CHARACTERISTIC CAL_TpcSmp_uDcLnkMaxMax_f32 "CAL_TpcSmp_uDcLnkMaxMax_f32" VALUE 0x8014561C Scalar_FLOAT32_IEEE 0 BSW_A2L_Ident_Float -3.4E+38 3.4E+38 /end CHARACTERISTIC
/begin CHARACTERISTIC CAL_TCF_TrqCalcMonErrRst_b "CAL_TCF_TrqCalcMonErrRst_b" VALUE 0x80143D3A Scalar_BOOLEAN 0 BSW_A2L_Ident_Int 0 1 /end CHARACTERISTIC
/begin CHARACTERISTIC CAL_TpcSmp_CntGenOvrCurt_u8 "CAL_TpcSmp_CntGenOvrCurt_u8" VALUE 0x8014581A Scalar_UBYTE 0 BSW_A2L_Ident_Int 0 255 /end CHARACTERISTIC
/begin CHARACTERISTIC CAL_TRSP_RslvRngExciLoLim_u16 "CAL_TRSP_RslvRngExciLoLim_u16" VALUE 0x80146310 Scalar_UWORD 0 BSW_A2L_Ident_Int 0 65535 /end CHARACTERISTIC
/begin CHARACTERISTIC CAL_TRSP_18VHSVoltErrRst_b "CAL_TRSP_18VHSVoltErrRst_b" VALUE 0x80146372 Scalar_BOOLEAN 0 BSW_A2L_Ident_Int 0 1 /end CHARACTERISTIC
/begin CHARACTERISTIC CAL_TpcTmp_IGBTTempRiseDiff_f32 "CAL_TpcTmp_IGBTTempRiseDiff_f32" VALUE 0x8014558C Scalar_FLOAT32_IEEE 0 BSW_A2L_Ident_Float -3.4E+38 3.4E+38 /end CHARACTERISTIC
/begin CHARACTERISTIC CAL_Tpc_TrqRiseRevStep_f32 "CAL_Tpc_TrqRiseRevStep_f32" VALUE 0x801451D8 Scalar_FLOAT32_IEEE 0 BSW_A2L_Ident_Float -3.4E+38 3.4E+38 /end CHARACTERISTIC
/begin CHARACTERISTIC CAL_TRSP_WCurrRngHiLim_f32 "CAL_TRSP_WCurrRngHiLim_f32" VALUE 0x801462D0 Scalar_FLOAT32_IEEE 0 BSW_A2L_Ident_Float -3.4E+38 3.4E+38 /end CHARACTERISTIC
/begin CHARACTERISTIC CAL_TCF_TempStrPlossFact_f32 "CAL_TCF_TempStrPlossFact_f32" VALUE 0x80143D40 Scalar_FLOAT32_IEEE 0 BSW_A2L_Ident_Float -3.4E+38 3.4E+38 /end CHARACTERISTIC
/begin CHARACTERISTIC CAL_TpcTmp_IgbtRiseChgTempDownDiff_f32 "CAL_TpcTmp_IgbtRiseChgTempDownDiff_f32" VALUE 0x80145580 Scalar_FLOAT32_IEEE 0 BSW_A2L_Ident_Float -3.4E+38 3.4E+38 /end CHARACTERISTIC
/begin CHARACTERISTIC CAL_TpcCod_NegSpdDirStop_f32 "CAL_TpcCod_NegSpdDirStop_f32" VALUE 0x80145FF0 Scalar_FLOAT32_IEEE 0 BSW_A2L_Ident_Float -3.4E+38 3.4E+38 /end CHARACTERISTIC
/begin CHARACTERISTIC CAL_TRSP_CurrRngErrRst_b "CAL_TRSP_CurrRngErrRst_b" VALUE 0x80146352 Scalar_BOOLEAN 0 BSW_A2L_Ident_Int 0 1 /end CHARACTERISTIC
/begin CHARACTERISTIC CAL_TpcCod_FlgUseTrqLimRampSet_b "CAL_TpcCod_FlgUseTrqLimRampSet_b" VALUE 0x80145FFF Scalar_BOOLEAN 0 BSW_A2L_Ident_Int 0 1 /end CHARACTERISTIC
/begin CHARACTERISTIC CAL_Tpc_NormalMode_u8 "CAL_Tpc_NormalMode_u8" VALUE 0x801451E7 Scalar_UBYTE 0 BSW_A2L_Ident_Int 0 255 /end CHARACTERISTIC
/begin CHARACTERISTIC CAL_TpcTmp_CoolTempRiseDiff_f32 "CAL_TpcTmp_CoolTempRiseDiff_f32" VALUE 0x801455EC Scalar_FLOAT32_IEEE 0 BSW_A2L_Ident_Float -3.4E+38 3.4E+38 /end CHARACTERISTIC
/begin CHARACTERISTIC CAL_SWD_Radian_u16 "CAL_SWD_Radian_u16" VALUE 0x8014349A Scalar_UWORD 0 BSW_A2L_Ident_Int 0 65535 /end CHARACTERISTIC
/begin CHARACTERISTIC CAL_TpcBlk_BlkTimSet_u16 "CAL_TpcBlk_BlkTimSet_u16" VALUE 0x801462A0 Scalar_UWORD 0 BSW_A2L_Ident_Int 0 65535 /end CHARACTERISTIC
/begin CHARACTERISTIC CAL_TCF_MotorPole_u8 "CAL_TCF_MotorPole_u8" VALUE 0x80144720 Scalar_UBYTE 0 BSW_A2L_Ident_Int 0 255 /end CHARACTERISTIC
/begin CHARACTERISTIC CAL_Tpcmot_flgOpenExcLimRamp_b "CAL_Tpcmot_flgOpenExcLimRamp_b" VALUE 0x801451C8 Scalar_BOOLEAN 0 BSW_A2L_Ident_Int 0 1 /end CHARACTERISTIC
/begin CHARACTERISTIC CAL_TpcTmp_tCoolantTraNormalToSave1_f32 "CAL_TpcTmp_tCoolantTraNormalToSave1_f32" VALUE 0x801454E8 Scalar_FLOAT32_IEEE 0 BSW_A2L_Ident_Float -3.4E+38 3.4E+38 /end CHARACTERISTIC
/begin CHARACTERISTIC CAL_TpcCod_NTCLowTemp_f32 "CAL_TpcCod_NTCLowTemp_f32" VALUE 0x80145FF4 Scalar_FLOAT32_IEEE 0 BSW_A2L_Ident_Float -3.4E+38 3.4E+38 /end CHARACTERISTIC
/begin CHARACTERISTIC CAL_TpcMot_flgPwrRefSwt_b "CAL_TpcMot_flgPwrRefSwt_b" VALUE 0x8014596D Scalar_BOOLEAN 0 BSW_A2L_Ident_Int 0 1 /end CHARACTERISTIC
/begin CHARACTERISTIC CAL_TpcMot_SttrTempKp_f32 "CAL_TpcMot_SttrTempKp_f32" VALUE 0x80145978 Scalar_FLOAT32_IEEE 0 BSW_A2L_Ident_Float -3.4E+38 3.4E+38 /end CHARACTERISTIC
/begin CHARACTERISTIC CAL_TpcMot_tSttrTraSave1ToNormal_f32 "CAL_TpcMot_tSttrTraSave1ToNormal_f32" VALUE 0x8014582C Scalar_FLOAT32_IEEE 0 BSW_A2L_Ident_Float -3.4E+38 3.4E+38 /end CHARACTERISTIC
/begin CHARACTERISTIC CAL_Scf_cntWakeLoss_u16 "CAL_Scf_cntWakeLoss_u16" VALUE 0x80143478 Scalar_UWORD 0 BSW_A2L_Ident_Int 0 65535 /end CHARACTERISTIC
/begin CHARACTERISTIC CAL_TCF_TrqInvalid_s16 "CAL_TCF_TrqInvalid_s16" VALUE 0x80143D38 Scalar_SWORD 0 BSW_A2L_Ident_Int -32768 32767 /end CHARACTERISTIC
/begin CHARACTERISTIC CAL_TpcSmp_iDcLnkOvCGenLim_f32 "CAL_TpcSmp_iDcLnkOvCGenLim_f32" VALUE 0x80145624 Scalar_FLOAT32_IEEE 0 BSW_A2L_Ident_Float -3.4E+38 3.4E+38 /end CHARACTERISTIC
/begin CHARACTERISTIC CAL_TpcCod_CoolFlow1LReq_f32 "CAL_TpcCod_CoolFlow1LReq_f32" VALUE 0x8014627C Scalar_FLOAT32_IEEE 0 BSW_A2L_Ident_Float -3.4E+38 3.4E+38 /end CHARACTERISTIC
/begin CHARACTERISTIC CAL_TpcCod_PosSpdDirStop_f32 "CAL_TpcCod_PosSpdDirStop_f32" VALUE 0x80145FE8 Scalar_FLOAT32_IEEE 0 BSW_A2L_Ident_Float -3.4E+38 3.4E+38 /end CHARACTERISTIC
/begin CHARACTERISTIC CAL_TpcMot_SttrTempRiseDiff_f32 "CAL_TpcMot_SttrTempRiseDiff_f32" VALUE 0x80145970 Scalar_FLOAT32_IEEE 0 BSW_A2L_Ident_Float -3.4E+38 3.4E+38 /end CHARACTERISTIC
/begin CHARACTERISTIC CAL_TpcMot_tRiseSttrTraSave2ToOverheating_f32 "CAL_TpcMot_tRiseSttrTraSave2ToOverheating_f32" VALUE 0x801458CC Scalar_FLOAT32_IEEE 0 BSW_A2L_Ident_Float -3.4E+38 3.4E+38 /end CHARACTERISTIC
/begin CHARACTERISTIC CAL_TpcTmp_IGBTRiseTempDecDiff_f32 "CAL_TpcTmp_IGBTRiseTempDecDiff_f32" VALUE 0x801455AC Scalar_FLOAT32_IEEE 0 BSW_A2L_Ident_Float -3.4E+38 3.4E+38 /end CHARACTERISTIC
/begin CHARACTERISTIC CAL_TpcSmp_iDcLnkMinMax_f32 "CAL_TpcSmp_iDcLnkMinMax_f32" VALUE 0x80145630 Scalar_FLOAT32_IEEE 0 BSW_A2L_Ident_Float -3.4E+38 3.4E+38 /end CHARACTERISTIC
/begin CHARACTERISTIC CAL_TpcTmp_CoolChgTempUpDiff_f32 "CAL_TpcTmp_CoolChgTempUpDiff_f32" VALUE 0x80145600 Scalar_FLOAT32_IEEE 0 BSW_A2L_Ident_Float -3.4E+38 3.4E+38 /end CHARACTERISTIC
/begin CHARACTERISTIC CAL_TpcFuv_CofPwrLimLv2_f32 "CAL_TpcFuv_CofPwrLimLv2_f32" VALUE 0x80145FCC Scalar_FLOAT32_IEEE 0 BSW_A2L_Ident_Float -3.4E+38 3.4E+38 /end CHARACTERISTIC
/begin CHARACTERISTIC CAL_SWD_AgrslvCompCnt_f32 "CAL_SWD_AgrslvCompCnt_f32" VALUE 0x80143CA0 Scalar_FLOAT32_IEEE 0 BSW_A2L_Ident_Float -3.4E+38 3.4E+38 /end CHARACTERISTIC
/begin CHARACTERISTIC CAL_TpcTmp_CoolTempAdds_f32 "CAL_TpcTmp_CoolTempAdds_f32" VALUE 0x801455FC Scalar_FLOAT32_IEEE 0 BSW_A2L_Ident_Float -3.4E+38 3.4E+38 /end CHARACTERISTIC
/begin CHARACTERISTIC CAL_TpcBlk_BlkRevTimSet_u16 "CAL_TpcBlk_BlkRevTimSet_u16" VALUE 0x801462A2 Scalar_UWORD 0 BSW_A2L_Ident_Int 0 65535 /end CHARACTERISTIC
/begin CHARACTERISTIC CAL_TRSP_RslvRngSinPHiLim_u16 "CAL_TRSP_RslvRngSinPHiLim_u16" VALUE 0x8014630A Scalar_UWORD 0 BSW_A2L_Ident_Int 0 65535 /end CHARACTERISTIC
/begin CHARACTERISTIC CAL_TpcBlk_MtrBlkIsSecondSet_f32 "CAL_TpcBlk_MtrBlkIsSecondSet_f32" VALUE 0x80146298 Scalar_FLOAT32_IEEE 0 BSW_A2L_Ident_Float -3.4E+38 3.4E+38 /end CHARACTERISTIC
/begin CHARACTERISTIC CAL_TpcTmp_tIGBTTempLoLim_f32 "CAL_TpcTmp_tIGBTTempLoLim_f32" VALUE 0x8014533C Scalar_FLOAT32_IEEE 0 BSW_A2L_Ident_Float -3.4E+38 3.4E+38 /end CHARACTERISTIC
/begin CHARACTERISTIC CAL_TpcTmp_tDbcTraSave2ToOverheating_f32 "CAL_TpcTmp_tDbcTraSave2ToOverheating_f32" VALUE 0x8014541C Scalar_FLOAT32_IEEE 0 BSW_A2L_Ident_Float -3.4E+38 3.4E+38 /end CHARACTERISTIC
/begin CHARACTERISTIC CAL_TpcCod_PosSpdStart_f32 "CAL_TpcCod_PosSpdStart_f32" VALUE 0x80145FE0 Scalar_FLOAT32_IEEE 0 BSW_A2L_Ident_Float -3.4E+38 3.4E+38 /end CHARACTERISTIC
/begin CHARACTERISTIC CAL_TRSP_18VHSVoltCountTrh_s16 "CAL_TRSP_18VHSVoltCountTrh_s16" VALUE 0x80146376 Scalar_SWORD 0 BSW_A2L_Ident_Int -32768 32767 /end CHARACTERISTIC
/begin CHARACTERISTIC CAL_TCF_SpeedCtlMode_u8 "CAL_TCF_SpeedCtlMode_u8" VALUE 0x80143D4C Scalar_UBYTE 0 BSW_A2L_Ident_Int 0 255 /end CHARACTERISTIC
/begin CHARACTERISTIC CAL_TpcSmp_iDcLnkMinMin_f32 "CAL_TpcSmp_iDcLnkMinMin_f32" VALUE 0x8014562C Scalar_FLOAT32_IEEE 0 BSW_A2L_Ident_Float -3.4E+38 3.4E+38 /end CHARACTERISTIC
/begin CHARACTERISTIC CAL_TpcSmp_uDcLnkOvVLim_f32 "CAL_TpcSmp_uDcLnkOvVLim_f32" VALUE 0x8014560C Scalar_FLOAT32_IEEE 0 BSW_A2L_Ident_Float -3.4E+38 3.4E+38 /end CHARACTERISTIC
/begin CHARACTERISTIC CAL_TpcMot_tRiseSttrTraNormalToSave1_f32 "CAL_TpcMot_tRiseSttrTraNormalToSave1_f32" VALUE 0x801458D8 Scalar_FLOAT32_IEEE 0 BSW_A2L_Ident_Float -3.4E+38 3.4E+38 /end CHARACTERISTIC
/begin CHARACTERISTIC CAL_TpcMot_SttrTempDecDiff_f32 "CAL_TpcMot_SttrTempDecDiff_f32" VALUE 0x8014597C Scalar_FLOAT32_IEEE 0 BSW_A2L_Ident_Float -3.4E+38 3.4E+38 /end CHARACTERISTIC
/begin CHARACTERISTIC CAL_TRSP_18VHSVoltLoLim_u16 "CAL_TRSP_18VHSVoltLoLim_u16" VALUE 0x8014636E Scalar_UWORD 0 BSW_A2L_Ident_Int 0 65535 /end CHARACTERISTIC
/begin CHARACTERISTIC CAL_TpcMot_tRiseSttrTraSave1ToNormal_f32 "CAL_TpcMot_tRiseSttrTraSave1ToNormal_f32" VALUE 0x801458D4 Scalar_FLOAT32_IEEE 0 BSW_A2L_Ident_Float -3.4E+38 3.4E+38 /end CHARACTERISTIC
/begin CHARACTERISTIC CAL_TpcCod_CntHysteresislop_u16 "CAL_TpcCod_CntHysteresislop_u16" VALUE 0x80146280 Scalar_UWORD 0 BSW_A2L_Ident_Int 0 65535 /end CHARACTERISTIC
/begin CHARACTERISTIC CAL_TpcBlk_MtrBlkSpdLowSet_f32 "CAL_TpcBlk_MtrBlkSpdLowSet_f32" VALUE 0x80146290 Scalar_FLOAT32_IEEE 0 BSW_A2L_Ident_Float -3.4E+38 3.4E+38 /end CHARACTERISTIC
/begin CHARACTERISTIC CAL_TpcTmp_tIGBTTempHiLim_f32 "CAL_TpcTmp_tIGBTTempHiLim_f32" VALUE 0x80145340 Scalar_FLOAT32_IEEE 0 BSW_A2L_Ident_Float -3.4E+38 3.4E+38 /end CHARACTERISTIC
/begin CHARACTERISTIC CAL_TpcMot_SttrChgTempDownDiff_f32 "CAL_TpcMot_SttrChgTempDownDiff_f32" VALUE 0x80145988 Scalar_FLOAT32_IEEE 0 BSW_A2L_Ident_Float -3.4E+38 3.4E+38 /end CHARACTERISTIC
/begin CHARACTERISTIC CAL_TpcSmp_ElecOvrCurtypLim_f32 "CAL_TpcSmp_ElecOvrCurtypLim_f32" VALUE 0x8014580C Scalar_FLOAT32_IEEE 0 BSW_A2L_Ident_Float -3.4E+38 3.4E+38 /end CHARACTERISTIC
/begin CHARACTERISTIC CAL_TpcTmp_tDbcTempULoLim_f32 "CAL_TpcTmp_tDbcTempULoLim_f32" VALUE 0x80145440 Scalar_FLOAT32_IEEE 0 BSW_A2L_Ident_Float -3.4E+38 3.4E+38 /end CHARACTERISTIC
/begin CHARACTERISTIC CAL_TpcSmp_GenOvrCurtKi_f32 "CAL_TpcSmp_GenOvrCurtKi_f32" VALUE 0x801457F8 Scalar_FLOAT32_IEEE 0 BSW_A2L_Ident_Float -3.4E+38 3.4E+38 /end CHARACTERISTIC
/begin CHARACTERISTIC CAL_TpcSmp_PwrAddMax_f32 "CAL_TpcSmp_PwrAddMax_f32" VALUE 0x8014567C Scalar_FLOAT32_IEEE 0 BSW_A2L_Ident_Float -3.4E+38 3.4E+38 /end CHARACTERISTIC
/begin CHARACTERISTIC CAL_TpcTmp_CoolTempKp_f32 "CAL_TpcTmp_CoolTempKp_f32" VALUE 0x801455F4 Scalar_FLOAT32_IEEE 0 BSW_A2L_Ident_Float -3.4E+38 3.4E+38 /end CHARACTERISTIC
/begin CHARACTERISTIC CAL_TpcSmp_TrqAddMaxGen_f32 "CAL_TpcSmp_TrqAddMaxGen_f32" VALUE 0x8014566C Scalar_FLOAT32_IEEE 0 BSW_A2L_Ident_Float -3.4E+38 3.4E+38 /end CHARACTERISTIC
/begin CHARACTERISTIC CAL_TpcTmp_DBCTempAdds_f32 "CAL_TpcTmp_DBCTempAdds_f32" VALUE 0x801455D4 Scalar_FLOAT32_IEEE 0 BSW_A2L_Ident_Float -3.4E+38 3.4E+38 /end CHARACTERISTIC
/begin CHARACTERISTIC CAL_TpcSmp_uDcLnkMinMin_f32 "CAL_TpcSmp_uDcLnkMinMin_f32" VALUE 0x80145610 Scalar_FLOAT32_IEEE 0 BSW_A2L_Ident_Float -3.4E+38 3.4E+38 /end CHARACTERISTIC
/begin CHARACTERISTIC CAL_TpcMot_tRiseSttrTraSave1ToSave2_f32 "CAL_TpcMot_tRiseSttrTraSave1ToSave2_f32" VALUE 0x801458D0 Scalar_FLOAT32_IEEE 0 BSW_A2L_Ident_Float -3.4E+38 3.4E+38 /end CHARACTERISTIC
/begin CHARACTERISTIC CAL_TRSP_1V8CPLDVoltDebTrh_s16 "CAL_TRSP_1V8CPLDVoltDebTrh_s16" VALUE 0x8014636A Scalar_SWORD 0 BSW_A2L_Ident_Int -32768 32767 /end CHARACTERISTIC
/begin CHARACTERISTIC CAL_TRSP_RslvRngCosPLoLim_u16 "CAL_TRSP_RslvRngCosPLoLim_u16" VALUE 0x8014631A Scalar_UWORD 0 BSW_A2L_Ident_Int 0 65535 /end CHARACTERISTIC
/begin CHARACTERISTIC CAL_TpcCod_NTCHighTemp_f32 "CAL_TpcCod_NTCHighTemp_f32" VALUE 0x80145FF8 Scalar_FLOAT32_IEEE 0 BSW_A2L_Ident_Float -3.4E+38 3.4E+38 /end CHARACTERISTIC
/begin CHARACTERISTIC CAL_STM_UxptTrqMonDebTrh_s16 "CAL_STM_UxptTrqMonDebTrh_s16" VALUE 0x80146B3A Scalar_SWORD 0 BSW_A2L_Ident_Int -32768 32767 /end CHARACTERISTIC
/begin CHARACTERISTIC CAL_TpcTmp_tCoolantTraSave2ToOverheating_f32 "CAL_TpcTmp_tCoolantTraSave2ToOverheating_f32" VALUE 0x801454DC Scalar_FLOAT32_IEEE 0 BSW_A2L_Ident_Float -3.4E+38 3.4E+38 /end CHARACTERISTIC
/begin CHARACTERISTIC CAL_TpcMot_SttrTempMinus_f32 "CAL_TpcMot_SttrTempMinus_f32" VALUE 0x80145974 Scalar_FLOAT32_IEEE 0 BSW_A2L_Ident_Float -3.4E+38 3.4E+38 /end CHARACTERISTIC
/begin CHARACTERISTIC CAL_TpcSmp_uDcLnkUnVLim_f32 "CAL_TpcSmp_uDcLnkUnVLim_f32" VALUE 0x80145608 Scalar_FLOAT32_IEEE 0 BSW_A2L_Ident_Float -3.4E+38 3.4E+38 /end CHARACTERISTIC
/begin CHARACTERISTIC CAL_TRSP_WCurrRngLoLim_f32 "CAL_TRSP_WCurrRngLoLim_f32" VALUE 0x801462CC Scalar_FLOAT32_IEEE 0 BSW_A2L_Ident_Float -3.4E+38 3.4E+38 /end CHARACTERISTIC
/begin CHARACTERISTIC CAL_TpcMot_SttrChgTempUpDiff_f32 "CAL_TpcMot_SttrChgTempUpDiff_f32" VALUE 0x80145984 Scalar_FLOAT32_IEEE 0 BSW_A2L_Ident_Float -3.4E+38 3.4E+38 /end CHARACTERISTIC
/begin CHARACTERISTIC CAL_TpcTmp_tRiseDbcTraSave1ToNormal_f32 "CAL_TpcTmp_tRiseDbcTraSave1ToNormal_f32" VALUE 0x80145290 Scalar_FLOAT32_IEEE 0 BSW_A2L_Ident_Float -3.4E+38 3.4E+38 /end CHARACTERISTIC
/begin CHARACTERISTIC CAL_TpcSmp_ElecUdrVoltypLim_f32 "CAL_TpcSmp_ElecUdrVoltypLim_f32" VALUE 0x80145800 Scalar_FLOAT32_IEEE 0 BSW_A2L_Ident_Float -3.4E+38 3.4E+38 /end CHARACTERISTIC
/begin CHARACTERISTIC CAL_TpcTmp_DBCRiseTempRiseDiff_f32 "CAL_TpcTmp_DBCRiseTempRiseDiff_f32" VALUE 0x801455D8 Scalar_FLOAT32_IEEE 0 BSW_A2L_Ident_Float -3.4E+38 3.4E+38 /end CHARACTERISTIC
/begin CHARACTERISTIC CAL_TpcTmp_DBCRiseTempDecDiff_f32 "CAL_TpcTmp_DBCRiseTempDecDiff_f32" VALUE 0x801455E4 Scalar_FLOAT32_IEEE 0 BSW_A2L_Ident_Float -3.4E+38 3.4E+38 /end CHARACTERISTIC
/begin CHARACTERISTIC CAL_TCF_Psi_f32 "CAL_TCF_Psi_f32" VALUE 0x801446DC Scalar_FLOAT32_IEEE 0 BSW_A2L_Ident_Float -3.4E+38 3.4E+38 /end CHARACTERISTIC
/begin CHARACTERISTIC CAL_TRSP_3V3CPLDVoltCountTrh_s16 "CAL_TRSP_3V3CPLDVoltCountTrh_s16" VALUE 0x80146362 Scalar_SWORD 0 BSW_A2L_Ident_Int -32768 32767 /end CHARACTERISTIC
/begin CHARACTERISTIC CAL_TRSP_RslvRngSinNHiLim_u16 "CAL_TRSP_RslvRngSinNHiLim_u16" VALUE 0x8014630E Scalar_UWORD 0 BSW_A2L_Ident_Int 0 65535 /end CHARACTERISTIC
/begin CHARACTERISTIC CAL_TpcTmp_tIGBTTraSave2ToOverheating_f32 "CAL_TpcTmp_tIGBTTraSave2ToOverheating_f32" VALUE 0x8014532C Scalar_FLOAT32_IEEE 0 BSW_A2L_Ident_Float -3.4E+38 3.4E+38 /end CHARACTERISTIC
/begin CHARACTERISTIC CAL_TCF_TrqCalcMonDebTrh_s16 "CAL_TCF_TrqCalcMonDebTrh_s16" VALUE 0x80143D3C Scalar_SWORD 0 BSW_A2L_Ident_Int -32768 32767 /end CHARACTERISTIC
/begin CHARACTERISTIC CAL_TCF_HiTrqDirStop_f32 "CAL_TCF_HiTrqDirStop_f32" VALUE 0x801450AC Scalar_FLOAT32_IEEE 0 BSW_A2L_Ident_Float -3.4E+38 3.4E+38 /end CHARACTERISTIC
/begin CHARACTERISTIC CAL_TpcSmp_GenOvrCurtKp_f32 "CAL_TpcSmp_GenOvrCurtKp_f32" VALUE 0x801457F4 Scalar_FLOAT32_IEEE 0 BSW_A2L_Ident_Float -3.4E+38 3.4E+38 /end CHARACTERISTIC
/begin CHARACTERISTIC CAL_Scf_ThreRuntoDischaFail_u8 "CAL_Scf_ThreRuntoDischaFail_u8" VALUE 0x80143488 Scalar_UBYTE 0 BSW_A2L_Ident_Int 0 255 /end CHARACTERISTIC
/begin CHARACTERISTIC CAL_TpcTmp_tRiseDbcTraNormalToSave1_f32 "CAL_TpcTmp_tRiseDbcTraNormalToSave1_f32" VALUE 0x80145294 Scalar_FLOAT32_IEEE 0 BSW_A2L_Ident_Float -3.4E+38 3.4E+38 /end CHARACTERISTIC
/begin CHARACTERISTIC CAL_TRSP_RslvRngCountTrh_s16 "CAL_TRSP_RslvRngCountTrh_s16" VALUE 0x80146318 Scalar_SWORD 0 BSW_A2L_Ident_Int -32768 32767 /end CHARACTERISTIC
/begin CHARACTERISTIC CAL_TRSP_RslvExciDebTrh_s16 "CAL_TRSP_RslvExciDebTrh_s16" VALUE 0x80146324 Scalar_SWORD 0 BSW_A2L_Ident_Int -32768 32767 /end CHARACTERISTIC
/begin CHARACTERISTIC CAL_TpcTmp_tRiseDbcTraSave2ToOverheating_f32 "CAL_TpcTmp_tRiseDbcTraSave2ToOverheating_f32" VALUE 0x80145288 Scalar_FLOAT32_IEEE 0 BSW_A2L_Ident_Float -3.4E+38 3.4E+38 /end CHARACTERISTIC
/begin CHARACTERISTIC CAL_TpcSmp_PwrAddMaxGen_f32 "CAL_TpcSmp_PwrAddMaxGen_f32" VALUE 0x80145680 Scalar_FLOAT32_IEEE 0 BSW_A2L_Ident_Float -3.4E+38 3.4E+38 /end CHARACTERISTIC
/begin CHARACTERISTIC CAL_TpcTmp_DbcChgTempDownDiff_f32 "CAL_TpcTmp_DbcChgTempDownDiff_f32" VALUE 0x801455C0 Scalar_FLOAT32_IEEE 0 BSW_A2L_Ident_Float -3.4E+38 3.4E+38 /end CHARACTERISTIC
/begin CHARACTERISTIC CAL_TpcSmp_CntElecUdrVolt_u8 "CAL_TpcSmp_CntElecUdrVolt_u8" VALUE 0x8014581B Scalar_UBYTE 0 BSW_A2L_Ident_Int 0 255 /end CHARACTERISTIC
/begin CHARACTERISTIC CAL_Tpc_Powersave2Mode_u8 "CAL_Tpc_Powersave2Mode_u8" VALUE 0x801451E4 Scalar_UBYTE 0 BSW_A2L_Ident_Int 0 255 /end CHARACTERISTIC
/begin CHARACTERISTIC CAL_TpcSmp_nCtlExtReq_u8 "CAL_TpcSmp_nCtlExtReq_u8" VALUE 0x80145621 Scalar_UBYTE 0 BSW_A2L_Ident_Int 0 255 /end CHARACTERISTIC
/begin CHARACTERISTIC CAL_TpcTmp_tDbcTraSave1ToSave2_f32 "CAL_TpcTmp_tDbcTraSave1ToSave2_f32" VALUE 0x80145420 Scalar_FLOAT32_IEEE 0 BSW_A2L_Ident_Float -3.4E+38 3.4E+38 /end CHARACTERISTIC
/begin CHARACTERISTIC CAL_TpcMot_SttrTempAdds_f32 "CAL_TpcMot_SttrTempAdds_f32" VALUE 0x80145980 Scalar_FLOAT32_IEEE 0 BSW_A2L_Ident_Float -3.4E+38 3.4E+38 /end CHARACTERISTIC
/begin CHARACTERISTIC CAL_TpcSmp_GenOvrVoltKi_f32 "CAL_TpcSmp_GenOvrVoltKi_f32" VALUE 0x801457EC Scalar_FLOAT32_IEEE 0 BSW_A2L_Ident_Float -3.4E+38 3.4E+38 /end CHARACTERISTIC
/begin CHARACTERISTIC CAL_TRSP_RslvSqrtCountTrh_s16 "CAL_TRSP_RslvSqrtCountTrh_s16" VALUE 0x801462FC Scalar_SWORD 0 BSW_A2L_Ident_Int -32768 32767 /end CHARACTERISTIC
/begin CHARACTERISTIC CAL_TpcSmp_GenOvrCurtypLim_f32 "CAL_TpcSmp_GenOvrCurtypLim_f32" VALUE 0x801457F0 Scalar_FLOAT32_IEEE 0 BSW_A2L_Ident_Float -3.4E+38 3.4E+38 /end CHARACTERISTIC
/begin CHARACTERISTIC CAL_TpcTmp_tIGBTTraNormalToSave1_f32 "CAL_TpcTmp_tIGBTTraNormalToSave1_f32" VALUE 0x80145338 Scalar_FLOAT32_IEEE 0 BSW_A2L_Ident_Float -3.4E+38 3.4E+38 /end CHARACTERISTIC
/begin CHARACTERISTIC CAL_TpcTmp_DbcRiseChgTempUpDiff_f32 "CAL_TpcTmp_DbcRiseChgTempUpDiff_f32" VALUE 0x801455B4 Scalar_FLOAT32_IEEE 0 BSW_A2L_Ident_Float -3.4E+38 3.4E+38 /end CHARACTERISTIC
/begin CHARACTERISTIC CAL_TpcTmp_IGBTRiseTempKp_f32 "CAL_TpcTmp_IGBTRiseTempKp_f32" VALUE 0x801455A8 Scalar_FLOAT32_IEEE 0 BSW_A2L_Ident_Float -3.4E+38 3.4E+38 /end CHARACTERISTIC
/begin CHARACTERISTIC CAL_TCF_TempStrMin_f32 "CAL_TCF_TempStrMin_f32" VALUE 0x80143D44 Scalar_FLOAT32_IEEE 0 BSW_A2L_Ident_Float -3.4E+38 3.4E+38 /end CHARACTERISTIC
/begin CHARACTERISTIC CAL_TRSP_RslvSensVoltHiLim_u16 "CAL_TRSP_RslvSensVoltHiLim_u16" VALUE 0x80146300 Scalar_UWORD 0 BSW_A2L_Ident_Int 0 65535 /end CHARACTERISTIC
/begin CHARACTERISTIC CAL_STM_UxptTrqLim_f32 "CAL_STM_UxptTrqLim_f32" VALUE 0x80146B40 Scalar_FLOAT32_IEEE 0 BSW_A2L_Ident_Float -3.4E+38 3.4E+38 /end CHARACTERISTIC
/begin CHARACTERISTIC CAL_TRSP_RslvRngSinNLoLim_u16 "CAL_TRSP_RslvRngSinNLoLim_u16" VALUE 0x8014630C Scalar_UWORD 0 BSW_A2L_Ident_Int 0 65535 /end CHARACTERISTIC
/begin CHARACTERISTIC CAL_TRSP_VCurrRngLoLim_f32 "CAL_TRSP_VCurrRngLoLim_f32" VALUE 0x801462D4 Scalar_FLOAT32_IEEE 0 BSW_A2L_Ident_Float -3.4E+38 3.4E+38 /end CHARACTERISTIC
/begin CHARACTERISTIC CAL_TDC_trqIncMax_f32 "CAL_TDC_trqIncMax_f32" VALUE 0x80145140 Scalar_FLOAT32_IEEE 0 BSW_A2L_Ident_Float -3.4E+38 3.4E+38 /end CHARACTERISTIC
/begin CHARACTERISTIC CAL_TpcTmp_IgbtChgTempUpDiff_f32 "CAL_TpcTmp_IgbtChgTempUpDiff_f32" VALUE 0x80145584 Scalar_FLOAT32_IEEE 0 BSW_A2L_Ident_Float -3.4E+38 3.4E+38 /end CHARACTERISTIC
/begin CHARACTERISTIC CAL_TpcSmp_FacGenOvrCurt_u8 "CAL_TpcSmp_FacGenOvrCurt_u8" VALUE 0x801457FD Scalar_UBYTE 0 BSW_A2L_Ident_Int 0 255 /end CHARACTERISTIC
/begin CHARACTERISTIC CAL_TpcCod_PosSpdHold_f32 "CAL_TpcCod_PosSpdHold_f32" VALUE 0x80145FE4 Scalar_FLOAT32_IEEE 0 BSW_A2L_Ident_Float -3.4E+38 3.4E+38 /end CHARACTERISTIC
/begin CHARACTERISTIC CAL_TpcTmp_tDbcTempUHiLim_f32 "CAL_TpcTmp_tDbcTempUHiLim_f32" VALUE 0x80145444 Scalar_FLOAT32_IEEE 0 BSW_A2L_Ident_Float -3.4E+38 3.4E+38 /end CHARACTERISTIC
/begin CHARACTERISTIC CAL_TpcCod_MotorSampErr_b "CAL_TpcCod_MotorSampErr_b" VALUE 0x80145FFD Scalar_BOOLEAN 0 BSW_A2L_Ident_Int 0 1 /end CHARACTERISTIC
/begin CHARACTERISTIC CAL_TRSP_3V3CPLDVoltDebTrh_s16 "CAL_TRSP_3V3CPLDVoltDebTrh_s16" VALUE 0x80146360 Scalar_SWORD 0 BSW_A2L_Ident_Int -32768 32767 /end CHARACTERISTIC
/begin CHARACTERISTIC CAL_TpcTmp_DBCTempMinus_f32 "CAL_TpcTmp_DBCTempMinus_f32" VALUE 0x801455C8 Scalar_FLOAT32_IEEE 0 BSW_A2L_Ident_Float -3.4E+38 3.4E+38 /end CHARACTERISTIC
/begin CHARACTERISTIC CAL_TpcTmp_IgbtRiseChgTempUpDiff_f32 "CAL_TpcTmp_IgbtRiseChgTempUpDiff_f32" VALUE 0x8014557C Scalar_FLOAT32_IEEE 0 BSW_A2L_Ident_Float -3.4E+38 3.4E+38 /end CHARACTERISTIC
/begin CHARACTERISTIC CAL_TpcTmp_tDbcTempVHiLim_f32 "CAL_TpcTmp_tDbcTempVHiLim_f32" VALUE 0x8014543C Scalar_FLOAT32_IEEE 0 BSW_A2L_Ident_Float -3.4E+38 3.4E+38 /end CHARACTERISTIC
/begin CHARACTERISTIC CAL_TpcTmp_DbcRiseChgTempDownDiff_f32 "CAL_TpcTmp_DbcRiseChgTempDownDiff_f32" VALUE 0x801455B8 Scalar_FLOAT32_IEEE 0 BSW_A2L_Ident_Float -3.4E+38 3.4E+38 /end CHARACTERISTIC
/begin CHARACTERISTIC CAL_TCF_TempStrMax_f32 "CAL_TCF_TempStrMax_f32" VALUE 0x80143D48 Scalar_FLOAT32_IEEE 0 BSW_A2L_Ident_Float -3.4E+38 3.4E+38 /end CHARACTERISTIC
/begin CHARACTERISTIC CAL_TpcBlk_MtrBlkSpdHighSet_f32 "CAL_TpcBlk_MtrBlkSpdHighSet_f32" VALUE 0x80146294 Scalar_FLOAT32_IEEE 0 BSW_A2L_Ident_Float -3.4E+38 3.4E+38 /end CHARACTERISTIC
/begin CHARACTERISTIC CAL_TpcTmp_tDbcTraSave1ToNormal_f32 "CAL_TpcTmp_tDbcTraSave1ToNormal_f32" VALUE 0x80145424 Scalar_FLOAT32_IEEE 0 BSW_A2L_Ident_Float -3.4E+38 3.4E+38 /end CHARACTERISTIC
/begin CHARACTERISTIC CAL_TpcTmp_tRiseIGBTTraSave1ToSave2_f32 "CAL_TpcTmp_tRiseIGBTTraSave1ToSave2_f32" VALUE 0x801451EC Scalar_FLOAT32_IEEE 0 BSW_A2L_Ident_Float -3.4E+38 3.4E+38 /end CHARACTERISTIC
/begin CHARACTERISTIC CAL_TpcSmp_SystemEffiElec_f32 "CAL_TpcSmp_SystemEffiElec_f32" VALUE 0x80145678 Scalar_FLOAT32_IEEE 0 BSW_A2L_Ident_Float -3.4E+38 3.4E+38 /end CHARACTERISTIC
/begin CHARACTERISTIC CAL_TpcCod_NegTrqDirStop_f32 "CAL_TpcCod_NegTrqDirStop_f32" VALUE 0x80145FEC Scalar_FLOAT32_IEEE 0 BSW_A2L_Ident_Float -3.4E+38 3.4E+38 /end CHARACTERISTIC
/begin CHARACTERISTIC CAL_TRSP_VCurrRngHiLim_f32 "CAL_TRSP_VCurrRngHiLim_f32" VALUE 0x801462D8 Scalar_FLOAT32_IEEE 0 BSW_A2L_Ident_Float -3.4E+38 3.4E+38 /end CHARACTERISTIC
/begin CHARACTERISTIC CAL_TRSP_1V8CPLDVoltCountTrh_s16 "CAL_TRSP_1V8CPLDVoltCountTrh_s16" VALUE 0x8014636C Scalar_SWORD 0 BSW_A2L_Ident_Int -32768 32767 /end CHARACTERISTIC
/begin CHARACTERISTIC CAL_TpcTmp_tDbcTempWHiLim_f32 "CAL_TpcTmp_tDbcTempWHiLim_f32" VALUE 0x80145434 Scalar_FLOAT32_IEEE 0 BSW_A2L_Ident_Float -3.4E+38 3.4E+38 /end CHARACTERISTIC
/begin CHARACTERISTIC CAL_TpcMot_tSttrTraSave2ToOverheating_f32 "CAL_TpcMot_tSttrTraSave2ToOverheating_f32" VALUE 0x80145824 Scalar_FLOAT32_IEEE 0 BSW_A2L_Ident_Float -3.4E+38 3.4E+38 /end CHARACTERISTIC
/begin CHARACTERISTIC CAL_TpcTmp_IgbtChgTempDownDiff_f32 "CAL_TpcTmp_IgbtChgTempDownDiff_f32" VALUE 0x80145588 Scalar_FLOAT32_IEEE 0 BSW_A2L_Ident_Float -3.4E+38 3.4E+38 /end CHARACTERISTIC
/begin CHARACTERISTIC CAL_STM_UxptNLim_f32 "CAL_STM_UxptNLim_f32" VALUE 0x80146B4C Scalar_FLOAT32_IEEE 0 BSW_A2L_Ident_Float -3.4E+38 3.4E+38 /end CHARACTERISTIC
/begin CHARACTERISTIC CAL_TpcMot_tSttrTraNormalToSave1_f32 "CAL_TpcMot_tSttrTraNormalToSave1_f32" VALUE 0x80145830 Scalar_FLOAT32_IEEE 0 BSW_A2L_Ident_Float -3.4E+38 3.4E+38 /end CHARACTERISTIC
/begin CHARACTERISTIC CAL_TpcSmp_ElecUdrVoltKi_f32 "CAL_TpcSmp_ElecUdrVoltKi_f32" VALUE 0x80145808 Scalar_FLOAT32_IEEE 0 BSW_A2L_Ident_Float -3.4E+38 3.4E+38 /end CHARACTERISTIC
/begin CHARACTERISTIC CAL_TpcSmp_CntGenOvrVolt_u8 "CAL_TpcSmp_CntGenOvrVolt_u8" VALUE 0x80145819 Scalar_UBYTE 0 BSW_A2L_Ident_Int 0 255 /end CHARACTERISTIC
/begin CHARACTERISTIC CAL_TpcSmp_GenOvrVoltKp_f32 "CAL_TpcSmp_GenOvrVoltKp_f32" VALUE 0x801457E8 Scalar_FLOAT32_IEEE 0 BSW_A2L_Ident_Float -3.4E+38 3.4E+38 /end CHARACTERISTIC
/begin CHARACTERISTIC CAL_SWD_MotorPole_u8 "CAL_SWD_MotorPole_u8" VALUE 0x80143C9C Scalar_UBYTE 0 BSW_A2L_Ident_Int 0 255 /end CHARACTERISTIC
/begin CHARACTERISTIC CAL_TpcSmp_ElecOvrCurtKp_f32 "CAL_TpcSmp_ElecOvrCurtKp_f32" VALUE 0x80145810 Scalar_FLOAT32_IEEE 0 BSW_A2L_Ident_Float -3.4E+38 3.4E+38 /end CHARACTERISTIC
/begin CHARACTERISTIC CAL_TRSP_RslvSensVoltCountTrh_s16 "CAL_TRSP_RslvSensVoltCountTrh_s16" VALUE 0x80146306 Scalar_SWORD 0 BSW_A2L_Ident_Int -32768 32767 /end CHARACTERISTIC
/begin CHARACTERISTIC CAL_TRSP_RslvSqrtDebTrh_s16 "CAL_TRSP_RslvSqrtDebTrh_s16" VALUE 0x801462FA Scalar_SWORD 0 BSW_A2L_Ident_Int -32768 32767 /end CHARACTERISTIC
/begin CHARACTERISTIC CAL_Tpc_TrqReduceRevStep_f32 "CAL_Tpc_TrqReduceRevStep_f32" VALUE 0x801451E0 Scalar_FLOAT32_IEEE 0 BSW_A2L_Ident_Float -3.4E+38 3.4E+38 /end CHARACTERISTIC
/begin CHARACTERISTIC CAL_TRSP_RslvSensVoltErrRst_b "CAL_TRSP_RslvSensVoltErrRst_b" VALUE 0x80146302 Scalar_BOOLEAN 0 BSW_A2L_Ident_Int 0 1 /end CHARACTERISTIC
/begin CHARACTERISTIC CAL_TpcTmp_tCoolantTraSave1ToSave2_f32 "CAL_TpcTmp_tCoolantTraSave1ToSave2_f32" VALUE 0x801454E0 Scalar_FLOAT32_IEEE 0 BSW_A2L_Ident_Float -3.4E+38 3.4E+38 /end CHARACTERISTIC
/begin CHARACTERISTIC CAL_TpcTmp_CoolTempMinus_f32 "CAL_TpcTmp_CoolTempMinus_f32" VALUE 0x801455F0 Scalar_FLOAT32_IEEE 0 BSW_A2L_Ident_Float -3.4E+38 3.4E+38 /end CHARACTERISTIC
/begin CHARACTERISTIC CAL_TpcBlk_MtrBlkIsFirstSet_f32 "CAL_TpcBlk_MtrBlkIsFirstSet_f32" VALUE 0x8014629C Scalar_FLOAT32_IEEE 0 BSW_A2L_Ident_Float -3.4E+38 3.4E+38 /end CHARACTERISTIC
/begin CHARACTERISTIC CAL_TpcTmp_tDBCTrqLimRamp_f32 "CAL_TpcTmp_tDBCTrqLimRamp_f32" VALUE 0x801454D8 Scalar_FLOAT32_IEEE 0 BSW_A2L_Ident_Float -3.4E+38 3.4E+38 /end CHARACTERISTIC
/begin CHARACTERISTIC CAL_TRSP_RslvExciErrRst_b "CAL_TRSP_RslvExciErrRst_b" VALUE 0x80146322 Scalar_BOOLEAN 0 BSW_A2L_Ident_Int 0 1 /end CHARACTERISTIC
/begin CHARACTERISTIC CAL_TRSP_RslvRngDebTrh_s16 "CAL_TRSP_RslvRngDebTrh_s16" VALUE 0x80146316 Scalar_SWORD 0 BSW_A2L_Ident_Int -32768 32767 /end CHARACTERISTIC
/begin CHARACTERISTIC CAL_TpcTmp_CoolChgTempDownDiff_f32 "CAL_TpcTmp_CoolChgTempDownDiff_f32" VALUE 0x80145604 Scalar_FLOAT32_IEEE 0 BSW_A2L_Ident_Float -3.4E+38 3.4E+38 /end CHARACTERISTIC
/begin CHARACTERISTIC CAL_TpcTmp_tDbcTempWLoLim_f32 "CAL_TpcTmp_tDbcTempWLoLim_f32" VALUE 0x80145430 Scalar_FLOAT32_IEEE 0 BSW_A2L_Ident_Float -3.4E+38 3.4E+38 /end CHARACTERISTIC
/begin CHARACTERISTIC CAL_Tpc_TrqRevStep_f32 "CAL_Tpc_TrqRevStep_f32" VALUE 0x801451DC Scalar_FLOAT32_IEEE 0 BSW_A2L_Ident_Float -3.4E+38 3.4E+38 /end CHARACTERISTIC
/begin CHARACTERISTIC CAL_TpcCod_PowIncRatLim_f32 "CAL_TpcCod_PowIncRatLim_f32" VALUE 0x80145FD8 Scalar_FLOAT32_IEEE 0 BSW_A2L_Ident_Float -3.4E+38 3.4E+38 /end CHARACTERISTIC
/begin CHARACTERISTIC CAL_TpcBlk_TrqDecRamp_f32 "CAL_TpcBlk_TrqDecRamp_f32" VALUE 0x80146288 Scalar_FLOAT32_IEEE 0 BSW_A2L_Ident_Float -3.4E+38 3.4E+38 /end CHARACTERISTIC
/begin CHARACTERISTIC CAL_TpcCod_MotorStallWarn_b "CAL_TpcCod_MotorStallWarn_b" VALUE 0x80145FFC Scalar_BOOLEAN 0 BSW_A2L_Ident_Int 0 1 /end CHARACTERISTIC
/begin CHARACTERISTIC CAL_TRSP_CurrSumCountTrh_s16 "CAL_TRSP_CurrSumCountTrh_s16" VALUE 0x80146350 Scalar_SWORD 0 BSW_A2L_Ident_Int -32768 32767 /end CHARACTERISTIC
/begin CHARACTERISTIC CAL_TpcMot_tSttrTraSave1ToSave2_f32 "CAL_TpcMot_tSttrTraSave1ToSave2_f32" VALUE 0x80145828 Scalar_FLOAT32_IEEE 0 BSW_A2L_Ident_Float -3.4E+38 3.4E+38 /end CHARACTERISTIC
/begin CHARACTERISTIC CAL_TpcSmp_uDcLnkMaxMin_f32 "CAL_TpcSmp_uDcLnkMaxMin_f32" VALUE 0x80145618 Scalar_FLOAT32_IEEE 0 BSW_A2L_Ident_Float -3.4E+38 3.4E+38 /end CHARACTERISTIC
/begin CHARACTERISTIC CAL_STM_UxptTrqMonCountTrh_s16 "CAL_STM_UxptTrqMonCountTrh_s16" VALUE 0x80146B3C Scalar_SWORD 0 BSW_A2L_Ident_Int -32768 32767 /end CHARACTERISTIC
/begin CHARACTERISTIC CAL_TpcSmp_iDcLnkMaxMin_f32 "CAL_TpcSmp_iDcLnkMaxMin_f32" VALUE 0x80145634 Scalar_FLOAT32_IEEE 0 BSW_A2L_Ident_Float -3.4E+38 3.4E+38 /end CHARACTERISTIC
/begin CHARACTERISTIC CAL_TpcSmp_nCtlIntReq_u8 "CAL_TpcSmp_nCtlIntReq_u8" VALUE 0x80145620 Scalar_UBYTE 0 BSW_A2L_Ident_Int 0 255 /end CHARACTERISTIC
/begin CHARACTERISTIC CAL_TpcFuv_CofTrqLimLv1_f32 "CAL_TpcFuv_CofTrqLimLv1_f32" VALUE 0x80145FC0 Scalar_FLOAT32_IEEE 0 BSW_A2L_Ident_Float -3.4E+38 3.4E+38 /end CHARACTERISTIC
/begin CHARACTERISTIC CAL_STM_UxptSpdMonDebTrh_s16 "CAL_STM_UxptSpdMonDebTrh_s16" VALUE 0x80146B46 Scalar_SWORD 0 BSW_A2L_Ident_Int -32768 32767 /end CHARACTERISTIC
/begin CHARACTERISTIC CAL_TpcTmp_IGBTRiseTempRiseDiff_f32 "CAL_TpcTmp_IGBTRiseTempRiseDiff_f32" VALUE 0x801455A0 Scalar_FLOAT32_IEEE 0 BSW_A2L_Ident_Float -3.4E+38 3.4E+38 /end CHARACTERISTIC
/begin CHARACTERISTIC CAL_STM_UxptSpdMonCountTrh_s16 "CAL_STM_UxptSpdMonCountTrh_s16" VALUE 0x80146B48 Scalar_SWORD 0 BSW_A2L_Ident_Int -32768 32767 /end CHARACTERISTIC
/begin CHARACTERISTIC CAL_TRSP_UCurrRngLoLim_f32 "CAL_TRSP_UCurrRngLoLim_f32" VALUE 0x801462DC Scalar_FLOAT32_IEEE 0 BSW_A2L_Ident_Float -3.4E+38 3.4E+38 /end CHARACTERISTIC
/begin CHARACTERISTIC CAL_TRSP_RslvSensVoltLoLim_u16 "CAL_TRSP_RslvSensVoltLoLim_u16" VALUE 0x801462FE Scalar_UWORD 0 BSW_A2L_Ident_Int 0 65535 /end CHARACTERISTIC
/begin CHARACTERISTIC CAL_TRSP_RslvSqrtErrRst_b "CAL_TRSP_RslvSqrtErrRst_b" VALUE 0x801462F8 Scalar_BOOLEAN 0 BSW_A2L_Ident_Int 0 1 /end CHARACTERISTIC
/begin CHARACTERISTIC CAL_TRSP_RslvRngErrRst_b "CAL_TRSP_RslvRngErrRst_b" VALUE 0x80146314 Scalar_BOOLEAN 0 BSW_A2L_Ident_Int 0 1 /end CHARACTERISTIC
/begin CHARACTERISTIC CAL_TpcSmp_iDcLnkMaxMax_f32 "CAL_TpcSmp_iDcLnkMaxMax_f32" VALUE 0x80145638 Scalar_FLOAT32_IEEE 0 BSW_A2L_Ident_Float -3.4E+38 3.4E+38 /end CHARACTERISTIC
/begin CHARACTERISTIC CAL_TpcSmp_GenOvrVoltypLim_f32 "CAL_TpcSmp_GenOvrVoltypLim_f32" VALUE 0x801457E4 Scalar_FLOAT32_IEEE 0 BSW_A2L_Ident_Float -3.4E+38 3.4E+38 /end CHARACTERISTIC
/begin CHARACTERISTIC CAL_TRSP_RslvRngExciHiLim_u16 "CAL_TRSP_RslvRngExciHiLim_u16" VALUE 0x80146312 Scalar_UWORD 0 BSW_A2L_Ident_Int 0 65535 /end CHARACTERISTIC
/begin CHARACTERISTIC CAL_TpcTmp_tRiseIGBTTraNormalToSave1_f32 "CAL_TpcTmp_tRiseIGBTTraNormalToSave1_f32" VALUE 0x801451F4 Scalar_FLOAT32_IEEE 0 BSW_A2L_Ident_Float -3.4E+38 3.4E+38 /end CHARACTERISTIC
/begin CHARACTERISTIC CAL_TCF_TrqMechCutOffFrq_f32 "CAL_TCF_TrqMechCutOffFrq_f32" VALUE 0x80143D34 Scalar_FLOAT32_IEEE 0 BSW_A2L_Ident_Float -3.4E+38 3.4E+38 /end CHARACTERISTIC
/begin CHARACTERISTIC CAL_TpcFuv_CofTrqLimLv4_f32 "CAL_TpcFuv_CofTrqLimLv4_f32" VALUE 0x80145FB4 Scalar_FLOAT32_IEEE 0 BSW_A2L_Ident_Float -3.4E+38 3.4E+38 /end CHARACTERISTIC
/begin CHARACTERISTIC CAL_TpcSmp_TrqAddMax_f32 "CAL_TpcSmp_TrqAddMax_f32" VALUE 0x80145668 Scalar_FLOAT32_IEEE 0 BSW_A2L_Ident_Float -3.4E+38 3.4E+38 /end CHARACTERISTIC
/begin CHARACTERISTIC CAL_Tpcmot_uDcHiset_f32 "CAL_Tpcmot_uDcHiset_f32" VALUE 0x801451C4 Scalar_FLOAT32_IEEE 0 BSW_A2L_Ident_Float -3.4E+38 3.4E+38 /end CHARACTERISTIC
/begin CHARACTERISTIC CAL_TRSP_UCurrRngHiLim_f32 "CAL_TRSP_UCurrRngHiLim_f32" VALUE 0x801462E0 Scalar_FLOAT32_IEEE 0 BSW_A2L_Ident_Float -3.4E+38 3.4E+38 /end CHARACTERISTIC
/begin CHARACTERISTIC CAL_TRSP_18VHSVoltHiLim_u16 "CAL_TRSP_18VHSVoltHiLim_u16" VALUE 0x80146370 Scalar_UWORD 0 BSW_A2L_Ident_Int 0 65535 /end CHARACTERISTIC
/begin CHARACTERISTIC CAL_TpcMot_tSttrLoLim_f32 "CAL_TpcMot_tSttrLoLim_f32" VALUE 0x80145834 Scalar_FLOAT32_IEEE 0 BSW_A2L_Ident_Float -3.4E+38 3.4E+38 /end CHARACTERISTIC
/begin CHARACTERISTIC CAL_TpcSmp_flgUsePwrLoss_b "CAL_TpcSmp_flgUsePwrLoss_b" VALUE 0x8014563C Scalar_BOOLEAN 0 BSW_A2L_Ident_Int 0 1 /end CHARACTERISTIC
/begin CHARACTERISTIC CAL_TpcTmp_DBCTempKp_f32 "CAL_TpcTmp_DBCTempKp_f32" VALUE 0x801455CC Scalar_FLOAT32_IEEE 0 BSW_A2L_Ident_Float -3.4E+38 3.4E+38 /end CHARACTERISTIC
/begin CHARACTERISTIC CAL_TpcSmp_uDcLnkMinMax_f32 "CAL_TpcSmp_uDcLnkMinMax_f32" VALUE 0x80145614 Scalar_FLOAT32_IEEE 0 BSW_A2L_Ident_Float -3.4E+38 3.4E+38 /end CHARACTERISTIC
/begin CHARACTERISTIC CAL_TRSP_1V8CPLDVoltHiLim_u16 "CAL_TRSP_1V8CPLDVoltHiLim_u16" VALUE 0x80146366 Scalar_UWORD 0 BSW_A2L_Ident_Int 0 65535 /end CHARACTERISTIC
/begin CHARACTERISTIC CAL_TpcTmp_DBCTempDecDiff_f32 "CAL_TpcTmp_DBCTempDecDiff_f32" VALUE 0x801455D0 Scalar_FLOAT32_IEEE 0 BSW_A2L_Ident_Float -3.4E+38 3.4E+38 /end CHARACTERISTIC
/begin CHARACTERISTIC CAL_STM_UxptTrqMonErrRst_b "CAL_STM_UxptTrqMonErrRst_b" VALUE 0x80146B39 Scalar_BOOLEAN 0 BSW_A2L_Ident_Int 0 1 /end CHARACTERISTIC
/begin CHARACTERISTIC CAL_TpcSmp_CntElecOvrCurt_u8 "CAL_TpcSmp_CntElecOvrCurt_u8" VALUE 0x8014581C Scalar_UBYTE 0 BSW_A2L_Ident_Int 0 255 /end CHARACTERISTIC
/begin CHARACTERISTIC CAL_STM_SpeedCtlMode_u8 "CAL_STM_SpeedCtlMode_u8" VALUE 0x80146B50 Scalar_UBYTE 0 BSW_A2L_Ident_Int 0 255 /end CHARACTERISTIC
/begin CHARACTERISTIC CAL_TpcTmp_IGBTRiseTempMinus_f32 "CAL_TpcTmp_IGBTRiseTempMinus_f32" VALUE 0x801455A4 Scalar_FLOAT32_IEEE 0 BSW_A2L_Ident_Float -3.4E+38 3.4E+38 /end CHARACTERISTIC
/begin CHARACTERISTIC CAL_TRSP_CurrRngDebTrh_s16 "CAL_TRSP_CurrRngDebTrh_s16" VALUE 0x80146354 Scalar_SWORD 0 BSW_A2L_Ident_Int -32768 32767 /end CHARACTERISTIC
/begin CHARACTERISTIC CAL_TpcFuv_CofPwrLimLv4_f32 "CAL_TpcFuv_CofPwrLimLv4_f32" VALUE 0x80145FC4 Scalar_FLOAT32_IEEE 0 BSW_A2L_Ident_Float -3.4E+38 3.4E+38 /end CHARACTERISTIC
/begin CHARACTERISTIC CAL_TpcSmp_OvSpdWarnHiLim_f32 "CAL_TpcSmp_OvSpdWarnHiLim_f32" VALUE 0x801457E0 Scalar_FLOAT32_IEEE 0 BSW_A2L_Ident_Float -3.4E+38 3.4E+38 /end CHARACTERISTIC
/begin CHARACTERISTIC CAL_TpcTmp_tRiseIGBTTraSave2ToOverheating_f32 "CAL_TpcTmp_tRiseIGBTTraSave2ToOverheating_f32" VALUE 0x801451E8 Scalar_FLOAT32_IEEE 0 BSW_A2L_Ident_Float -3.4E+38 3.4E+38 /end CHARACTERISTIC
/begin CHARACTERISTIC CAL_TpcTmp_tIGBTTraSave1ToSave2_f32 "CAL_TpcTmp_tIGBTTraSave1ToSave2_f32" VALUE 0x80145330 Scalar_FLOAT32_IEEE 0 BSW_A2L_Ident_Float -3.4E+38 3.4E+38 /end CHARACTERISTIC
/begin CHARACTERISTIC CAL_TpcTmp_tRiseDbcTraSave1ToSave2_f32 "CAL_TpcTmp_tRiseDbcTraSave1ToSave2_f32" VALUE 0x8014528C Scalar_FLOAT32_IEEE 0 BSW_A2L_Ident_Float -3.4E+38 3.4E+38 /end CHARACTERISTIC
/begin CHARACTERISTIC CAL_TRSP_18VHSVoltDebTrh_s16 "CAL_TRSP_18VHSVoltDebTrh_s16" VALUE 0x80146374 Scalar_SWORD 0 BSW_A2L_Ident_Int -32768 32767 /end CHARACTERISTIC
/begin CHARACTERISTIC CAL_TpcSmp_SystemEffiGen_f32 "CAL_TpcSmp_SystemEffiGen_f32" VALUE 0x80145674 Scalar_FLOAT32_IEEE 0 BSW_A2L_Ident_Float -3.4E+38 3.4E+38 /end CHARACTERISTIC
/begin CHARACTERISTIC CAL_TpcCod_IGBTSampErr_b "CAL_TpcCod_IGBTSampErr_b" VALUE 0x80145FFE Scalar_BOOLEAN 0 BSW_A2L_Ident_Int 0 1 /end CHARACTERISTIC
/begin CHARACTERISTIC CAL_TpcFuv_CofPwrLimLv1_f32 "CAL_TpcFuv_CofPwrLimLv1_f32" VALUE 0x80145FD0 Scalar_FLOAT32_IEEE 0 BSW_A2L_Ident_Float -3.4E+38 3.4E+38 /end CHARACTERISTIC
/begin CHARACTERISTIC CAL_TRSP_RslvRngCosNLoLim_u16 "CAL_TRSP_RslvRngCosNLoLim_u16" VALUE 0x8014631E Scalar_UWORD 0 BSW_A2L_Ident_Int 0 65535 /end CHARACTERISTIC
/begin CHARACTERISTIC CAL_Tpc_Powersave1Mode_u8 "CAL_Tpc_Powersave1Mode_u8" VALUE 0x801451E5 Scalar_UBYTE 0 BSW_A2L_Ident_Int 0 255 /end CHARACTERISTIC
/begin CHARACTERISTIC CAL_TpcSmp_OvSpdWarnLoLim_f32 "CAL_TpcSmp_OvSpdWarnLoLim_f32" VALUE 0x801457DC Scalar_FLOAT32_IEEE 0 BSW_A2L_Ident_Float -3.4E+38 3.4E+38 /end CHARACTERISTIC
/begin CHARACTERISTIC CAL_TpcTmp_tDbcTempVLoLim_f32 "CAL_TpcTmp_tDbcTempVLoLim_f32" VALUE 0x80145438 Scalar_FLOAT32_IEEE 0 BSW_A2L_Ident_Float -3.4E+38 3.4E+38 /end CHARACTERISTIC
/begin CHARACTERISTIC CAL_TRSP_1V8CPLDVoltErrRst_b "CAL_TRSP_1V8CPLDVoltErrRst_b" VALUE 0x80146368 Scalar_BOOLEAN 0 BSW_A2L_Ident_Int 0 1 /end CHARACTERISTIC
/begin CHARACTERISTIC CAL_TRSP_3V3CPLDVoltErrRst_b "CAL_TRSP_3V3CPLDVoltErrRst_b" VALUE 0x8014635E Scalar_BOOLEAN 0 BSW_A2L_Ident_Int 0 1 /end CHARACTERISTIC
/begin CHARACTERISTIC CAL_TpcTmp_DBCTempRiseDiff_f32 "CAL_TpcTmp_DBCTempRiseDiff_f32" VALUE 0x801455C4 Scalar_FLOAT32_IEEE 0 BSW_A2L_Ident_Float -3.4E+38 3.4E+38 /end CHARACTERISTIC
/begin CHARACTERISTIC CAL_Tpcmot_uDcLoset_f32 "CAL_Tpcmot_uDcLoset_f32" VALUE 0x801451C0 Scalar_FLOAT32_IEEE 0 BSW_A2L_Ident_Float -3.4E+38 3.4E+38 /end CHARACTERISTIC
/begin CHARACTERISTIC CAL_TpcTmp_IGBTTempDecDiff_f32 "CAL_TpcTmp_IGBTTempDecDiff_f32" VALUE 0x80145598 Scalar_FLOAT32_IEEE 0 BSW_A2L_Ident_Float -3.4E+38 3.4E+38 /end CHARACTERISTIC
/begin CHARACTERISTIC CAL_TpcSmp_ThresOverSpd_f32 "CAL_TpcSmp_ThresOverSpd_f32" VALUE 0x80145670 Scalar_FLOAT32_IEEE 0 BSW_A2L_Ident_Float -3.4E+38 3.4E+38 /end CHARACTERISTIC
/begin CHARACTERISTIC CAL_TRSP_RslvRngCosNHiLim_u16 "CAL_TRSP_RslvRngCosNHiLim_u16" VALUE 0x80146320 Scalar_UWORD 0 BSW_A2L_Ident_Int 0 65535 /end CHARACTERISTIC
/begin CHARACTERISTIC CAL_TRSP_RslvSensVoltDebTrh_s16 "CAL_TRSP_RslvSensVoltDebTrh_s16" VALUE 0x80146304 Scalar_SWORD 0 BSW_A2L_Ident_Int -32768 32767 /end CHARACTERISTIC
/begin CHARACTERISTIC CAL_TpcMot_flgTrqRefSwt_b "CAL_TpcMot_flgTrqRefSwt_b" VALUE 0x8014596C Scalar_BOOLEAN 0 BSW_A2L_Ident_Int 0 1 /end CHARACTERISTIC
/begin CHARACTERISTIC CAL_TCF_flgUsePlossCompa_b "CAL_TCF_flgUsePlossCompa_b" VALUE 0x80143CA6 Scalar_BOOLEAN 0 BSW_A2L_Ident_Int 0 1 /end CHARACTERISTIC
/begin CHARACTERISTIC CAL_TRSP_AgTimecompCtl_u8 "CAL_TRSP_AgTimecompCtl_u8" VALUE 0x80146358 Scalar_UBYTE 0 BSW_A2L_Ident_Int 0 255 /end CHARACTERISTIC
/begin CHARACTERISTIC CAL_TpcTmp_IGBTTempAdds_f32 "CAL_TpcTmp_IGBTTempAdds_f32" VALUE 0x8014559C Scalar_FLOAT32_IEEE 0 BSW_A2L_Ident_Float -3.4E+38 3.4E+38 /end CHARACTERISTIC
/begin CHARACTERISTIC CAL_TpcSmp_FacElecOvrCurt_u8 "CAL_TpcSmp_FacElecOvrCurt_u8" VALUE 0x801457FF Scalar_UBYTE 0 BSW_A2L_Ident_Int 0 255 /end CHARACTERISTIC
/begin CHARACTERISTIC CAL_TpcFuv_CofTrqLimLv2_f32 "CAL_TpcFuv_CofTrqLimLv2_f32" VALUE 0x80145FBC Scalar_FLOAT32_IEEE 0 BSW_A2L_Ident_Float -3.4E+38 3.4E+38 /end CHARACTERISTIC
/begin CHARACTERISTIC CAL_TCF_TrqCalcMonCountTrh_s16 "CAL_TCF_TrqCalcMonCountTrh_s16" VALUE 0x80143D3E Scalar_SWORD 0 BSW_A2L_Ident_Int -32768 32767 /end CHARACTERISTIC
/begin CHARACTERISTIC CAL_TpcTmp_IGBRiseTTempAdds_f32 "CAL_TpcTmp_IGBRiseTTempAdds_f32" VALUE 0x801455B0 Scalar_FLOAT32_IEEE 0 BSW_A2L_Ident_Float -3.4E+38 3.4E+38 /end CHARACTERISTIC
/begin CHARACTERISTIC CAL_TpcTmp_DBCRiseTempKp_f32 "CAL_TpcTmp_DBCRiseTempKp_f32" VALUE 0x801455E0 Scalar_FLOAT32_IEEE 0 BSW_A2L_Ident_Float -3.4E+38 3.4E+38 /end CHARACTERISTIC
/begin CHARACTERISTIC CAL_TCF_LoTrqDirStop_f32 "CAL_TCF_LoTrqDirStop_f32" VALUE 0x80144724 Scalar_FLOAT32_IEEE 0 BSW_A2L_Ident_Float -3.4E+38 3.4E+38 /end CHARACTERISTIC
/begin CHARACTERISTIC CAL_TDC_DeltaT_f32 "CAL_TDC_DeltaT_f32" VALUE 0x801451BC Scalar_FLOAT32_IEEE 0 BSW_A2L_Ident_Float -3.4E+38 3.4E+38 /end CHARACTERISTIC
/begin CHARACTERISTIC CAL_TpcSmp_ElecUdrVoltKp_f32 "CAL_TpcSmp_ElecUdrVoltKp_f32" VALUE 0x80145804 Scalar_FLOAT32_IEEE 0 BSW_A2L_Ident_Float -3.4E+38 3.4E+38 /end CHARACTERISTIC
/begin CHARACTERISTIC CAL_TpcMot_tSttrHiLim_f32 "CAL_TpcMot_tSttrHiLim_f32" VALUE 0x80145838 Scalar_FLOAT32_IEEE 0 BSW_A2L_Ident_Float -3.4E+38 3.4E+38 /end CHARACTERISTIC
/begin CHARACTERISTIC CAL_TpcFuv_CofPwrLimLv3_f32 "CAL_TpcFuv_CofPwrLimLv3_f32" VALUE 0x80145FC8 Scalar_FLOAT32_IEEE 0 BSW_A2L_Ident_Float -3.4E+38 3.4E+38 /end CHARACTERISTIC
/begin CHARACTERISTIC CAL_TpcTmp_IGBTTempKp_f32 "CAL_TpcTmp_IGBTTempKp_f32" VALUE 0x80145594 Scalar_FLOAT32_IEEE 0 BSW_A2L_Ident_Float -3.4E+38 3.4E+38 /end CHARACTERISTIC
/begin CHARACTERISTIC CAL_TpcSmp_ElecOvrCurtKi_f32 "CAL_TpcSmp_ElecOvrCurtKi_f32" VALUE 0x80145814 Scalar_FLOAT32_IEEE 0 BSW_A2L_Ident_Float -3.4E+38 3.4E+38 /end CHARACTERISTIC
/begin CHARACTERISTIC CAL_TpcTmp_tDbcTraNormalToSave1_f32 "CAL_TpcTmp_tDbcTraNormalToSave1_f32" VALUE 0x80145428 Scalar_FLOAT32_IEEE 0 BSW_A2L_Ident_Float -3.4E+38 3.4E+38 /end CHARACTERISTIC
/begin CHARACTERISTIC CAL_TRSP_RslvExciCountTrh_s16 "CAL_TRSP_RslvExciCountTrh_s16" VALUE 0x80146326 Scalar_SWORD 0 BSW_A2L_Ident_Int -32768 32767 /end CHARACTERISTIC
/begin CHARACTERISTIC CAL_Scf_cntPostDrvDone_u16 "CAL_Scf_cntPostDrvDone_u16" VALUE 0x8014347C Scalar_UWORD 0 BSW_A2L_Ident_Int 0 65535 /end CHARACTERISTIC
/begin CHARACTERISTIC CAL_STM_UxptSpdMonErrRst_b "CAL_STM_UxptSpdMonErrRst_b" VALUE 0x80146B44 Scalar_BOOLEAN 0 BSW_A2L_Ident_Int 0 1 /end CHARACTERISTIC
/begin CHARACTERISTIC CAL_TpcTmp_tIGBTTrqLimRamp_f32 "CAL_TpcTmp_tIGBTTrqLimRamp_f32" VALUE 0x80145328 Scalar_FLOAT32_IEEE 0 BSW_A2L_Ident_Float -3.4E+38 3.4E+38 /end CHARACTERISTIC
/begin CHARACTERISTIC CAL_TpcCod_PosTrqDirStop_f32 "CAL_TpcCod_PosTrqDirStop_f32" VALUE 0x80145FDC Scalar_FLOAT32_IEEE 0 BSW_A2L_Ident_Float -3.4E+38 3.4E+38 /end CHARACTERISTIC
/begin CHARACTERISTIC CAL_TpcTmp_DBCRiseTempAdds_f32 "CAL_TpcTmp_DBCRiseTempAdds_f32" VALUE 0x801455E8 Scalar_FLOAT32_IEEE 0 BSW_A2L_Ident_Float -3.4E+38 3.4E+38 /end CHARACTERISTIC
/begin CHARACTERISTIC CAL_TpcBlk_flgEnBlkFun_b "CAL_TpcBlk_flgEnBlkFun_b" VALUE 0x80146282 Scalar_BOOLEAN 0 BSW_A2L_Ident_Int 0 1 /end CHARACTERISTIC
/begin CHARACTERISTIC CAL_TCF_HiSpdDirStop_f32 "CAL_TCF_HiSpdDirStop_f32" VALUE 0x801450B0 Scalar_FLOAT32_IEEE 0 BSW_A2L_Ident_Float -3.4E+38 3.4E+38 /end CHARACTERISTIC
/begin CHARACTERISTIC CAL_TpcBlk_TrqIncRamp_f32 "CAL_TpcBlk_TrqIncRamp_f32" VALUE 0x80146284 Scalar_FLOAT32_IEEE 0 BSW_A2L_Ident_Float -3.4E+38 3.4E+38 /end CHARACTERISTIC
/begin CHARACTERISTIC CAL_TpcSmp_FacElecUdrVolt_u8 "CAL_TpcSmp_FacElecUdrVolt_u8" VALUE 0x801457FE Scalar_UBYTE 0 BSW_A2L_Ident_Int 0 255 /end CHARACTERISTIC
/begin CHARACTERISTIC CAL_TpcTmp_tDbcThrPhLoLim_f32 "CAL_TpcTmp_tDbcThrPhLoLim_f32" VALUE 0x8014542C Scalar_FLOAT32_IEEE 0 BSW_A2L_Ident_Float -3.4E+38 3.4E+38 /end CHARACTERISTIC
/begin CHARACTERISTIC CAL_TpcBlk_TrqBlkStab_f32 "CAL_TpcBlk_TrqBlkStab_f32" VALUE 0x8014628C Scalar_FLOAT32_IEEE 0 BSW_A2L_Ident_Float -3.4E+38 3.4E+38 /end CHARACTERISTIC
/begin CHARACTERISTIC CAL_Tpcmot_TrqDiffGen_f32 "CAL_Tpcmot_TrqDiffGen_f32" VALUE 0x801451CC Scalar_FLOAT32_IEEE 0 BSW_A2L_Ident_Float -3.4E+38 3.4E+38 /end CHARACTERISTIC
/begin CHARACTERISTIC CAL_TpcMot_tSttrTrqLimRamp_f32 "CAL_TpcMot_tSttrTrqLimRamp_f32" VALUE 0x80145820 Scalar_FLOAT32_IEEE 0 BSW_A2L_Ident_Float -3.4E+38 3.4E+38 /end CHARACTERISTIC
/begin CHARACTERISTIC CAL_TpcTmp_DbcChgTempUpDiff_f32 "CAL_TpcTmp_DbcChgTempUpDiff_f32" VALUE 0x801455BC Scalar_FLOAT32_IEEE 0 BSW_A2L_Ident_Float -3.4E+38 3.4E+38 /end CHARACTERISTIC
/begin CHARACTERISTIC CAL_TRSP_3V3CPLDVoltLoLim_u16 "CAL_TRSP_3V3CPLDVoltLoLim_u16" VALUE 0x8014635A Scalar_UWORD 0 BSW_A2L_Ident_Int 0 65535 /end CHARACTERISTIC
/begin CHARACTERISTIC CAL_TRSP_3V3CPLDVoltHiLim_u16 "CAL_TRSP_3V3CPLDVoltHiLim_u16" VALUE 0x8014635C Scalar_UWORD 0 BSW_A2L_Ident_Int 0 65535 /end CHARACTERISTIC
/begin CHARACTERISTIC CAL_TpcTmp_tIGBTTraSave1ToNormal_f32 "CAL_TpcTmp_tIGBTTraSave1ToNormal_f32" VALUE 0x80145334 Scalar_FLOAT32_IEEE 0 BSW_A2L_Ident_Float -3.4E+38 3.4E+38 /end CHARACTERISTIC
/begin CHARACTERISTIC CAL_TRSP_1V8CPLDVoltLoLim_u16 "CAL_TRSP_1V8CPLDVoltLoLim_u16" VALUE 0x80146364 Scalar_UWORD 0 BSW_A2L_Ident_Int 0 65535 /end CHARACTERISTIC
/begin CHARACTERISTIC CAL_TRSP_CurrRngCountTrh_s16 "CAL_TRSP_CurrRngCountTrh_s16" VALUE 0x80146356 Scalar_SWORD 0 BSW_A2L_Ident_Int -32768 32767 /end CHARACTERISTIC
/begin CHARACTERISTIC CAL_TCF_LdSubLqCAzGen_af32 "" MAP 0x80144BE8 Lookup2D_FLOAT32_IEEE 0 SWC_TCF_CM_single -3.4E+38 3.4E+38
 /begin AXIS_DESCR COM_AXIS NO_INPUT_QUANTITY SWC_TCF_CM_single 15 -3.4E+38 3.4E+38 AXIS_PTS_REF CAL_TCF_LdSubLqIqCAy_af32 /end AXIS_DESCR
 /begin AXIS_DESCR COM_AXIS NO_INPUT_QUANTITY SWC_TCF_CM_single 18 -3.4E+38 3.4E+38 AXIS_PTS_REF CAL_TCF_LdSubLqIdCAx_af32 /end AXIS_DESCR
/end CHARACTERISTIC
/begin CHARACTERISTIC CAL_TCF_LdSubLqCAzMot_af32 "" MAP 0x801447B0 Lookup2D_FLOAT32_IEEE 0 SWC_TCF_CM_single -3.4E+38 3.4E+38
 /begin AXIS_DESCR COM_AXIS NO_INPUT_QUANTITY SWC_TCF_CM_single 15 -3.4E+38 3.4E+38 AXIS_PTS_REF CAL_TCF_LdSubLqIqCAy_af32 /end AXIS_DESCR
 /begin AXIS_DESCR COM_AXIS NO_INPUT_QUANTITY SWC_TCF_CM_single 18 -3.4E+38 3.4E+38 AXIS_PTS_REF CAL_TCF_LdSubLqIdCAx_af32 /end AXIS_DESCR
/end CHARACTERISTIC
/begin CHARACTERISTIC CAL_TCF_PwrLossCAz_af32 "" MAP 0x80143E1C Lookup2D_FLOAT32_IEEE 0 SWC_TCF_CM_single -3.4E+38 3.4E+38
 /begin AXIS_DESCR COM_AXIS NO_INPUT_QUANTITY SWC_TCF_CM_single 10 -3.4E+38 3.4E+38 AXIS_PTS_REF CAL_TCF_NPwrLosCAy_af32 /end AXIS_DESCR
 /begin AXIS_DESCR COM_AXIS VAR_TCF_Is_f32 SWC_TCF_CM_single 10 -3.4E+38 3.4E+38 AXIS_PTS_REF CAL_TCF_IsPwrLosCAx_af32 /end AXIS_DESCR
/end CHARACTERISTIC
/begin CHARACTERISTIC CAL_TCF_PwrTrqSpdCompa_af32 "" CURVE 0x80143DDC Lookup1D_FLOAT32_IEEE 0 SWC_TCF_CM_single -3.4E+38 3.4E+38
 /begin AXIS_DESCR COM_AXIS NO_INPUT_QUANTITY SWC_TCF_CM_single 10 -3.4E+38 3.4E+38 AXIS_PTS_REF CAL_TCF_NPwrLosCAy_af32 /end AXIS_DESCR
/end CHARACTERISTIC
/begin CHARACTERISTIC CAL_TCF_AgTrqTubeCAy_af32 "" CURVE 0x801450B4 Lookup1D_FLOAT32_IEEE 0 SWC_TCF_CM_single -3.4E+38 3.4E+38
 /begin AXIS_DESCR COM_AXIS NO_INPUT_QUANTITY SWC_TCF_CM_single 35 -3.4E+38 3.4E+38 AXIS_PTS_REF CAL_TCF_TrqTubeNCAx_af32 /end AXIS_DESCR
/end CHARACTERISTIC
/begin CHARACTERISTIC CAL_TCF_PwrTrqTubeCAy_af32 "" CURVE 0x80143D50 Lookup1D_FLOAT32_IEEE 0 SWC_TCF_CM_single -3.4E+38 3.4E+38
 /begin AXIS_DESCR COM_AXIS NO_INPUT_QUANTITY SWC_TCF_CM_single 35 -3.4E+38 3.4E+38 AXIS_PTS_REF CAL_TCF_TrqTubeNCAx_af32 /end AXIS_DESCR
/end CHARACTERISTIC
/begin CHARACTERISTIC PRV_CalFltFrq_1ms "" VALUE 0x80143CA4 Scalar_UWORD 0 SWC_TCF_CM_uint16 0 65535 /end CHARACTERISTIC
/begin CHARACTERISTIC CAL_TDC_KiNCtl_Y_Af32 "¸ù¾Ý×ªËÙÆ«²îµÃµ½kiµÄÖµ" CURVE 0x80145194 Lookup1D_FLOAT32_IEEE 0 SWC_TDC_CM_single -3.4E+38 3.4E+38
 /begin AXIS_DESCR COM_AXIS NO_INPUT_QUANTITY SWC_TDC_CM_single 10 -3.4E+38 3.4E+38 AXIS_PTS_REF CAL_TDC_n_Error_X_Af32 /end AXIS_DESCR
/end CHARACTERISTIC
/begin CHARACTERISTIC CAL_TDC_KpNCtl_Y_Af32 "¸ù¾Ý×ªËÙÆ«²îµÃµ½kpµÄÖµ" CURVE 0x8014516C Lookup1D_FLOAT32_IEEE 0 SWC_TDC_CM_single -3.4E+38 3.4E+38
 /begin AXIS_DESCR COM_AXIS NO_INPUT_QUANTITY SWC_TDC_CM_single 10 -3.4E+38 3.4E+38 AXIS_PTS_REF CAL_TDC_n_Error_X_Af32 /end AXIS_DESCR
/end CHARACTERISTIC
/begin CHARACTERISTIC CAL_TpcCod_CoolFlow2LTableZ_Trq_af32 "" MAP 0x801461A8 Lookup2D_FLOAT32_IEEE 0 SWC_TPC_CM_single -3.4E+38 3.4E+38
 /begin AXIS_DESCR COM_AXIS NO_INPUT_QUANTITY SWC_TPC_CM_single 5 -3.4E+38 3.4E+38 AXIS_PTS_REF CAL_TpcCod_CoolFlow2LTableX_Udc_af32 /end AXIS_DESCR
 /begin AXIS_DESCR COM_AXIS NO_INPUT_QUANTITY SWC_TPC_CM_single 8 -3.4E+38 3.4E+38 AXIS_PTS_REF CAL_TpcCod_CoolFlow2LTableY_Spd_af32 /end AXIS_DESCR
/end CHARACTERISTIC
/begin CHARACTERISTIC CAL_TpcCod_CoolFlow4LTableZ_Trq_af32 "" MAP 0x801460D4 Lookup2D_FLOAT32_IEEE 0 SWC_TPC_CM_single -3.4E+38 3.4E+38
 /begin AXIS_DESCR COM_AXIS NO_INPUT_QUANTITY SWC_TPC_CM_single 5 -3.4E+38 3.4E+38 AXIS_PTS_REF CAL_TpcCod_CoolFlow4LTableX_Udc_af32 /end AXIS_DESCR
 /begin AXIS_DESCR COM_AXIS NO_INPUT_QUANTITY SWC_TPC_CM_single 8 -3.4E+38 3.4E+38 AXIS_PTS_REF CAL_TpcCod_CoolFlow4LTableY_Spd_af32 /end AXIS_DESCR
/end CHARACTERISTIC
/begin CHARACTERISTIC CAL_TpcCod_CoolFlow6LTableZ_Trq_af32 "" MAP 0x80146000 Lookup2D_FLOAT32_IEEE 0 SWC_TPC_CM_single -3.4E+38 3.4E+38
 /begin AXIS_DESCR COM_AXIS NO_INPUT_QUANTITY SWC_TPC_CM_single 5 -3.4E+38 3.4E+38 AXIS_PTS_REF CAL_TpcCod_CoolFlow6LTableX_Udc_af32 /end AXIS_DESCR
 /begin AXIS_DESCR COM_AXIS NO_INPUT_QUANTITY SWC_TPC_CM_single 8 -3.4E+38 3.4E+38 AXIS_PTS_REF CAL_TpcCod_CoolFlow6LTableY_Spd_af32 /end AXIS_DESCR
/end CHARACTERISTIC
/begin CHARACTERISTIC CAL_TpcMot_ExCElecTableZ_Trq_af32 "ÍâÌØÐÔ²é±íÅ¤¾ØÊä³ö-µç¶¯Ä£Ê½" MAP 0x80145CA0 Lookup2D_FLOAT32_IEEE 0 SWC_TPC_CM_single -3.4E+38 3.4E+38
 /begin AXIS_DESCR COM_AXIS NO_INPUT_QUANTITY SWC_TPC_CM_single 10 -3.4E+38 3.4E+38 AXIS_PTS_REF CAL_TpcMot_ExCElecTableX_Udc_af32 /end AXIS_DESCR
 /begin AXIS_DESCR COM_AXIS NO_INPUT_QUANTITY SWC_TPC_CM_single 17 -3.4E+38 3.4E+38 AXIS_PTS_REF CAL_TpcMot_ExCElecTableY_Spd_af32 /end AXIS_DESCR
/end CHARACTERISTIC
/begin CHARACTERISTIC CAL_TpcMot_ExCGenTableZ_Trq_af32 "ÍâÌØÐÔ²é±íÅ¤¾ØÊä³ö-·¢µçÄ£Ê½" MAP 0x8014598C Lookup2D_FLOAT32_IEEE 0 SWC_TPC_CM_single -3.4E+38 3.4E+38
 /begin AXIS_DESCR COM_AXIS NO_INPUT_QUANTITY SWC_TPC_CM_single 10 -3.4E+38 3.4E+38 AXIS_PTS_REF CAL_TpcMot_ExCGenTableX_Udc_af32 /end AXIS_DESCR
 /begin AXIS_DESCR COM_AXIS NO_INPUT_QUANTITY SWC_TPC_CM_single 17 -3.4E+38 3.4E+38 AXIS_PTS_REF CAL_TpcMot_ExCGenTableY_Spd_af32 /end AXIS_DESCR
/end CHARACTERISTIC
/begin CHARACTERISTIC CAL_TpcMot_tRiseSttrDertSave1TableY_Cof_af32 "" CURVE 0x80145924 Lookup1D_FLOAT32_IEEE 0 SWC_TPC_CM_single -3.4E+38 3.4E+38
 /begin AXIS_DESCR COM_AXIS VAR_TpcMot_tRiseSttr_f32 SWC_TPC_CM_single 9 -3.4E+38 3.4E+38 AXIS_PTS_REF CAL_TpcMot_tRiseSttrDertSave1TableX_tSttr_af32 /end AXIS_DESCR
/end CHARACTERISTIC
/begin CHARACTERISTIC CAL_TpcMot_tRiseSttrDertSave2TableY_Cof_af32 "" CURVE 0x801458DC Lookup1D_FLOAT32_IEEE 0 SWC_TPC_CM_single -3.4E+38 3.4E+38
 /begin AXIS_DESCR COM_AXIS NO_INPUT_QUANTITY SWC_TPC_CM_single 9 -3.4E+38 3.4E+38 AXIS_PTS_REF CAL_TpcMot_tRiseSttrDertSave2TableX_tSttr_af32 /end AXIS_DESCR
/end CHARACTERISTIC
/begin CHARACTERISTIC CAL_TpcMot_tSttrDertSave1TableY_Cof_af32 "" CURVE 0x80145884 Lookup1D_FLOAT32_IEEE 0 SWC_TPC_CM_single -3.4E+38 3.4E+38
 /begin AXIS_DESCR COM_AXIS VAR_TpcMot_tSttrTempFlt_f32 SWC_TPC_CM_single 9 -3.4E+38 3.4E+38 AXIS_PTS_REF CAL_TpcMot_tSttrDertSave1TableX_tSttr_af32 /end AXIS_DESCR
/end CHARACTERISTIC
/begin CHARACTERISTIC CAL_TpcMot_tSttrDertSave2TableY_Cof_af32 "" CURVE 0x8014583C Lookup1D_FLOAT32_IEEE 0 SWC_TPC_CM_single -3.4E+38 3.4E+38
 /begin AXIS_DESCR COM_AXIS NO_INPUT_QUANTITY SWC_TPC_CM_single 9 -3.4E+38 3.4E+38 AXIS_PTS_REF CAL_TpcMot_tSttrDertSave2TableX_tSttr_af32 /end AXIS_DESCR
/end CHARACTERISTIC
/begin CHARACTERISTIC CAL_TpcSmp_OvrSpdQurd1TableY_Cof_af32 "³¬ËÙÏÞÅ¤ÏµÊýÊä³ö_µÚÒ»ÏóÏÞ" CURVE 0x80145754 Lookup1D_FLOAT32_IEEE 0 SWC_TPC_CM_single -3.4E+38 3.4E+38
 /begin AXIS_DESCR COM_AXIS NO_INPUT_QUANTITY SWC_TPC_CM_single 7 -3.4E+38 3.4E+38 AXIS_PTS_REF CAL_TpcSmp_OvrSpdQurd1TableX_Spd_af32 /end AXIS_DESCR
/end CHARACTERISTIC
/begin CHARACTERISTIC CAL_TpcSmp_OvrSpdQurd2TableY_Cof_af32 "³¬ËÙÏÞÅ¤ÏµÊýÊä³ö_µÚ¶þÏóÏÞ" CURVE 0x8014571C Lookup1D_FLOAT32_IEEE 0 SWC_TPC_CM_single -3.4E+38 3.4E+38
 /begin AXIS_DESCR COM_AXIS NO_INPUT_QUANTITY SWC_TPC_CM_single 7 -3.4E+38 3.4E+38 AXIS_PTS_REF CAL_TpcSmp_OvrSpdQurd2TableX_Spd_af32 /end AXIS_DESCR
/end CHARACTERISTIC
/begin CHARACTERISTIC CAL_TpcSmp_OvrSpdQurd3TableY_Cof_af32 "³¬ËÙÏÞÅ¤ÏµÊýÊä³ö_µÚÈýÏóÏÞ" CURVE 0x801456E4 Lookup1D_FLOAT32_IEEE 0 SWC_TPC_CM_single -3.4E+38 3.4E+38
 /begin AXIS_DESCR COM_AXIS NO_INPUT_QUANTITY SWC_TPC_CM_single 7 -3.4E+38 3.4E+38 AXIS_PTS_REF CAL_TpcSmp_OvrSpdQurd3TableX_Spd_af32 /end AXIS_DESCR
/end CHARACTERISTIC
/begin CHARACTERISTIC CAL_TpcSmp_OvrSpdQurd4TableY_Cof_af32 "³¬ËÙÏÞÅ¤ÏµÊýÊä³ö_µÚËÄÏóÏÞ" CURVE 0x801456AC Lookup1D_FLOAT32_IEEE 0 SWC_TPC_CM_single -3.4E+38 3.4E+38
 /begin AXIS_DESCR COM_AXIS NO_INPUT_QUANTITY SWC_TPC_CM_single 7 -3.4E+38 3.4E+38 AXIS_PTS_REF CAL_TpcSmp_OvrSpdQurd4TableX_Spd_af32 /end AXIS_DESCR
/end CHARACTERISTIC
/begin CHARACTERISTIC CAL_TpcTmp_tDrvboardDertTableY_Cof_af32 "Çý¶¯°åÎÂ¶È²é±íderatingÏµÊýÊä³ö" CURVE 0x801453D4 Lookup1D_FLOAT32_IEEE 0 SWC_TPC_CM_single -3.4E+38 3.4E+38
 /begin AXIS_DESCR COM_AXIS NO_INPUT_QUANTITY SWC_TPC_CM_single 9 -3.4E+38 3.4E+38 AXIS_PTS_REF CAL_TpcTmp_tDrvboardDertTableX_tDrv_af32 /end AXIS_DESCR
/end CHARACTERISTIC
/begin CHARACTERISTIC CAL_TpcTmp_tIGBTDertSave1TableY_Cof_af32 "" CURVE 0x8014538C Lookup1D_FLOAT32_IEEE 0 SWC_TPC_CM_single -3.4E+38 3.4E+38
 /begin AXIS_DESCR COM_AXIS VAR_TpcTmp_tIGBTTempFlt_f32 SWC_TPC_CM_single 9 -3.4E+38 3.4E+38 AXIS_PTS_REF CAL_TpcTmp_tIGBTDertSave1TableX_tSttr_af32 /end AXIS_DESCR
/end CHARACTERISTIC
/begin CHARACTERISTIC CAL_TpcTmp_tIGBTDertSave2TableY_Cof_af32 "" CURVE 0x80145344 Lookup1D_FLOAT32_IEEE 0 SWC_TPC_CM_single -3.4E+38 3.4E+38
 /begin AXIS_DESCR COM_AXIS NO_INPUT_QUANTITY SWC_TPC_CM_single 9 -3.4E+38 3.4E+38 AXIS_PTS_REF CAL_TpcTmp_tIGBTDertSave2TableX_tSttr_af32 /end AXIS_DESCR
/end CHARACTERISTIC
/begin CHARACTERISTIC CAL_TpcTmp_tRiseIGBTDertSave1TableY_Cof_af32 "" CURVE 0x80145240 Lookup1D_FLOAT32_IEEE 0 SWC_TPC_CM_single -3.4E+38 3.4E+38
 /begin AXIS_DESCR COM_AXIS VAR_TpcTmp_tRiseIGBTFlt_f32 SWC_TPC_CM_single 9 -3.4E+38 3.4E+38 AXIS_PTS_REF CAL_TpcTmp_tRiseIGBTDertSave1TableX_tSttr_af32 /end AXIS_DESCR
/end CHARACTERISTIC
/begin CHARACTERISTIC CAL_TpcTmp_tRiseIGBTDertSave2TableY_Cof_af32 "" CURVE 0x801451F8 Lookup1D_FLOAT32_IEEE 0 SWC_TPC_CM_single -3.4E+38 3.4E+38
 /begin AXIS_DESCR COM_AXIS NO_INPUT_QUANTITY SWC_TPC_CM_single 9 -3.4E+38 3.4E+38 AXIS_PTS_REF CAL_TpcTmp_tRiseIGBTDertSave2TableX_tSttr_af32 /end AXIS_DESCR
/end CHARACTERISTIC
/begin CHARACTERISTIC CAL_TpcSmp_OvrCurtLimElecTableY_Cof_af32 "µç¶¯¹ýÁ÷ÏßÐÔ½µ¹¦ÂÊ²é±íderatingÏµÊýÊä³ö" CURVE 0x801457B4 Lookup1D_FLOAT32_IEEE 0 SWC_TPC_CM_single -3.4E+38 3.4E+38
 /begin AXIS_DESCR COM_AXIS NO_INPUT_QUANTITY SWC_TPC_CM_single 5 -3.4E+38 3.4E+38 AXIS_PTS_REF CAL_TpcSmp_OvrCurtLimElecTableX_iDc_af32 /end AXIS_DESCR
/end CHARACTERISTIC
/begin CHARACTERISTIC CAL_TpcSmp_OvrCurtLimGenTableY_Cof_af32 "·¢µç¹ýÁ÷ÏßÐÔ½µ¹¦ÂÊ²é±íderatingÏµÊýÊä³ö" CURVE 0x8014578C Lookup1D_FLOAT32_IEEE 0 SWC_TPC_CM_single -3.4E+38 3.4E+38
 /begin AXIS_DESCR COM_AXIS NO_INPUT_QUANTITY SWC_TPC_CM_single 5 -3.4E+38 3.4E+38 AXIS_PTS_REF CAL_TpcSmp_OvrCurtLimGenTableX_iDc_af32 /end AXIS_DESCR
/end CHARACTERISTIC
/begin CHARACTERISTIC CAL_TpcSmp_OvrVoltGenTableY_Cof_af32 "¹ýÑ¹ÏßÐÔ½µ¹¦ÂÊ²é±íderatingÏµÊýÊä³ö" CURVE 0x80145684 Lookup1D_FLOAT32_IEEE 0 SWC_TPC_CM_single -3.4E+38 3.4E+38
 /begin AXIS_DESCR COM_AXIS NO_INPUT_QUANTITY SWC_TPC_CM_single 5 -3.4E+38 3.4E+38 AXIS_PTS_REF CAL_TpcSmp_OvrVoltGenTableX_uDc_af32 /end AXIS_DESCR
/end CHARACTERISTIC
/begin CHARACTERISTIC CAL_TpcSmp_UdrVoltElecTableY_Cof_af32 "Ç·Ñ¹ÏßÐÔ½µ¹¦ÂÊ²é±íderatingÏµÊýÊä³ö" CURVE 0x80145640 Lookup1D_FLOAT32_IEEE 0 SWC_TPC_CM_single -3.4E+38 3.4E+38
 /begin AXIS_DESCR COM_AXIS NO_INPUT_QUANTITY SWC_TPC_CM_single 5 -3.4E+38 3.4E+38 AXIS_PTS_REF CAL_TpcSmp_UdrVoltElecTableX_uDc_af32 /end AXIS_DESCR
/end CHARACTERISTIC
/begin CHARACTERISTIC CAL_TpcTmp_tCoolantDertSave1TableY_Cof_af32 "" CURVE 0x80145534 Lookup1D_FLOAT32_IEEE 0 SWC_TPC_CM_single -3.4E+38 3.4E+38
 /begin AXIS_DESCR COM_AXIS VAR_TpcTmp_tCoolantTempFlt_f32 SWC_TPC_CM_single 9 -3.4E+38 3.4E+38 AXIS_PTS_REF CAL_TpcTmp_tCoolantDertSave1TableX_tSttr_af32 /end AXIS_DESCR
/end CHARACTERISTIC
/begin CHARACTERISTIC CAL_TpcTmp_tCoolantDertSave2TableY_Cof_af32 "" CURVE 0x801454EC Lookup1D_FLOAT32_IEEE 0 SWC_TPC_CM_single -3.4E+38 3.4E+38
 /begin AXIS_DESCR COM_AXIS NO_INPUT_QUANTITY SWC_TPC_CM_single 9 -3.4E+38 3.4E+38 AXIS_PTS_REF CAL_TpcTmp_tCoolantDertSave2TableX_tSttr_af32 /end AXIS_DESCR
/end CHARACTERISTIC
/begin CHARACTERISTIC CAL_TpcTmp_tDbcDertSave1TableY_Cof_af32 "" CURVE 0x80145490 Lookup1D_FLOAT32_IEEE 0 SWC_TPC_CM_single -3.4E+38 3.4E+38
 /begin AXIS_DESCR COM_AXIS VAR_TpcTmp_tDbcTempFlt_f32 SWC_TPC_CM_single 9 -3.4E+38 3.4E+38 AXIS_PTS_REF CAL_TpcTmp_tDbcDertSave1TableX_tSttr_af32 /end AXIS_DESCR
/end CHARACTERISTIC
/begin CHARACTERISTIC CAL_TpcTmp_tDbcDertSave2TableY_Cof_af32 "" CURVE 0x80145448 Lookup1D_FLOAT32_IEEE 0 SWC_TPC_CM_single -3.4E+38 3.4E+38
 /begin AXIS_DESCR COM_AXIS NO_INPUT_QUANTITY SWC_TPC_CM_single 9 -3.4E+38 3.4E+38 AXIS_PTS_REF CAL_TpcTmp_tDbcDertSave2TableX_tSttr_af32 /end AXIS_DESCR
/end CHARACTERISTIC
/begin CHARACTERISTIC CAL_TpcTmp_tRiseDbcDertSave1TableY_Cof_af32 "" CURVE 0x801452E0 Lookup1D_FLOAT32_IEEE 0 SWC_TPC_CM_single -3.4E+38 3.4E+38
 /begin AXIS_DESCR COM_AXIS VAR_TpcTmp_tRiseDbcFlt_f32 SWC_TPC_CM_single 9 -3.4E+38 3.4E+38 AXIS_PTS_REF CAL_TpcTmp_tRiseDbcDertSave1TableX_tSttr_af32 /end AXIS_DESCR
/end CHARACTERISTIC
/begin CHARACTERISTIC CAL_TpcTmp_tRiseDbcDertSave2TableY_Cof_af32 "" CURVE 0x80145298 Lookup1D_FLOAT32_IEEE 0 SWC_TPC_CM_single -3.4E+38 3.4E+38
 /begin AXIS_DESCR COM_AXIS NO_INPUT_QUANTITY SWC_TPC_CM_single 9 -3.4E+38 3.4E+38 AXIS_PTS_REF CAL_TpcTmp_tRiseDbcDertSave2TableX_tSttr_af32 /end AXIS_DESCR
/end CHARACTERISTIC
/begin AXIS_PTS CAL_TCF_LdSubLqIdCAx_af32 "" 0x80144768 NO_INPUT_QUANTITY Lookup2D_X_FLOAT32_IEEE 0 SWC_TCF_CM_single 18 -3.4E+38 3.4E+38 /end AXIS_PTS
/begin AXIS_PTS CAL_TCF_LdSubLqIqCAy_af32 "" 0x8014472C NO_INPUT_QUANTITY Lookup2D_X_FLOAT32_IEEE 0 SWC_TCF_CM_single 15 -3.4E+38 3.4E+38 /end AXIS_PTS
/begin AXIS_PTS CAL_TCF_IsPwrLosCAx_af32 "" 0x80145020 VAR_TCF_Is_f32 Lookup2D_X_FLOAT32_IEEE 0 SWC_TCF_CM_single 10 -3.4E+38 3.4E+38 /end AXIS_PTS
/begin AXIS_PTS CAL_TCF_NPwrLosCAy_af32 "" 0x801446E0 NO_INPUT_QUANTITY Lookup2D_X_FLOAT32_IEEE 0 SWC_TCF_CM_single 10 -3.4E+38 3.4E+38 /end AXIS_PTS
/begin AXIS_PTS CAL_TCF_TrqTubeNCAx_af32 "" 0x80143CA8 NO_INPUT_QUANTITY Lookup1D_X_FLOAT32_IEEE 0 SWC_TCF_CM_single 35 -3.4E+38 3.4E+38 /end AXIS_PTS
/begin AXIS_PTS CAL_TDC_n_Error_X_Af32 "×ªËÙÆ«²îµÄ¾ø¶ÔÖµ" 0x80145144 NO_INPUT_QUANTITY Lookup1D_X_FLOAT32_IEEE 0 SWC_TDC_CM_single 10 -3.4E+38 3.4E+38 /end AXIS_PTS
/begin AXIS_PTS CAL_TpcCod_CoolFlow2LTableY_Spd_af32 "" 0x80146248 NO_INPUT_QUANTITY Lookup2D_X_FLOAT32_IEEE 0 SWC_TPC_CM_single 8 -3.4E+38 3.4E+38 /end AXIS_PTS
/begin AXIS_PTS CAL_TpcCod_CoolFlow2LTableX_Udc_af32 "" 0x80146268 NO_INPUT_QUANTITY Lookup2D_X_FLOAT32_IEEE 0 SWC_TPC_CM_single 5 -3.4E+38 3.4E+38 /end AXIS_PTS
/begin AXIS_PTS CAL_TpcCod_CoolFlow4LTableY_Spd_af32 "" 0x80146174 NO_INPUT_QUANTITY Lookup2D_X_FLOAT32_IEEE 0 SWC_TPC_CM_single 8 -3.4E+38 3.4E+38 /end AXIS_PTS
/begin AXIS_PTS CAL_TpcCod_CoolFlow4LTableX_Udc_af32 "" 0x80146194 NO_INPUT_QUANTITY Lookup2D_X_FLOAT32_IEEE 0 SWC_TPC_CM_single 5 -3.4E+38 3.4E+38 /end AXIS_PTS
/begin AXIS_PTS CAL_TpcCod_CoolFlow6LTableY_Spd_af32 "" 0x801460A0 NO_INPUT_QUANTITY Lookup2D_X_FLOAT32_IEEE 0 SWC_TPC_CM_single 8 -3.4E+38 3.4E+38 /end AXIS_PTS
/begin AXIS_PTS CAL_TpcCod_CoolFlow6LTableX_Udc_af32 "" 0x801460C0 NO_INPUT_QUANTITY Lookup2D_X_FLOAT32_IEEE 0 SWC_TPC_CM_single 5 -3.4E+38 3.4E+38 /end AXIS_PTS
/begin AXIS_PTS CAL_TpcMot_ExCElecTableY_Spd_af32 "ÍâÌØÐÔ²é±íµç»ú×ªËÙÊäÈë-µç¶¯Ä£Ê½" 0x80145F48 NO_INPUT_QUANTITY Lookup2D_X_FLOAT32_IEEE 0 SWC_TPC_CM_single 17 -3.4E+38 3.4E+38 /end AXIS_PTS
/begin AXIS_PTS CAL_TpcMot_ExCElecTableX_Udc_af32 "ÍâÌØÐÔ²é±íÄ¸ÏßµçÑ¹ÊäÈë-µç¶¯Ä£Ê½" 0x80145F8C NO_INPUT_QUANTITY Lookup2D_X_FLOAT32_IEEE 0 SWC_TPC_CM_single 10 -3.4E+38 3.4E+38 /end AXIS_PTS
/begin AXIS_PTS CAL_TpcMot_ExCGenTableY_Spd_af32 "ÍâÌØÐÔ²é±íµç»ú×ªËÙÊäÈë-·¢µçÄ£Ê½" 0x80145C34 NO_INPUT_QUANTITY Lookup2D_X_FLOAT32_IEEE 0 SWC_TPC_CM_single 17 -3.4E+38 3.4E+38 /end AXIS_PTS
/begin AXIS_PTS CAL_TpcMot_ExCGenTableX_Udc_af32 "ÍâÌØÐÔ²é±íÄ¸ÏßµçÑ¹ÊäÈë-·¢µçÄ£Ê½" 0x80145C78 NO_INPUT_QUANTITY Lookup2D_X_FLOAT32_IEEE 0 SWC_TPC_CM_single 10 -3.4E+38 3.4E+38 /end AXIS_PTS
/begin AXIS_PTS CAL_TpcMot_tRiseSttrDertSave1TableX_tSttr_af32 "" 0x80145948 VAR_TpcMot_tRiseSttr_f32 Lookup1D_X_FLOAT32_IEEE 0 SWC_TPC_CM_single 9 -3.4E+38 3.4E+38 /end AXIS_PTS
/begin AXIS_PTS CAL_TpcMot_tRiseSttrDertSave2TableX_tSttr_af32 "" 0x80145900 NO_INPUT_QUANTITY Lookup1D_X_FLOAT32_IEEE 0 SWC_TPC_CM_single 9 -3.4E+38 3.4E+38 /end AXIS_PTS
/begin AXIS_PTS CAL_TpcMot_tSttrDertSave1TableX_tSttr_af32 "" 0x801458A8 VAR_TpcMot_tSttrTempFlt_f32 Lookup1D_X_FLOAT32_IEEE 0 SWC_TPC_CM_single 9 -3.4E+38 3.4E+38 /end AXIS_PTS
/begin AXIS_PTS CAL_TpcMot_tSttrDertSave2TableX_tSttr_af32 "" 0x80145860 NO_INPUT_QUANTITY Lookup1D_X_FLOAT32_IEEE 0 SWC_TPC_CM_single 9 -3.4E+38 3.4E+38 /end AXIS_PTS
/begin AXIS_PTS CAL_TpcSmp_OvrSpdQurd1TableX_Spd_af32 "³¬ËÙÏÞÅ¤×ªËÙÊäÈë_µÚÒ»ÏóÏÞ" 0x80145770 NO_INPUT_QUANTITY Lookup1D_X_FLOAT32_IEEE 0 SWC_TPC_CM_single 7 -3.4E+38 3.4E+38 /end AXIS_PTS
/begin AXIS_PTS CAL_TpcSmp_OvrSpdQurd2TableX_Spd_af32 "³¬ËÙÏÞÅ¤×ªËÙÊäÈë_µÚ¶þÏóÏÞ" 0x80145738 NO_INPUT_QUANTITY Lookup1D_X_FLOAT32_IEEE 0 SWC_TPC_CM_single 7 -3.4E+38 3.4E+38 /end AXIS_PTS
/begin AXIS_PTS CAL_TpcSmp_OvrSpdQurd3TableX_Spd_af32 "³¬ËÙÏÞÅ¤×ªËÙÊäÈë_µÚÈýÏóÏÞ" 0x80145700 NO_INPUT_QUANTITY Lookup1D_X_FLOAT32_IEEE 0 SWC_TPC_CM_single 7 -3.4E+38 3.4E+38 /end AXIS_PTS
/begin AXIS_PTS CAL_TpcSmp_OvrSpdQurd4TableX_Spd_af32 "³¬ËÙÏÞÅ¤×ªËÙÊäÈë_µÚËÄÏóÏÞ" 0x801456C8 NO_INPUT_QUANTITY Lookup1D_X_FLOAT32_IEEE 0 SWC_TPC_CM_single 7 -3.4E+38 3.4E+38 /end AXIS_PTS
/begin AXIS_PTS CAL_TpcTmp_tDrvboardDertTableX_tDrv_af32 "Çý¶¯°åÎÂ¶È²é±íÎÂ¶ÈÊäÈë" 0x801453F8 NO_INPUT_QUANTITY Lookup1D_X_FLOAT32_IEEE 0 SWC_TPC_CM_single 9 -3.4E+38 3.4E+38 /end AXIS_PTS
/begin AXIS_PTS CAL_TpcTmp_tIGBTDertSave1TableX_tSttr_af32 "" 0x801453B0 VAR_TpcTmp_tIGBTTempFlt_f32 Lookup1D_X_FLOAT32_IEEE 0 SWC_TPC_CM_single 9 -3.4E+38 3.4E+38 /end AXIS_PTS
/begin AXIS_PTS CAL_TpcTmp_tIGBTDertSave2TableX_tSttr_af32 "" 0x80145368 NO_INPUT_QUANTITY Lookup1D_X_FLOAT32_IEEE 0 SWC_TPC_CM_single 9 -3.4E+38 3.4E+38 /end AXIS_PTS
/begin AXIS_PTS CAL_TpcTmp_tRiseIGBTDertSave1TableX_tSttr_af32 "" 0x80145264 VAR_TpcTmp_tRiseIGBTFlt_f32 Lookup1D_X_FLOAT32_IEEE 0 SWC_TPC_CM_single 9 -3.4E+38 3.4E+38 /end AXIS_PTS
/begin AXIS_PTS CAL_TpcTmp_tRiseIGBTDertSave2TableX_tSttr_af32 "" 0x8014521C NO_INPUT_QUANTITY Lookup1D_X_FLOAT32_IEEE 0 SWC_TPC_CM_single 9 -3.4E+38 3.4E+38 /end AXIS_PTS
/begin AXIS_PTS CAL_TpcSmp_OvrCurtLimElecTableX_iDc_af32 "µç¶¯¹ýÁ÷ÏßÐÔ½µ¹¦ÂÊ²é±íµçÁ÷ÊäÈë" 0x801457C8 NO_INPUT_QUANTITY Lookup1D_X_FLOAT32_IEEE 0 SWC_TPC_CM_single 5 -3.4E+38 3.4E+38 /end AXIS_PTS
/begin AXIS_PTS CAL_TpcSmp_OvrCurtLimGenTableX_iDc_af32 "·¢µç¹ýÁ÷ÏßÐÔ½µ¹¦ÂÊ²é±íµçÁ÷ÊäÈë" 0x801457A0 NO_INPUT_QUANTITY Lookup1D_X_FLOAT32_IEEE 0 SWC_TPC_CM_single 5 -3.4E+38 3.4E+38 /end AXIS_PTS
/begin AXIS_PTS CAL_TpcSmp_OvrVoltGenTableX_uDc_af32 "¹ýÑ¹ÏßÐÔ½µ¹¦ÂÊ²é±íµçÑ¹ÊäÈë" 0x80145698 NO_INPUT_QUANTITY Lookup1D_X_FLOAT32_IEEE 0 SWC_TPC_CM_single 5 -3.4E+38 3.4E+38 /end AXIS_PTS
/begin AXIS_PTS CAL_TpcSmp_UdrVoltElecTableX_uDc_af32 "Ç·Ñ¹ÏßÐÔ½µ¹¦ÂÊ²é±íµçÑ¹ÊäÈë" 0x80145654 NO_INPUT_QUANTITY Lookup1D_X_FLOAT32_IEEE 0 SWC_TPC_CM_single 5 -3.4E+38 3.4E+38 /end AXIS_PTS
/begin AXIS_PTS CAL_TpcTmp_tCoolantDertSave1TableX_tSttr_af32 "" 0x80145558 VAR_TpcTmp_tCoolantTempFlt_f32 Lookup1D_X_FLOAT32_IEEE 0 SWC_TPC_CM_single 9 -3.4E+38 3.4E+38 /end AXIS_PTS
/begin AXIS_PTS CAL_TpcTmp_tCoolantDertSave2TableX_tSttr_af32 "" 0x80145510 NO_INPUT_QUANTITY Lookup1D_X_FLOAT32_IEEE 0 SWC_TPC_CM_single 9 -3.4E+38 3.4E+38 /end AXIS_PTS
/begin AXIS_PTS CAL_TpcTmp_tDbcDertSave1TableX_tSttr_af32 "" 0x801454B4 VAR_TpcTmp_tDbcTempFlt_f32 Lookup1D_X_FLOAT32_IEEE 0 SWC_TPC_CM_single 9 -3.4E+38 3.4E+38 /end AXIS_PTS
/begin AXIS_PTS CAL_TpcTmp_tDbcDertSave2TableX_tSttr_af32 "" 0x8014546C NO_INPUT_QUANTITY Lookup1D_X_FLOAT32_IEEE 0 SWC_TPC_CM_single 9 -3.4E+38 3.4E+38 /end AXIS_PTS
/begin AXIS_PTS CAL_TpcTmp_tRiseDbcDertSave1TableX_tSttr_af32 "" 0x80145304 VAR_TpcTmp_tRiseDbcFlt_f32 Lookup1D_X_FLOAT32_IEEE 0 SWC_TPC_CM_single 9 -3.4E+38 3.4E+38 /end AXIS_PTS
/begin AXIS_PTS CAL_TpcTmp_tRiseDbcDertSave2TableX_tSttr_af32 "" 0x801452BC NO_INPUT_QUANTITY Lookup1D_X_FLOAT32_IEEE 0 SWC_TPC_CM_single 9 -3.4E+38 3.4E+38 /end AXIS_PTS
/begin GROUP S44_CntShutDownTime "SWC_SCF/RE_SWC_SCF_10ms_sys/SCF_Ctl/SCF_SigInp_10ms/SCF_SysTrans/ShutDownOverTime&TranPostDrvToShutDown/ShutDownOverTime/CntShutDownTime" /begin REF_CHARACTERISTIC CAL_Scf_cntPostDrvDone_u16 /end REF_CHARACTERISTIC /begin REF_MEASUREMENT VAR_Scf_flgShutDwnOvtimErr_u8 /end REF_MEASUREMENT /end GROUP
/begin GROUP S44_Enabled_Subsystem "SWC_SCF/RE_SWC_SCF_10ms_sys/SCF_Ctl/SCF_SigInp_10ms/SCF_SysTrans/ShutDownOverTime&TranPostDrvToShutDown/ShutDownOverTime/Enabled Subsystem" /begin REF_MEASUREMENT VAR_Scf_flgbt15first_b /end REF_MEASUREMENT /end GROUP
/begin GROUP S44_Subsystem "SWC_SCF/RE_SWC_SCF_10ms_sys/SCF_Ctl/SCF_SigInp_10ms/SCF_SysTrans/ShutDownOverTime&TranPostDrvToShutDown/ShutDownOverTime/Subsystem" /begin REF_MEASUREMENT VAR_Scf_flgInitOut_b /end REF_MEASUREMENT /end GROUP
/begin GROUP S44_WakeLost "SWC_SCF/RE_SWC_SCF_10ms_sys/SCF_Ctl/SCF_SigInp_10ms/SCF_SysTrans/ShutDownOverTime&TranPostDrvToShutDown/ShutDownOverTime/WakeLost" /begin REF_CHARACTERISTIC CAL_Scf_cntWakeLoss_u16 /end REF_CHARACTERISTIC /begin REF_MEASUREMENT VAR_Scf_flgNoWakeSou_b /end REF_MEASUREMENT /end GROUP
/begin GROUP S19_TimeAdding "SWC_SCF/RE_SWC_SCF_10ms_sys/SCF_Ctl/SCF_SigInp_10ms/SCF_DchaCtl_10ms/CmftDchaCtl/DchaMcuReqWiRelay/RunToDisChaErr/TimeAdding" /begin REF_CHARACTERISTIC CAL_Scf_ThreRuntoDischaFail_u8 /end REF_CHARACTERISTIC /begin REF_MEASUREMENT VAR_Scf_DchaCntAdd_u8 /end REF_MEASUREMENT /end GROUP
/begin GROUP SWC_STM "SWC_STM" ROOT /begin SUB_GROUP Root_SWC_STM_1ms_sys /end SUB_GROUP /end GROUP
/begin GROUP Root_SWC_STM_1ms_sys "SWC_STM/SWC_STM_1ms_sys" /begin SUB_GROUP S1_SpdMonProc S1_TrqMonProc /end SUB_GROUP /end GROUP
/begin GROUP S1_SpdMonProc "SWC_STM/SWC_STM_1ms_sys/SpdMonProc" /begin SUB_GROUP S4_SpdMon S4_SpdMonEnable /end SUB_GROUP /end GROUP
/begin GROUP S1_TrqMonProc "SWC_STM/SWC_STM_1ms_sys/TrqMonProc" /begin SUB_GROUP S5_TrqMon S5_TrqMonEnable /end SUB_GROUP /end GROUP
/begin GROUP S4_SpdMon "SWC_STM/SWC_STM_1ms_sys/SpdMonProc/SpdMon"
 /begin REF_CHARACTERISTIC CAL_STM_UxptSpdMonCountTrh_s16 CAL_STM_UxptSpdMonDebTrh_s16 CAL_STM_UxptSpdMonErrRst_b /end REF_CHARACTERISTIC
 /begin SUB_GROUP S8_Debouncer S8_UintndSpdMon /end SUB_GROUP
/end GROUP
/begin GROUP S4_SpdMonEnable "SWC_STM/SWC_STM_1ms_sys/SpdMonProc/SpdMonEnable" /begin REF_CHARACTERISTIC CAL_STM_SpeedCtlMode_u8 /end REF_CHARACTERISTIC /end GROUP
/begin GROUP S5_TrqMon "SWC_STM/SWC_STM_1ms_sys/TrqMonProc/TrqMon"
 /begin REF_CHARACTERISTIC CAL_STM_UxptTrqMonCountTrh_s16 CAL_STM_UxptTrqMonDebTrh_s16 CAL_STM_UxptTrqMonErrRst_b /end REF_CHARACTERISTIC
 /begin SUB_GROUP S15_Debouncer S15_UintndTrqMon /end SUB_GROUP
/end GROUP
/begin GROUP S5_TrqMonEnable "SWC_STM/SWC_STM_1ms_sys/TrqMonProc/TrqMonEnable" /begin REF_CHARACTERISTIC CAL_STM_SpeedCtlMode_u8 /end REF_CHARACTERISTIC /end GROUP
/begin GROUP S8_Debouncer "SWC_STM/SWC_STM_1ms_sys/SpdMonProc/SpdMon/Debouncer" /begin REF_MEASUREMENT VAR_STM_UintndSpdErr_b /end REF_MEASUREMENT /end GROUP
/begin GROUP S8_UintndSpdMon "SWC_STM/SWC_STM_1ms_sys/SpdMonProc/SpdMon/UintndSpdMon" /begin REF_CHARACTERISTIC CAL_STM_UxptNLim_f32 /end REF_CHARACTERISTIC /begin REF_MEASUREMENT VAR_STM_UintndSpdMonRslt_b /end REF_MEASUREMENT /end GROUP
/begin GROUP S15_Debouncer "SWC_STM/SWC_STM_1ms_sys/TrqMonProc/TrqMon/Debouncer" /begin REF_MEASUREMENT VAR_STM_UintndTrqErr_b /end REF_MEASUREMENT /end GROUP
/begin GROUP S15_UintndTrqMon "SWC_STM/SWC_STM_1ms_sys/TrqMonProc/TrqMon/UintndTrqMon" /begin REF_CHARACTERISTIC CAL_STM_UxptTrqLim_f32 /end REF_CHARACTERISTIC /begin REF_MEASUREMENT VAR_STM_UintndTrqMonRslt_b /end REF_MEASUREMENT /end GROUP
/begin GROUP SWC_SWD "SWC_SWD" ROOT /begin SUB_GROUP Root_SWC_SWD_100us_sys /end SUB_GROUP /end GROUP
/begin GROUP Root_SWC_SWD_100us_sys "SWC_SWD/SWC_SWD_100us_sys" /begin SUB_GROUP S1_SWDecode S1_SpdCalc /end SUB_GROUP /end GROUP
/begin GROUP S1_SWDecode "SWC_SWD/SWC_SWD_100us_sys/SWDecode" /begin SUB_GROUP S3_AgRslvCalc S3_TanCalc /end SUB_GROUP /end GROUP
/begin GROUP S1_SpdCalc "SWC_SWD/SWC_SWD_100us_sys/SpdCalc" /begin SUB_GROUP S4_AgRslvDeltaCalc S4_SpdCalc /end SUB_GROUP /end GROUP
/begin GROUP S3_AgRslvCalc "SWC_SWD/SWC_SWD_100us_sys/SWDecode/AgRslvCalc" /begin REF_CHARACTERISTIC CAL_SWD_AgrslvCompCnt_f32 CAL_SWD_Radian_u16 /end REF_CHARACTERISTIC /begin REF_MEASUREMENT VAR_SWD_AgRslv45_f32 VAR_SWD_AgRslv_f32 /end REF_MEASUREMENT /end GROUP
/begin GROUP S3_TanCalc "SWC_SWD/SWC_SWD_100us_sys/SWDecode/TanCalc" /begin REF_MEASUREMENT VAR_SWD_Tan_f32 /end REF_MEASUREMENT /end GROUP
/begin GROUP S4_AgRslvDeltaCalc "SWC_SWD/SWC_SWD_100us_sys/SpdCalc/AgRslvDeltaCalc" /begin REF_MEASUREMENT VAR_SWD_AgRslvDelta0_f32 VAR_SWD_AgRslvDelta_f32 /end REF_MEASUREMENT /end GROUP
/begin GROUP S4_SpdCalc "SWC_SWD/SWC_SWD_100us_sys/SpdCalc/SpdCalc" /begin REF_CHARACTERISTIC CAL_SWD_MotorPole_u8 /end REF_CHARACTERISTIC /begin REF_MEASUREMENT VAR_SWD_Spd_f32 /end REF_MEASUREMENT /end GROUP
/begin GROUP SWC_TCF "SWC_TCF" ROOT /begin SUB_GROUP Root_SWC_TCF_1ms_sys /end SUB_GROUP /end GROUP
/begin GROUP Root_SWC_TCF_1ms_sys "SWC_TCF/SWC_TCF_1ms_sys"
 /begin REF_MEASUREMENT VAR_HSPF_StrrTempFlt_f32 VAR_L2Sampling_DycUMon_f32 VAR_L2Sampling_DycVMon_f32 VAR_L2Sampling_DycWMon_f32 /end REF_MEASUREMENT
 /begin SUB_GROUP S1_CurrAgTrqCalcProc S1_PwrTrqCalcProc S1_TrqBlendProc S1_TrqCalcEnable /end SUB_GROUP
/end GROUP
/begin GROUP S1_CurrAgTrqCalcProc "SWC_TCF/SWC_TCF_1ms_sys/CurrAgTrqCalcProc" /begin REF_CHARACTERISTIC CAL_TCF_TrqMechCutOffFrq_f32 PRV_CalFltFrq_1ms /end REF_CHARACTERISTIC /begin REF_MEASUREMENT VAR_TCF_CurrAgTrqflt_f32 /end REF_MEASUREMENT
 /begin SUB_GROUP S3_CurrAgTrqCalc S3_IdIqCalc S3_LdsubLqCalc S3_MotorModeJdg /end SUB_GROUP
/end GROUP
/begin GROUP S1_PwrTrqCalcProc "SWC_TCF/SWC_TCF_1ms_sys/PwrTrqCalcProc" /begin SUB_GROUP S5_IsCalc S5_PinputCalc S5_PlossCalc S5_PwrTrqCalc /end SUB_GROUP /end GROUP
/begin GROUP S1_TrqBlendProc "SWC_TCF/SWC_TCF_1ms_sys/TrqBlendProc"
 /begin REF_CHARACTERISTIC CAL_TCF_TrqCalcMonCountTrh_s16 CAL_TCF_TrqCalcMonDebTrh_s16 CAL_TCF_TrqCalcMonErrRst_b /end REF_CHARACTERISTIC
 /begin SUB_GROUP S6_Debouncer S6_TrqBlend S6_TrqTube /end SUB_GROUP
/end GROUP
/begin GROUP S1_TrqCalcEnable "SWC_TCF/SWC_TCF_1ms_sys/TrqCalcEnable" /begin REF_CHARACTERISTIC CAL_TCF_SpeedCtlMode_u8 /end REF_CHARACTERISTIC /end GROUP
/begin GROUP S3_CurrAgTrqCalc "SWC_TCF/SWC_TCF_1ms_sys/CurrAgTrqCalcProc/CurrAgTrqCalc" /begin REF_CHARACTERISTIC CAL_TCF_MotorPole_u8 CAL_TCF_Psi_f32 /end REF_CHARACTERISTIC /begin REF_MEASUREMENT VAR_TCF_CurrAgTrq1_f32 /end REF_MEASUREMENT /end GROUP
/begin GROUP S3_IdIqCalc "SWC_TCF/SWC_TCF_1ms_sys/CurrAgTrqCalcProc/IdIqCalc" /begin REF_MEASUREMENT VAR_TCF_idAct_f32 VAR_TCF_iqAct_f32 /end REF_MEASUREMENT /end GROUP
/begin GROUP S3_LdsubLqCalc "SWC_TCF/SWC_TCF_1ms_sys/CurrAgTrqCalcProc/LdsubLqCalc" /begin REF_CHARACTERISTIC CAL_TCF_LdSubLqCAzGen_af32 CAL_TCF_LdSubLqCAzMot_af32 /end REF_CHARACTERISTIC /begin REF_MEASUREMENT VAR_TCF_LdsubLq_f32 /end REF_MEASUREMENT /end GROUP
/begin GROUP S3_MotorModeJdg "SWC_TCF/SWC_TCF_1ms_sys/CurrAgTrqCalcProc/MotorModeJdg" /begin SUB_GROUP S11_MotorMode S11_TrqDir S11_nDir /end SUB_GROUP /end GROUP
/begin GROUP S5_IsCalc "SWC_TCF/SWC_TCF_1ms_sys/PwrTrqCalcProc/IsCalc" /begin REF_MEASUREMENT VAR_TCF_Is_f32 /end REF_MEASUREMENT /end GROUP
/begin GROUP S5_PinputCalc "SWC_TCF/SWC_TCF_1ms_sys/PwrTrqCalcProc/PinputCalc" /begin REF_MEASUREMENT VAR_TCF_Pinput_f32 /end REF_MEASUREMENT /end GROUP
/begin GROUP S5_PlossCalc "SWC_TCF/SWC_TCF_1ms_sys/PwrTrqCalcProc/PlossCalc"
 /begin REF_CHARACTERISTIC CAL_TCF_PwrLossCAz_af32 CAL_TCF_TempStrMax_f32 CAL_TCF_TempStrMin_f32 CAL_TCF_TempStrPlossFact_f32 CAL_TCF_flgUsePlossCompa_b /end REF_CHARACTERISTIC
 /begin REF_MEASUREMENT VAR_TCF_Ploss_f32 /end REF_MEASUREMENT
/end GROUP
/begin GROUP S5_PwrTrqCalc "SWC_TCF/SWC_TCF_1ms_sys/PwrTrqCalcProc/PwrTrqCalc" /begin REF_CHARACTERISTIC CAL_TCF_PwrTrqSpdCompa_af32 /end REF_CHARACTERISTIC /begin REF_MEASUREMENT VAR_TCF_PwrTrq1_f32 /end REF_MEASUREMENT /end GROUP
/begin GROUP S6_Debouncer "SWC_TCF/SWC_TCF_1ms_sys/TrqBlendProc/Debouncer" /begin REF_MEASUREMENT VAR_TCF_TrqCalcErr_b /end REF_MEASUREMENT /end GROUP
/begin GROUP S6_TrqBlend "SWC_TCF/SWC_TCF_1ms_sys/TrqBlendProc/TrqBlend" /begin REF_CHARACTERISTIC CAL_TCF_TrqInvalid_s16 /end REF_CHARACTERISTIC /begin REF_MEASUREMENT VAR_TCF_BlendTrq_f32 VAR_TCF_TrqCalcMonRslt_b /end REF_MEASUREMENT /end GROUP
/begin GROUP S6_TrqTube "SWC_TCF/SWC_TCF_1ms_sys/TrqBlendProc/TrqTube" /begin REF_CHARACTERISTIC CAL_TCF_AgTrqTubeCAy_af32 CAL_TCF_PwrTrqTubeCAy_af32 /end REF_CHARACTERISTIC
 /begin REF_MEASUREMENT VAR_TCF_CurrAgTrqTubeH1_f32 VAR_TCF_CurrAgTrqTubeL1_f32 VAR_TCF_PwrTrqTubeH1_f32 VAR_TCF_PwrTrqTubeL1_f32 /end REF_MEASUREMENT
/end GROUP
/begin GROUP S11_MotorMode "SWC_TCF/SWC_TCF_1ms_sys/CurrAgTrqCalcProc/MotorModeJdg/MotorMode" /begin REF_MEASUREMENT VAR_TCF_MotorMode_u8 /end REF_MEASUREMENT /end GROUP
/begin GROUP S11_TrqDir "SWC_TCF/SWC_TCF_1ms_sys/CurrAgTrqCalcProc/MotorModeJdg/TrqDir" /begin REF_CHARACTERISTIC CAL_TCF_HiTrqDirStop_f32 CAL_TCF_LoTrqDirStop_f32 /end REF_CHARACTERISTIC /begin REF_MEASUREMENT VAR_TCF_TrqDir_u8 /end REF_MEASUREMENT /end GROUP
/begin GROUP S11_nDir "SWC_TCF/SWC_TCF_1ms_sys/CurrAgTrqCalcProc/MotorModeJdg/nDir" /begin REF_CHARACTERISTIC CAL_TCF_HiSpdDirStop_f32 CAL_TCF_LoSpdDirStop_f32 /end REF_CHARACTERISTIC /begin REF_MEASUREMENT VAR_TCF_nDir_u8 /end REF_MEASUREMENT /end GROUP
/begin GROUP SWC_TDC "SWC_TDC" ROOT /begin SUB_GROUP Root_RE_SWC_TDC_2ms_sys /end SUB_GROUP /end GROUP
/begin GROUP Root_RE_SWC_TDC_2ms_sys "SWC_TDC/RE_SWC_TDC_2ms_sys" /begin SUB_GROUP S1_Subsystem /end SUB_GROUP /end GROUP
/begin GROUP S3_TDC_Coord "SWC_TDC/RE_SWC_TDC_2ms_sys/Subsystem/TDC_Coord" /begin SUB_GROUP S4_Tdc_ModeSelect S4_Tdc_Pretreatment /end SUB_GROUP /end GROUP
/begin GROUP S4_Tdc_ModeSelect "SWC_TDC/RE_SWC_TDC_2ms_sys/Subsystem/TDC_Coord/Tdc_ModeSelect" /begin REF_CHARACTERISTIC CAL_TDC_trqIncMax_f32 /end REF_CHARACTERISTIC /end GROUP
/begin GROUP S4_Tdc_Pretreatment "SWC_TDC/RE_SWC_TDC_2ms_sys/Subsystem/TDC_Coord/Tdc_Pretreatment" /begin REF_MEASUREMENT VAR_TDC_trqRmp_f32 /end REF_MEASUREMENT /begin SUB_GROUP S8_PiParameter /end SUB_GROUP /end GROUP
/begin GROUP S8_PiParameter "SWC_TDC/RE_SWC_TDC_2ms_sys/Subsystem/TDC_Coord/Tdc_Pretreatment/PiParameter"
 /begin REF_CHARACTERISTIC CAL_TDC_DeltaT_f32 CAL_TDC_KiNCtl_Y_Af32 CAL_TDC_KpNCtl_Y_Af32 /end REF_CHARACTERISTIC
/end GROUP
/begin GROUP SWC_TPC "SWC_TPC" ROOT /begin SUB_GROUP Root_RE_SWC_TPC_10ms_sys /end SUB_GROUP /end GROUP
/begin GROUP Root_RE_SWC_TPC_10ms_sys "SWC_TPC/RE_SWC_TPC_10ms_sys" /begin SUB_GROUP S1_TPC /end SUB_GROUP /end GROUP
/begin GROUP S1_TPC "SWC_TPC/RE_SWC_TPC_10ms_sys/TPC" /begin SUB_GROUP S3_TpcCod S3_TpcJudge /end SUB_GROUP /end GROUP
/begin GROUP S3_TpcCod "SWC_TPC/RE_SWC_TPC_10ms_sys/TPC/TpcCod"
 /begin SUB_GROUP S5_CoolantFlowControl S5_Coordinate S5_GetElecAndGenTrqLim S5_MotorModeJudgement S5_TorqueLimitationReason /end SUB_GROUP
/end GROUP
/begin GROUP S3_TpcJudge "SWC_TPC/RE_SWC_TPC_10ms_sys/TPC/TpcJudge" /begin SUB_GROUP S6_TpcBlk S6_TpcFuv S6_TpcMot S6_TpcSmp S6_TpcTmp /end SUB_GROUP /end GROUP
/begin GROUP S5_CoolantFlowControl "SWC_TPC/RE_SWC_TPC_10ms_sys/TPC/TpcCod/CoolantFlowControl"
 /begin REF_CHARACTERISTIC CAL_TpcCod_CntHysteresislop_u16 CAL_TpcCod_CoolFlow1LReq_f32 CAL_TpcCod_CoolFlow2LTableZ_Trq_af32 CAL_TpcCod_CoolFlow4LTableZ_Trq_af32 CAL_TpcCod_CoolFlow6LTableZ_Trq_af32 CAL_TpcCod_IGBTSampErr_b CAL_TpcCod_MotorSampErr_b CAL_TpcCod_MotorStallWarn_b CAL_TpcCod_PowIncRatLim_f32 CAL_TpcCod_TrqRelay_f32 /end REF_CHARACTERISTIC
 /begin REF_MEASUREMENT VAR_TpcCod_CoolantFlowFinReq_f32 VAR_TpcCod_CoolantFlowReq_f32 /end REF_MEASUREMENT
 /begin SUB_GROUP S7_GetPowerIncreasrRate S7_Subsystem1 /end SUB_GROUP
/end GROUP
/begin GROUP S5_Coordinate "SWC_TPC/RE_SWC_TPC_10ms_sys/TPC/TpcCod/Coordinate" /begin REF_CHARACTERISTIC CAL_TpcCod_FlgUseTrqLimRampSet_b /end REF_CHARACTERISTIC /begin REF_MEASUREMENT VAR_TpcCod_flgMotorElecMode_b /end REF_MEASUREMENT
 /begin SUB_GROUP S8_If_Action_Subsystem S8_If_Action_Subsystem1 S8_TrqLimRampSet S8_TrqLimRampSet1 /end SUB_GROUP
/end GROUP
/begin GROUP S5_GetElecAndGenTrqLim "SWC_TPC/RE_SWC_TPC_10ms_sys/TPC/TpcCod/GetElecAndGenTrqLim" /begin SUB_GROUP S10_GetElecTorqueLim S10_GetGenTorqueLim /end SUB_GROUP /end GROUP
/begin GROUP S5_MotorModeJudgement "SWC_TPC/RE_SWC_TPC_10ms_sys/TPC/TpcCod/MotorModeJudgement" /begin SUB_GROUP S12_GetSpdDirection S12_GetTorqueDirection /end SUB_GROUP /end GROUP
/begin GROUP S5_TorqueLimitationReason "SWC_TPC/RE_SWC_TPC_10ms_sys/TPC/TpcCod/TorqueLimitationReason" /begin SUB_GROUP S13_TorqLimReasonJudge /end SUB_GROUP /end GROUP
/begin GROUP S6_TpcBlk "SWC_TPC/RE_SWC_TPC_10ms_sys/TPC/TpcJudge/TpcBlk"
 /begin REF_CHARACTERISTIC CAL_TpcBlk_BlkRevTimSet_u16 CAL_TpcBlk_BlkTimSet_u16 CAL_TpcBlk_MtrBlkIsFirstSet_f32 CAL_TpcBlk_MtrBlkIsSecondSet_f32 CAL_TpcBlk_MtrBlkSpdHighSet_f32 CAL_TpcBlk_MtrBlkSpdLowSet_f32 CAL_TpcBlk_TrqBlkStab_f32 CAL_TpcBlk_TrqDecRamp_f32 CAL_TpcBlk_TrqIncRamp_f32 CAL_TpcBlk_flgEnBlkFun_b /end REF_CHARACTERISTIC
 /begin REF_MEASUREMENT VAR_TpcBlk_IsSum_f32 VAR_TpcBlk_IsValid_f32 VAR_Tpcblk_TrqLim01_f32 VAR_Tpcblk_TrqLim_f32 VAR_Tpcblk_TrqMax_f32 VAR_Tpcblk_TrqMin_f32 /end REF_MEASUREMENT
/end GROUP
/begin GROUP S6_TpcFuv "SWC_TPC/RE_SWC_TPC_10ms_sys/TPC/TpcJudge/TpcFuv" /begin SUB_GROUP S106_DeratingStrategy_FultLv S106_GetFaultLevelStatus /end SUB_GROUP /end GROUP
/begin GROUP S6_TpcMot "SWC_TPC/RE_SWC_TPC_10ms_sys/TPC/TpcJudge/TpcMot"
 /begin SUB_GROUP S107_ExternalCharacteristicDerating S107_GetTrqPwrBenchmark S107_SttrTemperatureDerating /end SUB_GROUP
/end GROUP
/begin GROUP S6_TpcSmp "SWC_TPC/RE_SWC_TPC_10ms_sys/TPC/TpcJudge/TpcSmp"
 /begin SUB_GROUP S108_DeratingStrategyCurrent S108_DeratingStrategyVoltage S108_DeratingStrategy_OverSpeed S108_GetBatteryCapacity S108_GetVcuTrqDertCommand /end SUB_GROUP
/end GROUP
/begin GROUP S6_TpcTmp "SWC_TPC/RE_SWC_TPC_10ms_sys/TPC/TpcJudge/TpcTmp" /begin REF_MEASUREMENT VAR_TpcTmp_tCoolTempFlt_u16 /end REF_MEASUREMENT
 /begin SUB_GROUP S109_CoolantTemperatureDerating S109_DbcTemperatureDerating S109_DrvBoardTemperatureDerating S109_IGBTTemperatureDerating /end SUB_GROUP
/end GROUP
/begin GROUP S7_GetPowerIncreasrRate "SWC_TPC/RE_SWC_TPC_10ms_sys/TPC/TpcCod/CoolantFlowControl/GetPowerIncreasrRate" /begin REF_MEASUREMENT VAR_TpcCod_PowerAdd_f32 VAR_TpcCod_PowerIncreaseRate_f32 /end REF_MEASUREMENT /end GROUP
/begin GROUP S7_Subsystem1 "SWC_TPC/RE_SWC_TPC_10ms_sys/TPC/TpcCod/CoolantFlowControl/Subsystem1" /begin REF_CHARACTERISTIC CAL_TpcCod_NTCHighTemp_f32 CAL_TpcCod_NTCLowTemp_f32 /end REF_CHARACTERISTIC /end GROUP
/begin GROUP S8_If_Action_Subsystem "SWC_TPC/RE_SWC_TPC_10ms_sys/TPC/TpcCod/Coordinate/If Action Subsystem" /begin REF_CHARACTERISTIC CAL_TpcCod_PosSpdHold_f32 CAL_TpcCod_PosSpdStart_f32 /end REF_CHARACTERISTIC /begin SUB_GROUP S17_Chart /end SUB_GROUP /end GROUP
/begin GROUP S8_If_Action_Subsystem1 "SWC_TPC/RE_SWC_TPC_10ms_sys/TPC/TpcCod/Coordinate/If Action Subsystem1" /begin REF_CHARACTERISTIC CAL_TpcCod_PosSpdHold_f32 CAL_TpcCod_PosSpdStart_f32 /end REF_CHARACTERISTIC /begin SUB_GROUP S18_Chart /end SUB_GROUP /end GROUP
/begin GROUP S8_TrqLimRampSet "SWC_TPC/RE_SWC_TPC_10ms_sys/TPC/TpcCod/Coordinate/TrqLimRampSet" /begin REF_CHARACTERISTIC CAL_Tpc_TrqRevStep_f32 /end REF_CHARACTERISTIC /end GROUP
/begin GROUP S8_TrqLimRampSet1 "SWC_TPC/RE_SWC_TPC_10ms_sys/TPC/TpcCod/Coordinate/TrqLimRampSet1" /begin REF_CHARACTERISTIC CAL_Tpc_TrqRevStep_f32 /end REF_CHARACTERISTIC /end GROUP
/begin GROUP S10_GetElecTorqueLim "SWC_TPC/RE_SWC_TPC_10ms_sys/TPC/TpcCod/GetElecAndGenTrqLim/GetElecTorqueLim" /begin REF_MEASUREMENT VAR_TpcCod_ElecTrqLim_f32 /end REF_MEASUREMENT /begin SUB_GROUP S33_GetTrqFromPwr S33_GetTrqFromPwr1 S33_GetTrqFromPwr2 /end SUB_GROUP /end GROUP
/begin GROUP S10_GetGenTorqueLim "SWC_TPC/RE_SWC_TPC_10ms_sys/TPC/TpcCod/GetElecAndGenTrqLim/GetGenTorqueLim" /begin REF_MEASUREMENT VAR_TpcCod_GenTrqLim_f32 /end REF_MEASUREMENT /begin SUB_GROUP S34_GetTrqFromPwr S34_GetTrqFromPwr1 S34_GetTrqFromPwr2 /end SUB_GROUP /end GROUP
/begin GROUP S12_GetSpdDirection "SWC_TPC/RE_SWC_TPC_10ms_sys/TPC/TpcCod/MotorModeJudgement/GetSpdDirection" /begin REF_CHARACTERISTIC CAL_TpcCod_NegSpdDirStop_f32 CAL_TpcCod_PosSpdDirStop_f32 /end REF_CHARACTERISTIC /end GROUP
/begin GROUP S12_GetTorqueDirection "SWC_TPC/RE_SWC_TPC_10ms_sys/TPC/TpcCod/MotorModeJudgement/GetTorqueDirection" /begin REF_CHARACTERISTIC CAL_TpcCod_NegTrqDirStop_f32 CAL_TpcCod_PosTrqDirStop_f32 /end REF_CHARACTERISTIC /end GROUP
/begin GROUP S13_TorqLimReasonJudge "SWC_TPC/RE_SWC_TPC_10ms_sys/TPC/TpcCod/TorqueLimitationReason/TorqLimReasonJudge"
 /begin SUB_GROUP S53_TorqLimReason_Can S53_TorqLimReason_ExcTrq S53_TorqLimReason_Idc S53_TorqLimReason_MtrSpd S53_TorqLimReason_OvUdc S53_TorqLimReason_TCool S53_TorqLimReason_TDbc S53_TorqLimReason_TDrvBoard S53_TorqLimReason_TIGBT S53_TorqLimReason_Tsttr S53_TorqLimReason_UnUdc /end SUB_GROUP
/end GROUP
/begin GROUP S106_DeratingStrategy_FultLv "SWC_TPC/RE_SWC_TPC_10ms_sys/TPC/TpcJudge/TpcFuv/DeratingStrategy_FultLv"
 /begin REF_CHARACTERISTIC CAL_TpcFuv_CofPwrLimLv1_f32 CAL_TpcFuv_CofPwrLimLv2_f32 CAL_TpcFuv_CofPwrLimLv3_f32 CAL_TpcFuv_CofPwrLimLv4_f32 CAL_TpcFuv_CofTrqLimLv1_f32 CAL_TpcFuv_CofTrqLimLv2_f32 CAL_TpcFuv_CofTrqLimLv3_f32 CAL_TpcFuv_CofTrqLimLv4_f32 /end REF_CHARACTERISTIC
 /begin REF_MEASUREMENT VAR_TpcFuv_ElecPwrLimDiag_f32 VAR_TpcFuv_ElecTrqLimDiag_f32 VAR_TpcFuv_GenPwrLimDiag_f32 VAR_TpcFuv_GenTrqLimDiag_f32 /end REF_MEASUREMENT
/end GROUP
/begin GROUP S106_GetFaultLevelStatus "SWC_TPC/RE_SWC_TPC_10ms_sys/TPC/TpcJudge/TpcFuv/GetFaultLevelStatus"
 /begin REF_MEASUREMENT VAR_TpcFuv_FimPwrLimLv1_b VAR_TpcFuv_FimPwrLimLv2_b VAR_TpcFuv_FimPwrLimLv3_b VAR_TpcFuv_FimPwrLimLv4_b VAR_TpcFuv_FimTrqLimLv1_b VAR_TpcFuv_FimTrqLimLv2_b VAR_TpcFuv_FimTrqLimLv3_b VAR_TpcFuv_FimTrqLimLv4_b /end REF_MEASUREMENT
/end GROUP
/begin GROUP S107_ExternalCharacteristicDerating "SWC_TPC/RE_SWC_TPC_10ms_sys/TPC/TpcJudge/TpcMot/ExternalCharacteristicDerating"
 /begin REF_CHARACTERISTIC CAL_TpcMot_ExCElecTableZ_Trq_af32 CAL_TpcMot_ExCGenTableZ_Trq_af32 CAL_Tpcmot_CofuDclnk_u8 CAL_Tpcmot_TrqDiffExc_f32 CAL_Tpcmot_TrqDiffGen_f32 CAL_Tpcmot_flgOpenExcLimRamp_b CAL_Tpcmot_uDcHiset_f32 CAL_Tpcmot_uDcLoset_f32 /end REF_CHARACTERISTIC
 /begin REF_MEASUREMENT VAR_TpcMot_TrqElecExCOrg_f32 VAR_TpcMot_TrqElecExC_f32 VAR_TpcMot_TrqGenExCOrg_f32 VAR_TpcMot_TrqGenExC_f32 VAR_TpcMot_flgStartExcLimRamp_b /end REF_MEASUREMENT
 /begin SUB_GROUP S116_TrqLimRampRiseAndReduceSet S116_TrqLimRampRiseAndReduceSet1 /end SUB_GROUP
/end GROUP
/begin GROUP S107_GetTrqPwrBenchmark "SWC_TPC/RE_SWC_TPC_10ms_sys/TPC/TpcJudge/TpcMot/GetTrqPwrBenchmark" /begin REF_CHARACTERISTIC CAL_TpcMot_flgPwrRefSwt_b CAL_TpcMot_flgTrqRefSwt_b /end REF_CHARACTERISTIC
 /begin REF_MEASUREMENT VAR_TpcMot_ElecPwrRef_f32 VAR_TpcMot_ElecTrqRef_f32 VAR_TpcMot_GenPwrRef_f32 VAR_TpcMot_GenTrqRef_f32 /end REF_MEASUREMENT
/end GROUP
/begin GROUP S107_SttrTemperatureDerating "SWC_TPC/RE_SWC_TPC_10ms_sys/TPC/TpcJudge/TpcMot/SttrTemperatureDerating"
 /begin REF_CHARACTERISTIC CAL_TpcMot_SttrTempAdds_f32 CAL_TpcMot_SttrTempDecDiff_f32 CAL_TpcMot_SttrTempKp_f32 CAL_TpcMot_SttrTempMinus_f32 CAL_TpcMot_SttrTempRiseDiff_f32 CAL_TpcMot_tSttrTrqLimRamp_f32 /end REF_CHARACTERISTIC
 /begin SUB_GROUP S119_DemStatorTemperature S119_GetRampElecTrqLim S119_GetRampGenTrqLim S119_GetSttrTempLimTorq S119_GetTRiseSttrDeratingCof S119_GetTsttrDeratingCof S119_SttrTempFlt /end SUB_GROUP
/end GROUP
/begin GROUP S108_DeratingStrategyCurrent "SWC_TPC/RE_SWC_TPC_10ms_sys/TPC/TpcJudge/TpcSmp/DeratingStrategyCurrent"
 /begin SUB_GROUP S140_DemBusCurrent S140_DeratingStrategy_OvercurrentElec S140_DeratingStrategy_OvercurrentGen /end SUB_GROUP
/end GROUP
/begin GROUP S108_DeratingStrategyVoltage "SWC_TPC/RE_SWC_TPC_10ms_sys/TPC/TpcJudge/TpcSmp/DeratingStrategyVoltage"
 /begin SUB_GROUP S141_DeratingStrategy_Overvoltage S141_DeratingStrategy_Undervoltage /end SUB_GROUP
/end GROUP
/begin GROUP S108_DeratingStrategy_OverSpeed "SWC_TPC/RE_SWC_TPC_10ms_sys/TPC/TpcJudge/TpcSmp/DeratingStrategy_OverSpeed" /begin SUB_GROUP S142_Subsystem S142_Subsystem1 /end SUB_GROUP /end GROUP
/begin GROUP S108_GetBatteryCapacity "SWC_TPC/RE_SWC_TPC_10ms_sys/TPC/TpcJudge/TpcSmp/GetBatteryCapacity"
 /begin REF_CHARACTERISTIC CAL_TpcSmp_iDcLnkMaxMax_f32 CAL_TpcSmp_iDcLnkMaxMin_f32 CAL_TpcSmp_iDcLnkMinMax_f32 CAL_TpcSmp_iDcLnkMinMin_f32 CAL_TpcSmp_uDcLnkMaxMax_f32 CAL_TpcSmp_uDcLnkMaxMin_f32 CAL_TpcSmp_uDcLnkMinMax_f32 CAL_TpcSmp_uDcLnkMinMin_f32 /end REF_CHARACTERISTIC
 /begin REF_MEASUREMENT VAR_TpcSmp_iDcLnkMax_f32 VAR_TpcSmp_iDcLnkMin_f32 VAR_TpcSmp_uDcLnkMax_f32 VAR_TpcSmp_uDcLnkMin_f32 /end REF_MEASUREMENT
/end GROUP
/begin GROUP S108_GetVcuTrqDertCommand "SWC_TPC/RE_SWC_TPC_10ms_sys/TPC/TpcJudge/TpcSmp/GetVcuTrqDertCommand" /begin REF_CHARACTERISTIC CAL_TpcSmp_nCtlExtReq_u8 CAL_TpcSmp_nCtlIntReq_u8 /end REF_CHARACTERISTIC /begin REF_MEASUREMENT VAR_TpcSmp_TrqMaxCanSet_f32 VAR_TpcSmp_TrqMinCanSet_f32 /end REF_MEASUREMENT /end GROUP
/begin GROUP S109_CoolantTemperatureDerating "SWC_TPC/RE_SWC_TPC_10ms_sys/TPC/TpcJudge/TpcTmp/CoolantTemperatureDerating"
 /begin SUB_GROUP S194_DemCoolantTemperature S194_DeratingStrategy_TCoolant S194_GetDeratingFlag_TCoolant /end SUB_GROUP
/end GROUP
/begin GROUP S109_DbcTemperatureDerating "SWC_TPC/RE_SWC_TPC_10ms_sys/TPC/TpcJudge/TpcTmp/DbcTemperatureDerating"
 /begin REF_CHARACTERISTIC CAL_TpcTmp_DBCTempAdds_f32 CAL_TpcTmp_DBCTempDecDiff_f32 CAL_TpcTmp_DBCTempKp_f32 CAL_TpcTmp_DBCTempMinus_f32 CAL_TpcTmp_DBCTempRiseDiff_f32 CAL_TpcTmp_tDBCTrqLimRamp_f32 /end REF_CHARACTERISTIC
 /begin SUB_GROUP S195_DBCTemperatureDerating S195_DbcTempFlt S195_DemDbcTemperature S195_GetDeratingFlag_Tdbc S195_GetMaxDbcTemp S195_GetRampElecTrqLim S195_GetRampGenTrqLim /end SUB_GROUP
/end GROUP
/begin GROUP S109_DrvBoardTemperatureDerating "SWC_TPC/RE_SWC_TPC_10ms_sys/TPC/TpcJudge/TpcTmp/DrvBoardTemperatureDerating"
 /begin SUB_GROUP S196_DemDrvBoardTemperature S196_DeratingStrategy_TDrvBoard S196_GetDeratingFlag_TDrvBoard /end SUB_GROUP
/end GROUP
/begin GROUP S109_IGBTTemperatureDerating "SWC_TPC/RE_SWC_TPC_10ms_sys/TPC/TpcJudge/TpcTmp/IGBTTemperatureDerating"
 /begin REF_CHARACTERISTIC CAL_TpcTmp_IGBTTempAdds_f32 CAL_TpcTmp_IGBTTempDecDiff_f32 CAL_TpcTmp_IGBTTempKp_f32 CAL_TpcTmp_IGBTTempMinus_f32 CAL_TpcTmp_IGBTTempRiseDiff_f32 CAL_TpcTmp_tIGBTTrqLimRamp_f32 /end REF_CHARACTERISTIC
 /begin SUB_GROUP S197_DemIGBTTemperature S197_GetIGBTTempLimTorq S197_GetRampElecTrqLim S197_GetRampGenTrqLim S197_GetTIGBTDeratingCof S197_GetTRiseIGBTDeratingCof S197_IgbtTempFlt /end SUB_GROUP
/end GROUP
/begin GROUP S17_Chart "SWC_TPC/RE_SWC_TPC_10ms_sys/TPC/TpcCod/Coordinate/If Action Subsystem/Chart" /begin SUB_GROUP S23_fun /end SUB_GROUP /end GROUP
/begin GROUP S18_Chart "SWC_TPC/RE_SWC_TPC_10ms_sys/TPC/TpcCod/Coordinate/If Action Subsystem1/Chart" /begin SUB_GROUP S25_fun /end SUB_GROUP /end GROUP
/begin GROUP S33_GetTrqFromPwr "SWC_TPC/RE_SWC_TPC_10ms_sys/TPC/TpcCod/GetElecAndGenTrqLim/GetElecTorqueLim/GetTrqFromPwr" /begin REF_MEASUREMENT VAR_TpcCod_ElecTrqCalcOvrCurt_f32 /end REF_MEASUREMENT /end GROUP
/begin GROUP S33_GetTrqFromPwr1 "SWC_TPC/RE_SWC_TPC_10ms_sys/TPC/TpcCod/GetElecAndGenTrqLim/GetElecTorqueLim/GetTrqFromPwr1" /begin REF_MEASUREMENT VAR_TpcCod_ElecTrqCalcUdrVolt_f32 /end REF_MEASUREMENT /end GROUP
/begin GROUP S33_GetTrqFromPwr2 "SWC_TPC/RE_SWC_TPC_10ms_sys/TPC/TpcCod/GetElecAndGenTrqLim/GetElecTorqueLim/GetTrqFromPwr2" /begin REF_MEASUREMENT VAR_TpcCod_ElecTrqCalcDiag_f32 /end REF_MEASUREMENT /end GROUP
/begin GROUP S34_GetTrqFromPwr "SWC_TPC/RE_SWC_TPC_10ms_sys/TPC/TpcCod/GetElecAndGenTrqLim/GetGenTorqueLim/GetTrqFromPwr" /begin REF_MEASUREMENT VAR_TpcCod_GenTrqCalcOvrCurt_f32 /end REF_MEASUREMENT /end GROUP
/begin GROUP S34_GetTrqFromPwr1 "SWC_TPC/RE_SWC_TPC_10ms_sys/TPC/TpcCod/GetElecAndGenTrqLim/GetGenTorqueLim/GetTrqFromPwr1" /begin REF_MEASUREMENT VAR_TpcCod_GenTrqCalcOvrVolt_f32 /end REF_MEASUREMENT /end GROUP
/begin GROUP S34_GetTrqFromPwr2 "SWC_TPC/RE_SWC_TPC_10ms_sys/TPC/TpcCod/GetElecAndGenTrqLim/GetGenTorqueLim/GetTrqFromPwr2" /begin REF_MEASUREMENT VAR_TpcCod_GenTrqCalcDiag_f32 /end REF_MEASUREMENT /end GROUP
/begin GROUP S53_TorqLimReason_Can "SWC_TPC/RE_SWC_TPC_10ms_sys/TPC/TpcCod/TorqueLimitationReason/TorqLimReasonJudge/TorqLimReason_Can" /begin SUB_GROUP S55_AEqualB24 S55_AEqualB33 /end SUB_GROUP /end GROUP
/begin GROUP S53_TorqLimReason_ExcTrq "SWC_TPC/RE_SWC_TPC_10ms_sys/TPC/TpcCod/TorqueLimitationReason/TorqLimReasonJudge/TorqLimReason_ExcTrq"
 /begin REF_MEASUREMENT VAR_tpccod_flgMaxDertExCTrq_b VAR_tpccod_flgMinDertExCTrq_b /end REF_MEASUREMENT
/end GROUP
/begin GROUP S53_TorqLimReason_Idc "SWC_TPC/RE_SWC_TPC_10ms_sys/TPC/TpcCod/TorqueLimitationReason/TorqLimReasonJudge/TorqLimReason_Idc"
 /begin REF_MEASUREMENT VAR_tpccod_flgMaxDertOvrIdc_b VAR_tpccod_flgMinDertOvrIdc_b /end REF_MEASUREMENT
/end GROUP
/begin GROUP S53_TorqLimReason_MtrSpd "SWC_TPC/RE_SWC_TPC_10ms_sys/TPC/TpcCod/TorqueLimitationReason/TorqLimReasonJudge/TorqLimReason_MtrSpd"
 /begin REF_MEASUREMENT VAR_tpccod_flgMaxDertMtrSpd_b VAR_tpccod_flgMinDertMtrSpd_b /end REF_MEASUREMENT
/end GROUP
/begin GROUP S53_TorqLimReason_OvUdc "SWC_TPC/RE_SWC_TPC_10ms_sys/TPC/TpcCod/TorqueLimitationReason/TorqLimReasonJudge/TorqLimReason_OvUdc"
 /begin REF_MEASUREMENT VAR_tpccod_flgMaxDertOvrUdc_b VAR_tpccod_flgMinDertOvrUdc_b /end REF_MEASUREMENT
/end GROUP
/begin GROUP S53_TorqLimReason_TCool "SWC_TPC/RE_SWC_TPC_10ms_sys/TPC/TpcCod/TorqueLimitationReason/TorqLimReasonJudge/TorqLimReason_TCool"
 /begin REF_MEASUREMENT VAR_tpccod_flgMaxDertTCoolant_b VAR_tpccod_flgMinDertTCoolant_b /end REF_MEASUREMENT
/end GROUP
/begin GROUP S53_TorqLimReason_TDbc "SWC_TPC/RE_SWC_TPC_10ms_sys/TPC/TpcCod/TorqueLimitationReason/TorqLimReasonJudge/TorqLimReason_TDbc"
 /begin REF_MEASUREMENT VAR_tpccod_flgMaxDertTempDBC_b VAR_tpccod_flgMinDertTempDBC_b /end REF_MEASUREMENT
/end GROUP
/begin GROUP S53_TorqLimReason_TDrvBoard "SWC_TPC/RE_SWC_TPC_10ms_sys/TPC/TpcCod/TorqueLimitationReason/TorqLimReasonJudge/TorqLimReason_TDrvBoard"
 /begin REF_MEASUREMENT VAR_tpccod_flgMaxDertTDrvBoard_b VAR_tpccod_flgMinDertTDrvBoard_b /end REF_MEASUREMENT
/end GROUP
/begin GROUP S53_TorqLimReason_TIGBT "SWC_TPC/RE_SWC_TPC_10ms_sys/TPC/TpcCod/TorqueLimitationReason/TorqLimReasonJudge/TorqLimReason_TIGBT" /begin REF_MEASUREMENT VAR_tpccod_flgMaxDertTIGBT_b VAR_tpccod_flgMinDertTIGBT_b /end REF_MEASUREMENT /end GROUP
/begin GROUP S53_TorqLimReason_Tsttr "SWC_TPC/RE_SWC_TPC_10ms_sys/TPC/TpcCod/TorqueLimitationReason/TorqLimReasonJudge/TorqLimReason_Tsttr"
 /begin REF_MEASUREMENT VAR_tpccod_flgMaxDertStrTemp_b VAR_tpccod_flgMinDertStrTemp_b /end REF_MEASUREMENT
/end GROUP
/begin GROUP S53_TorqLimReason_UnUdc "SWC_TPC/RE_SWC_TPC_10ms_sys/TPC/TpcCod/TorqueLimitationReason/TorqLimReasonJudge/TorqLimReason_UnUdc"
 /begin REF_MEASUREMENT VAR_tpccod_flgMaxDertUndrUdc_b VAR_tpccod_flgMinDertUndrUdc_b /end REF_MEASUREMENT
/end GROUP
/begin GROUP S116_TrqLimRampRiseAndReduceSet "SWC_TPC/RE_SWC_TPC_10ms_sys/TPC/TpcJudge/TpcMot/ExternalCharacteristicDerating/TrqLimRampRiseAndReduceSet" /begin SUB_GROUP S122_Subsystem1 /end SUB_GROUP /end GROUP
/begin GROUP S116_TrqLimRampRiseAndReduceSet1 "SWC_TPC/RE_SWC_TPC_10ms_sys/TPC/TpcJudge/TpcMot/ExternalCharacteristicDerating/TrqLimRampRiseAndReduceSet1" /begin SUB_GROUP S123_Subsystem1 /end SUB_GROUP /end GROUP
/begin GROUP S119_DemStatorTemperature "SWC_TPC/RE_SWC_TPC_10ms_sys/TPC/TpcJudge/TpcMot/SttrTemperatureDerating/DemStatorTemperature" /begin REF_CHARACTERISTIC CAL_TpcMot_tSttrHiLim_f32 CAL_TpcMot_tSttrLoLim_f32 /end REF_CHARACTERISTIC
 /begin REF_MEASUREMENT VAR_TpcMot_TSttrOvHiLimErrState_u8 VAR_TpcMot_TSttrOvHiWarnState_u8 VAR_TpcMot_TSttrOvLoWarnState_u8 /end REF_MEASUREMENT
/end GROUP
/begin GROUP S119_GetRampElecTrqLim "SWC_TPC/RE_SWC_TPC_10ms_sys/TPC/TpcJudge/TpcMot/SttrTemperatureDerating/GetRampElecTrqLim" /begin REF_MEASUREMENT VAR_TpcMot_ElecTrqLimTsttr_f32 /end REF_MEASUREMENT /end GROUP
/begin GROUP S119_GetRampGenTrqLim "SWC_TPC/RE_SWC_TPC_10ms_sys/TPC/TpcJudge/TpcMot/SttrTemperatureDerating/GetRampGenTrqLim" /begin REF_MEASUREMENT VAR_TpcMot_GenTrqLimTsttr_f32 /end REF_MEASUREMENT /end GROUP
/begin GROUP S119_GetSttrTempLimTorq "SWC_TPC/RE_SWC_TPC_10ms_sys/TPC/TpcJudge/TpcMot/SttrTemperatureDerating/GetSttrTempLimTorq"
 /begin REF_MEASUREMENT VAR_TpcMot_ElecTrqLimTsttrWoRamp_f32 VAR_TpcMot_GenTrqLimTsttrWoRamp_f32 /end REF_MEASUREMENT
 /begin SUB_GROUP S129_GetDeratingFlag_TIGBT /end SUB_GROUP
/end GROUP
/begin GROUP S119_GetTRiseSttrDeratingCof "SWC_TPC/RE_SWC_TPC_10ms_sys/TPC/TpcJudge/TpcMot/SttrTemperatureDerating/GetTRiseSttrDeratingCof"
 /begin REF_CHARACTERISTIC CAL_TpcMot_tRiseSttrDertSave1TableY_Cof_af32 CAL_TpcMot_tRiseSttrDertSave2TableY_Cof_af32 CAL_TpcMot_tRiseSttrTraNormalToSave1_f32 CAL_TpcMot_tRiseSttrTraSave1ToNormal_f32 CAL_TpcMot_tRiseSttrTraSave1ToSave2_f32 CAL_TpcMot_tRiseSttrTraSave2ToOverheating_f32 CAL_Tpc_NormalMode_u8 CAL_Tpc_OverheatingMode_u8 CAL_Tpc_Powersave1Mode_u8 CAL_Tpc_Powersave2Mode_u8 /end REF_CHARACTERISTIC
 /begin REF_MEASUREMENT VAR_TpcMot_CofDertTRiseSttrSave1_f32 VAR_TpcMot_CofDertTRiseSttrSave2_f32 VAR_TpcMot_CofDertTRiseSttr_f32 VAR_TpcMot_tRiseSttrOperationMode_u8 VAR_TpcMot_tRiseSttr_f32 /end REF_MEASUREMENT
/end GROUP
/begin GROUP S119_GetTsttrDeratingCof "SWC_TPC/RE_SWC_TPC_10ms_sys/TPC/TpcJudge/TpcMot/SttrTemperatureDerating/GetTsttrDeratingCof"
 /begin REF_CHARACTERISTIC CAL_TpcMot_tSttrDertSave1TableY_Cof_af32 CAL_TpcMot_tSttrDertSave2TableY_Cof_af32 CAL_TpcMot_tSttrTraNormalToSave1_f32 CAL_TpcMot_tSttrTraSave1ToNormal_f32 CAL_TpcMot_tSttrTraSave1ToSave2_f32 CAL_TpcMot_tSttrTraSave2ToOverheating_f32 CAL_Tpc_NormalMode_u8 CAL_Tpc_OverheatingMode_u8 CAL_Tpc_Powersave1Mode_u8 CAL_Tpc_Powersave2Mode_u8 /end REF_CHARACTERISTIC
 /begin REF_MEASUREMENT VAR_TpcMot_CofDertTSttrSave1_f32 VAR_TpcMot_CofDertTSttrSave2_f32 VAR_TpcMot_CofDertTsttr_f32 VAR_TpcMot_tSttrOperationMode_u8 /end REF_MEASUREMENT
/end GROUP
/begin GROUP S119_SttrTempFlt "SWC_TPC/RE_SWC_TPC_10ms_sys/TPC/TpcJudge/TpcMot/SttrTemperatureDerating/SttrTempFlt"
 /begin REF_CHARACTERISTIC CAL_TpcMot_SttrChgTempDownDiff_f32 CAL_TpcMot_SttrChgTempUpDiff_f32 /end REF_CHARACTERISTIC
 /begin REF_MEASUREMENT VAR_TpcMot_TsttrStableDiff_u16 VAR_TpcMot_tSttrTempFlt_f32 VAR_TpcMot_tSttrTempFlt_u16 /end REF_MEASUREMENT
/end GROUP
/begin GROUP S140_DemBusCurrent "SWC_TPC/RE_SWC_TPC_10ms_sys/TPC/TpcJudge/TpcSmp/DeratingStrategyCurrent/DemBusCurrent"
 /begin REF_CHARACTERISTIC CAL_TpcSmp_iDcLnkOvCElecLim_f32 CAL_TpcSmp_iDcLnkOvCGenLim_f32 /end REF_CHARACTERISTIC
 /begin REF_MEASUREMENT VAR_TpcSmp_iDcLnkOvCLimErrState_u8 VAR_TpcSmp_iDcLnkOvcWarnState_u8 /end REF_MEASUREMENT
/end GROUP
/begin GROUP S140_DeratingStrategy_OvercurrentElec "SWC_TPC/RE_SWC_TPC_10ms_sys/TPC/TpcJudge/TpcSmp/DeratingStrategyCurrent/DeratingStrategy_OvercurrentElec"
 /begin SUB_GROUP S147_Coordinate S147_LinearRegionPowerDerating S147_PIRegionPowerDerting S147_Subsystem /end SUB_GROUP
/end GROUP
/begin GROUP S140_DeratingStrategy_OvercurrentGen "SWC_TPC/RE_SWC_TPC_10ms_sys/TPC/TpcJudge/TpcSmp/DeratingStrategyCurrent/DeratingStrategy_OvercurrentGen"
 /begin SUB_GROUP S148_Coordinate S148_LinearRegionPowerDerating S148_PIRegionPowerDerting S148_Subsystem /end SUB_GROUP
/end GROUP
/begin GROUP S141_DeratingStrategy_Overvoltage "SWC_TPC/RE_SWC_TPC_10ms_sys/TPC/TpcJudge/TpcSmp/DeratingStrategyVoltage/DeratingStrategy_Overvoltage"
 /begin SUB_GROUP S167_Coordinate S167_DemBusOvrVoltage S167_LinearRegionPowerDerating S167_PIRegionPowerDerting /end SUB_GROUP
/end GROUP
/begin GROUP S141_DeratingStrategy_Undervoltage "SWC_TPC/RE_SWC_TPC_10ms_sys/TPC/TpcJudge/TpcSmp/DeratingStrategyVoltage/DeratingStrategy_Undervoltage"
 /begin SUB_GROUP S168_Coordinate S168_DemBusUndrVoltage S168_LinearRegionPowerDerating S168_PIRegionPowerDerting /end SUB_GROUP
/end GROUP
/begin GROUP S142_Subsystem "SWC_TPC/RE_SWC_TPC_10ms_sys/TPC/TpcJudge/TpcSmp/DeratingStrategy_OverSpeed/Subsystem"
 /begin REF_CHARACTERISTIC CAL_TpcSmp_OvrSpdQurd1TableY_Cof_af32 CAL_TpcSmp_OvrSpdQurd2TableY_Cof_af32 CAL_TpcSmp_OvrSpdQurd3TableY_Cof_af32 CAL_TpcSmp_OvrSpdQurd4TableY_Cof_af32 /end REF_CHARACTERISTIC
 /begin REF_MEASUREMENT VAR_TpcSmp_ElecTrqLimOvrSpd_f32 VAR_TpcSmp_GenTrqLimOvrSpd_f32 VAR_TpcSmp_cofDertOvrSpdElecQuad1_f32 VAR_TpcSmp_cofDertOvrSpdElecQuad3_f32 VAR_TpcSmp_cofDertOvrSpdGenQuad2_f32 VAR_TpcSmp_cofDertOvrSpdGenQuad4_f32 VAR_TpcSmp_flgElecTrqLimOvrSpdActv_b VAR_TpcSmp_flgGenTrqLimOvrSpdActv_b /end REF_MEASUREMENT
/end GROUP
/begin GROUP S142_Subsystem1 "SWC_TPC/RE_SWC_TPC_10ms_sys/TPC/TpcJudge/TpcSmp/DeratingStrategy_OverSpeed/Subsystem1"
 /begin REF_CHARACTERISTIC CAL_TpcSmp_OvSpdWarnHiLim_f32 CAL_TpcSmp_OvSpdWarnLoLim_f32 CAL_TpcSmp_ThresOverSpd_f32 /end REF_CHARACTERISTIC
 /begin REF_MEASUREMENT VAR_TpcSmp_SpdOvHiLimErrState_u8 VAR_TpcSmp_SpdOvHiWarnState_u8 /end REF_MEASUREMENT
/end GROUP
/begin GROUP S194_DemCoolantTemperature "SWC_TPC/RE_SWC_TPC_10ms_sys/TPC/TpcJudge/TpcTmp/CoolantTemperatureDerating/DemCoolantTemperature" /begin REF_MEASUREMENT VAR_TpcTmp_TCoolantOvHiWarnState_u8 /end REF_MEASUREMENT /end GROUP
/begin GROUP S194_DeratingStrategy_TCoolant "SWC_TPC/RE_SWC_TPC_10ms_sys/TPC/TpcJudge/TpcTmp/CoolantTemperatureDerating/DeratingStrategy_TCoolant"
 /begin REF_CHARACTERISTIC CAL_TpcTmp_CoolTempAdds_f32 CAL_TpcTmp_CoolTempDecDiff_f32 CAL_TpcTmp_CoolTempKp_f32 CAL_TpcTmp_CoolTempMinus_f32 CAL_TpcTmp_CoolTempRiseDiff_f32 /end REF_CHARACTERISTIC
 /begin REF_MEASUREMENT VAR_TpcTmp_ElecTrqLimTcoolant_f32 VAR_TpcTmp_GenTrqLimTcoolant_f32 /end REF_MEASUREMENT
 /begin SUB_GROUP S200_CoolantTempFlt S200_GetTDbcDeratingCof /end SUB_GROUP
/end GROUP
/begin GROUP S194_GetDeratingFlag_TCoolant "SWC_TPC/RE_SWC_TPC_10ms_sys/TPC/TpcJudge/TpcTmp/CoolantTemperatureDerating/GetDeratingFlag_TCoolant" /begin REF_MEASUREMENT VAR_TpcTmp_flgTrqLimTcoolantActv_b /end REF_MEASUREMENT /end GROUP
/begin GROUP S195_DBCTemperatureDerating "SWC_TPC/RE_SWC_TPC_10ms_sys/TPC/TpcJudge/TpcTmp/DbcTemperatureDerating/DBCTemperatureDerating"
 /begin SUB_GROUP S208_GetDbcTempLimTorq S208_GetTDbcDeratingCof S208_GetTRiseDbcDeratingCof /end SUB_GROUP
/end GROUP
/begin GROUP S195_DbcTempFlt "SWC_TPC/RE_SWC_TPC_10ms_sys/TPC/TpcJudge/TpcTmp/DbcTemperatureDerating/DbcTempFlt"
 /begin REF_CHARACTERISTIC CAL_TpcTmp_DbcChgTempDownDiff_f32 CAL_TpcTmp_DbcChgTempUpDiff_f32 /end REF_CHARACTERISTIC
 /begin REF_MEASUREMENT VAR_TpcTmp_TDbcStableDiff_u16 VAR_TpcTmp_tDbcTempFlt_f32 VAR_TpcTmp_tDbcTempFlt_u16 /end REF_MEASUREMENT
/end GROUP
/begin GROUP S195_DemDbcTemperature "SWC_TPC/RE_SWC_TPC_10ms_sys/TPC/TpcJudge/TpcTmp/DbcTemperatureDerating/DemDbcTemperature"
 /begin REF_CHARACTERISTIC CAL_TpcTmp_tDbcTempUHiLim_f32 CAL_TpcTmp_tDbcTempULoLim_f32 CAL_TpcTmp_tDbcTempVHiLim_f32 CAL_TpcTmp_tDbcTempVLoLim_f32 CAL_TpcTmp_tDbcTempWHiLim_f32 CAL_TpcTmp_tDbcTempWLoLim_f32 CAL_TpcTmp_tDbcThrPhLoLim_f32 /end REF_CHARACTERISTIC
 /begin REF_MEASUREMENT VAR_TpcTmp_TDbcOvHiWarnState_u8 VAR_TpcTmp_TDbcOvLoWarnState_u8 VAR_TpcTmp_TDbcUHiLimErrState_u8 VAR_TpcTmp_TDbcULoLimErrState_u8 VAR_TpcTmp_TDbcVHiLimErrState_u8 VAR_TpcTmp_TDbcVLoLimErrState_u8 VAR_TpcTmp_TDbcWHiLimErrState_u8 VAR_TpcTmp_TDbcWLoLimErrState_u8 /end REF_MEASUREMENT
/end GROUP
/begin GROUP S195_GetDeratingFlag_Tdbc "SWC_TPC/RE_SWC_TPC_10ms_sys/TPC/TpcJudge/TpcTmp/DbcTemperatureDerating/GetDeratingFlag_Tdbc" /begin REF_MEASUREMENT VAR_TpcTmp_flgTrqLimTdbcActv_b /end REF_MEASUREMENT /end GROUP
/begin GROUP S195_GetMaxDbcTemp "SWC_TPC/RE_SWC_TPC_10ms_sys/TPC/TpcJudge/TpcTmp/DbcTemperatureDerating/GetMaxDbcTemp" /begin REF_MEASUREMENT VAR_TpcTmp_tDbcMax_f32 /end REF_MEASUREMENT /end GROUP
/begin GROUP S195_GetRampElecTrqLim "SWC_TPC/RE_SWC_TPC_10ms_sys/TPC/TpcJudge/TpcTmp/DbcTemperatureDerating/GetRampElecTrqLim" /begin REF_MEASUREMENT VAR_TpcTmp_ElecTrqLimTdbc_f32 /end REF_MEASUREMENT /end GROUP
/begin GROUP S195_GetRampGenTrqLim "SWC_TPC/RE_SWC_TPC_10ms_sys/TPC/TpcJudge/TpcTmp/DbcTemperatureDerating/GetRampGenTrqLim" /begin REF_MEASUREMENT VAR_TpcTmp_GenTrqLimTdbc_f32 /end REF_MEASUREMENT /end GROUP
/begin GROUP S196_DemDrvBoardTemperature "SWC_TPC/RE_SWC_TPC_10ms_sys/TPC/TpcJudge/TpcTmp/DrvBoardTemperatureDerating/DemDrvBoardTemperature" /begin REF_MEASUREMENT VAR_TpcTmp_TDrvBoardOvHiWarnState_u8 /end REF_MEASUREMENT /end GROUP
/begin GROUP S196_DeratingStrategy_TDrvBoard "SWC_TPC/RE_SWC_TPC_10ms_sys/TPC/TpcJudge/TpcTmp/DrvBoardTemperatureDerating/DeratingStrategy_TDrvBoard" /begin REF_CHARACTERISTIC CAL_TpcTmp_tDrvboardDertTableY_Cof_af32 /end REF_CHARACTERISTIC
 /begin REF_MEASUREMENT VAR_TpcTmp_CofDertTdrvboard_f32 VAR_TpcTmp_ElecTrqLimTdrvboard_f32 VAR_TpcTmp_GenTrqLimTdrvboard_f32 /end REF_MEASUREMENT
/end GROUP
/begin GROUP S196_GetDeratingFlag_TDrvBoard "SWC_TPC/RE_SWC_TPC_10ms_sys/TPC/TpcJudge/TpcTmp/DrvBoardTemperatureDerating/GetDeratingFlag_TDrvBoard" /begin REF_MEASUREMENT VAR_TpcTmp_flgTrqLimTdrvboardActv_b /end REF_MEASUREMENT /end GROUP
/begin GROUP S197_DemIGBTTemperature "SWC_TPC/RE_SWC_TPC_10ms_sys/TPC/TpcJudge/TpcTmp/IGBTTemperatureDerating/DemIGBTTemperature"
 /begin REF_CHARACTERISTIC CAL_TpcTmp_tIGBTTempHiLim_f32 CAL_TpcTmp_tIGBTTempLoLim_f32 /end REF_CHARACTERISTIC
 /begin REF_MEASUREMENT VAR_TpcTmp_TIGBTOvHiErrState_u8 VAR_TpcTmp_TIGBTOvHiWarnState_u8 VAR_TpcTmp_TIGBTOvLoWarnState_u8 /end REF_MEASUREMENT
/end GROUP
/begin GROUP S197_GetIGBTTempLimTorq "SWC_TPC/RE_SWC_TPC_10ms_sys/TPC/TpcJudge/TpcTmp/IGBTTemperatureDerating/GetIGBTTempLimTorq"
 /begin REF_MEASUREMENT VAR_TpcTmp_ElecTrqLimTIGBTWoRamp_f32 VAR_TpcTmp_GenTrqLimTIGBTWoRamp_f32 /end REF_MEASUREMENT
 /begin SUB_GROUP S231_GetDeratingFlag_TIGBT /end SUB_GROUP
/end GROUP
/begin GROUP S197_GetRampElecTrqLim "SWC_TPC/RE_SWC_TPC_10ms_sys/TPC/TpcJudge/TpcTmp/IGBTTemperatureDerating/GetRampElecTrqLim" /begin REF_MEASUREMENT VAR_TpcTmp_ElecTrqLimTIGBT_f32 /end REF_MEASUREMENT /end GROUP
/begin GROUP S197_GetRampGenTrqLim "SWC_TPC/RE_SWC_TPC_10ms_sys/TPC/TpcJudge/TpcTmp/IGBTTemperatureDerating/GetRampGenTrqLim" /begin REF_MEASUREMENT VAR_TpcTmp_GenTrqLimTIGBT_f32 /end REF_MEASUREMENT /end GROUP
/begin GROUP S197_GetTIGBTDeratingCof "SWC_TPC/RE_SWC_TPC_10ms_sys/TPC/TpcJudge/TpcTmp/IGBTTemperatureDerating/GetTIGBTDeratingCof"
 /begin REF_CHARACTERISTIC CAL_TpcTmp_tIGBTDertSave1TableY_Cof_af32 CAL_TpcTmp_tIGBTDertSave2TableY_Cof_af32 CAL_TpcTmp_tIGBTTraNormalToSave1_f32 CAL_TpcTmp_tIGBTTraSave1ToNormal_f32 CAL_TpcTmp_tIGBTTraSave1ToSave2_f32 CAL_TpcTmp_tIGBTTraSave2ToOverheating_f32 CAL_Tpc_NormalMode_u8 CAL_Tpc_OverheatingMode_u8 CAL_Tpc_Powersave1Mode_u8 CAL_Tpc_Powersave2Mode_u8 /end REF_CHARACTERISTIC
 /begin REF_MEASUREMENT VAR_TpcTmp_CofDertIGBT_f32 VAR_TpcTmp_CofDertTIGBTSave1_f32 VAR_TpcTmp_CofDertTIGBTSave2_f32 VAR_TpcTmp_tIGBTOperationMode_u8 /end REF_MEASUREMENT
/end GROUP
/begin GROUP S197_GetTRiseIGBTDeratingCof "SWC_TPC/RE_SWC_TPC_10ms_sys/TPC/TpcJudge/TpcTmp/IGBTTemperatureDerating/GetTRiseIGBTDeratingCof"
 /begin REF_CHARACTERISTIC CAL_TpcTmp_IGBRiseTTempAdds_f32 CAL_TpcTmp_IGBTRiseTempDecDiff_f32 CAL_TpcTmp_IGBTRiseTempKp_f32 CAL_TpcTmp_IGBTRiseTempMinus_f32 CAL_TpcTmp_IGBTRiseTempRiseDiff_f32 CAL_TpcTmp_tRiseIGBTDertSave1TableY_Cof_af32 CAL_TpcTmp_tRiseIGBTDertSave2TableY_Cof_af32 CAL_TpcTmp_tRiseIGBTTraNormalToSave1_f32 CAL_TpcTmp_tRiseIGBTTraSave1ToNormal_f32 CAL_TpcTmp_tRiseIGBTTraSave1ToSave2_f32 CAL_TpcTmp_tRiseIGBTTraSave2ToOverheating_f32 CAL_Tpc_NormalMode_u8 CAL_Tpc_OverheatingMode_u8 CAL_Tpc_Powersave1Mode_u8 CAL_Tpc_Powersave2Mode_u8 /end REF_CHARACTERISTIC
 /begin REF_MEASUREMENT VAR_TpcTmp_CofDertTRiseIGBTSave1_f32 VAR_TpcTmp_CofDertTRiseIGBTSave2_f32 VAR_TpcTmp_CofDertTRiseIGBT_f32 VAR_TpcTmp_tRiseIGBTOperationMode_u8 VAR_TpcTmp_tRiseIGBT_f32 /end REF_MEASUREMENT
 /begin SUB_GROUP S235_IgbtTempFlt /end SUB_GROUP
/end GROUP
/begin GROUP S197_IgbtTempFlt "SWC_TPC/RE_SWC_TPC_10ms_sys/TPC/TpcJudge/TpcTmp/IGBTTemperatureDerating/IgbtTempFlt"
 /begin REF_CHARACTERISTIC CAL_TpcTmp_IgbtChgTempDownDiff_f32 CAL_TpcTmp_IgbtChgTempUpDiff_f32 /end REF_CHARACTERISTIC
 /begin REF_MEASUREMENT VAR_TpcTmp_TIgbtStableDiff_u16 VAR_TpcTmp_tIGBTTempFlt_f32 VAR_TpcTmp_tIgbtTempFlt_u16 /end REF_MEASUREMENT
/end GROUP
/begin GROUP S23_fun "SWC_TPC/RE_SWC_TPC_10ms_sys/TPC/TpcCod/Coordinate/If Action Subsystem/Chart/fun" /begin REF_CHARACTERISTIC CAL_TpcCod_PosSpdHold_f32 CAL_TpcCod_PosSpdStart_f32 /end REF_CHARACTERISTIC /end GROUP
/begin GROUP S25_fun "SWC_TPC/RE_SWC_TPC_10ms_sys/TPC/TpcCod/Coordinate/If Action Subsystem1/Chart/fun" /begin REF_CHARACTERISTIC CAL_TpcCod_PosSpdHold_f32 CAL_TpcCod_PosSpdStart_f32 /end REF_CHARACTERISTIC /end GROUP
/begin GROUP S55_AEqualB24 "SWC_TPC/RE_SWC_TPC_10ms_sys/TPC/TpcCod/TorqueLimitationReason/TorqLimReasonJudge/TorqLimReason_Can/AEqualB24" /begin REF_MEASUREMENT VAR_tpccod_flgMaxDertCAN_b /end REF_MEASUREMENT /end GROUP
/begin GROUP S55_AEqualB33 "SWC_TPC/RE_SWC_TPC_10ms_sys/TPC/TpcCod/TorqueLimitationReason/TorqLimReasonJudge/TorqLimReason_Can/AEqualB33" /begin REF_MEASUREMENT VAR_tpccod_flgMinDertCAN_b /end REF_MEASUREMENT /end GROUP
/begin GROUP S122_Subsystem1 "SWC_TPC/RE_SWC_TPC_10ms_sys/TPC/TpcJudge/TpcMot/ExternalCharacteristicDerating/TrqLimRampRiseAndReduceSet/Subsystem1" /begin REF_CHARACTERISTIC CAL_Tpc_TrqReduceRevStep_f32 CAL_Tpc_TrqRiseRevStep_f32 /end REF_CHARACTERISTIC /end GROUP
/begin GROUP S123_Subsystem1 "SWC_TPC/RE_SWC_TPC_10ms_sys/TPC/TpcJudge/TpcMot/ExternalCharacteristicDerating/TrqLimRampRiseAndReduceSet1/Subsystem1" /begin REF_CHARACTERISTIC CAL_Tpc_TrqReduceRevStep_f32 CAL_Tpc_TrqRiseRevStep_f32 /end REF_CHARACTERISTIC /end GROUP
/begin GROUP S129_GetDeratingFlag_TIGBT "SWC_TPC/RE_SWC_TPC_10ms_sys/TPC/TpcJudge/TpcMot/SttrTemperatureDerating/GetSttrTempLimTorq/GetDeratingFlag_TIGBT" /begin REF_MEASUREMENT VAR_TpcMot_flgTrqLimTsttrActv_b /end REF_MEASUREMENT /end GROUP
/begin GROUP S147_Coordinate "SWC_TPC/RE_SWC_TPC_10ms_sys/TPC/TpcJudge/TpcSmp/DeratingStrategyCurrent/DeratingStrategy_OvercurrentElec/Coordinate"
 /begin REF_CHARACTERISTIC CAL_TpcSmp_CntElecOvrCurt_u8 CAL_TpcSmp_CurtModeSelc_b CAL_TpcSmp_FacElecOvrCurt_u8 /end REF_CHARACTERISTIC
 /begin REF_MEASUREMENT VAR_TpcSmp_ElecPwrLimOvrCurt_f32 /end REF_MEASUREMENT
 /begin SUB_GROUP S149_Debounce /end SUB_GROUP
/end GROUP
/begin GROUP S147_LinearRegionPowerDerating "SWC_TPC/RE_SWC_TPC_10ms_sys/TPC/TpcJudge/TpcSmp/DeratingStrategyCurrent/DeratingStrategy_OvercurrentElec/LinearRegionPowerDerating" /begin REF_CHARACTERISTIC CAL_TpcSmp_OvrCurtLimElecTableY_Cof_af32 /end REF_CHARACTERISTIC
 /begin REF_MEASUREMENT VAR_TpcSmp_ElecPwrLinearDertOvrCurt_f32 VAR_TpcSmp_cofDertOvrCurtElec_f32 VAR_TpcSmp_flgLinearDertOvrCurtElec_b /end REF_MEASUREMENT
/end GROUP
/begin GROUP S147_PIRegionPowerDerting "SWC_TPC/RE_SWC_TPC_10ms_sys/TPC/TpcJudge/TpcSmp/DeratingStrategyCurrent/DeratingStrategy_OvercurrentElec/PIRegionPowerDerting"
 /begin REF_CHARACTERISTIC CAL_TpcSmp_ElecOvrCurtKi_f32 CAL_TpcSmp_ElecOvrCurtKp_f32 CAL_TpcSmp_ElecOvrCurtypLim_f32 CAL_TpcSmp_PwrAddMax_f32 CAL_TpcSmp_TrqAddMax_f32 CAL_TpcSmp_flgUsePwrLoss_b /end REF_CHARACTERISTIC
 /begin REF_MEASUREMENT VAR_TpcSmp_ElecPwrAlowMax_f32 VAR_TpcSmp_ErrElecOvrCurt_f32 VAR_tpcsmp_AddPwrElecOvrCurt_f32 VAR_tpcsmp_PwrLoss_f32 VAR_tpcsmp_RefPwrElecOvrCurt_f32 /end REF_MEASUREMENT
 /begin SUB_GROUP S152_PI /end SUB_GROUP
/end GROUP
/begin GROUP S147_Subsystem "SWC_TPC/RE_SWC_TPC_10ms_sys/TPC/TpcJudge/TpcSmp/DeratingStrategyCurrent/DeratingStrategy_OvercurrentElec/Subsystem" /begin REF_CHARACTERISTIC CAL_TpcSmp_SystemEffiElec_f32 /end REF_CHARACTERISTIC /begin REF_MEASUREMENT VAR_tpcsmp_ElecPwrDert_f32 /end REF_MEASUREMENT /end GROUP
/begin GROUP S148_Coordinate "SWC_TPC/RE_SWC_TPC_10ms_sys/TPC/TpcJudge/TpcSmp/DeratingStrategyCurrent/DeratingStrategy_OvercurrentGen/Coordinate"
 /begin REF_CHARACTERISTIC CAL_TpcSmp_CntGenOvrCurt_u8 CAL_TpcSmp_CurtModeSelc_b CAL_TpcSmp_FacGenOvrCurt_u8 /end REF_CHARACTERISTIC
 /begin REF_MEASUREMENT VAR_TpcSmp_GenPwrLimOvrCurt_f32 /end REF_MEASUREMENT
 /begin SUB_GROUP S158_Debounce /end SUB_GROUP
/end GROUP
/begin GROUP S148_LinearRegionPowerDerating "SWC_TPC/RE_SWC_TPC_10ms_sys/TPC/TpcJudge/TpcSmp/DeratingStrategyCurrent/DeratingStrategy_OvercurrentGen/LinearRegionPowerDerating" /begin REF_CHARACTERISTIC CAL_TpcSmp_OvrCurtLimGenTableY_Cof_af32 /end REF_CHARACTERISTIC
 /begin REF_MEASUREMENT VAR_TpcSmp_GenPwrLinearDertOvrCurt_f32 VAR_TpcSmp_cofDertOvrCurtGen_f32 VAR_TpcSmp_flgLinearDertOveCurtGen_b /end REF_MEASUREMENT
/end GROUP
/begin GROUP S148_PIRegionPowerDerting "SWC_TPC/RE_SWC_TPC_10ms_sys/TPC/TpcJudge/TpcSmp/DeratingStrategyCurrent/DeratingStrategy_OvercurrentGen/PIRegionPowerDerting"
 /begin REF_CHARACTERISTIC CAL_TpcSmp_GenOvrCurtKi_f32 CAL_TpcSmp_GenOvrCurtKp_f32 CAL_TpcSmp_GenOvrCurtypLim_f32 CAL_TpcSmp_PwrAddMaxGen_f32 CAL_TpcSmp_TrqAddMaxGen_f32 CAL_TpcSmp_flgUsePwrLossGen_b /end REF_CHARACTERISTIC
 /begin REF_MEASUREMENT VAR_TpcSmp_ErrGenOvrCurt_f32 VAR_TpcSmp_GenPwrAlowMax_f32 VAR_tpcsmp_PwrLossGen_f32 VAR_tpcsmp_RefPwrGenOvrCurt_f32 /end REF_MEASUREMENT
 /begin SUB_GROUP S161_PI /end SUB_GROUP
/end GROUP
/begin GROUP S148_Subsystem "SWC_TPC/RE_SWC_TPC_10ms_sys/TPC/TpcJudge/TpcSmp/DeratingStrategyCurrent/DeratingStrategy_OvercurrentGen/Subsystem" /begin REF_CHARACTERISTIC CAL_TpcSmp_SystemEffiGen_f32 /end REF_CHARACTERISTIC /begin REF_MEASUREMENT VAR_tpcsmp_GenPwrDert_f32 /end REF_MEASUREMENT /end GROUP
/begin GROUP S167_Coordinate "SWC_TPC/RE_SWC_TPC_10ms_sys/TPC/TpcJudge/TpcSmp/DeratingStrategyVoltage/DeratingStrategy_Overvoltage/Coordinate" /begin REF_CHARACTERISTIC CAL_TpcSmp_CntGenOvrVolt_u8 CAL_TpcSmp_FacGenOvrVolt_u8 /end REF_CHARACTERISTIC /begin REF_MEASUREMENT VAR_TpcSmp_GenPwrLimOvrVolt_f32 /end REF_MEASUREMENT /begin SUB_GROUP S169_Debounce /end SUB_GROUP /end GROUP
/begin GROUP S167_DemBusOvrVoltage "SWC_TPC/RE_SWC_TPC_10ms_sys/TPC/TpcJudge/TpcSmp/DeratingStrategyVoltage/DeratingStrategy_Overvoltage/DemBusOvrVoltage" /begin REF_CHARACTERISTIC CAL_TpcSmp_uDcLnkOvVLim_f32 /end REF_CHARACTERISTIC
 /begin REF_MEASUREMENT VAR_TpcSmp_uDcLnkOvVLimErrState_u8 VAR_TpcSmp_uDcLnkOvWarnState_u8 /end REF_MEASUREMENT
/end GROUP
/begin GROUP S167_LinearRegionPowerDerating "SWC_TPC/RE_SWC_TPC_10ms_sys/TPC/TpcJudge/TpcSmp/DeratingStrategyVoltage/DeratingStrategy_Overvoltage/LinearRegionPowerDerating" /begin REF_CHARACTERISTIC CAL_TpcSmp_OvrVoltGenTableY_Cof_af32 /end REF_CHARACTERISTIC
 /begin REF_MEASUREMENT VAR_TpcSmp_GenPwrLinearDertOvrVolt_f32 VAR_TpcSmp_cofDertOvrVoltGen_f32 VAR_TpcSmp_flgLinearDertOvrVoltGen_b /end REF_MEASUREMENT
/end GROUP
/begin GROUP S167_PIRegionPowerDerting "SWC_TPC/RE_SWC_TPC_10ms_sys/TPC/TpcJudge/TpcSmp/DeratingStrategyVoltage/DeratingStrategy_Overvoltage/PIRegionPowerDerting"
 /begin REF_CHARACTERISTIC CAL_TpcSmp_GenOvrVoltKi_f32 CAL_TpcSmp_GenOvrVoltKp_f32 CAL_TpcSmp_GenOvrVoltypLim_f32 /end REF_CHARACTERISTIC
 /begin SUB_GROUP S172_PI /end SUB_GROUP
/end GROUP
/begin GROUP S168_Coordinate "SWC_TPC/RE_SWC_TPC_10ms_sys/TPC/TpcJudge/TpcSmp/DeratingStrategyVoltage/DeratingStrategy_Undervoltage/Coordinate" /begin REF_CHARACTERISTIC CAL_TpcSmp_CntElecUdrVolt_u8 CAL_TpcSmp_FacElecUdrVolt_u8 /end REF_CHARACTERISTIC
 /begin REF_MEASUREMENT VAR_TpcSmp_ElecPwrLimUdrVolt_f32 VAR_TpcSmp_flgElecPwrLimUdrVoltActv_b /end REF_MEASUREMENT
/end GROUP
/begin GROUP S168_DemBusUndrVoltage "SWC_TPC/RE_SWC_TPC_10ms_sys/TPC/TpcJudge/TpcSmp/DeratingStrategyVoltage/DeratingStrategy_Undervoltage/DemBusUndrVoltage" /begin REF_CHARACTERISTIC CAL_TpcSmp_uDcLnkUnVLim_f32 /end REF_CHARACTERISTIC
 /begin REF_MEASUREMENT VAR_TpcSmp_uDcLnkUnVLimErrState_u8 VAR_TpcSmp_uDcLnkUnvWarnState_u8 /end REF_MEASUREMENT
/end GROUP
/begin GROUP S168_LinearRegionPowerDerating "SWC_TPC/RE_SWC_TPC_10ms_sys/TPC/TpcJudge/TpcSmp/DeratingStrategyVoltage/DeratingStrategy_Undervoltage/LinearRegionPowerDerating" /begin REF_CHARACTERISTIC CAL_TpcSmp_UdrVoltElecTableY_Cof_af32 /end REF_CHARACTERISTIC
 /begin REF_MEASUREMENT VAR_TpcSmp_ElecPwrLinearDertUdrVolt_f32 VAR_TpcSmp_cofDertUdrVoltElec_f32 VAR_TpcSmp_flgLinearDertUdrVoltElec_b /end REF_MEASUREMENT
/end GROUP
/begin GROUP S168_PIRegionPowerDerting "SWC_TPC/RE_SWC_TPC_10ms_sys/TPC/TpcJudge/TpcSmp/DeratingStrategyVoltage/DeratingStrategy_Undervoltage/PIRegionPowerDerting"
 /begin REF_CHARACTERISTIC CAL_TpcSmp_ElecUdrVoltKi_f32 CAL_TpcSmp_ElecUdrVoltKp_f32 CAL_TpcSmp_ElecUdrVoltypLim_f32 /end REF_CHARACTERISTIC
 /begin SUB_GROUP S180_PI /end SUB_GROUP
/end GROUP
/begin GROUP S200_CoolantTempFlt "SWC_TPC/RE_SWC_TPC_10ms_sys/TPC/TpcJudge/TpcTmp/CoolantTemperatureDerating/DeratingStrategy_TCoolant/CoolantTempFlt"
 /begin REF_CHARACTERISTIC CAL_TpcTmp_CoolChgTempDownDiff_f32 CAL_TpcTmp_CoolChgTempUpDiff_f32 /end REF_CHARACTERISTIC
 /begin REF_MEASUREMENT VAR_TpcTmp_TCoolStableDiff_u16 VAR_TpcTmp_tCoolantTempFlt_f32 /end REF_MEASUREMENT
/end GROUP
/begin GROUP S200_GetTDbcDeratingCof "SWC_TPC/RE_SWC_TPC_10ms_sys/TPC/TpcJudge/TpcTmp/CoolantTemperatureDerating/DeratingStrategy_TCoolant/GetTDbcDeratingCof"
 /begin REF_CHARACTERISTIC CAL_TpcTmp_tCoolantDertSave1TableY_Cof_af32 CAL_TpcTmp_tCoolantDertSave2TableY_Cof_af32 CAL_TpcTmp_tCoolantTraNormalToSave1_f32 CAL_TpcTmp_tCoolantTraSave1ToNormal_f32 CAL_TpcTmp_tCoolantTraSave1ToSave2_f32 CAL_TpcTmp_tCoolantTraSave2ToOverheating_f32 CAL_Tpc_NormalMode_u8 CAL_Tpc_OverheatingMode_u8 CAL_Tpc_Powersave1Mode_u8 CAL_Tpc_Powersave2Mode_u8 /end REF_CHARACTERISTIC
 /begin REF_MEASUREMENT VAR_TpcTmp_CofDertTCoolantSave1_f32 VAR_TpcTmp_CofDertTCoolantSave2_f32 VAR_TpcTmp_CofDertTcoolant_f32 VAR_TpcTmp_tCoolantOperationMode_u8 /end REF_MEASUREMENT
/end GROUP
/begin GROUP S208_GetDbcTempLimTorq "SWC_TPC/RE_SWC_TPC_10ms_sys/TPC/TpcJudge/TpcTmp/DbcTemperatureDerating/DBCTemperatureDerating/GetDbcTempLimTorq"
 /begin REF_MEASUREMENT VAR_TpcTmp_ElecTrqLimTdbcWoRamp_f32 VAR_TpcTmp_GenTrqLimTdbcWoRamp_f32 /end REF_MEASUREMENT
/end GROUP
/begin GROUP S208_GetTDbcDeratingCof "SWC_TPC/RE_SWC_TPC_10ms_sys/TPC/TpcJudge/TpcTmp/DbcTemperatureDerating/DBCTemperatureDerating/GetTDbcDeratingCof"
 /begin REF_CHARACTERISTIC CAL_TpcTmp_tDbcDertSave1TableY_Cof_af32 CAL_TpcTmp_tDbcDertSave2TableY_Cof_af32 CAL_TpcTmp_tDbcTraNormalToSave1_f32 CAL_TpcTmp_tDbcTraSave1ToNormal_f32 CAL_TpcTmp_tDbcTraSave1ToSave2_f32 CAL_TpcTmp_tDbcTraSave2ToOverheating_f32 CAL_Tpc_NormalMode_u8 CAL_Tpc_OverheatingMode_u8 CAL_Tpc_Powersave1Mode_u8 CAL_Tpc_Powersave2Mode_u8 /end REF_CHARACTERISTIC
 /begin REF_MEASUREMENT VAR_TpcTmp_CofDertDbc_f32 VAR_TpcTmp_CofDertTDbcSave1_f32 VAR_TpcTmp_CofDertTDbcSave2_f32 VAR_TpcTmp_tDbcOperationMode_u8 /end REF_MEASUREMENT
/end GROUP
/begin GROUP S208_GetTRiseDbcDeratingCof "SWC_TPC/RE_SWC_TPC_10ms_sys/TPC/TpcJudge/TpcTmp/DbcTemperatureDerating/DBCTemperatureDerating/GetTRiseDbcDeratingCof"
 /begin REF_CHARACTERISTIC CAL_TpcTmp_DBCRiseTempAdds_f32 CAL_TpcTmp_DBCRiseTempDecDiff_f32 CAL_TpcTmp_DBCRiseTempKp_f32 CAL_TpcTmp_DBCRiseTempMinus_f32 CAL_TpcTmp_DBCRiseTempRiseDiff_f32 CAL_TpcTmp_tRiseDbcDertSave1TableY_Cof_af32 CAL_TpcTmp_tRiseDbcDertSave2TableY_Cof_af32 CAL_TpcTmp_tRiseDbcTraNormalToSave1_f32 CAL_TpcTmp_tRiseDbcTraSave1ToNormal_f32 CAL_TpcTmp_tRiseDbcTraSave1ToSave2_f32 CAL_TpcTmp_tRiseDbcTraSave2ToOverheating_f32 CAL_Tpc_NormalMode_u8 CAL_Tpc_OverheatingMode_u8 CAL_Tpc_Powersave1Mode_u8 CAL_Tpc_Powersave2Mode_u8 /end REF_CHARACTERISTIC
 /begin REF_MEASUREMENT VAR_TpcTmp_CofDertTRiseDbcSave1_f32 VAR_TpcTmp_CofDertTRiseDbcSave2_f32 VAR_TpcTmp_CofDertTRiseDbc_f32 VAR_TpcTmp_tRiseDbcOperationMode_u8 VAR_TpcTmp_tRiseDbc_f32 /end REF_MEASUREMENT
 /begin SUB_GROUP S217_DbcTempFlt /end SUB_GROUP
/end GROUP
/begin GROUP S231_GetDeratingFlag_TIGBT "SWC_TPC/RE_SWC_TPC_10ms_sys/TPC/TpcJudge/TpcTmp/IGBTTemperatureDerating/GetIGBTTempLimTorq/GetDeratingFlag_TIGBT" /begin REF_MEASUREMENT VAR_TpcTmp_flgTrqLimTIGBTActv_b /end REF_MEASUREMENT /end GROUP
/begin GROUP S235_IgbtTempFlt "SWC_TPC/RE_SWC_TPC_10ms_sys/TPC/TpcJudge/TpcTmp/IGBTTemperatureDerating/GetTRiseIGBTDeratingCof/IgbtTempFlt"
 /begin REF_CHARACTERISTIC CAL_TpcTmp_IgbtRiseChgTempDownDiff_f32 CAL_TpcTmp_IgbtRiseChgTempUpDiff_f32 /end REF_CHARACTERISTIC
 /begin REF_MEASUREMENT VAR_TpcTmp_TIgbtRiseStableDiff_u16 VAR_TpcTmp_tIgbtRiseTempFlt_u16 VAR_TpcTmp_tRiseIGBTFlt_f32 /end REF_MEASUREMENT
/end GROUP
/begin GROUP S149_Debounce "SWC_TPC/RE_SWC_TPC_10ms_sys/TPC/TpcJudge/TpcSmp/DeratingStrategyCurrent/DeratingStrategy_OvercurrentElec/Coordinate/Debounce" /begin REF_MEASUREMENT VAR_TpcSmp_flgElecPwrLimOvrCurtActv_b /end REF_MEASUREMENT /end GROUP
/begin GROUP S152_PI "SWC_TPC/RE_SWC_TPC_10ms_sys/TPC/TpcJudge/TpcSmp/DeratingStrategyCurrent/DeratingStrategy_OvercurrentElec/PIRegionPowerDerting/PI"
 /begin REF_MEASUREMENT VAR_TpcSmp_ElecPwrPIDertOvrCurt_f32 VAR_TpcSmp_flgPIDertOvrCurtElec_b VAR_tpcsmp_KiProductSum_f32 VAR_tpcsmp_KiProduct_f32 VAR_tpcsmp_KpProductSau_f32 VAR_tpcsmp_KpProduct_f32 VAR_tpcsmp_PIOutput_f32 VAR_tpcsmp_negOutputjudge_f32 VAR_tpcsmp_posOutputjudge_f32 VAR_tpcsmp_yiDelay_f32 VAR_tpcsmp_yi_f32 /end REF_MEASUREMENT
/end GROUP
/begin GROUP S158_Debounce "SWC_TPC/RE_SWC_TPC_10ms_sys/TPC/TpcJudge/TpcSmp/DeratingStrategyCurrent/DeratingStrategy_OvercurrentGen/Coordinate/Debounce" /begin REF_MEASUREMENT VAR_TpcSmp_flgGenPwrLimCurtActv_b /end REF_MEASUREMENT /end GROUP
/begin GROUP S161_PI "SWC_TPC/RE_SWC_TPC_10ms_sys/TPC/TpcJudge/TpcSmp/DeratingStrategyCurrent/DeratingStrategy_OvercurrentGen/PIRegionPowerDerting/PI"
 /begin REF_MEASUREMENT VAR_TpcSmp_GenPwrPIDertOvrCurt_f32 VAR_TpcSmp_flgPIDertOvrCurtGen_b /end REF_MEASUREMENT
/end GROUP
/begin GROUP S169_Debounce "SWC_TPC/RE_SWC_TPC_10ms_sys/TPC/TpcJudge/TpcSmp/DeratingStrategyVoltage/DeratingStrategy_Overvoltage/Coordinate/Debounce" /begin REF_MEASUREMENT VAR_TpcSmp_flgGenPwrLimOvrVoltActv_b /end REF_MEASUREMENT /end GROUP
/begin GROUP S172_PI "SWC_TPC/RE_SWC_TPC_10ms_sys/TPC/TpcJudge/TpcSmp/DeratingStrategyVoltage/DeratingStrategy_Overvoltage/PIRegionPowerDerting/PI"
 /begin REF_MEASUREMENT VAR_TpcSmp_GenPwrPIDertOvrVolt_f32 VAR_TpcSmp_flgPIDertOvrVoltGen_b /end REF_MEASUREMENT
/end GROUP
/begin GROUP S180_PI "SWC_TPC/RE_SWC_TPC_10ms_sys/TPC/TpcJudge/TpcSmp/DeratingStrategyVoltage/DeratingStrategy_Undervoltage/PIRegionPowerDerting/PI"
 /begin REF_MEASUREMENT VAR_TpcSmp_ElecPwrPIDertUdrVolt_f32 VAR_TpcSmp_flgPIDertUdrVoltElec_b /end REF_MEASUREMENT
/end GROUP
/begin GROUP S217_DbcTempFlt "SWC_TPC/RE_SWC_TPC_10ms_sys/TPC/TpcJudge/TpcTmp/DbcTemperatureDerating/DBCTemperatureDerating/GetTRiseDbcDeratingCof/DbcTempFlt"
 /begin REF_CHARACTERISTIC CAL_TpcTmp_DbcRiseChgTempDownDiff_f32 CAL_TpcTmp_DbcRiseChgTempUpDiff_f32 /end REF_CHARACTERISTIC
 /begin REF_MEASUREMENT VAR_TpcTmp_TDbcRiseStableDiff_u16 VAR_TpcTmp_tDbcRiseTempFlt_u16 VAR_TpcTmp_tRiseDbcFlt_f32 /end REF_MEASUREMENT
/end GROUP
/begin GROUP SWC_TRSP "SWC_TRSP" ROOT
 /begin SUB_GROUP Root_SWC_TRSP_100us_sys Root_SWC_TRSP_10ms_sys Root_SWC_TRSP_1ms_sys /end SUB_GROUP
/end GROUP
/begin GROUP Root_SWC_TRSP_100us_sys "SWC_TRSP/SWC_TRSP_100us_sys"
 /begin REF_MEASUREMENT VAR_L2Sampling_18VHS_MON_u16 VAR_L2Sampling_1V8CPLD_MON_u16 VAR_L2Sampling_3V3CPLD_MON_u16 VAR_L2Sampling_Exci18VLS_MON_u16 VAR_L2Sampling_ExciBackN_u16 VAR_L2Sampling_ExciBackP_u16 VAR_L2Sampling_IsU_Mon_f32 VAR_L2Sampling_IsV_Mon_f32 VAR_L2Sampling_IsW_Mon_f32 VAR_L2Sampling_LEM5V_MON_u16 VAR_L2Sampling_RslvCosN_VADC_u16 VAR_L2Sampling_RslvCosP_VADC_u16 VAR_L2Sampling_RslvCos_s32 VAR_L2Sampling_RslvSinN_VADC_u16 VAR_L2Sampling_RslvSinP_VADC_u16 VAR_L2Sampling_RslvSin_s32 VAR_L2Sampling_UBRWIDE_MON_u16 VAR_L2Sampling_UB_SBC_MON_u16 /end REF_MEASUREMENT
 /begin SUB_GROUP S1_18VHSVoltChk S1_1V8CPLDVoltChk S1_3V3CPLDVoltChk S1_AgRtrCalc S1_CurrChk S1_RslvChk S1_RslvSensVoltChk S1_UBRVoltChk S1_iPhasSensVoltChk /end SUB_GROUP
/end GROUP
/begin GROUP Root_SWC_TRSP_10ms_sys "SWC_TRSP/SWC_TRSP_10ms_sys" /begin REF_MEASUREMENT VAR_L2Com_TrqSetP_f32 /end REF_MEASUREMENT /begin SUB_GROUP S2_CANSigChk /end SUB_GROUP /end GROUP
/begin GROUP Root_SWC_TRSP_1ms_sys "SWC_TRSP/SWC_TRSP_1ms_sys" /begin REF_MEASUREMENT VAR_L2Com_ModeReq_u16 VAR_NvM_AngAutoClbOffset_f32 /end REF_MEASUREMENT /begin SUB_GROUP S3_OfstAgChk /end SUB_GROUP /end GROUP
/begin GROUP S1_18VHSVoltChk "SWC_TRSP/SWC_TRSP_100us_sys/18VHSVoltChk"
 /begin REF_CHARACTERISTIC CAL_TRSP_18VHSVoltCountTrh_s16 CAL_TRSP_18VHSVoltDebTrh_s16 CAL_TRSP_18VHSVoltErrRst_b CAL_TRSP_18VHSVoltHiLim_u16 CAL_TRSP_18VHSVoltLoLim_u16 /end REF_CHARACTERISTIC
 /begin REF_MEASUREMENT VAR_TRSP_18VHSVoltRngChkRslt_b VAR_TRSP_18VHSVoltRngErr_b /end REF_MEASUREMENT
/end GROUP
/begin GROUP S1_1V8CPLDVoltChk "SWC_TRSP/SWC_TRSP_100us_sys/1V8CPLDVoltChk"
 /begin REF_CHARACTERISTIC CAL_TRSP_1V8CPLDVoltCountTrh_s16 CAL_TRSP_1V8CPLDVoltDebTrh_s16 CAL_TRSP_1V8CPLDVoltErrRst_b CAL_TRSP_1V8CPLDVoltHiLim_u16 CAL_TRSP_1V8CPLDVoltLoLim_u16 /end REF_CHARACTERISTIC
 /begin REF_MEASUREMENT VAR_TRSP_1V8CPLDVoltRngChkRslt_b VAR_TRSP_1V8CPLDVoltRngErr_b /end REF_MEASUREMENT
/end GROUP
/begin GROUP S1_3V3CPLDVoltChk "SWC_TRSP/SWC_TRSP_100us_sys/3V3CPLDVoltChk"
 /begin REF_CHARACTERISTIC CAL_TRSP_3V3CPLDVoltCountTrh_s16 CAL_TRSP_3V3CPLDVoltDebTrh_s16 CAL_TRSP_3V3CPLDVoltErrRst_b CAL_TRSP_3V3CPLDVoltHiLim_u16 CAL_TRSP_3V3CPLDVoltLoLim_u16 /end REF_CHARACTERISTIC
 /begin REF_MEASUREMENT VAR_TRSP_3V3CPLDVoltRngChkRslt_b VAR_TRSP_3V3CPLDVoltRngErr_b /end REF_MEASUREMENT
/end GROUP
/begin GROUP S1_AgRtrCalc "SWC_TRSP/SWC_TRSP_100us_sys/AgRtrCalc" /begin REF_CHARACTERISTIC CAL_TRSP_AgTimecompCtl_u8 /end REF_CHARACTERISTIC /begin REF_MEASUREMENT VAR_TRSP_AgRtr_f32 /end REF_MEASUREMENT /end GROUP
/begin GROUP S1_CurrChk "SWC_TRSP/SWC_TRSP_100us_sys/CurrChk"
 /begin REF_CHARACTERISTIC CAL_TRSP_CurrRngCountTrh_s16 CAL_TRSP_CurrRngDebTrh_s16 CAL_TRSP_CurrRngErrRst_b CAL_TRSP_CurrSumCountTrh_s16 CAL_TRSP_CurrSumDebTrh_s16 CAL_TRSP_CurrSumErrRst_b CAL_TRSP_UCurrRngHiLim_f32 CAL_TRSP_UCurrRngLoLim_f32 CAL_TRSP_VCurrRngHiLim_f32 CAL_TRSP_VCurrRngLoLim_f32 CAL_TRSP_WCurrRngHiLim_f32 CAL_TRSP_WCurrRngLoLim_f32 /end REF_CHARACTERISTIC
 /begin REF_MEASUREMENT VAR_TRSP_CurrRngErr_b VAR_TRSP_CurrSumErr_b VAR_TRSP_UCurrRngChkRslt_b VAR_TRSP_UCurrRngErr_b VAR_TRSP_VCurrRngChkRslt_b VAR_TRSP_VCurrRngErr_b VAR_TRSP_WCurrRngChkRslt_b VAR_TRSP_WCurrRngErr_b /end REF_MEASUREMENT
 /begin SUB_GROUP S9_CurrSumChk S9_iPhaCalc /end SUB_GROUP
/end GROUP
/begin GROUP S1_RslvChk "SWC_TRSP/SWC_TRSP_100us_sys/RslvChk"
 /begin REF_CHARACTERISTIC CAL_TRSP_RslvExciCountTrh_s16 CAL_TRSP_RslvExciDebTrh_s16 CAL_TRSP_RslvExciErrRst_b CAL_TRSP_RslvRngCosNHiLim_u16 CAL_TRSP_RslvRngCosNLoLim_u16 CAL_TRSP_RslvRngCosPHiLim_u16 CAL_TRSP_RslvRngCosPLoLim_u16 CAL_TRSP_RslvRngCountTrh_s16 CAL_TRSP_RslvRngDebTrh_s16 CAL_TRSP_RslvRngErrRst_b CAL_TRSP_RslvRngExciHiLim_u16 CAL_TRSP_RslvRngExciLoLim_u16 CAL_TRSP_RslvRngSinNHiLim_u16 CAL_TRSP_RslvRngSinNLoLim_u16 CAL_TRSP_RslvRngSinPHiLim_u16 CAL_TRSP_RslvRngSinPLoLim_u16 CAL_TRSP_RslvSqrtCountTrh_s16 CAL_TRSP_RslvSqrtDebTrh_s16 CAL_TRSP_RslvSqrtErrRst_b /end REF_CHARACTERISTIC
 /begin REF_MEASUREMENT VAR_L2Sampling_RslvCosN_VADC_Max1_u16 VAR_L2Sampling_RslvCosN_VADC_Min1_u16 VAR_L2Sampling_RslvCosP_VADC_Max1_u16 VAR_L2Sampling_RslvCosP_VADC_Min1_u16 VAR_L2Sampling_RslvSinN_VADC_Max1_u16 VAR_L2Sampling_RslvSinN_VADC_Min1_u16 VAR_L2Sampling_RslvSinP_VADC_Max1_u16 VAR_L2Sampling_RslvSinP_VADC_Min1_u16 VAR_TRSP_RslvCosNRngChkRslt_b VAR_TRSP_RslvCosNRngErr_b VAR_TRSP_RslvCosPRngChkRslt_b VAR_TRSP_RslvCosPRngErr_b VAR_TRSP_RslvExciNRngChkRslt_b VAR_TRSP_RslvExciNRngErr_b VAR_TRSP_RslvExciPRngChkRslt_b VAR_TRSP_RslvExciPRngErr_b VAR_TRSP_RslvExciRngErr_b VAR_TRSP_RslvRngErr_b VAR_TRSP_RslvSinNRngChkRslt_b VAR_TRSP_RslvSinNRngErr_b VAR_TRSP_RslvSinPRngChkRslt_b VAR_TRSP_RslvSinPRngErr_b VAR_TRSP_RslvSqrtErr_b /end REF_MEASUREMENT
 /begin SUB_GROUP S10_RslvSigCalc S10_RslvSqrtChk /end SUB_GROUP
/end GROUP
/begin GROUP S1_RslvSensVoltChk "SWC_TRSP/SWC_TRSP_100us_sys/RslvSensVoltChk"
 /begin REF_CHARACTERISTIC CAL_TRSP_RslvSensVoltCountTrh_s16 CAL_TRSP_RslvSensVoltDebTrh_s16 CAL_TRSP_RslvSensVoltErrRst_b CAL_TRSP_RslvSensVoltHiLim_u16 CAL_TRSP_RslvSensVoltLoLim_u16 /end REF_CHARACTERISTIC
 /begin REF_MEASUREMENT VAR_TRSP_RslvSensVoltRngChkRslt_b VAR_TRSP_RslvSensVoltRngErr_b /end REF_MEASUREMENT
/end GROUP
/begin MEASUREMENT VAR_Scf_DchaCntAdd_u8 "" UBYTE SWC_SCF_CM_uint8 0 0 0.0 255.0 ECU_ADDRESS 0x70005A34 /end MEASUREMENT
/begin MEASUREMENT VAR_Scf_flgbt15first_b "" UBYTE SWC_SCF_CM_boolean 0 0 0.0 1.0 ECU_ADDRESS 0x70005A00 /end MEASUREMENT
/begin MEASUREMENT VAR_Scf_flgNoWakeSou_b "" UBYTE SWC_SCF_CM_boolean 0 0 0.0 1.0 ECU_ADDRESS 0x70005A17 /end MEASUREMENT
/begin MEASUREMENT VAR_Scf_flgInitOut_b "" UBYTE SWC_SCF_CM_boolean 0 0 0.0 1.0 ECU_ADDRESS 0x70005A19 /end MEASUREMENT
/begin MEASUREMENT VAR_Scf_flgShutDwnOvtimErr_u8 "Êý¾Ý´æ´¢³¬Ê±Ê§°ÜÏÂµç³¬Ê±¹ÊÕÏ±êÖ¾" UBYTE SWC_SCF_CM_uint8 0 0 0.0 255.0 ECU_ADDRESS 0x70005A35 /end MEASUREMENT
/begin MEASUREMENT VAR_STM_UintndTrqErr_b "" UBYTE SWC_STM_CM_boolean 0 0 0.0 1.0 ECU_ADDRESS 0x60000A4A /end MEASUREMENT
/begin MEASUREMENT VAR_STM_UintndSpdMonRslt_b "" UBYTE SWC_STM_CM_boolean 0 0 0.0 1.0 ECU_ADDRESS 0x60000A49 /end MEASUREMENT
/begin MEASUREMENT VAR_STM_UintndSpdErr_b "" UBYTE SWC_STM_CM_boolean 0 0 0.0 1.0 ECU_ADDRESS 0x60000A48 /end MEASUREMENT
/begin MEASUREMENT VAR_STM_UintndTrqMonRslt_b "" UBYTE SWC_STM_CM_boolean 0 0 0.0 1.0 ECU_ADDRESS 0x60000A4B /end MEASUREMENT
/begin MEASUREMENT VAR_SWD_Spd_f32 "" FLOAT32_IEEE SWC_SWD_CM_single 0 0 -24000.0 24000.0 ECU_ADDRESS 0x70005A58 /end MEASUREMENT
/begin MEASUREMENT VAR_SWD_AgRslvDelta0_f32 "" FLOAT32_IEEE SWC_SWD_CM_single 0 0 -10000.0 10000.0 ECU_ADDRESS 0x70005A54 /end MEASUREMENT
/begin MEASUREMENT VAR_SWD_Tan_f32 "" FLOAT32_IEEE SWC_SWD_CM_single 0 0 0.0 1000.0 ECU_ADDRESS 0x70005A4C /end MEASUREMENT
/begin MEASUREMENT VAR_SWD_AgRslv_f32 "" FLOAT32_IEEE SWC_SWD_CM_single 0 0 -360.0 360.0 ECU_ADDRESS 0x70005A44 /end MEASUREMENT
/begin MEASUREMENT VAR_SWD_AgRslv45_f32 "" FLOAT32_IEEE SWC_SWD_CM_single 0 0 -360.0 360.0 ECU_ADDRESS 0x70005A48 /end MEASUREMENT
/begin MEASUREMENT VAR_SWD_AgRslvDelta_f32 "" FLOAT32_IEEE SWC_SWD_CM_single 0 0 -10000.0 10000.0 ECU_ADDRESS 0x70005A50 /end MEASUREMENT
/begin MEASUREMENT VAR_TCF_BlendTrq_f32 "" FLOAT32_IEEE SWC_TCF_CM_single 0 0 -500.0 500.0 ECU_ADDRESS 0x70005A8C /end MEASUREMENT
/begin MEASUREMENT VAR_L2Sampling_DycVMon_f32 "" FLOAT32_IEEE SWC_TCF_CM_single 0 0 0.0 1.0 ECU_ADDRESS 0x70005AA8 /end MEASUREMENT
/begin MEASUREMENT VAR_TCF_PwrTrqTubeH1_f32 "" FLOAT32_IEEE SWC_TCF_CM_single 0 0 -500.0 500.0 ECU_ADDRESS 0x70005A94 /end MEASUREMENT
/begin MEASUREMENT VAR_TCF_Pinput_f32 "" FLOAT32_IEEE SWC_TCF_CM_single 0 0 -200000.0 200000.0 ECU_ADDRESS 0x70005A80 /end MEASUREMENT
/begin MEASUREMENT VAR_TCF_iqAct_f32 "" FLOAT32_IEEE SWC_TCF_CM_single 0 0 -1200.0 1200.0 ECU_ADDRESS 0x70005A68 /end MEASUREMENT
/begin MEASUREMENT VAR_TCF_idAct_f32 "" FLOAT32_IEEE SWC_TCF_CM_single 0 0 -1200.0 1200.0 ECU_ADDRESS 0x70005A6C /end MEASUREMENT
/begin MEASUREMENT VAR_TCF_TrqCalcMonRslt_b "" UBYTE SWC_TCF_CM_boolean 0 0 0.0 1.0 ECU_ADDRESS 0x70005A5D /end MEASUREMENT
/begin MEASUREMENT VAR_L2Sampling_DycUMon_f32 "" FLOAT32_IEEE SWC_TCF_CM_single 0 0 0.0 1.0 ECU_ADDRESS 0x70005AAC /end MEASUREMENT
/begin MEASUREMENT VAR_TCF_nDir_u8 "" UBYTE SWC_TCF_CM_uint8 0 0 0.0 255.0 ECU_ADDRESS 0x70005A60 /end MEASUREMENT
/begin MEASUREMENT VAR_TCF_Is_f32 "" FLOAT32_IEEE SWC_TCF_CM_single 0 0 -1200.0 1200.0 ECU_ADDRESS 0x70005A78 /end MEASUREMENT
/begin MEASUREMENT VAR_TCF_TrqDir_u8 "" UBYTE SWC_TCF_CM_uint8 0 0 0.0 255.0 ECU_ADDRESS 0x70005A5F /end MEASUREMENT
/begin MEASUREMENT VAR_HSPF_StrrTempFlt_f32 "" FLOAT32_IEEE SWC_TCF_CM_single 0 0 0.0 1.0 ECU_ADDRESS 0x70005AA0 /end MEASUREMENT
/begin MEASUREMENT VAR_TCF_CurrAgTrqflt_f32 "" FLOAT32_IEEE SWC_TCF_CM_single 0 0 -500.0 500.0 ECU_ADDRESS 0x70005A74 /end MEASUREMENT
/begin MEASUREMENT VAR_TCF_CurrAgTrqTubeL1_f32 "" FLOAT32_IEEE SWC_TCF_CM_single 0 0 -500.0 500.0 ECU_ADDRESS 0x70005A98 /end MEASUREMENT
/begin MEASUREMENT VAR_TCF_MotorMode_u8 "" UBYTE SWC_TCF_CM_uint8 0 0 0.0 255.0 ECU_ADDRESS 0x70005A5E /end MEASUREMENT
/begin MEASUREMENT VAR_TCF_PwrTrq1_f32 "" FLOAT32_IEEE SWC_TCF_CM_single 0 0 -500.0 500.0 ECU_ADDRESS 0x70005A88 /end MEASUREMENT
/begin MEASUREMENT VAR_TCF_Ploss_f32 "" FLOAT32_IEEE SWC_TCF_CM_single 0 0 -200000.0 200000.0 ECU_ADDRESS 0x70005A84 /end MEASUREMENT
/begin MEASUREMENT VAR_L2Sampling_DycWMon_f32 "" FLOAT32_IEEE SWC_TCF_CM_single 0 0 0.0 1.0 ECU_ADDRESS 0x70005AA4 /end MEASUREMENT
/begin MEASUREMENT VAR_TCF_TrqCalcErr_b "" UBYTE SWC_TCF_CM_boolean 0 0 0.0 1.0 ECU_ADDRESS 0x70005A5C /end MEASUREMENT
/begin MEASUREMENT VAR_TCF_CurrAgTrqTubeH1_f32 "" FLOAT32_IEEE SWC_TCF_CM_single 0 0 -500.0 500.0 ECU_ADDRESS 0x70005A9C /end MEASUREMENT
/begin MEASUREMENT VAR_TCF_LdsubLq_f32 "" FLOAT32_IEEE SWC_TCF_CM_single 0 0 -1.0 1.0 ECU_ADDRESS 0x70005A70 /end MEASUREMENT
/begin MEASUREMENT VAR_TCF_CurrAgTrq1_f32 "" FLOAT32_IEEE SWC_TCF_CM_single 0 0 -500.0 500.0 ECU_ADDRESS 0x70005A64 /end MEASUREMENT
/begin MEASUREMENT VAR_TCF_PwrTrqTubeL1_f32 "" FLOAT32_IEEE SWC_TCF_CM_single 0 0 -500.0 500.0 ECU_ADDRESS 0x70005A90 /end MEASUREMENT
/begin MEASUREMENT VAR_TDC_trqRmp_f32 "Å¤¾ØRampÖµ" FLOAT32_IEEE SWC_TDC_CM_single 0 0 -65535.0 65535.0 ECU_ADDRESS 0x70005ABC /end MEASUREMENT
/begin MEASUREMENT VAR_TpcTmp_CofDertTRiseDbcSave1_f32 "" FLOAT32_IEEE SWC_TPC_CM_single 0 0 -3.4E+38 3.4E+38 ECU_ADDRESS 0x70005E30 /end MEASUREMENT
/begin MEASUREMENT VAR_TpcTmp_tDbcTempFlt_f32 "" FLOAT32_IEEE SWC_TPC_CM_single 0 0 -3.4E+38 3.4E+38 ECU_ADDRESS 0x70005E48 /end MEASUREMENT
/begin MEASUREMENT VAR_TpcTmp_TDbcVHiLimErrState_u8 "DEM´¥·¢×´Ì¬_VÏà¹ýÎÂ¹ÊÕÏ" UBYTE SWC_TPC_CM_uint8 0 0 0 255 ECU_ADDRESS 0x70005C46 /end MEASUREMENT
/begin MEASUREMENT VAR_Tpcblk_TrqLim01_f32 "" FLOAT32_IEEE SWC_TPC_CM_single 0 0 -3.4E+38 3.4E+38 ECU_ADDRESS 0x70005C9C /end MEASUREMENT
/begin MEASUREMENT VAR_TpcSmp_flgElecPwrLimUdrVoltActv_b "Ä¸ÏßÇ·Ñ¹½µµç¶¯¹¦ÂÊ´¥·¢×´Ì¬±êÖ¾" UBYTE SWC_TPC_CM_boolean 0 0 0.0 1.0 ECU_ADDRESS 0x70005C1D /end MEASUREMENT
/begin MEASUREMENT VAR_tpccod_flgMaxDertStrTemp_b "" UBYTE SWC_TPC_CM_boolean 0 0 0 1 ECU_ADDRESS 0x70005C10 /end MEASUREMENT
/begin MEASUREMENT VAR_TpcTmp_ElecTrqLimTcoolant_f32 "ÀäÈ´Ë®ÎÂ¶ÈÏÞÅ¤µç¶¯Å¤¾Ø" FLOAT32_IEEE SWC_TPC_CM_single_Nm 0 0 0.0 310.0 ECU_ADDRESS 0x70005D40 /end MEASUREMENT
/begin MEASUREMENT VAR_TpcSmp_flgGenPwrLimOvrVoltActv_b "Ä¸Ïß¹ýÑ¹½µ·¢µç¹¦ÂÊ´¥·¢×´Ì¬±êÖ¾" UBYTE SWC_TPC_CM_boolean 0 0 0.0 1.0 ECU_ADDRESS 0x70005C20 /end MEASUREMENT
/begin MEASUREMENT VAR_TpcTmp_TIGBTOvHiWarnState_u8 "" UBYTE SWC_TPC_CM_uint8 0 0 0 255 ECU_ADDRESS 0x70005C40 /end MEASUREMENT
/begin MEASUREMENT VAR_TpcCod_GenTrqLim_f32 "·¢µçÅ¤¾ØÏÞÖµ" FLOAT32_IEEE SWC_TPC_CM_single_Nm 0 0 -3.4E+38 3.4E+38 ECU_ADDRESS 0x70005C70 /end MEASUREMENT
/begin MEASUREMENT VAR_tpcsmp_yi_f32 "" FLOAT32_IEEE SWC_TPC_CM_single 0 0 -3.4E+38 3.4E+38 ECU_ADDRESS 0x70005C88 /end MEASUREMENT
/begin MEASUREMENT VAR_TpcTmp_CofDertTcoolant_f32 "ÀäÈ´Ë®ÎÂ¶ÈÏÞÅ¤DeratingÏµÊý" FLOAT32_IEEE SWC_TPC_CM_single 0 0 0.0 1.0 ECU_ADDRESS 0x70005E50 /end MEASUREMENT
/begin MEASUREMENT VAR_TpcMot_CofDertTsttr_f32 "¶¨×ÓÎÂ¶ÈÏÞÅ¤deratingÏµÊý" FLOAT32_IEEE SWC_TPC_CM_single 0 0 0.0 1.0 ECU_ADDRESS 0x70005DF0 /end MEASUREMENT
/begin MEASUREMENT VAR_tpccod_flgMinDertMtrSpd_b "" UBYTE SWC_TPC_CM_boolean 0 0 0 1 ECU_ADDRESS 0x70005C00 /end MEASUREMENT
/begin MEASUREMENT VAR_tpccod_flgMinDertTempDBC_b "" UBYTE SWC_TPC_CM_boolean 0 0 0 1 ECU_ADDRESS 0x70005C04 /end MEASUREMENT
/begin MEASUREMENT VAR_TpcFuv_GenPwrLimDiag_f32 "¹ÊÕÏµÈ¼¶ÏÞÅ¤·¢µç¹¦ÂÊ" FLOAT32_IEEE SWC_TPC_CM_single_KW 0 0 -3.4E+38 3.4E+38 ECU_ADDRESS 0x70005C78 /end MEASUREMENT
/begin MEASUREMENT VAR_TpcTmp_ElecTrqLimTdbc_f32 "DbcÎÂ¶ÈÏÞÅ¤µç¶¯Å¤¾Ø" FLOAT32_IEEE SWC_TPC_CM_single_Nm 0 0 0.0 310.0 ECU_ADDRESS 0x70005D44 /end MEASUREMENT
/begin MEASUREMENT VAR_TpcTmp_CofDertTIGBTSave1_f32 "" FLOAT32_IEEE SWC_TPC_CM_single 0 0 -3.4E+38 3.4E+38 ECU_ADDRESS 0x70005E1C /end MEASUREMENT
/begin MEASUREMENT VAR_TpcSmp_ErrGenOvrCurt_f32 "" FLOAT32_IEEE SWC_TPC_CM_single 0 0 -3.4E+38 3.4E+38 ECU_ADDRESS 0x70005D98 /end MEASUREMENT
/begin MEASUREMENT VAR_TpcSmp_cofDertUdrVoltElec_f32 "Ä¸ÏßÇ·Ñ¹ÏßÐÔ½µµç¶¯¹¦ÂÊderatingÏµÊý" FLOAT32_IEEE SWC_TPC_CM_single 0 0 0.0 1.0 ECU_ADDRESS 0x70005D70 /end MEASUREMENT
/begin MEASUREMENT VAR_TpcCod_GenTrqCalcOvrCurt_f32 "¹ýÁ÷½µ·¢µç¹¦ÂÊÖµ¼ÆËãÅ¤¾Ø" FLOAT32_IEEE SWC_TPC_CM_single_Nm 0 0 -3.4E+38 3.4E+38 ECU_ADDRESS 0x70005CC4 /end MEASUREMENT
/begin MEASUREMENT VAR_tpcsmp_RefPwrGenOvrCurt_f32 "" FLOAT32_IEEE SWC_TPC_CM_single 0 0 -3.4E+38 3.4E+38 ECU_ADDRESS 0x70005D90 /end MEASUREMENT
/begin MEASUREMENT VAR_TpcTmp_TCoolStableDiff_u16 "" SWORD SWC_TPC_CM_int16 0 0 -32768 32767 ECU_ADDRESS 0x70005C62 /end MEASUREMENT
/begin MEASUREMENT VAR_TpcTmp_CofDertTCoolantSave2_f32 "" FLOAT32_IEEE SWC_TPC_CM_single 0 0 -3.4E+38 3.4E+38 ECU_ADDRESS 0x70005E54 /end MEASUREMENT
/begin MEASUREMENT VAR_tpcsmp_KpProduct_f32 "" FLOAT32_IEEE SWC_TPC_CM_single 0 0 -3.4E+38 3.4E+38 ECU_ADDRESS 0x70005DC0 /end MEASUREMENT
/begin MEASUREMENT VAR_tpccod_flgMaxDertTCoolant_b "" UBYTE SWC_TPC_CM_boolean 0 0 0 1 ECU_ADDRESS 0x70005C0E /end MEASUREMENT
/begin MEASUREMENT VAR_TpcTmp_tIgbtRiseTempFlt_u16 "" SWORD SWC_TPC_CM_int16 0 0 -32768 32767 ECU_ADDRESS 0x70005C54 /end MEASUREMENT
/begin MEASUREMENT VAR_TpcTmp_TIgbtStableDiff_u16 "" SWORD SWC_TPC_CM_int16 0 0 -32768 32767 ECU_ADDRESS 0x70005C56 /end MEASUREMENT
/begin MEASUREMENT VAR_TpcSmp_uDcLnkOvVLimErrState_u8 "DEM´¥·¢×´Ì¬_¹ýÑ¹¹ÊÕÏ" UBYTE SWC_TPC_CM_uint8 0 0 0 255 ECU_ADDRESS 0x70005C39 /end MEASUREMENT
/begin MEASUREMENT VAR_tpccod_flgMaxDertOvrUdc_b "" UBYTE SWC_TPC_CM_boolean 0 0 0 1 ECU_ADDRESS 0x70005C08 /end MEASUREMENT
/begin MEASUREMENT VAR_TpcTmp_CofDertDbc_f32 "" FLOAT32_IEEE SWC_TPC_CM_single 0 0 -3.4E+38 3.4E+38 ECU_ADDRESS 0x70005E3C /end MEASUREMENT
/begin MEASUREMENT VAR_TpcSmp_SpdOvHiWarnState_u8 "DEM´¥·¢×´Ì¬_³¬ËÙ±¨¾¯" UBYTE SWC_TPC_CM_uint8 0 0 0 255 ECU_ADDRESS 0x70005C4C /end MEASUREMENT
/begin MEASUREMENT VAR_TpcSmp_flgLinearDertOvrCurtElec_b "Ä¸Ïß¹ýÁ÷ÏßÐÔ½µµç¶¯¹¦ÂÊ´¥·¢×´Ì¬±êÖ¾Î»" UBYTE SWC_TPC_CM_boolean 0 0 0.0 1.0 ECU_ADDRESS 0x70005C29 /end MEASUREMENT
/begin MEASUREMENT VAR_TpcTmp_tIgbtTempFlt_u16 "" SWORD SWC_TPC_CM_int16 0 0 -32768 32767 ECU_ADDRESS 0x70005C58 /end MEASUREMENT
/begin MEASUREMENT VAR_TpcSmp_ElecPwrLinearDertOvrCurt_f32 "Ä¸Ïß¹ýÁ÷ÏßÐÔ½µµç¶¯¹¦ÂÊ" FLOAT32_IEEE SWC_TPC_CM_single_KW 0 0 0.0 150.0 ECU_ADDRESS 0x70005D1C /end MEASUREMENT
/begin MEASUREMENT VAR_tpcsmp_yiDelay_f32 "" FLOAT32_IEEE SWC_TPC_CM_single 0 0 -3.4E+38 3.4E+38 ECU_ADDRESS 0x70005DD4 /end MEASUREMENT
/begin MEASUREMENT VAR_TpcSmp_flgPIDertOvrCurtElec_b "Ä¸Ïß¹ýÁ÷PI½µµç¶¯¹¦ÂÊ´¥·¢×´Ì¬±êÖ¾Î»" UBYTE SWC_TPC_CM_boolean 0 0 0.0 1.0 ECU_ADDRESS 0x70005C28 /end MEASUREMENT
/begin MEASUREMENT VAR_TpcSmp_ElecPwrPIDertUdrVolt_f32 "Ä¸ÏßÇ·Ñ¹PI½µµç¶¯¹¦ÂÊ" FLOAT32_IEEE SWC_TPC_CM_single_KW 0 0 -3.4E+38 3.4E+38 ECU_ADDRESS 0x70005D64 /end MEASUREMENT
/begin MEASUREMENT VAR_tpcsmp_KiProductSum_f32 "" FLOAT32_IEEE SWC_TPC_CM_single 0 0 -3.4E+38 3.4E+38 ECU_ADDRESS 0x70005DC4 /end MEASUREMENT
/begin MEASUREMENT VAR_TpcTmp_CofDertTDbcSave2_f32 "" FLOAT32_IEEE SWC_TPC_CM_single 0 0 -3.4E+38 3.4E+38 ECU_ADDRESS 0x70005E40 /end MEASUREMENT
/begin MEASUREMENT VAR_TpcSmp_GenPwrAlowMax_f32 "" FLOAT32_IEEE SWC_TPC_CM_single 0 0 -3.4E+38 3.4E+38 ECU_ADDRESS 0x70005D9C /end MEASUREMENT
/begin MEASUREMENT VAR_TpcTmp_TDbcRiseStableDiff_u16 "" SWORD SWC_TPC_CM_int16 0 0 -32768 32767 ECU_ADDRESS 0x70005C5A /end MEASUREMENT
/begin MEASUREMENT VAR_tpcsmp_PwrLossGen_f32 "" FLOAT32_IEEE SWC_TPC_CM_single 0 0 -3.4E+38 3.4E+38 ECU_ADDRESS 0x70005D94 /end MEASUREMENT
/begin MEASUREMENT VAR_TpcFuv_ElecPwrLimDiag_f32 "¹ÊÕÏµÈ¼¶ÏÞÅ¤µç¶¯¹¦ÂÊ" FLOAT32_IEEE SWC_TPC_CM_single_KW 0 0 -3.4E+38 3.4E+38 ECU_ADDRESS 0x70005C7C /end MEASUREMENT
/begin MEASUREMENT VAR_TpcCod_GenTrqCalcDiag_f32 "¹ÊÕÏµÈ¼¶½µ·¢µç¹¦ÂÊÖµ¼ÆËãÅ¤¾Ø" FLOAT32_IEEE SWC_TPC_CM_single_Nm 0 0 -3.4E+38 3.4E+38 ECU_ADDRESS 0x70005CB0 /end MEASUREMENT
/begin MEASUREMENT VAR_tpccod_flgMinDertOvrUdc_b "" UBYTE SWC_TPC_CM_boolean 0 0 0 1 ECU_ADDRESS 0x70005BFD /end MEASUREMENT
/begin MEASUREMENT VAR_TpcSmp_GenPwrPIDertOvrVolt_f32 "Ä¸Ïß¹ýÑ¹PI½µ·¢µç¹¦ÂÊ" FLOAT32_IEEE SWC_TPC_CM_single 0 0 -3.4E+38 3.4E+38 ECU_ADDRESS 0x70005CBC /end MEASUREMENT
/begin MEASUREMENT VAR_TpcMot_TSttrOvHiWarnState_u8 "DEM´¥·¢×´Ì¬_¶¨×Ó¹ýÎÂ±¨¾¯" UBYTE SWC_TPC_CM_uint8 0 0 0 255 ECU_ADDRESS 0x70005C3D /end MEASUREMENT
/begin MEASUREMENT VAR_TpcSmp_cofDertOvrSpdElecQuad1_f32 "³¬ËÙÏÞÅ¤µÚÒ»ÏóÏÞ²é±íDeratingÏµÊý" FLOAT32_IEEE SWC_TPC_CM_single 0 0 0.0 1.0 ECU_ADDRESS 0x70005D30 /end MEASUREMENT
/begin MEASUREMENT VAR_tpcsmp_KpProductSau_f32 "" FLOAT32_IEEE SWC_TPC_CM_single 0 0 -3.4E+38 3.4E+38 ECU_ADDRESS 0x70005DBC /end MEASUREMENT
/begin MEASUREMENT VAR_TpcSmp_flgGenTrqLimOvrSpdActv_b "³¬ËÙ½µ·¢µçÅ¤¾Ø´¥·¢×´Ì¬±êÖ¾Î»" UBYTE SWC_TPC_CM_boolean 0 0 0.0 1.0 ECU_ADDRESS 0x70005C12 /end MEASUREMENT
/begin MEASUREMENT VAR_tpccod_flgMinDertTIGBT_b "" UBYTE SWC_TPC_CM_boolean 0 0 0 1 ECU_ADDRESS 0x70005C01 /end MEASUREMENT
/begin MEASUREMENT VAR_TpcSmp_ErrElecOvrCurt_f32 "¹ýÁ÷½µµç¶¯¹¦ÂÊPIÄ£¿é²îÖµÊäÈë" FLOAT32_IEEE SWC_TPC_CM_single 0 0 -3.4E+38 3.4E+38 ECU_ADDRESS 0x70005DCC /end MEASUREMENT
/begin MEASUREMENT VAR_TpcSmp_GenPwrLinearDertOvrVolt_f32 "Ä¸Ïß¹ýÑ¹ÏßÐÔ½µ·¢µç¹¦ÂÊ" FLOAT32_IEEE SWC_TPC_CM_single 0 0 -3.4E+38 3.4E+38 ECU_ADDRESS 0x70005CC0 /end MEASUREMENT
/begin MEASUREMENT VAR_TpcTmp_ElecTrqLimTdrvboard_f32 "Çý¶¯°åÎÂ¶ÈÏÞÅ¤µç¶¯Å¤¾Ø" FLOAT32_IEEE SWC_TPC_CM_single_Nm 0 0 0.0 310.0 ECU_ADDRESS 0x70005D3C /end MEASUREMENT
/begin MEASUREMENT VAR_TpcTmp_CofDertIGBT_f32 "" FLOAT32_IEEE SWC_TPC_CM_single 0 0 -3.4E+38 3.4E+38 ECU_ADDRESS 0x70005E14 /end MEASUREMENT
/begin MEASUREMENT VAR_tpcsmp_GenPwrDert_f32 "" FLOAT32_IEEE SWC_TPC_CM_single 0 0 -3.4E+38 3.4E+38 ECU_ADDRESS 0x70005CD4 /end MEASUREMENT
/begin MEASUREMENT VAR_TpcCod_ElecTrqCalcOvrCurt_f32 "¹ýÁ÷½µµç¶¯¹¦ÂÊÖµ¼ÆËãÅ¤¾Ø" FLOAT32_IEEE SWC_TPC_CM_single_Nm 0 0 -3.4E+38 3.4E+38 ECU_ADDRESS 0x70005D14 /end MEASUREMENT
/begin MEASUREMENT VAR_Tpcblk_TrqLim_f32 "" FLOAT32_IEEE SWC_TPC_CM_single 0 0 -3.4E+38 3.4E+38 ECU_ADDRESS 0x70005CA0 /end MEASUREMENT
/begin MEASUREMENT VAR_TpcMot_CofDertTSttrSave2_f32 "" FLOAT32_IEEE SWC_TPC_CM_single 0 0 -3.4E+38 3.4E+38 ECU_ADDRESS 0x70005DF4 /end MEASUREMENT
/begin MEASUREMENT VAR_TpcTmp_GenTrqLimTIGBTWoRamp_f32 "" FLOAT32_IEEE SWC_TPC_CM_single 0 0 -3.4E+38 3.4E+38 ECU_ADDRESS 0x70005CE8 /end MEASUREMENT
/begin MEASUREMENT VAR_TpcTmp_GenTrqLimTdrvboard_f32 "Çý¶¯°åÎÂ¶ÈÏÞÅ¤·¢µçÅ¤¾Ø" FLOAT32_IEEE SWC_TPC_CM_single_Nm 0 0 -310.0 0.0 ECU_ADDRESS 0x70005CEC /end MEASUREMENT
/begin MEASUREMENT VAR_TpcTmp_TIGBTOvLoWarnState_u8 "" UBYTE SWC_TPC_CM_uint8 0 0 0 255 ECU_ADDRESS 0x70005C3F /end MEASUREMENT
/begin MEASUREMENT VAR_TpcMot_TrqGenExCOrg_f32 "" FLOAT32_IEEE SWC_TPC_CM_single 0 0 -3.4E+38 3.4E+38 ECU_ADDRESS 0x70005D84 /end MEASUREMENT
/begin MEASUREMENT VAR_TpcSmp_flgElecPwrLimOvrCurtActv_b "Ä¸Ïß¹ýÁ÷½µµç¶¯¹¦ÂÊ´¥·¢×´Ì¬±êÖ¾" UBYTE SWC_TPC_CM_boolean 0 0 0.0 1.0 ECU_ADDRESS 0x70005C27 /end MEASUREMENT
/begin MEASUREMENT VAR_TpcFuv_ElecTrqLimDiag_f32 "¹ÊÕÏµÈ¼¶ÏÞÅ¤µç¶¯Å¤¾Ø" FLOAT32_IEEE SWC_TPC_CM_single_Nm 0 0 -3.4E+38 3.4E+38 ECU_ADDRESS 0x70005C84 /end MEASUREMENT
/begin MEASUREMENT VAR_tpcsmp_AddPwrElecOvrCurt_f32 "" FLOAT32_IEEE SWC_TPC_CM_single 0 0 -3.4E+38 3.4E+38 ECU_ADDRESS 0x70005DB0 /end MEASUREMENT
/begin MEASUREMENT VAR_TpcMot_flgStartExcLimRamp_b "" UBYTE SWC_TPC_CM_boolean 0 0 0 1 ECU_ADDRESS 0x70005C22 /end MEASUREMENT
/begin MEASUREMENT VAR_TpcSmp_uDcLnkOvWarnState_u8 "DEM´¥·¢×´Ì¬_¹ýÑ¹±¨¾¯" UBYTE SWC_TPC_CM_uint8 0 0 0 255 ECU_ADDRESS 0x70005C38 /end MEASUREMENT
/begin MEASUREMENT VAR_TpcCod_PowerAdd_f32 "" FLOAT32_IEEE SWC_TPC_CM_single 0 0 -3.4E+38 3.4E+38 ECU_ADDRESS 0x70005D60 /end MEASUREMENT
/begin MEASUREMENT VAR_TpcSmp_cofDertOvrSpdElecQuad3_f32 "³¬ËÙÏÞÅ¤µÚÈýÏóÏÞ²é±íDeratingÏµÊý" FLOAT32_IEEE SWC_TPC_CM_single 0 0 0.0 1.0 ECU_ADDRESS 0x70005D2C /end MEASUREMENT
/begin MEASUREMENT VAR_TpcSmp_flgElecTrqLimOvrSpdActv_b "³¬ËÙ½µµç¶¯Å¤¾Ø´¥·¢×´Ì¬±êÖ¾Î»" UBYTE SWC_TPC_CM_boolean 0 0 0.0 1.0 ECU_ADDRESS 0x70005C13 /end MEASUREMENT
/begin MEASUREMENT VAR_TpcSmp_TrqMaxCanSet_f32 "CANÖ¸ÁîÏÞÅ¤×î´óÅ¤¾Ø" FLOAT32_IEEE SWC_TPC_CM_single 0 0 -3.4E+38 3.4E+38 ECU_ADDRESS 0x70005CAC /end MEASUREMENT
/begin MEASUREMENT VAR_TpcMot_GenTrqLimTsttrWoRamp_f32 "" FLOAT32_IEEE SWC_TPC_CM_single 0 0 -3.4E+38 3.4E+38 ECU_ADDRESS 0x70005D00 /end MEASUREMENT
/begin MEASUREMENT VAR_TpcTmp_TDbcWHiLimErrState_u8 "DEM´¥·¢×´Ì¬_WÏà¹ýÎÂ¹ÊÕÏ" UBYTE SWC_TPC_CM_uint8 0 0 0 255 ECU_ADDRESS 0x70005C44 /end MEASUREMENT
/begin MEASUREMENT VAR_tpccod_flgMaxDertMtrSpd_b "" UBYTE SWC_TPC_CM_boolean 0 0 0 1 ECU_ADDRESS 0x70005C0B /end MEASUREMENT
/begin MEASUREMENT VAR_TpcSmp_cofDertOvrCurtGen_f32 "Ä¸Ïß¹ýÁ÷ÏßÐÔ½µ·¢µç¹¦ÂÊderatingÏµÊý" FLOAT32_IEEE SWC_TPC_CM_single 0 0 0.0 1.0 ECU_ADDRESS 0x70005DA0 /end MEASUREMENT
/begin MEASUREMENT VAR_TpcFuv_FimPwrLimLv1_b "Ò»¼¶¹ÊÕÏÏÞ¹¦ÂÊFIM×´Ì¬" UBYTE SWC_TPC_CM_boolean 0 0 0 1 ECU_ADDRESS 0x70005C17 /end MEASUREMENT
/begin MEASUREMENT VAR_TpcSmp_GenTrqLimOvrSpd_f32 "³¬ËÙÏÞÅ¤·¢µçÅ¤¾Ø" FLOAT32_IEEE SWC_TPC_CM_single 0 0 -3.4E+38 3.4E+38 ECU_ADDRESS 0x70005CD8 /end MEASUREMENT
/begin MEASUREMENT VAR_TpcSmp_GenPwrPIDertOvrCurt_f32 "Ä¸Ïß¹ýÁ÷PI½µ·¢µç¹¦ÂÊ" FLOAT32_IEEE SWC_TPC_CM_single_KW 0 0 -3.4E+38 3.4E+38 ECU_ADDRESS 0x70005CD0 /end MEASUREMENT
/begin MEASUREMENT VAR_tpcsmp_posOutputjudge_f32 "" FLOAT32_IEEE SWC_TPC_CM_single 0 0 -3.4E+38 3.4E+38 ECU_ADDRESS 0x70005C90 /end MEASUREMENT
/begin MEASUREMENT VAR_TpcSmp_flgLinearDertOvrVoltGen_b "Ä¸Ïß¹ýÑ¹ÏßÐÔ½µ·¢µç¹¦ÂÊ´¥·¢×´Ì¬±êÖ¾Î»" UBYTE SWC_TPC_CM_boolean 0 0 0.0 1.0 ECU_ADDRESS 0x70005C23 /end MEASUREMENT
/begin MEASUREMENT VAR_TpcFuv_FimPwrLimLv2_b "¶þ¼¶¹ÊÕÏÏÞ¹¦ÂÊFIM×´Ì¬" UBYTE SWC_TPC_CM_boolean 0 0 0 1 ECU_ADDRESS 0x70005C16 /end MEASUREMENT
/begin MEASUREMENT VAR_TpcTmp_ElecTrqLimTIGBT_f32 "" FLOAT32_IEEE SWC_TPC_CM_single 0 0 -3.4E+38 3.4E+38 ECU_ADDRESS 0x70005D34 /end MEASUREMENT
/begin MEASUREMENT VAR_TpcSmp_GenPwrLinearDertOvrCurt_f32 "Ä¸Ïß¹ýÁ÷ÏßÐÔ½µ·¢µç¹¦ÂÊ" FLOAT32_IEEE SWC_TPC_CM_single_KW 0 0 -150.0 0.0 ECU_ADDRESS 0x70005CCC /end MEASUREMENT
/begin MEASUREMENT VAR_TpcMot_tSttrTempFlt_u16 "" SWORD SWC_TPC_CM_int16 0 0 -32768 32767 ECU_ADDRESS 0x70005C50 /end MEASUREMENT
/begin MEASUREMENT VAR_tpccod_flgMinDertUndrUdc_b "" UBYTE SWC_TPC_CM_boolean 0 0 0 1 ECU_ADDRESS 0x70005BFE /end MEASUREMENT
/begin MEASUREMENT VAR_tpccod_flgMaxDertTDrvBoard_b "" UBYTE SWC_TPC_CM_boolean 0 0 0 1 ECU_ADDRESS 0x70005C0D /end MEASUREMENT
/begin MEASUREMENT VAR_TpcCod_ElecTrqLim_f32 "µç¶¯Å¤¾ØÏÞÖµ" FLOAT32_IEEE SWC_TPC_CM_single_Nm 0 0 -3.4E+38 3.4E+38 ECU_ADDRESS 0x70005C6C /end MEASUREMENT
/begin MEASUREMENT VAR_TpcFuv_FimPwrLimLv3_b "Èý¼¶¹ÊÕÏÏÞ¹¦ÂÊFIM×´Ì¬" UBYTE SWC_TPC_CM_boolean 0 0 0 1 ECU_ADDRESS 0x70005C15 /end MEASUREMENT
/begin MEASUREMENT VAR_TpcMot_CofDertTRiseSttr_f32 "" FLOAT32_IEEE SWC_TPC_CM_single 0 0 -3.4E+38 3.4E+38 ECU_ADDRESS 0x70005DE0 /end MEASUREMENT
/begin MEASUREMENT VAR_TpcTmp_TIgbtRiseStableDiff_u16 "" SWORD SWC_TPC_CM_int16 0 0 -32768 32767 ECU_ADDRESS 0x70005C52 /end MEASUREMENT
/begin MEASUREMENT VAR_TpcTmp_tDbcMax_f32 "ÈýÏàDbcÎÂ¶È×î´óÖµ" FLOAT32_IEEE SWC_TPC_CM_single__ 0 0 -3.4E+38 3.4E+38 ECU_ADDRESS 0x70005E4C /end MEASUREMENT
/begin MEASUREMENT VAR_tpcsmp_negOutputjudge_f32 "" FLOAT32_IEEE SWC_TPC_CM_single 0 0 -3.4E+38 3.4E+38 ECU_ADDRESS 0x70005C8C /end MEASUREMENT
/begin MEASUREMENT VAR_TpcMot_TSttrOvLoWarnState_u8 "DEM´¥·¢×´Ì¬_¶¨×ÓÎÂ¶È¹ýµÍ±¨¾¯" UBYTE SWC_TPC_CM_uint8 0 0 0 255 ECU_ADDRESS 0x70005C3C /end MEASUREMENT
/begin MEASUREMENT VAR_TpcMot_CofDertTRiseSttrSave2_f32 "" FLOAT32_IEEE SWC_TPC_CM_single 0 0 -3.4E+38 3.4E+38 ECU_ADDRESS 0x70005DE4 /end MEASUREMENT
/begin MEASUREMENT VAR_TpcTmp_tRiseDbc_f32 "" FLOAT32_IEEE SWC_TPC_CM_single 0 0 -3.4E+38 3.4E+38 ECU_ADDRESS 0x70005E38 /end MEASUREMENT
/begin MEASUREMENT VAR_TpcTmp_CofDertTdrvboard_f32 "Çý¶¯°åÎÂ¶ÈÏÞÅ¤DeratingÏµÊý" FLOAT32_IEEE SWC_TPC_CM_single 0 0 0.0 1.0 ECU_ADDRESS 0x70005E24 /end MEASUREMENT
/begin MEASUREMENT VAR_TpcTmp_CofDertTRiseIGBTSave2_f32 "" FLOAT32_IEEE SWC_TPC_CM_single 0 0 -3.4E+38 3.4E+38 ECU_ADDRESS 0x70005E04 /end MEASUREMENT
/begin MEASUREMENT VAR_TpcTmp_tDbcTempFlt_u16 "" SWORD SWC_TPC_CM_int16 0 0 -32768 32767 ECU_ADDRESS 0x70005C60 /end MEASUREMENT
/begin MEASUREMENT VAR_TpcFuv_FimPwrLimLv4_b "ËÄ¼¶¹ÊÕÏÏÞ¹¦ÂÊFIM×´Ì¬" UBYTE SWC_TPC_CM_boolean 0 0 0 1 ECU_ADDRESS 0x70005C14 /end MEASUREMENT
/begin MEASUREMENT VAR_TpcSmp_ElecPwrLimOvrCurt_f32 "Ä¸Ïß¹ýÁ÷½µµç¶¯¹¦ÂÊ" FLOAT32_IEEE SWC_TPC_CM_single_KW 0 0 -3.4E+38 3.4E+38 ECU_ADDRESS 0x70005D18 /end MEASUREMENT
/begin MEASUREMENT VAR_Tpcblk_TrqMax_f32 "" FLOAT32_IEEE SWC_TPC_CM_single 0 0 -3.4E+38 3.4E+38 ECU_ADDRESS 0x70005C98 /end MEASUREMENT
/begin MEASUREMENT VAR_tpccod_flgMaxDertTempDBC_b "" UBYTE SWC_TPC_CM_boolean 0 0 0 1 ECU_ADDRESS 0x70005C0F /end MEASUREMENT
/begin MEASUREMENT VAR_TpcTmp_GenTrqLimTcoolant_f32 "ÀäÈ´Ë®ÎÂ¶ÈÏÞÅ¤·¢µçÅ¤¾Ø" FLOAT32_IEEE SWC_TPC_CM_single_Nm 0 0 -310.0 0.0 ECU_ADDRESS 0x70005CF0 /end MEASUREMENT
/begin MEASUREMENT VAR_TpcSmp_flgLinearDertOveCurtGen_b "Ä¸Ïß¹ýÁ÷ÏßÐÔ½µ·¢µç¹¦ÂÊ´¥·¢×´Ì¬±êÖ¾Î»" UBYTE SWC_TPC_CM_boolean 0 0 0.0 1.0 ECU_ADDRESS 0x70005C26 /end MEASUREMENT
/begin MEASUREMENT VAR_tpccod_flgMinDertTCoolant_b "" UBYTE SWC_TPC_CM_boolean 0 0 0 1 ECU_ADDRESS 0x70005C03 /end MEASUREMENT
/begin MEASUREMENT VAR_TpcSmp_GenPwrLimOvrVolt_f32 "Ä¸Ïß¹ýÑ¹½µ·¢µç¹¦ÂÊ" FLOAT32_IEEE SWC_TPC_CM_single 0 0 -3.4E+38 3.4E+38 ECU_ADDRESS 0x70005CB8 /end MEASUREMENT
/begin MEASUREMENT VAR_TpcSmp_iDcLnkMax_f32 "ÏÞ·ùµÄµç³ØÔÊÐí×î´ó·ÅµçµçÁ÷" FLOAT32_IEEE SWC_TPC_CM_single_A 0 0 -3.4E+38 3.4E+38 ECU_ADDRESS 0x70005DDC /end MEASUREMENT
/begin MEASUREMENT VAR_TpcTmp_flgTrqLimTdrvboardActv_b "Çý¶¯°åÎÂ¶ÈÏÞÅ¤´¥·¢×´Ì¬±êÖ¾Î»" UBYTE SWC_TPC_CM_boolean 0 0 0.0 1.0 ECU_ADDRESS 0x70005C2C /end MEASUREMENT
/begin MEASUREMENT VAR_TpcMot_GenTrqRef_f32 "TpcMotÄ£¿é»ù×¼·¢µçÅ¤¾Ø" FLOAT32_IEEE SWC_TPC_CM_single_Nm 0 0 -310.0 0.0 ECU_ADDRESS 0x70005D24 /end MEASUREMENT
/begin MEASUREMENT VAR_TpcTmp_tCoolantOperationMode_u8 "" UBYTE SWC_TPC_CM_uint8 0 0 0 255 ECU_ADDRESS 0x70005C31 /end MEASUREMENT
/begin MEASUREMENT VAR_TpcTmp_TDbcVLoLimErrState_u8 "DEM´¥·¢×´Ì¬_VÏàÎÂ¶È¹ýµÍ¹ÊÕÏ" UBYTE SWC_TPC_CM_uint8 0 0 0 255 ECU_ADDRESS 0x70005C45 /end MEASUREMENT
/begin MEASUREMENT VAR_tpccod_flgMaxDertExCTrq_b "" UBYTE SWC_TPC_CM_boolean 0 0 0 1 ECU_ADDRESS 0x70005C11 /end MEASUREMENT
/begin MEASUREMENT VAR_TpcBlk_IsValid_f32 "" FLOAT32_IEEE SWC_TPC_CM_single 0 0 -3.4E+38 3.4E+38 ECU_ADDRESS 0x70005CA4 /end MEASUREMENT
/begin MEASUREMENT VAR_TpcTmp_CofDertTRiseDbcSave2_f32 "" FLOAT32_IEEE SWC_TPC_CM_single 0 0 -3.4E+38 3.4E+38 ECU_ADDRESS 0x70005E2C /end MEASUREMENT
/begin MEASUREMENT VAR_tpcsmp_ElecPwrDert_f32 "" FLOAT32_IEEE SWC_TPC_CM_single 0 0 -3.4E+38 3.4E+38 ECU_ADDRESS 0x70005D20 /end MEASUREMENT
/begin MEASUREMENT VAR_TpcTmp_tDbcRiseTempFlt_u16 "" SWORD SWC_TPC_CM_int16 0 0 -32768 32767 ECU_ADDRESS 0x70005C5C /end MEASUREMENT
/begin MEASUREMENT VAR_TpcTmp_TCoolantOvHiWarnState_u8 "DEM´¥·¢×´Ì¬_ÀäÈ´Ë®¹ýÎÂ±¨¾¯" UBYTE SWC_TPC_CM_uint8 0 0 0 255 ECU_ADDRESS 0x70005C4B /end MEASUREMENT
/begin MEASUREMENT VAR_TpcSmp_flgPIDertOvrVoltGen_b "Ä¸Ïß¹ýÑ¹PI½µ·¢µç¹¦ÂÊ´¥·¢×´Ì¬±êÖ¾Î»" UBYTE SWC_TPC_CM_boolean 0 0 0.0 1.0 ECU_ADDRESS 0x70005C21 /end MEASUREMENT
/begin MEASUREMENT VAR_TpcSmp_iDcLnkOvCLimErrState_u8 "DEM´¥·¢×´Ì¬_¹ýÁ÷¹ÊÕÏ" UBYTE SWC_TPC_CM_uint8 0 0 0 255 ECU_ADDRESS 0x70005C3B /end MEASUREMENT
/begin MEASUREMENT VAR_TpcTmp_CofDertTCoolantSave1_f32 "" FLOAT32_IEEE SWC_TPC_CM_single 0 0 -3.4E+38 3.4E+38 ECU_ADDRESS 0x70005E58 /end MEASUREMENT
/begin MEASUREMENT VAR_TpcCod_CoolantFlowReq_f32 "" FLOAT32_IEEE SWC_TPC_CM_single 0 0 -3.4E+38 3.4E+38 ECU_ADDRESS 0x70005C68 /end MEASUREMENT
/begin MEASUREMENT VAR_TpcTmp_TDbcStableDiff_u16 "" SWORD SWC_TPC_CM_int16 0 0 -32768 32767 ECU_ADDRESS 0x70005C5E /end MEASUREMENT
/begin MEASUREMENT VAR_tpccod_flgMinDertTDrvBoard_b "" UBYTE SWC_TPC_CM_boolean 0 0 0 1 ECU_ADDRESS 0x70005C02 /end MEASUREMENT
/begin MEASUREMENT VAR_TpcMot_ElecTrqLimTsttr_f32 "¶¨×ÓÎÂ¶ÈÏÞÅ¤µç¶¯Å¤¾Ø" FLOAT32_IEEE SWC_TPC_CM_single_Nm 0 0 0.0 310.0 ECU_ADDRESS 0x70005D4C /end MEASUREMENT
/begin MEASUREMENT VAR_TpcTmp_CofDertTIGBTSave2_f32 "" FLOAT32_IEEE SWC_TPC_CM_single 0 0 -3.4E+38 3.4E+38 ECU_ADDRESS 0x70005E18 /end MEASUREMENT
/begin MEASUREMENT VAR_TpcMot_GenTrqLimTsttr_f32 "¶¨×ÓÎÂ¶ÈÏÞÅ¤·¢µçÅ¤¾Ø" FLOAT32_IEEE SWC_TPC_CM_single_Nm 0 0 -310.0 0.0 ECU_ADDRESS 0x70005CFC /end MEASUREMENT
/begin MEASUREMENT VAR_TpcCod_GenTrqCalcOvrVolt_f32 "Ç·Ñ¹½µ·¢µç¹¦ÂÊÖµ¼ÆËãÅ¤¾Ø" FLOAT32_IEEE SWC_TPC_CM_single_Nm 0 0 -3.4E+38 3.4E+38 ECU_ADDRESS 0x70005CB4 /end MEASUREMENT
/begin MEASUREMENT VAR_TpcSmp_ElecTrqLimOvrSpd_f32 "³¬ËÙÏÞÅ¤µç¶¯Å¤¾Ø" FLOAT32_IEEE SWC_TPC_CM_single 0 0 -3.4E+38 3.4E+38 ECU_ADDRESS 0x70005D28 /end MEASUREMENT
/begin MEASUREMENT VAR_tpccod_flgMinDertExCTrq_b "" UBYTE SWC_TPC_CM_boolean 0 0 0 1 ECU_ADDRESS 0x70005C06 /end MEASUREMENT
/begin MEASUREMENT VAR_TpcSmp_ElecPwrLinearDertUdrVolt_f32 "Ä¸ÏßÇ·Ñ¹ÏßÐÔ½µµç¶¯¹¦ÂÊ" FLOAT32_IEEE SWC_TPC_CM_single_KW 0 0 -3.4E+38 3.4E+38 ECU_ADDRESS 0x70005D10 /end MEASUREMENT
/begin MEASUREMENT VAR_tpccod_flgMinDertStrTemp_b "" UBYTE SWC_TPC_CM_boolean 0 0 0 1 ECU_ADDRESS 0x70005C05 /end MEASUREMENT
/begin MEASUREMENT VAR_TpcTmp_CofDertTDbcSave1_f32 "" FLOAT32_IEEE SWC_TPC_CM_single 0 0 -3.4E+38 3.4E+38 ECU_ADDRESS 0x70005E44 /end MEASUREMENT
/begin MEASUREMENT VAR_TpcTmp_tRiseIGBT_f32 "" FLOAT32_IEEE SWC_TPC_CM_single 0 0 -3.4E+38 3.4E+38 ECU_ADDRESS 0x70005E10 /end MEASUREMENT
/begin MEASUREMENT VAR_TpcMot_TSttrOvHiLimErrState_u8 "DEM´¥·¢×´Ì¬_¶¨×Ó¹ýÎÂ¹ÊÕÏ" UBYTE SWC_TPC_CM_uint8 0 0 0 255 ECU_ADDRESS 0x70005C3E /end MEASUREMENT
/begin MEASUREMENT VAR_TpcSmp_flgPIDertOvrCurtGen_b "Ä¸Ïß¹ýÁ÷PI½µ·¢µç¹¦ÂÊ´¥·¢×´Ì¬±êÖ¾Î»" UBYTE SWC_TPC_CM_boolean 0 0 0.0 1.0 ECU_ADDRESS 0x70005C25 /end MEASUREMENT
/begin MEASUREMENT VAR_TpcSmp_ElecPwrPIDertOvrCurt_f32 "Ä¸Ïß¹ýÁ÷PI½µµç¶¯¹¦ÂÊ" FLOAT32_IEEE SWC_TPC_CM_single_KW 0 0 -3.4E+38 3.4E+38 ECU_ADDRESS 0x70005DA8 /end MEASUREMENT
/begin MEASUREMENT VAR_TpcMot_TsttrStableDiff_u16 "" SWORD SWC_TPC_CM_int16 0 0 -32768 32767 ECU_ADDRESS 0x70005C4E /end MEASUREMENT
/begin MEASUREMENT VAR_TpcSmp_iDcLnkOvcWarnState_u8 "DEM´¥·¢×´Ì¬_¹ýÁ÷±¨¾¯" UBYTE SWC_TPC_CM_uint8 0 0 0 255 ECU_ADDRESS 0x70005C3A /end MEASUREMENT
/begin MEASUREMENT VAR_tpcsmp_PIOutput_f32 "" FLOAT32_IEEE SWC_TPC_CM_single 0 0 -3.4E+38 3.4E+38 ECU_ADDRESS 0x70005DB8 /end MEASUREMENT
/begin MEASUREMENT VAR_TpcCod_flgMotorElecMode_b "µç»ú´¦ÓÚµç¶¯Ä£Ê½±êÖ¾Î»" UBYTE SWC_TPC_CM_boolean 0 0 0.0 1.0 ECU_ADDRESS 0x70005C1C /end MEASUREMENT
/begin MEASUREMENT VAR_TpcTmp_tRiseIGBTOperationMode_u8 "" UBYTE SWC_TPC_CM_uint8 0 0 0 255 ECU_ADDRESS 0x70005C35 /end MEASUREMENT
/begin MEASUREMENT VAR_TpcTmp_tIGBTTempFlt_f32 "" FLOAT32_IEEE SWC_TPC_CM_single 0 0 -3.4E+38 3.4E+38 ECU_ADDRESS 0x70005E20 /end MEASUREMENT
/begin MEASUREMENT VAR_tpccod_flgMaxDertOvrIdc_b "" UBYTE SWC_TPC_CM_boolean 0 0 0 1 ECU_ADDRESS 0x70005C0A /end MEASUREMENT
/begin MEASUREMENT VAR_TpcSmp_SpdOvHiLimErrState_u8 "DEM´¥·¢×´Ì¬_³¬ËÙ¹ÊÕÏ" UBYTE SWC_TPC_CM_uint8 0 0 0 255 ECU_ADDRESS 0x70005C4D /end MEASUREMENT
/begin MEASUREMENT VAR_TpcMot_tRiseSttr_f32 "" FLOAT32_IEEE SWC_TPC_CM_single 0 0 -3.4E+38 3.4E+38 ECU_ADDRESS 0x70005DEC /end MEASUREMENT
/begin MEASUREMENT VAR_TpcCod_ElecTrqCalcDiag_f32 "¹ÊÕÏµÈ¼¶½µµç¶¯¹¦ÂÊÖµ¼ÆËãÅ¤¾Ø" FLOAT32_IEEE SWC_TPC_CM_single_Nm 0 0 -3.4E+38 3.4E+38 ECU_ADDRESS 0x70005D04 /end MEASUREMENT
/begin MEASUREMENT VAR_TpcTmp_tRiseIGBTFlt_f32 "" FLOAT32_IEEE SWC_TPC_CM_single 0 0 -3.4E+38 3.4E+38 ECU_ADDRESS 0x70005E0C /end MEASUREMENT
/begin MEASUREMENT VAR_TpcMot_ElecTrqRef_f32 "TpcMotÄ£¿é»ù×¼µç¶¯Å¤¾Ø" FLOAT32_IEEE SWC_TPC_CM_single_Nm 0 0 0.0 310.0 ECU_ADDRESS 0x70005D54 /end MEASUREMENT
/begin MEASUREMENT VAR_TpcTmp_TDbcUHiLimErrState_u8 "DEM´¥·¢×´Ì¬_UÏà¹ýÎÂ¹ÊÕÏ" UBYTE SWC_TPC_CM_uint8 0 0 0 255 ECU_ADDRESS 0x70005C48 /end MEASUREMENT
/begin MEASUREMENT VAR_TpcMot_CofDertTSttrSave1_f32 "" FLOAT32_IEEE SWC_TPC_CM_single 0 0 -3.4E+38 3.4E+38 ECU_ADDRESS 0x70005DF8 /end MEASUREMENT
/begin MEASUREMENT VAR_TpcTmp_tRiseDbcFlt_f32 "" FLOAT32_IEEE SWC_TPC_CM_single 0 0 -3.4E+38 3.4E+38 ECU_ADDRESS 0x70005E34 /end MEASUREMENT
/begin MEASUREMENT VAR_TpcSmp_cofDertOvrSpdGenQuad2_f32 "³¬ËÙÏÞÅ¤µÚ¶þÏóÏÞ²é±íDeratingÏµÊý" FLOAT32_IEEE SWC_TPC_CM_single 0 0 0.0 1.0 ECU_ADDRESS 0x70005CDC /end MEASUREMENT
/begin MEASUREMENT VAR_Tpcblk_TrqMin_f32 "" FLOAT32_IEEE SWC_TPC_CM_single 0 0 -3.4E+38 3.4E+38 ECU_ADDRESS 0x70005C94 /end MEASUREMENT
/begin MEASUREMENT VAR_TpcSmp_uDcLnkMin_f32 "ÏÞ·ùµÄµç³ØÔÊÐí×îÐ¡·ÅµçµçÑ¹" FLOAT32_IEEE SWC_TPC_CM_single_V 0 0 -3.4E+38 3.4E+38 ECU_ADDRESS 0x70005D74 /end MEASUREMENT
/begin MEASUREMENT VAR_TpcTmp_TDbcOvHiWarnState_u8 "DEM´¥·¢×´Ì¬_DBC¹ýÎÂ±¨¾¯" UBYTE SWC_TPC_CM_uint8 0 0 0 255 ECU_ADDRESS 0x70005C4A /end MEASUREMENT
/begin MEASUREMENT VAR_TpcCod_ElecTrqCalcUdrVolt_f32 "Ç·Ñ¹½µµç¶¯¹¦ÂÊÖµ¼ÆËãÅ¤¾Ø" FLOAT32_IEEE SWC_TPC_CM_single_Nm 0 0 -3.4E+38 3.4E+38 ECU_ADDRESS 0x70005D08 /end MEASUREMENT
/begin MEASUREMENT VAR_TpcTmp_TIGBTOvHiErrState_u8 "" UBYTE SWC_TPC_CM_uint8 0 0 0 255 ECU_ADDRESS 0x70005C41 /end MEASUREMENT
/begin MEASUREMENT VAR_TpcSmp_uDcLnkUnVLimErrState_u8 "DEM´¥·¢×´Ì¬_Ç·Ñ¹¹ÊÕÏ" UBYTE SWC_TPC_CM_uint8 0 0 0 255 ECU_ADDRESS 0x70005C37 /end MEASUREMENT
/begin MEASUREMENT VAR_TpcFuv_FimTrqLimLv1_b "Ò»¼¶¹ÊÕÏÏÞÅ¤¾ØFIM×´Ì¬" UBYTE SWC_TPC_CM_boolean 0 0 0 1 ECU_ADDRESS 0x70005C1B /end MEASUREMENT
/begin MEASUREMENT VAR_TpcSmp_iDcLnkMin_f32 "ÏÞ·ùµÄµç³ØÔÊÐí×î´ó³äµçµçÁ÷" FLOAT32_IEEE SWC_TPC_CM_single_A 0 0 -3.4E+38 3.4E+38 ECU_ADDRESS 0x70005DA4 /end MEASUREMENT
/begin MEASUREMENT VAR_TpcTmp_GenTrqLimTdbcWoRamp_f32 "" FLOAT32_IEEE SWC_TPC_CM_single 0 0 -3.4E+38 3.4E+38 ECU_ADDRESS 0x70005CF8 /end MEASUREMENT
/begin MEASUREMENT VAR_TpcTmp_flgTrqLimTcoolantActv_b "ÀäÈ´Ë®ÎÂ¶ÈÏÞÅ¤´¥·¢×´Ì¬±êÖ¾Î»" UBYTE SWC_TPC_CM_boolean 0 0 0.0 1.0 ECU_ADDRESS 0x70005C2E /end MEASUREMENT
/begin MEASUREMENT VAR_tpccod_flgMaxDertUndrUdc_b "" UBYTE SWC_TPC_CM_boolean 0 0 0 1 ECU_ADDRESS 0x70005C09 /end MEASUREMENT
/begin MEASUREMENT VAR_TpcTmp_tIGBTOperationMode_u8 "" UBYTE SWC_TPC_CM_uint8 0 0 0 255 ECU_ADDRESS 0x70005C34 /end MEASUREMENT
/begin MEASUREMENT VAR_tpcsmp_RefPwrElecOvrCurt_f32 "" FLOAT32_IEEE SWC_TPC_CM_single 0 0 -3.4E+38 3.4E+38 ECU_ADDRESS 0x70005DAC /end MEASUREMENT
/begin MEASUREMENT VAR_TpcTmp_ElecTrqLimTdbcWoRamp_f32 "" FLOAT32_IEEE SWC_TPC_CM_single 0 0 -3.4E+38 3.4E+38 ECU_ADDRESS 0x70005D48 /end MEASUREMENT
/begin MEASUREMENT VAR_TpcMot_GenPwrRef_f32 "TpcMotÏÞÅ¤»ù×¼·¢µç¹¦ÂÊ" FLOAT32_IEEE SWC_TPC_CM_single_KW 0 0 -150.0 0.0 ECU_ADDRESS 0x70005D78 /end MEASUREMENT
/begin MEASUREMENT VAR_tpccod_flgMinDertOvrIdc_b "" UBYTE SWC_TPC_CM_boolean 0 0 0 1 ECU_ADDRESS 0x70005BFF /end MEASUREMENT
/begin MEASUREMENT VAR_tpcsmp_KiProduct_f32 "" FLOAT32_IEEE SWC_TPC_CM_single 0 0 -3.4E+38 3.4E+38 ECU_ADDRESS 0x70005DC8 /end MEASUREMENT
/begin MEASUREMENT VAR_TpcTmp_tCoolantTempFlt_f32 "" FLOAT32_IEEE SWC_TPC_CM_single 0 0 -3.4E+38 3.4E+38 ECU_ADDRESS 0x70005E5C /end MEASUREMENT
/begin MEASUREMENT VAR_TpcSmp_uDcLnkMax_f32 "ÏÞ·ùµÄµç³ØÔÊÐí×î´ó³äµçµçÑ¹" FLOAT32_IEEE SWC_TPC_CM_single_V 0 0 -3.4E+38 3.4E+38 ECU_ADDRESS 0x70005D8C /end MEASUREMENT
/begin MEASUREMENT VAR_TpcBlk_IsSum_f32 "" FLOAT32_IEEE SWC_TPC_CM_single 0 0 -3.4E+38 3.4E+38 ECU_ADDRESS 0x70005C74 /end MEASUREMENT
/begin MEASUREMENT VAR_TpcFuv_FimTrqLimLv2_b "¶þ¼¶¹ÊÕÏÏÞÅ¤¾ØFIM×´Ì¬" UBYTE SWC_TPC_CM_boolean 0 0 0 1 ECU_ADDRESS 0x70005C1A /end MEASUREMENT
/begin MEASUREMENT VAR_TpcSmp_cofDertOvrSpdGenQuad4_f32 "³¬ËÙÏÞÅ¤µÚËÄÏóÏÞ²é±íDeratingÏµÊý" FLOAT32_IEEE SWC_TPC_CM_single 0 0 0.0 1.0 ECU_ADDRESS 0x70005CE0 /end MEASUREMENT
/begin MEASUREMENT VAR_TpcTmp_tDbcOperationMode_u8 "" UBYTE SWC_TPC_CM_uint8 0 0 0 255 ECU_ADDRESS 0x70005C32 /end MEASUREMENT
/begin MEASUREMENT VAR_TpcTmp_TDrvBoardOvHiWarnState_u8 "DEM´¥·¢×´Ì¬_Çý¶¯°å¹ýÎÂ±¨¾¯" UBYTE SWC_TPC_CM_uint8 0 0 0 255 ECU_ADDRESS 0x70005C42 /end MEASUREMENT
/begin MEASUREMENT VAR_TpcCod_CoolantFlowFinReq_f32 "" FLOAT32_IEEE SWC_TPC_CM_single 0 0 -3.4E+38 3.4E+38 ECU_ADDRESS 0x70005D58 /end MEASUREMENT
/begin MEASUREMENT VAR_TpcTmp_TDbcWLoLimErrState_u8 "DEM´¥·¢×´Ì¬_WÏàÎÂ¶È¹ýµÍ¹ÊÕÏ" UBYTE SWC_TPC_CM_uint8 0 0 0 255 ECU_ADDRESS 0x70005C43 /end MEASUREMENT
/begin MEASUREMENT VAR_TpcFuv_GenTrqLimDiag_f32 "¹ÊÕÏµÈ¼¶ÏÞÅ¤·¢µçÅ¤¾Ø" FLOAT32_IEEE SWC_TPC_CM_single_Nm 0 0 -3.4E+38 3.4E+38 ECU_ADDRESS 0x70005C80 /end MEASUREMENT
/begin MEASUREMENT VAR_TpcTmp_flgTrqLimTdbcActv_b "DbcÎÂ¶ÈÏÞÅ¤´¥·¢×´Ì¬±êÖ¾Î»" UBYTE SWC_TPC_CM_boolean 0 0 0.0 1.0 ECU_ADDRESS 0x70005C2D /end MEASUREMENT
/begin MEASUREMENT VAR_TpcTmp_GenTrqLimTIGBT_f32 "" FLOAT32_IEEE SWC_TPC_CM_single 0 0 -3.4E+38 3.4E+38 ECU_ADDRESS 0x70005CE4 /end MEASUREMENT
/begin MEASUREMENT VAR_TpcFuv_FimTrqLimLv3_b "Èý¼¶¹ÊÕÏÏÞÅ¤¾ØFIM×´Ì¬" UBYTE SWC_TPC_CM_boolean 0 0 0 1 ECU_ADDRESS 0x70005C19 /end MEASUREMENT
/begin MEASUREMENT VAR_TpcTmp_CofDertTRiseIGBT_f32 "" FLOAT32_IEEE SWC_TPC_CM_single 0 0 -3.4E+38 3.4E+38 ECU_ADDRESS 0x70005E00 /end MEASUREMENT
/begin MEASUREMENT VAR_TpcSmp_flgGenPwrLimCurtActv_b "Ä¸Ïß¹ýÁ÷½µ·¢µç¹¦ÂÊ´¥·¢×´Ì¬±êÖ¾" UBYTE SWC_TPC_CM_boolean 0 0 0.0 1.0 ECU_ADDRESS 0x70005C24 /end MEASUREMENT
/begin MEASUREMENT VAR_TpcTmp_CofDertTRiseDbc_f32 "" FLOAT32_IEEE SWC_TPC_CM_single 0 0 -3.4E+38 3.4E+38 ECU_ADDRESS 0x70005E28 /end MEASUREMENT
/begin MEASUREMENT VAR_TpcSmp_ElecPwrAlowMax_f32 "µç³ØÔÊÐí×î´ó·Åµç¹¦ÂÊ" FLOAT32_IEEE SWC_TPC_CM_single_KW 0 0 -3.4E+38 3.4E+38 ECU_ADDRESS 0x70005DD0 /end MEASUREMENT
/begin MEASUREMENT VAR_TpcMot_tRiseSttrOperationMode_u8 "" UBYTE SWC_TPC_CM_uint8 0 0 0 255 ECU_ADDRESS 0x70005C2F /end MEASUREMENT
/begin MEASUREMENT VAR_TpcFuv_FimTrqLimLv4_b "ËÄ¼¶¹ÊÕÏÏÞÅ¤¾ØFIM×´Ì¬" UBYTE SWC_TPC_CM_boolean 0 0 0 1 ECU_ADDRESS 0x70005C18 /end MEASUREMENT
/begin MEASUREMENT VAR_TpcMot_TrqElecExCOrg_f32 "" FLOAT32_IEEE SWC_TPC_CM_single 0 0 -3.4E+38 3.4E+38 ECU_ADDRESS 0x70005D80 /end MEASUREMENT
/begin MEASUREMENT VAR_TpcSmp_flgLinearDertUdrVoltElec_b "Ä¸ÏßÇ·Ñ¹ÏßÐÔ½µµç¶¯¹¦ÂÊ´¥·¢×´Ì¬±êÖ¾Î»" UBYTE SWC_TPC_CM_boolean 0 0 0.0 1.0 ECU_ADDRESS 0x70005C1F /end MEASUREMENT
/begin MEASUREMENT VAR_TpcMot_ElecTrqLimTsttrWoRamp_f32 "" FLOAT32_IEEE SWC_TPC_CM_single 0 0 -3.4E+38 3.4E+38 ECU_ADDRESS 0x70005D50 /end MEASUREMENT
/begin MEASUREMENT VAR_TpcMot_CofDertTRiseSttrSave1_f32 "" FLOAT32_IEEE SWC_TPC_CM_single 0 0 -3.4E+38 3.4E+38 ECU_ADDRESS 0x70005DE8 /end MEASUREMENT
/begin MEASUREMENT VAR_TpcMot_TrqGenExC_f32 "ÍâÌØÐÔÏÞÖÆ·¢µçÅ¤¾Ø" FLOAT32_IEEE SWC_TPC_CM_single_Nm 0 0 -310.0 0.0 ECU_ADDRESS 0x70005D7C /end MEASUREMENT
/begin MEASUREMENT VAR_TpcTmp_TDbcULoLimErrState_u8 "DEM´¥·¢×´Ì¬_UÏàÎÂ¶È¹ýµÍ¹ÊÕÏ" UBYTE SWC_TPC_CM_uint8 0 0 0 255 ECU_ADDRESS 0x70005C47 /end MEASUREMENT
/begin MEASUREMENT VAR_TpcSmp_cofDertOvrVoltGen_f32 "Ä¸Ïß¹ýÑ¹ÏßÐÔ½µ·¢µç¹¦ÂÊderatingÏµÊý" FLOAT32_IEEE SWC_TPC_CM_single 0 0 0.0 1.0 ECU_ADDRESS 0x70005D88 /end MEASUREMENT
/begin MEASUREMENT VAR_TpcTmp_CofDertTRiseIGBTSave1_f32 "" FLOAT32_IEEE SWC_TPC_CM_single 0 0 -3.4E+38 3.4E+38 ECU_ADDRESS 0x70005E08 /end MEASUREMENT
/begin MEASUREMENT VAR_tpcsmp_PwrLoss_f32 "" FLOAT32_IEEE SWC_TPC_CM_single 0 0 -3.4E+38 3.4E+38 ECU_ADDRESS 0x70005DB4 /end MEASUREMENT
/begin MEASUREMENT VAR_TpcSmp_flgPIDertUdrVoltElec_b "Ä¸ÏßÇ·Ñ¹PI½µµç¶¯¹¦ÂÊ´¥·¢×´Ì¬±êÖ¾Î»" UBYTE SWC_TPC_CM_boolean 0 0 0.0 1.0 ECU_ADDRESS 0x70005C1E /end MEASUREMENT
/begin MEASUREMENT VAR_TpcMot_flgTrqLimTsttrActv_b "¶¨×ÓÎÂ¶ÈÏÞÅ¤´¥·¢×´Ì¬±êÖ¾Î»" UBYTE SWC_TPC_CM_boolean 0 0 0.0 1.0 ECU_ADDRESS 0x70005C2A /end MEASUREMENT
/begin MEASUREMENT VAR_TpcMot_tSttrOperationMode_u8 "" UBYTE SWC_TPC_CM_uint8 0 0 0 255 ECU_ADDRESS 0x70005C30 /end MEASUREMENT
/begin MEASUREMENT VAR_TpcSmp_GenPwrLimOvrCurt_f32 "Ä¸Ïß¹ýÁ÷½µ·¢µç¹¦ÂÊ" FLOAT32_IEEE SWC_TPC_CM_single_KW 0 0 -3.4E+38 3.4E+38 ECU_ADDRESS 0x70005CC8 /end MEASUREMENT
/begin MEASUREMENT VAR_TpcMot_tSttrTempFlt_f32 "" FLOAT32_IEEE SWC_TPC_CM_single 0 0 -3.4E+38 3.4E+38 ECU_ADDRESS 0x70005DFC /end MEASUREMENT
/begin MEASUREMENT VAR_TpcSmp_TrqMinCanSet_f32 "CANÖ¸ÁîÏÞÅ¤×îÐ¡Å¤¾Ø" FLOAT32_IEEE SWC_TPC_CM_single 0 0 -3.4E+38 3.4E+38 ECU_ADDRESS 0x70005CA8 /end MEASUREMENT
/begin MEASUREMENT VAR_TpcSmp_ElecPwrLimUdrVolt_f32 "Ä¸ÏßÇ·Ñ¹½µµç¶¯¹¦ÂÊ" FLOAT32_IEEE SWC_TPC_CM_single_KW 0 0 -3.4E+38 3.4E+38 ECU_ADDRESS 0x70005D0C /end MEASUREMENT
/begin MEASUREMENT VAR_TpcTmp_GenTrqLimTdbc_f32 "DbcÎÂ¶ÈÏÞÅ¤·¢µçÅ¤¾Ø" FLOAT32_IEEE SWC_TPC_CM_single_Nm 0 0 -310.0 0.0 ECU_ADDRESS 0x70005CF4 /end MEASUREMENT
/begin MEASUREMENT VAR_TpcTmp_TDbcOvLoWarnState_u8 "DEM´¥·¢×´Ì¬_DBCÎÂ¶È¹ýµÍ±¨¾¯" UBYTE SWC_TPC_CM_uint8 0 0 0 255 ECU_ADDRESS 0x70005C49 /end MEASUREMENT
/begin MEASUREMENT VAR_tpccod_flgMinDertCAN_b "" UBYTE SWC_TPC_CM_boolean 0 0 0 1 ECU_ADDRESS 0x70005BFC /end MEASUREMENT
/begin MEASUREMENT VAR_TpcCod_PowerIncreaseRate_f32 "" FLOAT32_IEEE SWC_TPC_CM_single 0 0 -3.4E+38 3.4E+38 ECU_ADDRESS 0x70005D5C /end MEASUREMENT
/begin MEASUREMENT VAR_TpcTmp_tRiseDbcOperationMode_u8 "" UBYTE SWC_TPC_CM_uint8 0 0 0 255 ECU_ADDRESS 0x70005C33 /end MEASUREMENT
/begin MEASUREMENT VAR_tpccod_flgMaxDertTIGBT_b "" UBYTE SWC_TPC_CM_boolean 0 0 0 1 ECU_ADDRESS 0x70005C0C /end MEASUREMENT
/begin MEASUREMENT VAR_TpcSmp_cofDertOvrCurtElec_f32 "Ä¸Ïß¹ýÁ÷ÏßÐÔ½µµç¶¯¹¦ÂÊderatingÏµÊý" FLOAT32_IEEE SWC_TPC_CM_single 0 0 0.0 1.0 ECU_ADDRESS 0x70005DD8 /end MEASUREMENT
/begin MEASUREMENT VAR_TpcTmp_tCoolTempFlt_u16 "" SWORD SWC_TPC_CM_int16 0 0 -32768 32767 ECU_ADDRESS 0x70005C64 /end MEASUREMENT
/begin MEASUREMENT VAR_TpcMot_ElecPwrRef_f32 "TpcMotÏÞÅ¤»ù×¼µç¶¯¹¦ÂÊ" FLOAT32_IEEE SWC_TPC_CM_single_KW 0 0 0.0 150.0 ECU_ADDRESS 0x70005D68 /end MEASUREMENT
/begin MEASUREMENT VAR_tpccod_flgMaxDertCAN_b "" UBYTE SWC_TPC_CM_boolean 0 0 0 1 ECU_ADDRESS 0x70005C07 /end MEASUREMENT
/begin MEASUREMENT VAR_TpcTmp_flgTrqLimTIGBTActv_b "" UBYTE SWC_TPC_CM_boolean 0 0 0 1 ECU_ADDRESS 0x70005C2B /end MEASUREMENT
/begin MEASUREMENT VAR_TpcTmp_ElecTrqLimTIGBTWoRamp_f32 "" FLOAT32_IEEE SWC_TPC_CM_single 0 0 -3.4E+38 3.4E+38 ECU_ADDRESS 0x70005D38 /end MEASUREMENT
/begin MEASUREMENT VAR_TpcSmp_uDcLnkUnvWarnState_u8 "DEM´¥·¢×´Ì¬_Ç·Ñ¹±¨¾¯" UBYTE SWC_TPC_CM_uint8 0 0 0 255 ECU_ADDRESS 0x70005C36 /end MEASUREMENT
/begin MEASUREMENT VAR_TpcMot_TrqElecExC_f32 "ÍâÌØÐÔÏÞÖÆµç¶¯Å¤¾Ø" FLOAT32_IEEE SWC_TPC_CM_single_Nm 0 0 0.0 310.0 ECU_ADDRESS 0x70005D6C /end MEASUREMENT
/begin MEASUREMENT VAR_L2Sampling_RslvSinN_VADC_Max1_u16 "" UWORD SWC_TRSP_CM_uint16 0 0 0.0 1024.0 ECU_ADDRESS 0x70005EA6 /end MEASUREMENT
/begin MEASUREMENT VAR_TRSP_WCurrRngErr_b "" UBYTE SWC_TRSP_CM_boolean 0 0 0.0 1.0 ECU_ADDRESS 0x70005E75 /end MEASUREMENT
/begin MEASUREMENT VAR_TRSP_RslvSinPRngChkRslt_b "" UBYTE SWC_TRSP_CM_boolean 0 0 0.0 1.0 ECU_ADDRESS 0x70005E82 /end MEASUREMENT
/begin MEASUREMENT VAR_TRSP_WCurrRngChkRslt_b "" UBYTE SWC_TRSP_CM_boolean 0 0 0.0 1.0 ECU_ADDRESS 0x70005E76 /end MEASUREMENT
/begin MEASUREMENT VAR_TRSP_RslvSinNRngChkRslt_b "" UBYTE SWC_TRSP_CM_boolean 0 0 0.0 1.0 ECU_ADDRESS 0x70005E80 /end MEASUREMENT
/begin MEASUREMENT VAR_TRSP_RslvSinPRngErr_b "" UBYTE SWC_TRSP_CM_boolean 0 0 0.0 1.0 ECU_ADDRESS 0x70005E81 /end MEASUREMENT
/begin MEASUREMENT VAR_L2Sampling_ExciBackN_u16 "" UWORD SWC_TRSP_CM_uint16 0 0 0.0 1024.0 ECU_ADDRESS 0x70005E98 /end MEASUREMENT
/begin MEASUREMENT VAR_L2Sampling_RslvCosN_VADC_u16 "" UWORD SWC_TRSP_CM_uint16 0 0 0.0 1024.0 ARRAY_SIZE 32 ECU_ADDRESS 0x70005EAC /end MEASUREMENT
/begin MEASUREMENT VAR_TRSP_RslvSensVoltRngErr_b "" UBYTE SWC_TRSP_CM_boolean 0 0 0.0 1.0 ECU_ADDRESS 0x70005E6C /end MEASUREMENT
/begin MEASUREMENT VAR_L2Sampling_ExciBackP_u16 "" UWORD SWC_TRSP_CM_uint16 0 0 0.0 1024.0 ECU_ADDRESS 0x70005E9A /end MEASUREMENT
/begin MEASUREMENT VAR_TRSP_CurrRngErr_b "" UBYTE SWC_TRSP_CM_boolean 0 0 0.0 1.0 ECU_ADDRESS 0x70005E74 /end MEASUREMENT
/begin MEASUREMENT VAR_NvM_AngAutoClbOffset_f32 "" FLOAT32_IEEE SWC_TRSP_CM_single 0 0 0.0 360.0 ECU_ADDRESS 0x70005FF4 /end MEASUREMENT
/begin MEASUREMENT VAR_L2Sampling_UB_SBC_MON_u16 "" UWORD SWC_TRSP_CM_uint16 0 0 0.0 4095.0 ECU_ADDRESS 0x70005E90 /end MEASUREMENT
/begin MEASUREMENT VAR_L2Sampling_IsU_Mon_f32 "" FLOAT32_IEEE SWC_TRSP_CM_single 0 0 -30000.0 0.0 ECU_ADDRESS 0x70005FEC /end MEASUREMENT
/begin MEASUREMENT VAR_TRSP_RslvCosPRngErr_b "" UBYTE SWC_TRSP_CM_boolean 0 0 0.0 1.0 ECU_ADDRESS 0x70005E7D /end MEASUREMENT
/begin MEASUREMENT VAR_L2Sampling_RslvCosP_VADC_u16 "" UWORD SWC_TRSP_CM_uint16 0 0 0.0 1024.0 ARRAY_SIZE 32 ECU_ADDRESS 0x70005EEC /end MEASUREMENT
/begin MEASUREMENT VAR_TRSP_RslvExciPRngChkRslt_b "" UBYTE SWC_TRSP_CM_boolean 0 0 0.0 1.0 ECU_ADDRESS 0x70005E72 /end MEASUREMENT
/begin MEASUREMENT VAR_TRSP_UCurrRngErr_b "" UBYTE SWC_TRSP_CM_boolean 0 0 0.0 1.0 ECU_ADDRESS 0x70005E79 /end MEASUREMENT
/begin MEASUREMENT VAR_TRSP_RslvExciNRngChkRslt_b "" UBYTE SWC_TRSP_CM_boolean 0 0 0.0 1.0 ECU_ADDRESS 0x70005E70 /end MEASUREMENT
/begin MEASUREMENT VAR_TRSP_18VHSVoltRngChkRslt_b "" UBYTE SWC_TRSP_CM_boolean 0 0 0.0 1.0 ECU_ADDRESS 0x70005E68 /end MEASUREMENT
/begin MEASUREMENT VAR_L2Sampling_RslvSin_s32 "" SLONG SWC_TRSP_CM_int32 0 0 0.0 4095.0 ECU_ADDRESS 0x70005FB0 /end MEASUREMENT
/begin MEASUREMENT VAR_L2Sampling_RslvSinN_VADC_u16 "" UWORD SWC_TRSP_CM_uint16 0 0 0.0 1024.0 ARRAY_SIZE 32 ECU_ADDRESS 0x70005F2C /end MEASUREMENT
/begin MEASUREMENT VAR_L2Sampling_18VHS_MON_u16 "" UWORD SWC_TRSP_CM_uint16 0 0 0.0 4095.0 ECU_ADDRESS 0x70005E8E /end MEASUREMENT
/begin MEASUREMENT VAR_L2Sampling_UBRWIDE_MON_u16 "" UWORD SWC_TRSP_CM_uint16 0 0 0.0 4095.0 ECU_ADDRESS 0x70005E92 /end MEASUREMENT
/begin MEASUREMENT VAR_L2Com_TrqSetP_f32 "" FLOAT32_IEEE SWC_TRSP_CM_single 0 0 -500.0 500.0 ECU_ADDRESS 0x70005FF0 /end MEASUREMENT
/begin MEASUREMENT VAR_TRSP_CurrSumErr_b "" UBYTE SWC_TRSP_CM_boolean 0 0 0.0 1.0 ECU_ADDRESS 0x70005E73 /end MEASUREMENT
/begin MEASUREMENT VAR_TRSP_RslvExciNRngErr_b "" UBYTE SWC_TRSP_CM_boolean 0 0 0.0 1.0 ECU_ADDRESS 0x70005E6F /end MEASUREMENT
/begin MEASUREMENT VAR_L2Sampling_1V8CPLD_MON_u16 "" UWORD SWC_TRSP_CM_uint16 0 0 0.0 4095.0 ECU_ADDRESS 0x70005E8A /end MEASUREMENT
/begin MEASUREMENT VAR_L2Sampling_RslvSinP_VADC_u16 "" UWORD SWC_TRSP_CM_uint16 0 0 0.0 1024.0 ARRAY_SIZE 32 ECU_ADDRESS 0x70005F6C /end MEASUREMENT
/begin MEASUREMENT VAR_TRSP_1V8CPLDVoltRngChkRslt_b "" UBYTE SWC_TRSP_CM_boolean 0 0 0.0 1.0 ECU_ADDRESS 0x70005E64 /end MEASUREMENT
/begin MEASUREMENT VAR_L2Sampling_RslvCosP_VADC_Max1_u16 "" UWORD SWC_TRSP_CM_uint16 0 0 0.0 1024.0 ECU_ADDRESS 0x70005EAA /end MEASUREMENT
/begin MEASUREMENT VAR_L2Sampling_RslvCosP_VADC_Min1_u16 "" UWORD SWC_TRSP_CM_uint16 0 0 0.0 1024.0 ECU_ADDRESS 0x70005EA8 /end MEASUREMENT
/begin MEASUREMENT VAR_L2Sampling_IsV_Mon_f32 "" FLOAT32_IEEE SWC_TRSP_CM_single 0 0 0.0 30000.0 ECU_ADDRESS 0x70005FE8 /end MEASUREMENT
/begin MEASUREMENT VAR_L2Sampling_RslvSinP_VADC_Max1_u16 "" UWORD SWC_TRSP_CM_uint16 0 0 0.0 1024.0 ECU_ADDRESS 0x70005EA2 /end MEASUREMENT
/begin MEASUREMENT VAR_TRSP_RslvRngErr_b "" UBYTE SWC_TRSP_CM_boolean 0 0 0.0 1.0 ECU_ADDRESS 0x70005E7C /end MEASUREMENT
/begin MEASUREMENT VAR_L2Sampling_RslvSinP_VADC_Min1_u16 "" UWORD SWC_TRSP_CM_uint16 0 0 0.0 1024.0 ECU_ADDRESS 0x70005EA0 /end MEASUREMENT
/begin MEASUREMENT VAR_TRSP_RslvCosNRngErr_b "" UBYTE SWC_TRSP_CM_boolean 0 0 0.0 1.0 ECU_ADDRESS 0x70005E83 /end MEASUREMENT
/begin MEASUREMENT VAR_TRSP_18VHSVoltRngErr_b "" UBYTE SWC_TRSP_CM_boolean 0 0 0.0 1.0 ECU_ADDRESS 0x70005E67 /end MEASUREMENT
/begin MEASUREMENT VAR_TRSP_VCurrRngErr_b "" UBYTE SWC_TRSP_CM_boolean 0 0 0.0 1.0 ECU_ADDRESS 0x70005E77 /end MEASUREMENT
/begin MEASUREMENT VAR_TRSP_UCurrRngChkRslt_b "" UBYTE SWC_TRSP_CM_boolean 0 0 0.0 1.0 ECU_ADDRESS 0x70005E7A /end MEASUREMENT
/begin MEASUREMENT VAR_TRSP_RslvSinNRngErr_b "" UBYTE SWC_TRSP_CM_boolean 0 0 0.0 1.0 ECU_ADDRESS 0x70005E7F /end MEASUREMENT
/begin MEASUREMENT VAR_TRSP_RslvExciRngErr_b "" UBYTE SWC_TRSP_CM_boolean 0 0 0.0 1.0 ECU_ADDRESS 0x70005E6E /end MEASUREMENT
/begin MEASUREMENT VAR_TRSP_AgRtr_f32 "" FLOAT32_IEEE SWC_TRSP_CM_single 0 0 0.0 360.0 ECU_ADDRESS 0x70005FB8 /end MEASUREMENT
/begin MEASUREMENT VAR_L2Sampling_3V3CPLD_MON_u16 "" UWORD SWC_TRSP_CM_uint16 0 0 0.0 4095.0 ECU_ADDRESS 0x70005E8C /end MEASUREMENT
/begin MEASUREMENT VAR_TRSP_RslvSensVoltRngChkRslt_b "" UBYTE SWC_TRSP_CM_boolean 0 0 0.0 1.0 ECU_ADDRESS 0x70005E6D /end MEASUREMENT
/begin MEASUREMENT VAR_L2Com_ModeReq_u16 "" UWORD SWC_TRSP_CM_uint16 0 0 0.0 15.0 ECU_ADDRESS 0x70005FAC /end MEASUREMENT
/begin MEASUREMENT VAR_TRSP_VCurrRngChkRslt_b "" UBYTE SWC_TRSP_CM_boolean 0 0 0.0 1.0 ECU_ADDRESS 0x70005E78 /end MEASUREMENT
/begin MEASUREMENT VAR_L2Sampling_LEM5V_MON_u16 "" UWORD SWC_TRSP_CM_uint16 0 0 0.0 4095.0 ECU_ADDRESS 0x70005E94 /end MEASUREMENT
/begin MEASUREMENT VAR_L2Sampling_RslvCosN_VADC_Min1_u16 "" UWORD SWC_TRSP_CM_uint16 0 0 0.0 1024.0 ECU_ADDRESS 0x70005E9C /end MEASUREMENT
/begin MEASUREMENT VAR_TRSP_3V3CPLDVoltRngChkRslt_b "" UBYTE SWC_TRSP_CM_boolean 0 0 0.0 1.0 ECU_ADDRESS 0x70005E66 /end MEASUREMENT
/begin MEASUREMENT VAR_TRSP_RslvCosPRngChkRslt_b "" UBYTE SWC_TRSP_CM_boolean 0 0 0.0 1.0 ECU_ADDRESS 0x70005E7E /end MEASUREMENT
/begin MEASUREMENT VAR_TRSP_RslvExciPRngErr_b "" UBYTE SWC_TRSP_CM_boolean 0 0 0.0 1.0 ECU_ADDRESS 0x70005E71 /end MEASUREMENT
/begin MEASUREMENT VAR_TRSP_RslvCosNRngChkRslt_b "" UBYTE SWC_TRSP_CM_boolean 0 0 0.0 1.0 ECU_ADDRESS 0x70005E84 /end MEASUREMENT
/begin MEASUREMENT VAR_L2Sampling_RslvCos_s32 "" SLONG SWC_TRSP_CM_int32 0 0 0.0 4095.0 ECU_ADDRESS 0x70005FB4 /end MEASUREMENT
/begin MEASUREMENT VAR_L2Sampling_RslvSinN_VADC_Min1_u16 "" UWORD SWC_TRSP_CM_uint16 0 0 0.0 1024.0 ECU_ADDRESS 0x70005EA4 /end MEASUREMENT
/begin MEASUREMENT VAR_L2Sampling_IsW_Mon_f32 "" FLOAT32_IEEE SWC_TRSP_CM_single 0 0 0.0 30000.0 ECU_ADDRESS 0x70005FE4 /end MEASUREMENT
/begin MEASUREMENT VAR_TRSP_1V8CPLDVoltRngErr_b "" UBYTE SWC_TRSP_CM_boolean 0 0 0.0 1.0 ECU_ADDRESS 0x70005E63 /end MEASUREMENT
/begin MEASUREMENT VAR_L2Sampling_Exci18VLS_MON_u16 "" UWORD SWC_TRSP_CM_uint16 0 0 0.0 4095.0 ECU_ADDRESS 0x70005E96 /end MEASUREMENT
/begin MEASUREMENT VAR_TRSP_RslvSqrtErr_b "" UBYTE SWC_TRSP_CM_boolean 0 0 0.0 1.0 ECU_ADDRESS 0x70005E7B /end MEASUREMENT
/begin MEASUREMENT VAR_L2Sampling_RslvCosN_VADC_Max1_u16 "" UWORD SWC_TRSP_CM_uint16 0 0 0.0 1024.0 ECU_ADDRESS 0x70005E9E /end MEASUREMENT
/begin MEASUREMENT VAR_TRSP_3V3CPLDVoltRngErr_b "" UBYTE SWC_TRSP_CM_boolean 0 0 0.0 1.0 ECU_ADDRESS 0x70005E65 /end MEASUREMENT
/end MODULE
/end PROJECT
