/* -------------------------------------------------------------------------
Visu-IT!
ASAP2Toolkit DEMO
- ASAP2 export -
Version 13.2.R0
Component-Version Build<000000.18> 2017/07/24 18:34:50
CreationDate 08 Jan 2018, 14:55:15
Project TC27x
Number -
Structure -
Serial Nr. -
Option Project (DataBase) demo
Option Verbose false
Option ASAP2File demo
Option IgnoreAddressCheck false
Option ASAP2Version 1.60
Option PartialExportViaFunction
Option PartialExportViaFunctionMode <2>
Option CompuMethodName <0>
Option ExportUnitDisplayName <0>
Option IfDataTemplateList
Option A2MLMode <0>
Option CalibrationMethodList
Option MemoryRegionAutoAssignment <0>
Option AddressOffset <0>
Option A2LName EntityName
Option ExportHiddenData false
Option ExportInvisibleData false
Option ExportSoftwareGrouping false
Option ExportComponentGrouping false
Option SuppressFunctionGrouping false
Option SuppressAxisFunctionGrouping false
Option SuppressDefaultFunction false
Option ExportDisplayIdentifier <1>
Option ExportLongIdentifier <0>
Option ExportAnnotation false
Option ExportReference2MemorySegment false
Option ExportSystemConstants <0>
Option CreateVirtualCharacteristics.. false
Option CreateVirtualMeasurements4In.. false
Option CreateSymbolLink false
Option SuppressEcuAddress false
Option SuppressFloat false
Option SuppressVariantCoding false
Option VariantCodingMode <0>
Option OnlineOnly false
Option Map2PointLinearConv2RatFunc false
Option NonLinearConvMode <0>
Option MapVTabRange2VTab false
Option MaxCompuTabValuePairs <255>
Option DefaultFormat4VerbalConvers...
Option WriteEscapeCharacters false
Option SASList
Option SAS4All false
Option ApplyOldIdentSyntax4NonInstr.. false
Option IgnorePartialIdentLengthCheck false
Option AllowEmptyContainer false
Option CreateAddressOffsetFile <0>
Option SupportEdicMobileV3 false
Option SuppressBitfieldCarrier false
Option DefaultLanguage en
Option SkipInputDefinitions false
Option Force1DValBlks false
Option ExportMaxRefresh <0>
Option SuppressRefUnit false
Option ExportUnusedAttributes false
Option CustomAmlFiles
------------------------------------------------------------------------- */ ASAP2_VERSION 1 60
/begin PROJECT tc27x "default"
/begin HEADER "iEDS MCU" VERSION "1.0" PROJECT_NO default /end HEADER
/begin MODULE iEDS_MCU "default"
/************* 姝ゅ娣诲姞memory segment鐨勪俊鎭�?********************/
/begin MOD_PAR "DEFAULT" /begin MEMORY_SEGMENT _RAM0 "" DATA RAM INTERN 0x70000000 0x1C000 -1 -1 -1 -1 -1 /end MEMORY_SEGMENT
 /begin MEMORY_SEGMENT _PF0_INT "" CODE FLASH INTERN 0x800F0000 0xFFFF -1 -1 -1 -1 -1 /end MEMORY_SEGMENT
 /begin MEMORY_SEGMENT _LMU "" DATA RAM INTERN 0x9000000 0x4000 -1 -1 -1 -1 -1 /end MEMORY_SEGMENT
 /begin MEMORY_SEGMENT _STARTUP "" CODE FLASH INTERN 0xA0020000 0x24 -1 -1 -1 -1 -1 /end MEMORY_SEGMENT
 /begin MEMORY_SEGMENT _PF1_CACHE "" CODE FLASH INTERN 0xA00F0000 0xFFFF -1 -1 -1 -1 -1 /end MEMORY_SEGMENT
 /begin MEMORY_SEGMENT FR_DATA "" CODE FLASH INTERN 0xA0180000 0x10000 -1 -1 -1 -1 -1 /end MEMORY_SEGMENT
 /begin MEMORY_SEGMENT _CALROM "" DATA FLASH INTERN 0x80140000 0x8000 -1 -1 -1 -1 -1
  /begin IF_DATA XCP
   /begin SEGMENT 0 2 0 0 0 /begin CHECKSUM XCP_ADD_14 /end CHECKSUM
    /begin PAGE 0 ECU_ACCESS_WITH_XCP_ONLY XCP_READ_ACCESS_WITH_ECU_ONLY XCP_WRITE_ACCESS_NOT_ALLOWED INIT_SEGMENT 0 /end PAGE
    /begin PAGE 1 ECU_ACCESS_WITH_XCP_ONLY XCP_READ_ACCESS_WITH_ECU_ONLY XCP_WRITE_ACCESS_WITH_ECU_ONLY INIT_SEGMENT 0 /end PAGE
   /end SEGMENT
  /end IF_DATA
 /end MEMORY_SEGMENT
 /begin MEMORY_SEGMENT _ECU_CODE1 "" CODE FLASH INTERN 0x80000024 0xE0000 -1 -1 -1 -1 -1 /end MEMORY_SEGMENT
 /begin MEMORY_SEGMENT _INT_RAM "" VARIABLES RAM INTERN 0x70000000 0x1C000 -1 -1 -1 -1 -1 /end MEMORY_SEGMENT
/end MOD_PAR
/begin MOD_COMMON "DEFAULT" DEPOSIT ABSOLUTE BYTE_ORDER MSB_LAST ALIGNMENT_BYTE 1 ALIGNMENT_WORD 1 ALIGNMENT_LONG 1 ALIGNMENT_FLOAT32_IEEE 1 ALIGNMENT_FLOAT64_IEEE 1 /end MOD_COMMON
/****************浠ヤ笅鏇挎崲鎴愮敓鎴愮殑a2l妯℃�?*****************************/
/begin IF_DATA XCP /* Insert this block within the MODULE block of the A2L file. */
 /begin PROTOCOL_LAYER 0x0100 /* XCP protocol layer 1.0 */ 2000 /* T1 [ms] */ 2000 /* T2 [ms] */ 2000 /* T3 [ms] */ 2000 /* T4 [ms] */ 2000 /* T5 [ms] */ 0005 /* T6 [ms] */ 0005 /* T7 [ms] */ 8 /* MAX_CTO */ 8 /* MAX_DTO */ BYTE_ORDER_MSB_LAST ADDRESS_GRANULARITY_BYTE OPTIONAL_CMD SET_REQUEST OPTIONAL_CMD SET_MTA OPTIONAL_CMD UPLOAD OPTIONAL_CMD BUILD_CHECKSUM OPTIONAL_CMD TRANSPORT_LAYER_CMD OPTIONAL_CMD CLEAR_DAQ_LIST OPTIONAL_CMD SET_DAQ_PTR OPTIONAL_CMD WRITE_DAQ OPTIONAL_CMD SET_DAQ_LIST_MODE OPTIONAL_CMD START_STOP_DAQ_LIST OPTIONAL_CMD START_STOP_SYNCH OPTIONAL_CMD GET_DAQ_CLOCK OPTIONAL_CMD MODIFY_BITS OPTIONAL_CMD DOWNLOAD OPTIONAL_CMD DOWNLOAD_NEXT OPTIONAL_CMD SET_CAL_PAGE OPTIONAL_CMD GET_CAL_PAGE OPTIONAL_CMD COPY_CAL_PAGE COMMUNICATION_MODE_SUPPORTED BLOCK SLAVE MASTER 0xff /* MAX_BS */ 100 /* MIN_ST */ /end PROTOCOL_LAYER
 /begin DAQ STATIC /* DAQ_CONFIG_TYPE */ 3 /* MAX_DAQ */ 3 /* MAX_EVENT_CHANNEL */ 0 /* MIN_DAQ, i.e. the number of predefined DAQ lists */ OPTIMISATION_TYPE_DEFAULT ADDRESS_EXTENSION_DAQ /* ADDR_EXTENSION_TYPE */ IDENTIFICATION_FIELD_TYPE_ABSOLUTE GRANULARITY_ODT_ENTRY_SIZE_DAQ_BYTE 8 /* MAX_ODT_ENTRY_SIZE_DAQ */ NO_OVERLOAD_INDICATION
  /begin TIMESTAMP_SUPPORTED 1 /* TIMESTAMP_TICKS */ NO_TIME_STAMP /* TIMESTAMP_SIZE */ UNIT_1MS /* TIMESTAMP_RESOLUTION */ /end TIMESTAMP_SUPPORTED
  /begin DAQ_LIST /* DAQ0 */ 0 DAQ_LIST_TYPE DAQ MAX_ODT 5 MAX_ODT_ENTRIES 7 FIRST_PID 0 EVENT_FIXED 0 /end DAQ_LIST
  /begin DAQ_LIST /* DAQ1 */ 1 DAQ_LIST_TYPE DAQ MAX_ODT 10 MAX_ODT_ENTRIES 7 FIRST_PID 5 EVENT_FIXED 1 /end DAQ_LIST
  /begin DAQ_LIST /* DAQ2 */ 2 DAQ_LIST_TYPE DAQ MAX_ODT 20 MAX_ODT_ENTRIES 7 FIRST_PID 15 EVENT_FIXED 2 /end DAQ_LIST
  /begin EVENT "2ms_Raster" "2msRstr" 0 DAQ_STIM 0xff 2 6 0 /end EVENT
  /begin EVENT "10ms_Raster" "10msRstr" 1 DAQ_STIM 0xff 10 6 0 /end EVENT
  /begin EVENT "100ms_Raster" "100msRstr" 2 DAQ_STIM 0xff 10 7 0 /end EVENT
 /end DAQ
 /begin PAG 1 /* MAX_SEGMENTS */ FREEZE_SUPPORTED /end PAG
 /begin PGM PGM_MODE_ABSOLUTE 0 /* MAX_SECTORS */ 0x08 /* MAX_CTO_PGM */ COMMUNICATION_MODE_SUPPORTED BLOCK SLAVE MASTER 0xff /* MAX_BS_PGM */ 100 /* MIN_ST_PGM */ /end PGM
 /begin XCP_ON_CAN 0x0100 /* XCP on CAN 1.0 */ CAN_ID_BROADCAST 0x210 /* auto-detection */ CAN_ID_MASTER 0x220 /* CMD/STIM */ CAN_ID_SLAVE 0x300 /* RES/ERR/EV/SERV/DAQ */ BAUDRATE 1000000 /* In Hz */ SAMPLE_POINT 75 /* Percentage of complete bit time. */ SAMPLE_RATE SINGLE BTL_CYCLES 0 /* Slots per bit time. */ SJW 2 /* Length of the synch segment. */ SYNC_EDGE SINGLE /begin DAQ_LIST_CAN_ID 0 FIXED 0x310 /end DAQ_LIST_CAN_ID /begin DAQ_LIST_CAN_ID 1 FIXED 0x311 /end DAQ_LIST_CAN_ID /begin DAQ_LIST_CAN_ID 2 FIXED 0x312 /end DAQ_LIST_CAN_ID /end XCP_ON_CAN
/end IF_DATA
/****************姝や笂鏇挎崲鎴愮敓鎴愮殑a2l妯℃�?*****************************/
/begin COMPU_METHOD stDrvCtl_Verb "" TAB_VERB "%2.1" "-" COMPU_TAB_REF stDrvCtl_List /end COMPU_METHOD
/begin COMPU_METHOD stSysCtl_Verb "" TAB_VERB "%2.1" "-" COMPU_TAB_REF stSysCtl_List /end COMPU_METHOD
/begin COMPU_METHOD stDern_Verb "" TAB_VERB "%2.1" "-" COMPU_TAB_REF stDern_List /end COMPU_METHOD
/begin COMPU_VTAB stDrvCtl_List "" TAB_VERB 20 0 "Drv_Initial" 1 "Drv_MocSop" 2 "Drv_SensCalFW" 3 "Drv_Standby" 4 "Drv_Run" 5 "Drv_OffsetAcc" 6 "Drv_OffsetFw" 7 "Drv_Discharge" 8 "Drv_Failure" 9 "Drv_TrqCtl" 10 "Drv_nCtlExt" 11 "Drv_inActive" 12 "Drv_nCtlInt" 13 "Drv_IsCtl" 14 "Drv_UdcCtl" 15 "Drv_UdcBatCtl" 16 "Drv_FrWCtl" 17 "Drv_Ready" 18 "Drv_TestBench" 19 "Drv_OffsetCal" DEFAULT_VALUE "---" /end COMPU_VTAB
/begin COMPU_VTAB stSysCtl_List "" TAB_VERB 4 0 "PreDriveMod" 1 "DriveMod" 2 "PostDriveMod" 3 "ShutDownMod" DEFAULT_VALUE "---" /end COMPU_VTAB
/begin COMPU_VTAB stDern_List "" TAB_VERB 9 0 "bDern_Inactive" 1 "bDern_ExCTrq" 2 "bDern_StrTemp" 3 "bDern_TempIGBT" 4 "bDern_N" 5 "bDern_OvrIdc" 6 "bDern_UndrUdc" 7 "bDern_OvrUdc" 8 "bDern_CAN" DEFAULT_VALUE "---" /end COMPU_VTAB
/end MODULE
/end PROJECT
/* -------------------------------------------------------------------------
Visu-IT! - ASAP2Toolkit
Quality FatalError<0> NonContinuationError<0> Error<0> Warning<1>
Quantity CURVE/MAP <0> VALUE<1> AXIS_PTS<0> MEASUREMENT<4>
------------------------------------------------------------------------- */
