ASAP2_VERSION 1 60
/begin PROJECT ETAS_AUTOSAR "XCP on CAN"
/begin HEADER "" VERSION "1.0.0.0" PROJECT_NO ETAS_AUTOSAR /end HEADER
/begin MODULE ETAS_AUTOSAR ""
/begin MOD_COMMON "" DEPOSIT ABSOLUTE BYTE_ORDER MSB_LAST /end MOD_COMMON
/begin MOD_PAR "" VERSION "XCP_1.0.0" CUSTOMER_NO "" USER "" PHONE_NO "" ECU "ETAS AUTOSAR" CPU_TYPE "Tc275"
 /begin MEMORY_SEGMENT Pst80040000 "" CODE FLASH INTERN 0x80040000 0x100000 -1 -1 -1 -1 -1 /end MEMORY_SEGMENT
 /begin MEMORY_SEGMENT Dst80140000 "" DATA FLASH INTERN 0x80140000 0x8000 -1 -1 -1 -1 -1
  /begin IF_DATA XCPplus 0x0102
   /begin SEGMENT 3 0x02 0x00 0x00 0x00
    /begin CHECKSUM XCP_ADD_14 /* checksum: add bytes to 16bit result */ MAX_BLOCK_SIZE 0x400 /end CHECKSUM
    /begin PAGE 0x00 /* page number */ ECU_ACCESS_DONT_CARE XCP_READ_ACCESS_DONT_CARE XCP_WRITE_ACCESS_NOT_ALLOWED /end PAGE
    /begin PAGE 0x01 /* page number */ ECU_ACCESS_DONT_CARE XCP_READ_ACCESS_DONT_CARE XCP_WRITE_ACCESS_WITH_ECU_ONLY /end PAGE
   /end SEGMENT
  /end IF_DATA
 /end MEMORY_SEGMENT
 /begin MEMORY_SEGMENT Pst80148000 "" CODE FLASH INTERN 0x80148000 0xB6000 -1 -1 -1 -1 -1 /end MEMORY_SEGMENT
 /begin MEMORY_SEGMENT RamB0000000 "" VARIABLES RAM INTERN 0xB0000000 0x8000 -1 -1 -1 -1 -1
  /begin IF_DATA XCPplus 0x0102
   /begin SEGMENT 4 0x00 0x00 0x00 0x00 /end SEGMENT
  /end IF_DATA
 /end MEMORY_SEGMENT
 /begin MEMORY_SEGMENT Ram70000000 "" VARIABLES RAM INTERN 0x70000000 0x1C000 -1 -1 -1 -1 -1
  /begin IF_DATA XCPplus 0x0102
   /begin SEGMENT 5 0x00 0x00 0x00 0x00 /end SEGMENT
  /end IF_DATA
 /end MEMORY_SEGMENT
 /begin MEMORY_SEGMENT Ram60000000 "" VARIABLES RAM INTERN 0x60000000 0x1E000 -1 -1 -1 -1 -1
  /begin IF_DATA XCPplus 0x0102
   /begin SEGMENT 6 0x00 0x00 0x00 0x00 /end SEGMENT
  /end IF_DATA
 /end MEMORY_SEGMENT
 /begin MEMORY_SEGMENT Ram50000000 "" VARIABLES RAM INTERN 0x50000000 0x1E000 -1 -1 -1 -1 -1
  /begin IF_DATA XCPplus 0x0102
   /begin SEGMENT 7 0x00 0x00 0x00 0x00 /end SEGMENT
  /end IF_DATA
 /end MEMORY_SEGMENT
 /begin CALIBRATION_METHOD /* name calibration methode */ "DataSetId" /* version calibration metode */ 256 /begin CALIBRATION_HANDLE /* adr data set id characteristic,dummy */ 0x80145000 /end CALIBRATION_HANDLE /end CALIBRATION_METHOD
/end MOD_PAR
/begin IF_DATA XCPplus 0x0102
 /begin PAG /* MAX_SEGMENTS */ 4 /end PAG
 /begin XCP_ON_CAN /************************ start of CAN *********************/ 0x0102 /* XCP on CAN version */ CAN_ID_MASTER 0x220 /* CMD/STIM CAN-ID */ /* master -> slave */ CAN_ID_SLAVE 0x300 /* RES/ERR/EV/SERV/DAQ CAN-ID */ /* slave -> master */ /* Bit31= 1: extended identifier */ BAUDRATE 500000 /* BAUDRATE [Hz] */ SAMPLE_POINT 100 /* sample point */ /* [% complete bit time] */ BTL_CYCLES 11 /* BTL_CYCLES */ /* [slots per bit time] */ SJW 0 /* length synchr. segment */ /* [BTL_CYCLES] */ /begin EVENT_CAN_ID_LIST 0 /* reference to EVENT_NUMBER: 2msRstr */ FIXED 0x310 /end EVENT_CAN_ID_LIST /begin EVENT_CAN_ID_LIST 1 /* reference to EVENT_NUMBER: 10msRstr */ FIXED 0x311 /end EVENT_CAN_ID_LIST /begin EVENT_CAN_ID_LIST 2 /* reference to EVENT_NUMBER: 100msRstr */ FIXED 0x312 /end EVENT_CAN_ID_LIST MAX_BUS_LOAD 100 /* maximum available bus */ /************************* end of CAN **********************/ /*************** start of PROTOCOL_LAYER *******************/
  /begin PROTOCOL_LAYER /* At MODULE */ 0x0102 /* XCP protocol layer version */ 2000 /* T1 [ms] */ 2000 /* T2 [ms] */ 0 /* T3 [ms] */ 0 /* T4 [ms] */ 0 /* T5 [ms] */ 0 /* T6 [ms] */ 2000 /* T7 [ms] */ 8 /* MAX_CTO */ 8 /* MAX_DTO default for DAQ and STIM */ BYTE_ORDER_MSB_LAST /* BYTE_ORDER: MOTOROLA */ ADDRESS_GRANULARITY_BYTE /* ADDRESS_GRANULARITY */ OPTIONAL_CMD GET_SEED OPTIONAL_CMD UNLOCK OPTIONAL_CMD SET_MTA OPTIONAL_CMD UPLOAD OPTIONAL_CMD SHORT_UPLOAD OPTIONAL_CMD BUILD_CHECKSUM OPTIONAL_CMD DOWNLOAD OPTIONAL_CMD DOWNLOAD_NEXT OPTIONAL_CMD DOWNLOAD_MAX OPTIONAL_CMD MODIFY_BITS OPTIONAL_CMD SET_CAL_PAGE OPTIONAL_CMD GET_CAL_PAGE OPTIONAL_CMD GET_PAG_PROCESSOR_INFO OPTIONAL_CMD GET_SEGMENT_INFO OPTIONAL_CMD GET_PAGE_INFO OPTIONAL_CMD COPY_CAL_PAGE OPTIONAL_CMD CLEAR_DAQ_LIST OPTIONAL_CMD SET_DAQ_PTR OPTIONAL_CMD WRITE_DAQ OPTIONAL_CMD SET_DAQ_LIST_MODE OPTIONAL_CMD START_STOP_DAQ_LIST OPTIONAL_CMD START_STOP_SYNCH OPTIONAL_CMD GET_DAQ_CLOCK OPTIONAL_CMD READ_DAQ OPTIONAL_CMD GET_DAQ_PROCESSOR_INFO OPTIONAL_CMD GET_DAQ_RESOLUTION_INFO OPTIONAL_CMD GET_DAQ_EVENT_INFO OPTIONAL_CMD FREE_DAQ OPTIONAL_CMD ALLOC_DAQ OPTIONAL_CMD ALLOC_ODT OPTIONAL_CMD ALLOC_ODT_ENTRY COMMUNICATION_MODE_SUPPORTED /* optional modes supported */ BLOCK SLAVE /* Slave Block Mode supported */ MASTER /* Master Block Mode supported */ 255 /* MAX_BS */ 50 /* MIN_ST */ SEED_AND_KEY_EXTERNAL_FUNCTION "XcpSeedNKey.dll" /* Name of the SeedAndKey function */ /* including file extension */ /* without path */ /end PROTOCOL_LAYER
  /***************** end of PROTOCOL_LAYER *******************/ /********************* start of DAQ ************************/
  /begin DAQ /* DAQ supported, at MODULE*/ DYNAMIC /* DAQ_CONFIG_TYPE */ 65535 /* MAX_DAQ */ 3 /* MAX_EVENT_CHANNEL */ 0 /* MIN_DAQ */ OPTIMISATION_TYPE_DEFAULT /* OPTIMISATION_TYPE */ ADDRESS_EXTENSION_FREE /* ADDRESS_EXTENSION */ IDENTIFICATION_FIELD_TYPE_ABSOLUTE /* IDENTIFICATION_FIELD */ GRANULARITY_ODT_ENTRY_SIZE_DAQ_BYTE /* GRANULARITY_ODT_ENTRY_SIZE_DAQ */ 255 /* MAX_ODT_ENTRY_SIZE_DAQ */ NO_OVERLOAD_INDICATION /* OVERLOAD_INDICATION */ PRESCALER_SUPPORTED
   /begin TIMESTAMP_SUPPORTED 1 /* TIMESTAMP_TICKS */ SIZE_WORD /* TIMESTAMP_SIZE */ UNIT_1MS /* RESOLUTION OF TIMESTAMP */ /end TIMESTAMP_SUPPORTED
   /begin DAQ_MEMORY_CONSUMPTION 4091 /* DAQ_MEMORY_LIMIT: in Elements[AG] */ 46 /* DAQ_SIZE: number of elements[AG] per DAQ list */ 6 /* ODT_SIZE: number of elements[AG] per ODT */ 5 /* ODT_ENTRY_SIZE: number of elements[AG] per ODT_entry */ 2 /* ODT_DAQ_BUFFER_ELEMENT_SIZE: number of */ /* payload elements[AG]*factor = sizeof(send buffer)[AG] */ 0 /* ODT_STIM_BUFFER_ELEMENT_SIZE: number of */ /* payload elements[AG]*factor = sizeof(receive buffer)[AG] */ /end DAQ_MEMORY_CONSUMPTION
   /******************* start of EVENT ************************/
   /begin EVENT "XcpEvent_2ms_Raster" "2msRstr" 0 DAQ 1 2 6 /* EVENT_CHANNEL_TIME_UNIT: UNIT_1MS */ 3 /end EVENT
   /begin EVENT "XcpEvent_10ms_Raster" "10msRstr" 1 DAQ 1 10 6 /* EVENT_CHANNEL_TIME_UNIT: UNIT_1MS */ 2 /end EVENT
   /begin EVENT "XcpEvent_100ms_Raster" "100msRstr" 2 DAQ 1 10 7 /* EVENT_CHANNEL_TIME_UNIT: UNIT_10MS */ 1 /end EVENT
   /********************* end of EVENT ************************/ /end DAQ
  /********************* end of DAQ **************************/ TRANSPORT_LAYER_INSTANCE "XCP_TPL" /end XCP_ON_CAN
/end IF_DATA
/begin FUNCTION __DDS_EXPA2_DEFAULT_FUNC__ "__DDS_EXPA2_DEFAULT_FUNC__" /end FUNCTION
/begin COMPU_METHOD ident "" RAT_FUNC "%8.4" "" COEFFS 0 1 0 0 0 1 /end COMPU_METHOD
/begin COMPU_METHOD stDrvCtl_Verb "" TAB_VERB "%2.1" "-" COMPU_TAB_REF stDrvCtl_List /end COMPU_METHOD
/begin COMPU_METHOD stSysCtl_Verb "" TAB_VERB "%2.1" "-" COMPU_TAB_REF stSysCtl_List /end COMPU_METHOD
/begin COMPU_METHOD stDern_Verb "" TAB_VERB "%2.1" "-" COMPU_TAB_REF stDern_List /end COMPU_METHOD
/begin COMPU_VTAB stDrvCtl_List "" TAB_VERB 20 0 "Drv_Initial" 1 "Drv_MocSop" 2 "Drv_SensCalFW" 3 "Drv_Standby" 4 "Drv_Run" 5 "Drv_OffsetAcc" 6 "Drv_OffsetFw" 7 "Drv_Discharge" 8 "Drv_Failure" 9 "Drv_TrqCtl" 10 "Drv_nCtlExt" 11 "Drv_inActive" 12 "Drv_nCtlInt" 13 "Drv_IsCtl" 14 "Drv_UdcCtl" 15 "Drv_UdcBatCtl" 16 "Drv_FrWCtl" 17 "Drv_IdLe" 18 "Drv_TestBench" 19 "Drv_OffsetCal" DEFAULT_VALUE "---" /end COMPU_VTAB
/begin COMPU_VTAB stSysCtl_List "" TAB_VERB 5 0 "PreDriveMod" 1 "DriveMod" 2 "PostDriveMod" 3 "ShutDownMod" 4 "FaultMod" DEFAULT_VALUE "---" /end COMPU_VTAB
/begin COMPU_VTAB stDern_List "" TAB_VERB 9 0 "bDern_Inactive" 1 "bDern_ExCTrq" 2 "bDern_StrTemp" 3 "bDern_TempIGBT" 4 "bDern_N" 5 "bDern_OvrIdc" 6 "bDern_UndrUdc" 7 "bDern_OvrUdc" 8 "bDern_CAN" DEFAULT_VALUE "---" /end COMPU_VTAB
/begin RECORD_LAYOUT RL.FNC.FLOAT32_IEEE.ROW_DIR FNC_VALUES 1 FLOAT32_IEEE ROW_DIR DIRECT /end RECORD_LAYOUT
/begin RECORD_LAYOUT STANDARD_VALUE_S8 FNC_VALUES 1 SBYTE COLUMN_DIR DIRECT /end RECORD_LAYOUT
/begin RECORD_LAYOUT STANDARD_VALUE_S16 FNC_VALUES 1 SWORD COLUMN_DIR DIRECT /end RECORD_LAYOUT
/begin RECORD_LAYOUT STANDARD_VALUE_S32 FNC_VALUES 1 SLONG COLUMN_DIR DIRECT /end RECORD_LAYOUT
/begin RECORD_LAYOUT STANDARD_VALUE_U8 FNC_VALUES 1 UBYTE COLUMN_DIR DIRECT /end RECORD_LAYOUT
/begin RECORD_LAYOUT STANDARD_VALUE_U16 FNC_VALUES 1 UWORD COLUMN_DIR DIRECT /end RECORD_LAYOUT
/begin RECORD_LAYOUT STANDARD_VALUE_U32 FNC_VALUES 1 ULONG COLUMN_DIR DIRECT /end RECORD_LAYOUT
/begin RECORD_LAYOUT STANDARD_VALUE_R32 FNC_VALUES 1 FLOAT32_IEEE COLUMN_DIR DIRECT /end RECORD_LAYOUT
/end MODULE
/end PROJECT
