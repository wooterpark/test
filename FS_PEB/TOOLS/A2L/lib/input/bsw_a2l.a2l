ASAP2_VERSION 1 31
/begin PROJECT ProjectName "A2LTOOLKIT_A2L"
/begin HEADER "A2LTOOLKIT_A2L" /end HEADER
/begin MODULE ModuleName "A2LTOOLKIT_A2L"
/begin MOD_COMMON "A2LTOOLKIT_A2L" BYTE_ORDER MSB_LAST /end MOD_COMMON
/begin RECORD_LAYOUT Scalar_BOOLEAN FNC_VALUES 1 UBYTE COLUMN_DIR DIRECT /end RECORD_LAYOUT
/begin RECORD_LAYOUT Scalar_UBYTE FNC_VALUES 1 UBYTE COLUMN_DIR DIRECT /end RECORD_LAYOUT
/begin RECORD_LAYOUT Scalar_BYTE FNC_VALUES 1 SBYTE COLUMN_DIR DIRECT /end RECORD_LAYOUT
/begin RECORD_LAYOUT Scalar_UWORD FNC_VALUES 1 UWORD COLUMN_DIR DIRECT /end RECORD_LAYOUT
/begin RECORD_LAYOUT Scalar_SWORD FNC_VALUES 1 SWORD COLUMN_DIR DIRECT /end RECORD_LAYOUT
/begin RECORD_LAYOUT Scalar_ULONG FNC_VALUES 1 ULONG COLUMN_DIR DIRECT /end RECORD_LAYOUT
/begin RECORD_LAYOUT Scalar_FLOAT32_IEEE FNC_VALUES 1 FLOAT32_IEEE COLUMN_DIR DIRECT /end RECORD_LAYOUT
/begin CHARACTERISTIC CAL_TpcMot_tRiseSttrTraSave1ToSave2_f32 "CAL_TpcMot_tRiseSttrTraSave1ToSave2_f32" VALUE 0x00000000 Scalar_FLOAT32_IEEE 0 BSW_A2L_Ident_Float -3.4E+38 3.4E+38 /end CHARACTERISTIC
/begin CHARACTERISTIC CAL_TRSP_1V8CPLDVoltDebTrh_s16 "CAL_TRSP_1V8CPLDVoltDebTrh_s16" VALUE 0x00000000 Scalar_SWORD 0 BSW_A2L_Ident_Int -32768 32767 /end CHARACTERISTIC
/begin CHARACTERISTIC CAL_Cspf_bDernOvrUdc_u8 "CAL_Cspf_bDernOvrUdc_u8" VALUE 0x00000000 Scalar_UBYTE 0 BSW_A2L_Ident_Int 0 255 /end CHARACTERISTIC
/begin MEASUREMENT VAR_DEM_Event_Epark_PosSampFail_Status_u8 "VAR_DEM_Event_Epark_PosSampFail_Status_u8" UBYTE BSW_A2L_Ident_Int 1 100 0 255 ECU_ADDRESS 0x00000000 /end MEASUREMENT
/begin CHARACTERISTIC CAL_PcfSig_TimesTestP_u16 "CAL_PcfSig_TimesTestP_u16" VALUE 0x00000000 Scalar_UWORD 0 BSW_A2L_Ident_Int 0 65535 /end CHARACTERISTIC
/begin CHARACTERISTIC CAL_TRSP_RslvRngCosPLoLim_u16 "CAL_TRSP_RslvRngCosPLoLim_u16" VALUE 0x00000000 Scalar_UWORD 0 BSW_A2L_Ident_Int 0 65535 /end CHARACTERISTIC
/begin CHARACTERISTIC CAL_MCF_flgLowOrHvudcLnk_b "CAL_MCF_flgLowOrHvudcLnk_b" VALUE 0x00000000 Scalar_BOOLEAN 0 BSW_A2L_Ident_Int 0 1 /end CHARACTERISTIC
/begin CHARACTERISTIC CAL_DEM_Disbl_DFC_SCF_RunToDischarErr_u8 "CAL_DEM_Disbl_DFC_SCF_RunToDischarErr_u8" VALUE 0x00000000 Scalar_UBYTE 0 BSW_A2L_Ident_Int 0 255 /end CHARACTERISTIC
/begin MEASUREMENT VAR_PcfDia_stActPos_u8 "VAR_PcfDia_stActPos_u8" UBYTE BSW_A2L_Ident_Int 1 100 0 255 ECU_ADDRESS 0x00000000 /end MEASUREMENT
/begin MEASUREMENT VAR_TRSP_1V8CPLDVoltRngChkRslt_b "VAR_TRSP_1V8CPLDVoltRngChkRslt_b" UBYTE BSW_A2L_Ident_Int 1 100 0 1 ECU_ADDRESS 0x00000000 /end MEASUREMENT
/begin CHARACTERISTIC CAL_ADM_stModeReq_u8 "CAL_ADM_stModeReq_u8" VALUE 0x00000000 Scalar_UBYTE 0 BSW_A2L_Ident_Int 0 255 /end CHARACTERISTIC
/begin CHARACTERISTIC CAL_DEM_Disbl_DFC_TPC_TDbcULoLimFail_u8 "CAL_DEM_Disbl_DFC_TPC_TDbcULoLimFail_u8" VALUE 0x00000000 Scalar_UBYTE 0 BSW_A2L_Ident_Int 0 255 /end CHARACTERISTIC
/begin CHARACTERISTIC CAL_PcfDia_cntOverAct_u16 "CAL_PcfDia_cntOverAct_u16" VALUE 0x00000000 Scalar_UWORD 0 BSW_A2L_Ident_Int 0 65535 /end CHARACTERISTIC
/begin CHARACTERISTIC CAL_Cspf_flgHwVerSwt_b "CAL_Cspf_flgHwVerSwt_b" VALUE 0x00000000 Scalar_BOOLEAN 0 BSW_A2L_Ident_Int 0 1 /end CHARACTERISTIC
/begin MEASUREMENT VAR_L2Sampling_RslvSinP_VADC_u16 "VAR_L2Sampling_RslvSinP_VADC_u16" UWORD BSW_A2L_Ident_Int 1 100 0 65535 ECU_ADDRESS 0x00000000 /end MEASUREMENT
/begin CHARACTERISTIC CAL_DEM_Disbl_DFC_Cpld_SZTKT_InFail_u8 "CAL_DEM_Disbl_DFC_Cpld_SZTKT_InFail_u8" VALUE 0x00000000 Scalar_UBYTE 0 BSW_A2L_Ident_Int 0 255 /end CHARACTERISTIC
/begin MEASUREMENT VAR_BCC_iDcLnkEst_f32 "VAR_BCC_iDcLnkEst_f32" FLOAT32_IEEE BSW_A2L_Ident_Float 1 100 -3.4E+38 3.4E+38 ECU_ADDRESS 0x00000000 /end MEASUREMENT
/begin CHARACTERISTIC CAL_DEM_Disbl_DFC_RCF_EstOfsErr_u8 "CAL_DEM_Disbl_DFC_RCF_EstOfsErr_u8" VALUE 0x00000000 Scalar_UBYTE 0 BSW_A2L_Ident_Int 0 255 /end CHARACTERISTIC
/begin MEASUREMENT VAR_TpcMot_TSttrOvHiWarnState_u8 "VAR_TpcMot_TSttrOvHiWarnState_u8" UBYTE BSW_A2L_Ident_Int 1 100 0 255 ECU_ADDRESS 0x00000000 /end MEASUREMENT
/begin MEASUREMENT VAR_TpcTmp_CofDertTCoolantSave1_f32 "VAR_TpcTmp_CofDertTCoolantSave1_f32" FLOAT32_IEEE BSW_A2L_Ident_Float 1 100 -3.4E+38 3.4E+38 ECU_ADDRESS 0x00000000 /end MEASUREMENT
/begin MEASUREMENT VAR_BCC_flgstGateDrv_b "VAR_BCC_flgstGateDrv_b" UBYTE BSW_A2L_Ident_Int 1 100 0 1 ECU_ADDRESS 0x00000000 /end MEASUREMENT
/begin MEASUREMENT VAR_FS_DycW_f32 "VAR_FS_DycW_f32" FLOAT32_IEEE BSW_A2L_Ident_Float 1 100 -3.4E+38 3.4E+38 ECU_ADDRESS 0x00000000 /end MEASUREMENT
/begin MEASUREMENT VAR_SWD_Spd_f32 "VAR_SWD_Spd_f32" FLOAT32_IEEE BSW_A2L_Ident_Float 1 100 -3.4E+38 3.4E+38 ECU_ADDRESS 0x00000000 /end MEASUREMENT
/begin MEASUREMENT VAR_DEM_Event_TPC_iDcLnkOvcWarn_Status_u8 "VAR_DEM_Event_TPC_iDcLnkOvcWarn_Status_u8" UBYTE BSW_A2L_Ident_Int 1 100 0 255 ECU_ADDRESS 0x00000000 /end MEASUREMENT
/begin MEASUREMENT VAR_RCF_OfsFlt3800Fwd_f32 "VAR_RCF_OfsFlt3800Fwd_f32" FLOAT32_IEEE BSW_A2L_Ident_Float 1 100 -3.4E+38 3.4E+38 ECU_ADDRESS 0x00000000 /end MEASUREMENT
/begin CHARACTERISTIC CAL_Cspf_bDernDbcTemp_u8 "CAL_Cspf_bDernDbcTemp_u8" VALUE 0x00000000 Scalar_UBYTE 0 BSW_A2L_Ident_Int 0 255 /end CHARACTERISTIC
/begin MEASUREMENT VAR_Scf_flgInitOut_b "VAR_Scf_flgInitOut_b" UBYTE BSW_A2L_Ident_Int 1 100 0 1 ECU_ADDRESS 0x00000000 /end MEASUREMENT
/begin CHARACTERISTIC CAL_MCF_FlgUseOpen_b "CAL_MCF_FlgUseOpen_b" VALUE 0x00000000 Scalar_BOOLEAN 0 BSW_A2L_Ident_Int 0 1 /end CHARACTERISTIC
/begin MEASUREMENT VAR_TpcSmp_GenPwrPIDertOvrVolt_f32 "VAR_TpcSmp_GenPwrPIDertOvrVolt_f32" FLOAT32_IEEE BSW_A2L_Ident_Float 1 100 -3.4E+38 3.4E+38 ECU_ADDRESS 0x00000000 /end MEASUREMENT
/begin CHARACTERISTIC CAL_DEM_FIM_DFC_IOHWAB_DcLnkOverVolFail_au8 "CAL_DEM_FIM_DFC_IOHWAB_DcLnkOverVolFail_au8" VAL_BLK 0x00000000 Scalar_UBYTE 0 FID_Verb 0 255 NUMBER 10 /end CHARACTERISTIC
/begin CHARACTERISTIC CAL_Hspf_TmpVFltFrq_f32 "CAL_Hspf_TmpVFltFrq_f32" VALUE 0x00000000 Scalar_FLOAT32_IEEE 0 BSW_A2L_Ident_Float -3.4E+38 3.4E+38 /end CHARACTERISTIC
/begin MEASUREMENT VAR_Scf_flgShutDwnOvtimErr_u8 "VAR_Scf_flgShutDwnOvtimErr_u8" UBYTE BSW_A2L_Ident_Int 1 100 0 255 ECU_ADDRESS 0x00000000 /end MEASUREMENT
/begin MEASUREMENT VAR_TpcTmp_tDbcTempFlt_u16 "VAR_TpcTmp_tDbcTempFlt_u16" UWORD BSW_A2L_Ident_Int 1 100 0 65535 ECU_ADDRESS 0x00000000 /end MEASUREMENT
/begin MEASUREMENT VAR_DEM_Event_HSPF_VerMatchFailureErr_Status_u8 "VAR_DEM_Event_HSPF_VerMatchFailureErr_Status_u8" UBYTE BSW_A2L_Ident_Int 1 100 0 255 ECU_ADDRESS 0x00000000 /end MEASUREMENT
/begin MEASUREMENT VAR_TpcSmp_cofDertOvrSpdGenQuad2_f32 "VAR_TpcSmp_cofDertOvrSpdGenQuad2_f32" FLOAT32_IEEE BSW_A2L_Ident_Float 1 100 -3.4E+38 3.4E+38 ECU_ADDRESS 0x00000000 /end MEASUREMENT
/begin CHARACTERISTIC CAL_Scf_nSafeMinLim_f32 "CAL_Scf_nSafeMinLim_f32" VALUE 0x00000000 Scalar_FLOAT32_IEEE 0 BSW_A2L_Ident_Float -3.4E+38 3.4E+38 /end CHARACTERISTIC
/begin MEASUREMENT VAR_RCF_TrqEmDesOfsClb_f32 "VAR_RCF_TrqEmDesOfsClb_f32" FLOAT32_IEEE BSW_A2L_Ident_Float 1 100 -3.4E+38 3.4E+38 ECU_ADDRESS 0x00000000 /end MEASUREMENT
/begin MEASUREMENT VAR_MCF_uqDes_f32 "VAR_MCF_uqDes_f32" FLOAT32_IEEE BSW_A2L_Ident_Float 1 100 -3.4E+38 3.4E+38 ECU_ADDRESS 0x00000000 /end MEASUREMENT
/begin MEASUREMENT VAR_PcfStm_flgBPCToFault_b "VAR_PcfStm_flgBPCToFault_b" UBYTE BSW_A2L_Ident_Int 1 100 0 1 ECU_ADDRESS 0x00000000 /end MEASUREMENT
/begin CHARACTERISTIC CAL_DEM_FIM_DFC_TPC_SpdOvHiLimFail_au8 "CAL_DEM_FIM_DFC_TPC_SpdOvHiLimFail_au8" VAL_BLK 0x00000000 Scalar_UBYTE 0 FID_Verb 0 255 NUMBER 10 /end CHARACTERISTIC
/begin MEASUREMENT VAR_DEM_Event_HSPF_MotorOpenErr_Status_u8 "VAR_DEM_Event_HSPF_MotorOpenErr_Status_u8" UBYTE BSW_A2L_Ident_Int 1 100 0 255 ECU_ADDRESS 0x00000000 /end MEASUREMENT
/begin CHARACTERISTIC CAL_TRSP_iPhasSensVoltCountTrh_s16 "CAL_TRSP_iPhasSensVoltCountTrh_s16" VALUE 0x00000000 Scalar_SWORD 0 BSW_A2L_Ident_Int -32768 32767 /end CHARACTERISTIC
/begin MEASUREMENT VAR_PcfCtl_PosKi_f32 "VAR_PcfCtl_PosKi_f32" FLOAT32_IEEE BSW_A2L_Ident_Float 1 100 -3.4E+38 3.4E+38 ECU_ADDRESS 0x00000000 /end MEASUREMENT
/begin MEASUREMENT VAR_DEM_Event_HvMcu_UdcOverFlagLimit_Status_u8 "VAR_DEM_Event_HvMcu_UdcOverFlagLimit_Status_u8" UBYTE BSW_A2L_Ident_Int 1 100 0 255 ECU_ADDRESS 0x00000000 /end MEASUREMENT
/begin CHARACTERISTIC CAL_TpcCod_NTCHighTemp_f32 "CAL_TpcCod_NTCHighTemp_f32" VALUE 0x00000000 Scalar_FLOAT32_IEEE 0 BSW_A2L_Ident_Float -3.4E+38 3.4E+38 /end CHARACTERISTIC
/begin MEASUREMENT VAR_MCF_idMotHeat_f32 "VAR_MCF_idMotHeat_f32" FLOAT32_IEEE BSW_A2L_Ident_Float 1 100 -3.4E+38 3.4E+38 ECU_ADDRESS 0x00000000 /end MEASUREMENT
/begin CHARACTERISTIC CAL_Scf_FFActionArea2_u8 "CAL_Scf_FFActionArea2_u8" VALUE 0x00000000 Scalar_UBYTE 0 BSW_A2L_Ident_Int 0 255 /end CHARACTERISTIC
/begin CHARACTERISTIC CAL_Hspf_CrashChkSubCnt_s8 "CAL_Hspf_CrashChkSubCnt_s8" VALUE 0x00000000 Scalar_BYTE 0 BSW_A2L_Ident_Int -128 127 /end CHARACTERISTIC
/begin CHARACTERISTIC CAL_DEM_Disbl_DFC_TPC_TDrvBoardOvHiWarn_u8 "CAL_DEM_Disbl_DFC_TPC_TDrvBoardOvHiWarn_u8" VALUE 0x00000000 Scalar_UBYTE 0 BSW_A2L_Ident_Int 0 255 /end CHARACTERISTIC
/begin CHARACTERISTIC CAL_RDC_SpdHi_f32 "CAL_RDC_SpdHi_f32" VALUE 0x00000000 Scalar_FLOAT32_IEEE 0 BSW_A2L_Ident_Float -3.4E+38 3.4E+38 /end CHARACTERISTIC
/begin CHARACTERISTIC CAL_IOHWAB_AN30_IUVW_N_REF_MIN_f32 "CAL_IOHWAB_AN30_IUVW_N_REF_MIN_f32" VALUE 0x00000000 Scalar_FLOAT32_IEEE 0 BSW_A2L_Ident_Float -3.4E+38 3.4E+38 /end CHARACTERISTIC
/begin CHARACTERISTIC CAL_STM_UxptTrqMonDebTrh_s16 "CAL_STM_UxptTrqMonDebTrh_s16" VALUE 0x00000000 Scalar_SWORD 0 BSW_A2L_Ident_Int -32768 32767 /end CHARACTERISTIC
/begin CHARACTERISTIC CAL_POWER_UBSBC_Threhold_V5_f32 "CAL_POWER_UBSBC_Threhold_V5_f32" VALUE 0x00000000 Scalar_FLOAT32_IEEE 0 BSW_A2L_Ident_Float -3.4E+38 3.4E+38 /end CHARACTERISTIC
/begin MEASUREMENT VAR_Cspf_TraFailCode4_u8 "VAR_Cspf_TraFailCode4_u8" UBYTE BSW_A2L_Ident_Int 1 100 0 255 ECU_ADDRESS 0x00000000 /end MEASUREMENT
/begin CHARACTERISTIC CAL_TpcTmp_tCoolantTraSave2ToOverheating_f32 "CAL_TpcTmp_tCoolantTraSave2ToOverheating_f32" VALUE 0x00000000 Scalar_FLOAT32_IEEE 0 BSW_A2L_Ident_Float -3.4E+38 3.4E+38 /end CHARACTERISTIC
/begin MEASUREMENT VAR_tpcsmp_PIOutput_f32 "VAR_tpcsmp_PIOutput_f32" FLOAT32_IEEE BSW_A2L_Ident_Float 1 100 -3.4E+38 3.4E+38 ECU_ADDRESS 0x00000000 /end MEASUREMENT
/begin CHARACTERISTIC CAL_DEM_Disbl_DFC_HSPF_tDBCTempCmpErr_u8 "CAL_DEM_Disbl_DFC_HSPF_tDBCTempCmpErr_u8" VALUE 0x00000000 Scalar_UBYTE 0 BSW_A2L_Ident_Int 0 255 /end CHARACTERISTIC
/begin CHARACTERISTIC CAL_DEM_Disbl_DFC_MDF_AlOfsNoPlausErr_u8 "CAL_DEM_Disbl_DFC_MDF_AlOfsNoPlausErr_u8" VALUE 0x00000000 Scalar_UBYTE 0 BSW_A2L_Ident_Int 0 255 /end CHARACTERISTIC
/begin MEASUREMENT VAR_TCF_CurrAgTrqTubeH1_f32 "VAR_TCF_CurrAgTrqTubeH1_f32" FLOAT32_IEEE BSW_A2L_Ident_Float 1 100 -3.4E+38 3.4E+38 ECU_ADDRESS 0x00000000 /end MEASUREMENT
/begin CHARACTERISTIC CAL_TpcMot_SttrTempMinus_f32 "CAL_TpcMot_SttrTempMinus_f32" VALUE 0x00000000 Scalar_FLOAT32_IEEE 0 BSW_A2L_Ident_Float -3.4E+38 3.4E+38 /end CHARACTERISTIC
/begin MEASUREMENT VAR_Vcf_SlipFlag_b "VAR_Vcf_SlipFlag_b" UBYTE BSW_A2L_Ident_Int 1 100 0 1 ECU_ADDRESS 0x00000000 /end MEASUREMENT
/begin MEASUREMENT VAR_RCF_flgUseUsSet_b "VAR_RCF_flgUseUsSet_b" UBYTE BSW_A2L_Ident_Int 1 100 0 1 ECU_ADDRESS 0x00000000 /end MEASUREMENT
/begin CHARACTERISTIC CAL_Scf_curSenChgToPostDrv_f32 "CAL_Scf_curSenChgToPostDrv_f32" VALUE 0x00000000 Scalar_FLOAT32_IEEE 0 BSW_A2L_Ident_Float -3.4E+38 3.4E+38 /end CHARACTERISTIC
/begin MEASUREMENT VAR_PcfDia_flgUnexPosWarn_b "VAR_PcfDia_flgUnexPosWarn_b" UBYTE BSW_A2L_Ident_Int 1 100 0 1 ECU_ADDRESS 0x00000000 /end MEASUREMENT
/begin CHARACTERISTIC CAL_TpcSmp_uDcLnkUnVLim_f32 "CAL_TpcSmp_uDcLnkUnVLim_f32" VALUE 0x00000000 Scalar_FLOAT32_IEEE 0 BSW_A2L_Ident_Float -3.4E+38 3.4E+38 /end CHARACTERISTIC
/begin CHARACTERISTIC CAL_PcfStm_SLWaitimeLimt_u16 "CAL_PcfStm_SLWaitimeLimt_u16" VALUE 0x00000000 Scalar_UWORD 0 BSW_A2L_Ident_Int 0 65535 /end CHARACTERISTIC
/begin MEASUREMENT VAR_TRSP_OfstRngErr_b "VAR_TRSP_OfstRngErr_b" UBYTE BSW_A2L_Ident_Int 1 100 0 1 ECU_ADDRESS 0x00000000 /end MEASUREMENT
/begin CHARACTERISTIC CAL_TRSP_iVCnvFac_f32 "CAL_TRSP_iVCnvFac_f32" VALUE 0x00000000 Scalar_FLOAT32_IEEE 0 BSW_A2L_Ident_Float -3.4E+38 3.4E+38 /end CHARACTERISTIC
/begin CHARACTERISTIC CAL_DEM_Disbl_DFC_IOHWAB_KL30SevOverVolFail_u8 "CAL_DEM_Disbl_DFC_IOHWAB_KL30SevOverVolFail_u8" VALUE 0x00000000 Scalar_UBYTE 0 BSW_A2L_Ident_Int 0 255 /end CHARACTERISTIC
/begin CHARACTERISTIC CAL_MCF_flgUseisTheta_b "CAL_MCF_flgUseisTheta_b" VALUE 0x00000000 Scalar_BOOLEAN 0 BSW_A2L_Ident_Int 0 1 /end CHARACTERISTIC
/begin MEASUREMENT VAR_DEM_Event_IOHWAB_KL30UnderVolErr_Status_u8 "VAR_DEM_Event_IOHWAB_KL30UnderVolErr_Status_u8" UBYTE BSW_A2L_Ident_Int 1 100 0 255 ECU_ADDRESS 0x00000000 /end MEASUREMENT
/begin CHARACTERISTIC CAL_Cspf_flgFailCode1Swt_b "CAL_Cspf_flgFailCode1Swt_b" VALUE 0x00000000 Scalar_BOOLEAN 0 BSW_A2L_Ident_Int 0 1 /end CHARACTERISTIC
/begin MEASUREMENT VAR_MDF_flagOperOutdRngFault_b "VAR_MDF_flagOperOutdRngFault_b" UBYTE BSW_A2L_Ident_Int 1 100 0 1 ECU_ADDRESS 0x00000000 /end MEASUREMENT
/begin MEASUREMENT VAR_IoHwAb_Adc_Phy_12V_Wide_f32 "VAR_IoHwAb_Adc_Phy_12V_Wide_f32" FLOAT32_IEEE BSW_A2L_Ident_Float 1 100 -3.4E+38 3.4E+38 ECU_ADDRESS 0x00000000 /end MEASUREMENT
/begin CHARACTERISTIC CAL_DEM_Disbl_DFC_IOHWAB_TCoolantSampFail_u8 "CAL_DEM_Disbl_DFC_IOHWAB_TCoolantSampFail_u8" VALUE 0x00000000 Scalar_UBYTE 0 BSW_A2L_Ident_Int 0 255 /end CHARACTERISTIC
/begin CHARACTERISTIC CAL_Cspf_flgstDmpCtLReqSwt_b "CAL_Cspf_flgstDmpCtLReqSwt_b" VALUE 0x00000000 Scalar_BOOLEAN 0 BSW_A2L_Ident_Int 0 1 /end CHARACTERISTIC
/begin CHARACTERISTIC CAL_MPC_flgDesOrAct_b "CAL_MPC_flgDesOrAct_b" VALUE 0x00000000 Scalar_BOOLEAN 0 BSW_A2L_Ident_Int 0 1 /end CHARACTERISTIC
/begin MEASUREMENT VAR_RCF_agRtrOffsEstimd_f32 "VAR_RCF_agRtrOffsEstimd_f32" FLOAT32_IEEE BSW_A2L_Ident_Float 1 100 -3.4E+38 3.4E+38 ECU_ADDRESS 0x00000000 /end MEASUREMENT
/begin CHARACTERISTIC CAL_Scf_LowPwrSetUpErr_u8 "CAL_Scf_LowPwrSetUpErr_u8" VALUE 0x00000000 Scalar_UBYTE 0 BSW_A2L_Ident_Int 0 255 /end CHARACTERISTIC
/begin CHARACTERISTIC CAL_TRSP_WCurrRngLoLim_f32 "CAL_TRSP_WCurrRngLoLim_f32" VALUE 0x00000000 Scalar_FLOAT32_IEEE 0 BSW_A2L_Ident_Float -3.4E+38 3.4E+38 /end CHARACTERISTIC
/begin CHARACTERISTIC CAL_TpcMot_SttrChgTempUpDiff_f32 "CAL_TpcMot_SttrChgTempUpDiff_f32" VALUE 0x00000000 Scalar_FLOAT32_IEEE 0 BSW_A2L_Ident_Float -3.4E+38 3.4E+38 /end CHARACTERISTIC
/begin MEASUREMENT VAR_SWD_AgRslv_f32 "VAR_SWD_AgRslv_f32" FLOAT32_IEEE BSW_A2L_Ident_Float 1 100 -3.4E+38 3.4E+38 ECU_ADDRESS 0x00000000 /end MEASUREMENT
/begin CHARACTERISTIC CAL_MCF_CoefFltZero_C_f32 "CAL_MCF_CoefFltZero_C_f32" VALUE 0x00000000 Scalar_FLOAT32_IEEE 0 BSW_A2L_Ident_Float -3.4E+38 3.4E+38 /end CHARACTERISTIC
/begin CHARACTERISTIC CAL_TpcTmp_tRiseDbcTraSave1ToNormal_f32 "CAL_TpcTmp_tRiseDbcTraSave1ToNormal_f32" VALUE 0x00000000 Scalar_FLOAT32_IEEE 0 BSW_A2L_Ident_Float -3.4E+38 3.4E+38 /end CHARACTERISTIC
/begin CHARACTERISTIC CAL_MCF_isMax_f32 "CAL_MCF_isMax_f32" VALUE 0x00000000 Scalar_FLOAT32_IEEE 0 BSW_A2L_Ident_Float -3.4E+38 3.4E+38 /end CHARACTERISTIC
/begin MEASUREMENT VAR_UTjpwr_f32 "VAR_UTjpwr_f32" FLOAT32_IEEE BSW_A2L_Ident_Float 1 100 -3.4E+38 3.4E+38 ECU_ADDRESS 0x00000000 /end MEASUREMENT
/begin CHARACTERISTIC CAL_MPC_nTrqMonMax_f32 "CAL_MPC_nTrqMonMax_f32" VALUE 0x00000000 Scalar_FLOAT32_IEEE 0 BSW_A2L_Ident_Float -3.4E+38 3.4E+38 /end CHARACTERISTIC
/begin CHARACTERISTIC CAL_Scf_StandbyVcuReq_u8 "CAL_Scf_StandbyVcuReq_u8" VALUE 0x00000000 Scalar_UBYTE 0 BSW_A2L_Ident_Int 0 255 /end CHARACTERISTIC
/begin CHARACTERISTIC CAL_TpcSmp_ElecUdrVoltypLim_f32 "CAL_TpcSmp_ElecUdrVoltypLim_f32" VALUE 0x00000000 Scalar_FLOAT32_IEEE 0 BSW_A2L_Ident_Float -3.4E+38 3.4E+38 /end CHARACTERISTIC
/begin CHARACTERISTIC CAL_PcfDia_flgBCLocked_b "CAL_PcfDia_flgBCLocked_b" VALUE 0x00000000 Scalar_BOOLEAN 0 BSW_A2L_Ident_Int 0 1 /end CHARACTERISTIC
/begin MEASUREMENT VAR_RCF_stOfsClbFrwhl_u8 "VAR_RCF_stOfsClbFrwhl_u8" UBYTE BSW_A2L_Ident_Int 1 100 0 255 ECU_ADDRESS 0x00000000 /end MEASUREMENT
/begin CHARACTERISTIC CAL_TpcTmp_DBCRiseTempRiseDiff_f32 "CAL_TpcTmp_DBCRiseTempRiseDiff_f32" VALUE 0x00000000 Scalar_FLOAT32_IEEE 0 BSW_A2L_Ident_Float -3.4E+38 3.4E+38 /end CHARACTERISTIC
/begin CHARACTERISTIC CAL_DEM_FIM_DFC_TPC_uDcLnkUnvWarn_au8 "CAL_DEM_FIM_DFC_TPC_uDcLnkUnvWarn_au8" VAL_BLK 0x00000000 Scalar_UBYTE 0 FID_Verb 0 255 NUMBER 10 /end CHARACTERISTIC
/begin MEASUREMENT VAR_Cspf_TraFailCode7_u8 "VAR_Cspf_TraFailCode7_u8" UBYTE BSW_A2L_Ident_Int 1 100 0 255 ECU_ADDRESS 0x00000000 /end MEASUREMENT
/begin MEASUREMENT VAR_Hspf_flgSttr2NoErr_b "VAR_Hspf_flgSttr2NoErr_b" UBYTE BSW_A2L_Ident_Int 1 100 0 1 ECU_ADDRESS 0x00000000 /end MEASUREMENT
/begin CHARACTERISTIC CAL_PcfSig_IUBSet_f32 "CAL_PcfSig_IUBSet_f32" VALUE 0x00000000 Scalar_FLOAT32_IEEE 0 BSW_A2L_Ident_Float -3.4E+38 3.4E+38 /end CHARACTERISTIC
/begin CHARACTERISTIC CAL_PcfDia_SpdHi_f32 "CAL_PcfDia_SpdHi_f32" VALUE 0x00000000 Scalar_FLOAT32_IEEE 0 BSW_A2L_Ident_Float -3.4E+38 3.4E+38 /end CHARACTERISTIC
/begin MEASUREMENT VAR_Scf_flgTranStbToOfstCal_b "VAR_Scf_flgTranStbToOfstCal_b" UBYTE BSW_A2L_Ident_Int 1 100 0 1 ECU_ADDRESS 0x00000000 /end MEASUREMENT
/begin CHARACTERISTIC CAL_DEM_FIM_DFC_MDF_ICtlRatErr_au8 "CAL_DEM_FIM_DFC_MDF_ICtlRatErr_au8" VAL_BLK 0x00000000 Scalar_UBYTE 0 FID_Verb 0 255 NUMBER 10 /end CHARACTERISTIC
/begin CHARACTERISTIC CAL_Cspf_bDernUndrUdc_u8 "CAL_Cspf_bDernUndrUdc_u8" VALUE 0x00000000 Scalar_UBYTE 0 BSW_A2L_Ident_Int 0 255 /end CHARACTERISTIC
/begin MEASUREMENT VAR_ADM_BMSVolt_f32 "VAR_ADM_BMSVolt_f32" FLOAT32_IEEE BSW_A2L_Ident_Float 1 100 -3.4E+38 3.4E+38 ECU_ADDRESS 0x00000000 /end MEASUREMENT
/begin CHARACTERISTIC CAL_FRP_FaultReactCtl_b "CAL_FRP_FaultReactCtl_b" VALUE 0x00000000 Scalar_BOOLEAN 0 BSW_A2L_Ident_Int 0 1 /end CHARACTERISTIC
/begin CHARACTERISTIC CAL_TpcTmp_DBCRiseTempDecDiff_f32 "CAL_TpcTmp_DBCRiseTempDecDiff_f32" VALUE 0x00000000 Scalar_FLOAT32_IEEE 0 BSW_A2L_Ident_Float -3.4E+38 3.4E+38 /end CHARACTERISTIC
/begin MEASUREMENT VAR_CheckSumTx_MCU_430_u8 "VAR_CheckSumTx_MCU_430_u8" UBYTE BSW_A2L_Ident_Int 1 100 0 255 ECU_ADDRESS 0x00000000 /end MEASUREMENT
/begin CHARACTERISTIC CAL_DEM_Disbl_DFC_IgbtDrv_UpBrgFaultAFail_u8 "CAL_DEM_Disbl_DFC_IgbtDrv_UpBrgFaultAFail_u8" VALUE 0x00000000 Scalar_UBYTE 0 BSW_A2L_Ident_Int 0 255 /end CHARACTERISTIC
/begin MEASUREMENT VAR_TpcSmp_flgPIDertUdrVoltElec_b "VAR_TpcSmp_flgPIDertUdrVoltElec_b" UBYTE BSW_A2L_Ident_Int 1 100 0 1 ECU_ADDRESS 0x00000000 /end MEASUREMENT
/begin MEASUREMENT VAR_TpcMot_ElecTrqRef_f32 "VAR_TpcMot_ElecTrqRef_f32" FLOAT32_IEEE BSW_A2L_Ident_Float 1 100 -3.4E+38 3.4E+38 ECU_ADDRESS 0x00000000 /end MEASUREMENT
/begin CHARACTERISTIC CAL_TCF_Psi_f32 "CAL_TCF_Psi_f32" VALUE 0x00000000 Scalar_FLOAT32_IEEE 0 BSW_A2L_Ident_Float -3.4E+38 3.4E+38 /end CHARACTERISTIC
/begin CHARACTERISTIC CAL_TjrthLv4dlntc_f32 "CAL_TjrthLv4dlntc_f32" VALUE 0x00000000 Scalar_FLOAT32_IEEE 0 BSW_A2L_Ident_Float -3.4E+38 3.4E+38 /end CHARACTERISTIC
/begin MEASUREMENT VAR_NvM_BSW_NVM_AimOutP_au8 "VAR_NvM_BSW_NVM_AimOutP_au8" UBYTE BSW_A2L_Ident_Int 1 100 0 255 ARRAY_SIZE 8 ECU_ADDRESS 0x00000000 /end MEASUREMENT
/begin MEASUREMENT VAR_Scf_DischaBeginUdc_f32 "VAR_Scf_DischaBeginUdc_f32" FLOAT32_IEEE BSW_A2L_Ident_Float 1 100 -3.4E+38 3.4E+38 ECU_ADDRESS 0x00000000 /end MEASUREMENT
/begin MEASUREMENT VAR_TpcSmp_GenPwrLimOvrCurt_f32 "VAR_TpcSmp_GenPwrLimOvrCurt_f32" FLOAT32_IEEE BSW_A2L_Ident_Float 1 100 -3.4E+38 3.4E+38 ECU_ADDRESS 0x00000000 /end MEASUREMENT
/begin MEASUREMENT VAR_PcfStm_BCenMos_b "VAR_PcfStm_BCenMos_b" UBYTE BSW_A2L_Ident_Int 1 100 0 1 ECU_ADDRESS 0x00000000 /end MEASUREMENT
/begin MEASUREMENT VAR_TRSP_TrqSetPRngChkRslt_b "VAR_TRSP_TrqSetPRngChkRslt_b" UBYTE BSW_A2L_Ident_Int 1 100 0 1 ECU_ADDRESS 0x00000000 /end MEASUREMENT
/begin CHARACTERISTIC CAL_Hspf_bt15ChkCntHiLim_u8 "CAL_Hspf_bt15ChkCntHiLim_u8" VALUE 0x00000000 Scalar_UBYTE 0 BSW_A2L_Ident_Int 0 255 /end CHARACTERISTIC
/begin MEASUREMENT VAR_Vcf_AsrSlipFlg2_b "VAR_Vcf_AsrSlipFlg2_b" UBYTE BSW_A2L_Ident_Int 1 100 0 1 ECU_ADDRESS 0x00000000 /end MEASUREMENT
/begin CHARACTERISTIC CAL_TRSP_3V3CPLDVoltCountTrh_s16 "CAL_TRSP_3V3CPLDVoltCountTrh_s16" VALUE 0x00000000 Scalar_SWORD 0 BSW_A2L_Ident_Int -32768 32767 /end CHARACTERISTIC
/begin MEASUREMENT VAR_PcfStm_SLstDiag_u8 "VAR_PcfStm_SLstDiag_u8" UBYTE BSW_A2L_Ident_Int 1 100 0 255 ECU_ADDRESS 0x00000000 /end MEASUREMENT
/begin CHARACTERISTIC CAL_MCF_FixFreq_f32 "CAL_MCF_FixFreq_f32" VALUE 0x00000000 Scalar_FLOAT32_IEEE 0 BSW_A2L_Ident_Float -3.4E+38 3.4E+38 /end CHARACTERISTIC
/begin CHARACTERISTIC CAL_RCF_nOfsClbMinFwd_f32 "CAL_RCF_nOfsClbMinFwd_f32" VALUE 0x00000000 Scalar_FLOAT32_IEEE 0 BSW_A2L_Ident_Float -3.4E+38 3.4E+38 /end CHARACTERISTIC
/begin CHARACTERISTIC CAL_SnapshotRam_Enable_u8 "CAL_SnapshotRam_Enable_u8" VALUE 0x00000000 Scalar_UBYTE 0 BSW_A2L_Ident_Int 0 255 /end CHARACTERISTIC
/begin CHARACTERISTIC CAL_Vcf_SLCalTrqSlp_f32 "CAL_Vcf_SLCalTrqSlp_f32" VALUE 0x00000000 Scalar_FLOAT32_IEEE 0 BSW_A2L_Ident_Float -3.4E+38 3.4E+38 /end CHARACTERISTIC
/begin CHARACTERISTIC CAL_Vcf_SpdCtlReq_u8 "CAL_Vcf_SpdCtlReq_u8" VALUE 0x00000000 Scalar_UBYTE 0 BSW_A2L_Ident_Int 0 255 /end CHARACTERISTIC
/begin CHARACTERISTIC CAL_TRSP_RslvRngSinNHiLim_u16 "CAL_TRSP_RslvRngSinNHiLim_u16" VALUE 0x00000000 Scalar_UWORD 0 BSW_A2L_Ident_Int 0 65535 /end CHARACTERISTIC
/begin CHARACTERISTIC CAL_TpcTmp_tIGBTTraSave2ToOverheating_f32 "CAL_TpcTmp_tIGBTTraSave2ToOverheating_f32" VALUE 0x00000000 Scalar_FLOAT32_IEEE 0 BSW_A2L_Ident_Float -3.4E+38 3.4E+38 /end CHARACTERISTIC
/begin MEASUREMENT VAR_DEM_Event_Event_NvM_ReadErr_Status_u8 "VAR_DEM_Event_Event_NvM_ReadErr_Status_u8" UBYTE BSW_A2L_Ident_Int 1 100 0 255 ECU_ADDRESS 0x00000000 /end MEASUREMENT
/begin CHARACTERISTIC CAL_TRSP_UBRVoltDebTrh_s16 "CAL_TRSP_UBRVoltDebTrh_s16" VALUE 0x00000000 Scalar_SWORD 0 BSW_A2L_Ident_Int -32768 32767 /end CHARACTERISTIC
/begin MEASUREMENT VAR_L2Sampling_RslvCosN_VADC_u16 "VAR_L2Sampling_RslvCosN_VADC_u16" UWORD BSW_A2L_Ident_Int 1 100 0 65535 ECU_ADDRESS 0x00000000 /end MEASUREMENT
/begin MEASUREMENT VAR_FS_VADC_RSLVEXC_u16 "VAR_FS_VADC_RSLVEXC_u16" UWORD BSW_A2L_Ident_Int 1 100 0 65535 ECU_ADDRESS 0x00000000 /end MEASUREMENT
/begin CHARACTERISTIC CAL_DEM_FIM_DFC_HvMcu_ComErr_au8 "CAL_DEM_FIM_DFC_HvMcu_ComErr_au8" VAL_BLK 0x00000000 Scalar_UBYTE 0 FID_Verb 0 255 NUMBER 10 /end CHARACTERISTIC
/begin CHARACTERISTIC CAL_TRSP_iUCnvFac_f32 "CAL_TRSP_iUCnvFac_f32" VALUE 0x00000000 Scalar_FLOAT32_IEEE 0 BSW_A2L_Ident_Float -3.4E+38 3.4E+38 /end CHARACTERISTIC
/begin MEASUREMENT VAR_L2Sampling_RslvCosN_VADC_Max1_u16 "VAR_L2Sampling_RslvCosN_VADC_Max1_u16" UWORD BSW_A2L_Ident_Int 1 100 0 65535 ECU_ADDRESS 0x00000000 /end MEASUREMENT
/begin MEASUREMENT VAR_TpcTmp_GenTrqLimTdbc_f32 "VAR_TpcTmp_GenTrqLimTdbc_f32" FLOAT32_IEEE BSW_A2L_Ident_Float 1 100 -3.4E+38 3.4E+38 ECU_ADDRESS 0x00000000 /end MEASUREMENT
/begin MEASUREMENT VAR_DEM_Event_IOHWAB_SttrSenorShrFail_Status_u8 "VAR_DEM_Event_IOHWAB_SttrSenorShrFail_Status_u8" UBYTE BSW_A2L_Ident_Int 1 100 0 255 ECU_ADDRESS 0x00000000 /end MEASUREMENT
/begin MEASUREMENT VAR_DEM_Event_TPC_TDbcWLoLimFail_Status_u8 "VAR_DEM_Event_TPC_TDbcWLoLimFail_Status_u8" UBYTE BSW_A2L_Ident_Int 1 100 0 255 ECU_ADDRESS 0x00000000 /end MEASUREMENT
/begin MEASUREMENT VAR_DEM_Event_IOHWAB_18VUpBrgSampFail_Status_u8 "VAR_DEM_Event_IOHWAB_18VUpBrgSampFail_Status_u8" UBYTE BSW_A2L_Ident_Int 1 100 0 255 ECU_ADDRESS 0x00000000 /end MEASUREMENT
/begin CHARACTERISTIC CAL_DEM_FIM_DFC_HvMcu_UdcOverFlagLimit_au8 "CAL_DEM_FIM_DFC_HvMcu_UdcOverFlagLimit_au8" VAL_BLK 0x00000000 Scalar_UBYTE 0 FID_Verb 0 255 NUMBER 10 /end CHARACTERISTIC
/begin CHARACTERISTIC CAL_Hvmcu_ComErr_deb_s8 "CAL_Hvmcu_ComErr_deb_s8" VALUE 0x00000000 Scalar_BYTE 0 BSW_A2L_Ident_Int -128 127 /end CHARACTERISTIC
/begin MEASUREMENT VAR_FS_DycV_f32 "VAR_FS_DycV_f32" FLOAT32_IEEE BSW_A2L_Ident_Float 1 100 -3.4E+38 3.4E+38 ECU_ADDRESS 0x00000000 /end MEASUREMENT
/begin CHARACTERISTIC CAL_TCF_TrqCalcMonDebTrh_s16 "CAL_TCF_TrqCalcMonDebTrh_s16" VALUE 0x00000000 Scalar_SWORD 0 BSW_A2L_Ident_Int -32768 32767 /end CHARACTERISTIC
/begin MEASUREMENT VAR_Scf_flgTranStbToSLCal_b "VAR_Scf_flgTranStbToSLCal_b" UBYTE BSW_A2L_Ident_Int 1 100 0 1 ECU_ADDRESS 0x00000000 /end MEASUREMENT
/begin CHARACTERISTIC CAL_Vcf_HoldTrqLoadSwt_b "CAL_Vcf_HoldTrqLoadSwt_b" VALUE 0x00000000 Scalar_BOOLEAN 0 BSW_A2L_Ident_Int 0 1 /end CHARACTERISTIC
/begin CHARACTERISTIC CAL_DEM_FIM_DFC_MDF_PrfElDrvErr_au8 "CAL_DEM_FIM_DFC_MDF_PrfElDrvErr_au8" VAL_BLK 0x00000000 Scalar_UBYTE 0 FID_Verb 0 255 NUMBER 10 /end CHARACTERISTIC
/begin CHARACTERISTIC CAL_Scf_nSnsrClbFw_f32 "CAL_Scf_nSnsrClbFw_f32" VALUE 0x00000000 Scalar_FLOAT32_IEEE 0 BSW_A2L_Ident_Float -3.4E+38 3.4E+38 /end CHARACTERISTIC
/begin CHARACTERISTIC CAL_DEM_Disbl_DFC_Cpld_DI_ExdClk_InFail_u8 "CAL_DEM_Disbl_DFC_Cpld_DI_ExdClk_InFail_u8" VALUE 0x00000000 Scalar_UBYTE 0 BSW_A2L_Ident_Int 0 255 /end CHARACTERISTIC
/begin CHARACTERISTIC CAL_RCF_nOfValFwdStp_f32 "CAL_RCF_nOfValFwdStp_f32" VALUE 0x00000000 Scalar_FLOAT32_IEEE 0 BSW_A2L_Ident_Float -3.4E+38 3.4E+38 /end CHARACTERISTIC
/begin CHARACTERISTIC CAL_Vcf_TrqAbsDiff_f32 "CAL_Vcf_TrqAbsDiff_f32" VALUE 0x00000000 Scalar_FLOAT32_IEEE 0 BSW_A2L_Ident_Float -3.4E+38 3.4E+38 /end CHARACTERISTIC
/begin CHARACTERISTIC CAL_MCF_stDpwm_u8 "CAL_MCF_stDpwm_u8" VALUE 0x00000000 Scalar_UBYTE 0 BSW_A2L_Ident_Int 0 255 /end CHARACTERISTIC
/begin CHARACTERISTIC CAL_Cspf_flgTrqMechFltSwt_b "CAL_Cspf_flgTrqMechFltSwt_b" VALUE 0x00000000 Scalar_BOOLEAN 0 BSW_A2L_Ident_Int 0 1 /end CHARACTERISTIC
/begin MEASUREMENT VAR_DEM_Event_Cpld_Rx_SelfTest_Fail_Status_u8 "VAR_DEM_Event_Cpld_Rx_SelfTest_Fail_Status_u8" UBYTE BSW_A2L_Ident_Int 1 100 0 255 ECU_ADDRESS 0x00000000 /end MEASUREMENT
/begin CHARACTERISTIC CAL_Cspf_flgTrqCurrWoDmpCSwt_b "CAL_Cspf_flgTrqCurrWoDmpCSwt_b" VALUE 0x00000000 Scalar_BOOLEAN 0 BSW_A2L_Ident_Int 0 1 /end CHARACTERISTIC
/begin MEASUREMENT VAR_TpcFuv_FimTrqLimLv4_b "VAR_TpcFuv_FimTrqLimLv4_b" UBYTE BSW_A2L_Ident_Int 1 100 0 1 ECU_ADDRESS 0x00000000 /end MEASUREMENT
/begin CHARACTERISTIC CAL_Scf_uSafeVolt_f32 "CAL_Scf_uSafeVolt_f32" VALUE 0x00000000 Scalar_FLOAT32_IEEE 0 BSW_A2L_Ident_Float -3.4E+38 3.4E+38 /end CHARACTERISTIC
/begin MEASUREMENT VAR_MDF_bshCirNoPsblFaul_b "VAR_MDF_bshCirNoPsblFaul_b" UBYTE BSW_A2L_Ident_Int 1 100 0 1 ECU_ADDRESS 0x00000000 /end MEASUREMENT
/begin MEASUREMENT VAR_TRSP_3V3CPLDVoltRngChkRslt_b "VAR_TRSP_3V3CPLDVoltRngChkRslt_b" UBYTE BSW_A2L_Ident_Int 1 100 0 1 ECU_ADDRESS 0x00000000 /end MEASUREMENT
/begin CHARACTERISTIC CAL_TCF_HiTrqDirStop_f32 "CAL_TCF_HiTrqDirStop_f32" VALUE 0x00000000 Scalar_FLOAT32_IEEE 0 BSW_A2L_Ident_Float -3.4E+38 3.4E+38 /end CHARACTERISTIC
/begin CHARACTERISTIC CAL_DEM_Disbl_DFC_TPC_TDbcOvHiWarn_u8 "CAL_DEM_Disbl_DFC_TPC_TDbcOvHiWarn_u8" VALUE 0x00000000 Scalar_UBYTE 0 BSW_A2L_Ident_Int 0 255 /end CHARACTERISTIC
/begin CHARACTERISTIC CAL_Cspf_tDBCTempUFlt_f32 "CAL_Cspf_tDBCTempUFlt_f32" VALUE 0x00000000 Scalar_FLOAT32_IEEE 0 BSW_A2L_Ident_Float -3.4E+38 3.4E+38 /end CHARACTERISTIC
/begin CHARACTERISTIC CAL_MCF_KiUdEOL_f32 "CAL_MCF_KiUdEOL_f32" VALUE 0x00000000 Scalar_FLOAT32_IEEE 0 BSW_A2L_Ident_Float -3.4E+38 3.4E+38 /end CHARACTERISTIC
/begin CHARACTERISTIC CAL_Hspf_uDcLnkFltFrq_f32 "CAL_Hspf_uDcLnkFltFrq_f32" VALUE 0x00000000 Scalar_FLOAT32_IEEE 0 BSW_A2L_Ident_Float -3.4E+38 3.4E+38 /end CHARACTERISTIC
/begin MEASUREMENT VAR_TRSP_RslvCosNRngChkRslt_b "VAR_TRSP_RslvCosNRngChkRslt_b" UBYTE BSW_A2L_Ident_Int 1 100 0 1 ECU_ADDRESS 0x00000000 /end MEASUREMENT
/begin MEASUREMENT VAR_DEM_Event_TPC_uDcLnkOvWarn_Status_u8 "VAR_DEM_Event_TPC_uDcLnkOvWarn_Status_u8" UBYTE BSW_A2L_Ident_Int 1 100 0 255 ECU_ADDRESS 0x00000000 /end MEASUREMENT
/begin CHARACTERISTIC CAL_Vcf_FunctionReqSwt_b "CAL_Vcf_FunctionReqSwt_b" VALUE 0x00000000 Scalar_BOOLEAN 0 BSW_A2L_Ident_Int 0 1 /end CHARACTERISTIC
/begin MEASUREMENT VAR_TpcSmp_cofDertUdrVoltElec_f32 "VAR_TpcSmp_cofDertUdrVoltElec_f32" FLOAT32_IEEE BSW_A2L_Ident_Float 1 100 -3.4E+38 3.4E+38 ECU_ADDRESS 0x00000000 /end MEASUREMENT
/begin CHARACTERISTIC CAL_MCF_perCpnAg_f32 "CAL_MCF_perCpnAg_f32" VALUE 0x00000000 Scalar_FLOAT32_IEEE 0 BSW_A2L_Ident_Float -3.4E+38 3.4E+38 /end CHARACTERISTIC
/begin CHARACTERISTIC CAL_DEM_FIM_DFC_RSL_DOSErr_au8 "CAL_DEM_FIM_DFC_RSL_DOSErr_au8" VAL_BLK 0x00000000 Scalar_UBYTE 0 FID_Verb 0 255 NUMBER 10 /end CHARACTERISTIC
/begin CHARACTERISTIC CAL_Vcf_GearLvR_u8 "CAL_Vcf_GearLvR_u8" VALUE 0x00000000 Scalar_UBYTE 0 BSW_A2L_Ident_Int 0 255 /end CHARACTERISTIC
/begin CHARACTERISTIC CAL_DEM_FIM_DFC_IgbtDrv_UpBrgFaultAFail_au8 "CAL_DEM_FIM_DFC_IgbtDrv_UpBrgFaultAFail_au8" VAL_BLK 0x00000000 Scalar_UBYTE 0 FID_Verb 0 255 NUMBER 10 /end CHARACTERISTIC
/begin CHARACTERISTIC CAL_Cspf_flgbDernDrvBoardTempSwt_b "CAL_Cspf_flgbDernDrvBoardTempSwt_b" VALUE 0x00000000 Scalar_BOOLEAN 0 BSW_A2L_Ident_Int 0 1 /end CHARACTERISTIC
/begin CHARACTERISTIC CAL_RCF_tMaxAcc_u16 "CAL_RCF_tMaxAcc_u16" VALUE 0x00000000 Scalar_UWORD 0 BSW_A2L_Ident_Int 0 65535 /end CHARACTERISTIC
/begin MEASUREMENT VAR_MDF_bIsOvHiFault_b "VAR_MDF_bIsOvHiFault_b" UBYTE BSW_A2L_Ident_Int 1 100 0 1 ECU_ADDRESS 0x00000000 /end MEASUREMENT
/begin MEASUREMENT VAR_IgbtDrv_Level_NRST_RDY_u8 "VAR_IgbtDrv_Level_NRST_RDY_u8" UBYTE BSW_A2L_Ident_Int 1 100 0 255 ECU_ADDRESS 0x00000000 /end MEASUREMENT
/begin CHARACTERISTIC CAL_Vcf_TrqSlopAccStep_f32 "CAL_Vcf_TrqSlopAccStep_f32" VALUE 0x00000000 Scalar_FLOAT32_IEEE 0 BSW_A2L_Ident_Float -3.4E+38 3.4E+38 /end CHARACTERISTIC
/begin MEASUREMENT VAR_STM1_TimeData_VADC_RDC_u32 "VAR_STM1_TimeData_VADC_RDC_u32" ULONG BSW_A2L_Ident_Int 1 100 0 4294967295 ECU_ADDRESS 0x00000000 /end MEASUREMENT
/begin CHARACTERISTIC CAL_DEM_FIM_DFC_TPC_TSttrOvHiWarn_au8 "CAL_DEM_FIM_DFC_TPC_TSttrOvHiWarn_au8" VAL_BLK 0x00000000 Scalar_UBYTE 0 FID_Verb 0 255 NUMBER 10 /end CHARACTERISTIC
/begin CHARACTERISTIC CAL_DEM_Disbl_DFC_TPC_SpdOvHiWarn_u8 "CAL_DEM_Disbl_DFC_TPC_SpdOvHiWarn_u8" VALUE 0x00000000 Scalar_UBYTE 0 BSW_A2L_Ident_Int 0 255 /end CHARACTERISTIC
/begin MEASUREMENT VAR_TpcMot_flgTrqLimTsttrActv_b "VAR_TpcMot_flgTrqLimTsttrActv_b" UBYTE BSW_A2L_Ident_Int 1 100 0 1 ECU_ADDRESS 0x00000000 /end MEASUREMENT
/begin CHARACTERISTIC CAL_MCF_KiMotHeat_f32 "CAL_MCF_KiMotHeat_f32" VALUE 0x00000000 Scalar_FLOAT32_IEEE 0 BSW_A2L_Ident_Float -3.4E+38 3.4E+38 /end CHARACTERISTIC
/begin MEASUREMENT VAR_Vcf_AsrUnLolim_b "VAR_Vcf_AsrUnLolim_b" UBYTE BSW_A2L_Ident_Int 1 100 0 1 ECU_ADDRESS 0x00000000 /end MEASUREMENT
/begin MEASUREMENT VAR_PcfSig_Pos2_f32 "VAR_PcfSig_Pos2_f32" FLOAT32_IEEE BSW_A2L_Ident_Float 1 100 -3.4E+38 3.4E+38 ECU_ADDRESS 0x00000000 /end MEASUREMENT
/begin CHARACTERISTIC CAL_RCF_nLimitSucToDef_f32 "CAL_RCF_nLimitSucToDef_f32" VALUE 0x00000000 Scalar_FLOAT32_IEEE 0 BSW_A2L_Ident_Float -3.4E+38 3.4E+38 /end CHARACTERISTIC
/begin CHARACTERISTIC CAL_RCF_360EdgeRag_f32 "CAL_RCF_360EdgeRag_f32" VALUE 0x00000000 Scalar_FLOAT32_IEEE 0 BSW_A2L_Ident_Float -3.4E+38 3.4E+38 /end CHARACTERISTIC
/begin MEASUREMENT VAR_Vcf_SlopeReq_f32 "VAR_Vcf_SlopeReq_f32" FLOAT32_IEEE BSW_A2L_Ident_Float 1 100 -3.4E+38 3.4E+38 ECU_ADDRESS 0x00000000 /end MEASUREMENT
/begin CHARACTERISTIC CAL_Scf_flgActvSubisSwt_b "CAL_Scf_flgActvSubisSwt_b" VALUE 0x00000000 Scalar_BOOLEAN 0 BSW_A2L_Ident_Int 0 1 /end CHARACTERISTIC
/begin CHARACTERISTIC CAL_ADM_BMSVoltRngErrDebThr_s16 "CAL_ADM_BMSVoltRngErrDebThr_s16" VALUE 0x00000000 Scalar_SWORD 0 BSW_A2L_Ident_Int -32768 32767 /end CHARACTERISTIC
/begin MEASUREMENT VAR_PcfSig_flgACC_b "VAR_PcfSig_flgACC_b" UBYTE BSW_A2L_Ident_Int 1 100 0 1 ECU_ADDRESS 0x00000000 /end MEASUREMENT
/begin MEASUREMENT VAR_Cspf_TraiGBTTempV_f32 "VAR_Cspf_TraiGBTTempV_f32" FLOAT32_IEEE BSW_A2L_Ident_Float 1 100 -3.4E+38 3.4E+38 ECU_ADDRESS 0x00000000 /end MEASUREMENT
/begin CHARACTERISTIC CAL_MCF_BetaRefZeroCtl_f32 "CAL_MCF_BetaRefZeroCtl_f32" VALUE 0x00000000 Scalar_FLOAT32_IEEE 0 BSW_A2L_Ident_Float -3.4E+38 3.4E+38 /end CHARACTERISTIC
/begin MEASUREMENT VAR_DEM_HisEvtFailedList_au8 "VAR_DEM_HisEvtFailedList_au8" UBYTE BSW_A2L_Ident_Int 1 100 0 255 ARRAY_SIZE 24 ECU_ADDRESS 0x00000000 /end MEASUREMENT
/begin CHARACTERISTIC CAL_DEM_Disbl_DFC_MDF_DiashCirNoPsblErr_u8 "CAL_DEM_Disbl_DFC_MDF_DiashCirNoPsblErr_u8" VALUE 0x00000000 Scalar_UBYTE 0 BSW_A2L_Ident_Int 0 255 /end CHARACTERISTIC
/begin MEASUREMENT VAR_TpcSmp_flgGenPwrLimOvrVoltActv_b "VAR_TpcSmp_flgGenPwrLimOvrVoltActv_b" UBYTE BSW_A2L_Ident_Int 1 100 0 1 ECU_ADDRESS 0x00000000 /end MEASUREMENT
/begin MEASUREMENT VAR_Cspf_TrabDernOvrUdc_u8 "VAR_Cspf_TrabDernOvrUdc_u8" UBYTE BSW_A2L_Ident_Int 1 100 0 255 ECU_ADDRESS 0x00000000 /end MEASUREMENT
/begin CHARACTERISTIC CAL_Cspf_flgFailCode7Swt_b "CAL_Cspf_flgFailCode7Swt_b" VALUE 0x00000000 Scalar_BOOLEAN 0 BSW_A2L_Ident_Int 0 1 /end CHARACTERISTIC
/begin MEASUREMENT VAR_MCF_uAOfsClb_f32 "VAR_MCF_uAOfsClb_f32" FLOAT32_IEEE BSW_A2L_Ident_Float 1 100 -3.4E+38 3.4E+38 ECU_ADDRESS 0x00000000 /end MEASUREMENT
/begin CHARACTERISTIC CAL_MCF_iVCnvFac_f32 "CAL_MCF_iVCnvFac_f32" VALUE 0x00000000 Scalar_FLOAT32_IEEE 0 BSW_A2L_Ident_Float -3.4E+38 3.4E+38 /end CHARACTERISTIC
/begin CHARACTERISTIC CAL_Vcf_Crawltrqsub_f32 "CAL_Vcf_Crawltrqsub_f32" VALUE 0x00000000 Scalar_FLOAT32_IEEE 0 BSW_A2L_Ident_Float -3.4E+38 3.4E+38 /end CHARACTERISTIC
/begin CHARACTERISTIC CAL_DEM_Disbl_DFC_PCF_SenOvErr_u8 "CAL_DEM_Disbl_DFC_PCF_SenOvErr_u8" VALUE 0x00000000 Scalar_UBYTE 0 BSW_A2L_Ident_Int 0 255 /end CHARACTERISTIC
/begin MEASUREMENT VAR_TRSP_UB_SBC_f32 "VAR_TRSP_UB_SBC_f32" FLOAT32_IEEE BSW_A2L_Ident_Float 1 100 -3.4E+38 3.4E+38 ECU_ADDRESS 0x00000000 /end MEASUREMENT
/begin CHARACTERISTIC CAL_Cspf_FailCode2_u8 "CAL_Cspf_FailCode2_u8" VALUE 0x00000000 Scalar_UBYTE 0 BSW_A2L_Ident_Int 0 255 /end CHARACTERISTIC
/begin CHARACTERISTIC CAL_TpcSmp_GenOvrCurtKp_f32 "CAL_TpcSmp_GenOvrCurtKp_f32" VALUE 0x00000000 Scalar_FLOAT32_IEEE 0 BSW_A2L_Ident_Float -3.4E+38 3.4E+38 /end CHARACTERISTIC
/begin MEASUREMENT VAR_PcfSig_stParkCtlReq_u8 "VAR_PcfSig_stParkCtlReq_u8" UBYTE BSW_A2L_Ident_Int 1 100 0 255 ECU_ADDRESS 0x00000000 /end MEASUREMENT
/begin CHARACTERISTIC CAL_Vcf_CrawlSwt_b "CAL_Vcf_CrawlSwt_b" VALUE 0x00000000 Scalar_BOOLEAN 0 BSW_A2L_Ident_Int 0 1 /end CHARACTERISTIC
/begin MEASUREMENT VAR_tpccod_flgMinDertExCTrq_b "VAR_tpccod_flgMinDertExCTrq_b" UBYTE BSW_A2L_Ident_Int 1 100 0 1 ECU_ADDRESS 0x00000000 /end MEASUREMENT
/begin CHARACTERISTIC CAL_PcfStm_cntSLWaitRunLimt_u16 "CAL_PcfStm_cntSLWaitRunLimt_u16" VALUE 0x00000000 Scalar_UWORD 0 BSW_A2L_Ident_Int 0 65535 /end CHARACTERISTIC
/begin CHARACTERISTIC CAL_Hspf_tSwtTempSttrHiLim_f32 "CAL_Hspf_tSwtTempSttrHiLim_f32" VALUE 0x00000000 Scalar_FLOAT32_IEEE 0 BSW_A2L_Ident_Float -3.4E+38 3.4E+38 /end CHARACTERISTIC
/begin MEASUREMENT VAR_DEM_Event_FR_StorageErr_Status_u8 "VAR_DEM_Event_FR_StorageErr_Status_u8" UBYTE BSW_A2L_Ident_Int 1 100 0 255 ECU_ADDRESS 0x00000000 /end MEASUREMENT
/begin MEASUREMENT VAR_DEM_Event_IOHWAB_Nen33Fail_Status_u8 "VAR_DEM_Event_IOHWAB_Nen33Fail_Status_u8" UBYTE BSW_A2L_Ident_Int 1 100 0 255 ECU_ADDRESS 0x00000000 /end MEASUREMENT
/begin CHARACTERISTIC CAL_PcfStm_SLActRunSpdUp_f32 "CAL_PcfStm_SLActRunSpdUp_f32" VALUE 0x00000000 Scalar_FLOAT32_IEEE 0 BSW_A2L_Ident_Float -3.4E+38 3.4E+38 /end CHARACTERISTIC
/begin CHARACTERISTIC CAL_Scf_ThreRuntoDischaFail_u8 "CAL_Scf_ThreRuntoDischaFail_u8" VALUE 0x00000000 Scalar_UBYTE 0 BSW_A2L_Ident_Int 0 255 /end CHARACTERISTIC
/begin MEASUREMENT VAR_tpccod_flgMinDertUndrUdc_b "VAR_tpccod_flgMinDertUndrUdc_b" UBYTE BSW_A2L_Ident_Int 1 100 0 1 ECU_ADDRESS 0x00000000 /end MEASUREMENT
/begin CHARACTERISTIC CAL_Vcf_GearHoldOutSwt_b "CAL_Vcf_GearHoldOutSwt_b" VALUE 0x00000000 Scalar_BOOLEAN 0 BSW_A2L_Ident_Int 0 1 /end CHARACTERISTIC
/begin CHARACTERISTIC CAL_TpcTmp_tRiseDbcTraNormalToSave1_f32 "CAL_TpcTmp_tRiseDbcTraNormalToSave1_f32" VALUE 0x00000000 Scalar_FLOAT32_IEEE 0 BSW_A2L_Ident_Float -3.4E+38 3.4E+38 /end CHARACTERISTIC
/begin MEASUREMENT VAR_TpcSmp_flgGenTrqLimOvrSpdActv_b "VAR_TpcSmp_flgGenTrqLimOvrSpdActv_b" UBYTE BSW_A2L_Ident_Int 1 100 0 1 ECU_ADDRESS 0x00000000 /end MEASUREMENT
/begin CHARACTERISTIC CAL_DEM_FIM_DFC_HvMcu_UartCheckFailErr_au8 "CAL_DEM_FIM_DFC_HvMcu_UartCheckFailErr_au8" VAL_BLK 0x00000000 Scalar_UBYTE 0 FID_Verb 0 255 NUMBER 10 /end CHARACTERISTIC
/begin CHARACTERISTIC CAL_Cspf_uDcLnkSlowFlt_f32 "CAL_Cspf_uDcLnkSlowFlt_f32" VALUE 0x00000000 Scalar_FLOAT32_IEEE 0 BSW_A2L_Ident_Float -3.4E+38 3.4E+38 /end CHARACTERISTIC
/begin MEASUREMENT VAR_MDF_bFaultEMBlkWarn_b "VAR_MDF_bFaultEMBlkWarn_b" UBYTE BSW_A2L_Ident_Int 1 100 0 1 ECU_ADDRESS 0x00000000 /end MEASUREMENT
/begin CHARACTERISTIC CAL_TRSP_RslvRngCountTrh_s16 "CAL_TRSP_RslvRngCountTrh_s16" VALUE 0x00000000 Scalar_SWORD 0 BSW_A2L_Ident_Int -32768 32767 /end CHARACTERISTIC
/begin MEASUREMENT VAR_DEM_Event_IOHWAB_SttrTemp2SampFail_Status_u8 "VAR_DEM_Event_IOHWAB_SttrTemp2SampFail_Status_u8" UBYTE BSW_A2L_Ident_Int 1 100 0 255 ECU_ADDRESS 0x00000000 /end MEASUREMENT
/begin CHARACTERISTIC CAL_PcfSig_deltaAimOutP_f32 "CAL_PcfSig_deltaAimOutP_f32" VALUE 0x00000000 Scalar_FLOAT32_IEEE 0 BSW_A2L_Ident_Float -3.4E+38 3.4E+38 /end CHARACTERISTIC
/begin MEASUREMENT VAR_TpcTmp_CofDertTRiseIGBTSave1_f32 "VAR_TpcTmp_CofDertTRiseIGBTSave1_f32" FLOAT32_IEEE BSW_A2L_Ident_Float 1 100 -3.4E+38 3.4E+38 ECU_ADDRESS 0x00000000 /end MEASUREMENT
/begin MEASUREMENT VAR_L2Sampling_DycUMon_f32 "VAR_L2Sampling_DycUMon_f32" FLOAT32_IEEE BSW_A2L_Ident_Float 1 100 -3.4E+38 3.4E+38 ECU_ADDRESS 0x00000000 /end MEASUREMENT
/begin CHARACTERISTIC CAL_RCF_SuccdToDefault_b "CAL_RCF_SuccdToDefault_b" VALUE 0x00000000 Scalar_BOOLEAN 0 BSW_A2L_Ident_Int 0 1 /end CHARACTERISTIC
/begin CHARACTERISTIC CAL_Cspf_flgtDBCTempUFltSwt_b "CAL_Cspf_flgtDBCTempUFltSwt_b" VALUE 0x00000000 Scalar_BOOLEAN 0 BSW_A2L_Ident_Int 0 1 /end CHARACTERISTIC
/begin CHARACTERISTIC CAL_Hspf_Multiple_u8 "CAL_Hspf_Multiple_u8" VALUE 0x00000000 Scalar_UBYTE 0 BSW_A2L_Ident_Int 0 255 /end CHARACTERISTIC
/begin MEASUREMENT VAR_DEM_DiagEvtHistList_au8 "VAR_DEM_DiagEvtHistList_au8" UBYTE BSW_A2L_Ident_Int 1 100 0 255 ARRAY_SIZE 24 ECU_ADDRESS 0x00000000 /end MEASUREMENT
/begin MEASUREMENT VAR_Cspf_TraUdcCurr_f32 "VAR_Cspf_TraUdcCurr_f32" FLOAT32_IEEE BSW_A2L_Ident_Float 1 100 -3.4E+38 3.4E+38 ECU_ADDRESS 0x00000000 /end MEASUREMENT
/begin CHARACTERISTIC CAL_DEM_Disbl_DFC_TPC_TDbcVLoLimFail_u8 "CAL_DEM_Disbl_DFC_TPC_TDbcVLoLimFail_u8" VALUE 0x00000000 Scalar_UBYTE 0 BSW_A2L_Ident_Int 0 255 /end CHARACTERISTIC
/begin MEASUREMENT VAR_RCF_flgFailorFnhToDefault_b "VAR_RCF_flgFailorFnhToDefault_b" UBYTE BSW_A2L_Ident_Int 1 100 0 1 ECU_ADDRESS 0x00000000 /end MEASUREMENT
/begin MEASUREMENT VAR_Cspf_TraFailCode3_u8 "VAR_Cspf_TraFailCode3_u8" UBYTE BSW_A2L_Ident_Int 1 100 0 255 ECU_ADDRESS 0x00000000 /end MEASUREMENT
/begin MEASUREMENT VAR_ADM_GlbDchgErr_b "VAR_ADM_GlbDchgErr_b" UBYTE BSW_A2L_Ident_Int 1 100 0 1 ECU_ADDRESS 0x00000000 /end MEASUREMENT
/begin CHARACTERISTIC CAL_DEM_FIM_DFC_Cpld_UdcOverVolFail_au8 "CAL_DEM_FIM_DFC_Cpld_UdcOverVolFail_au8" VAL_BLK 0x00000000 Scalar_UBYTE 0 FID_Verb 0 255 NUMBER 10 /end CHARACTERISTIC
/begin CHARACTERISTIC CAL_MDF_tiQuitEMBlk_f32 "CAL_MDF_tiQuitEMBlk_f32" VALUE 0x00000000 Scalar_FLOAT32_IEEE 0 BSW_A2L_Ident_Float -3.4E+38 3.4E+38 /end CHARACTERISTIC
/begin MEASUREMENT VAR_PcfSig_tMosPcf_f32 "VAR_PcfSig_tMosPcf_f32" FLOAT32_IEEE BSW_A2L_Ident_Float 1 100 -3.4E+38 3.4E+38 ECU_ADDRESS 0x00000000 /end MEASUREMENT
/begin CHARACTERISTIC CAL_TRSP_RslvExciDebTrh_s16 "CAL_TRSP_RslvExciDebTrh_s16" VALUE 0x00000000 Scalar_SWORD 0 BSW_A2L_Ident_Int -32768 32767 /end CHARACTERISTIC
/begin CHARACTERISTIC CAL_PcfSig_flgACC_b "CAL_PcfSig_flgACC_b" VALUE 0x00000000 Scalar_BOOLEAN 0 BSW_A2L_Ident_Int 0 1 /end CHARACTERISTIC
/begin CHARACTERISTIC CAL_DEM_Disbl_DFC_Cpld_ExdClkInFail_u8 "CAL_DEM_Disbl_DFC_Cpld_ExdClkInFail_u8" VALUE 0x00000000 Scalar_UBYTE 0 BSW_A2L_Ident_Int 0 255 /end CHARACTERISTIC
/begin CHARACTERISTIC CAL_PcfSig_flgKL15_b "CAL_PcfSig_flgKL15_b" VALUE 0x00000000 Scalar_BOOLEAN 0 BSW_A2L_Ident_Int 0 1 /end CHARACTERISTIC
/begin CHARACTERISTIC CAL_TpcTmp_tRiseDbcTraSave2ToOverheating_f32 "CAL_TpcTmp_tRiseDbcTraSave2ToOverheating_f32" VALUE 0x00000000 Scalar_FLOAT32_IEEE 0 BSW_A2L_Ident_Float -3.4E+38 3.4E+38 /end CHARACTERISTIC
/begin MEASUREMENT VAR_Hspf_tStrrTemp1_s16 "VAR_Hspf_tStrrTemp1_s16" SWORD BSW_A2L_Ident_Int 1 100 -32768 32767 ECU_ADDRESS 0x00000000 /end MEASUREMENT
/begin CHARACTERISTIC CAL_PcfDia_PosHighset_f32 "CAL_PcfDia_PosHighset_f32" VALUE 0x00000000 Scalar_FLOAT32_IEEE 0 BSW_A2L_Ident_Float -3.4E+38 3.4E+38 /end CHARACTERISTIC
/begin CHARACTERISTIC CAL_DEM_Disbl_DFC_MDF_IsOvHiErr_u8 "CAL_DEM_Disbl_DFC_MDF_IsOvHiErr_u8" VALUE 0x00000000 Scalar_UBYTE 0 BSW_A2L_Ident_Int 0 255 /end CHARACTERISTIC
/begin CHARACTERISTIC CAL_TpcSmp_PwrAddMaxGen_f32 "CAL_TpcSmp_PwrAddMaxGen_f32" VALUE 0x00000000 Scalar_FLOAT32_IEEE 0 BSW_A2L_Ident_Float -3.4E+38 3.4E+38 /end CHARACTERISTIC
/begin CHARACTERISTIC CAL_TpcTmp_DbcChgTempDownDiff_f32 "CAL_TpcTmp_DbcChgTempDownDiff_f32" VALUE 0x00000000 Scalar_FLOAT32_IEEE 0 BSW_A2L_Ident_Float -3.4E+38 3.4E+38 /end CHARACTERISTIC
/begin MEASUREMENT VAR_TpcSmp_GenPwrLinearDertOvrVolt_f32 "VAR_TpcSmp_GenPwrLinearDertOvrVolt_f32" FLOAT32_IEEE BSW_A2L_Ident_Float 1 100 -3.4E+38 3.4E+38 ECU_ADDRESS 0x00000000 /end MEASUREMENT
/begin CHARACTERISTIC CAL_Cspf_flgFailCode6Swt_b "CAL_Cspf_flgFailCode6Swt_b" VALUE 0x00000000 Scalar_BOOLEAN 0 BSW_A2L_Ident_Int 0 1 /end CHARACTERISTIC
/begin MEASUREMENT VAR_RDC_nWoFlt_f32 "VAR_RDC_nWoFlt_f32" FLOAT32_IEEE BSW_A2L_Ident_Float 1 100 -3.4E+38 3.4E+38 ECU_ADDRESS 0x00000000 /end MEASUREMENT
/begin CHARACTERISTIC CAL_TpcSmp_CntElecUdrVolt_u8 "CAL_TpcSmp_CntElecUdrVolt_u8" VALUE 0x00000000 Scalar_UBYTE 0 BSW_A2L_Ident_Int 0 255 /end CHARACTERISTIC
/begin MEASUREMENT VAR_PcfStm_SLEnMotorAcc_b "VAR_PcfStm_SLEnMotorAcc_b" UBYTE BSW_A2L_Ident_Int 1 100 0 1 ECU_ADDRESS 0x00000000 /end MEASUREMENT
/begin MEASUREMENT VAR_TpcSmp_cofDertOvrSpdGenQuad4_f32 "VAR_TpcSmp_cofDertOvrSpdGenQuad4_f32" FLOAT32_IEEE BSW_A2L_Ident_Float 1 100 -3.4E+38 3.4E+38 ECU_ADDRESS 0x00000000 /end MEASUREMENT
/begin MEASUREMENT VAR_TpcCod_ElecTrqCalcDiag_f32 "VAR_TpcCod_ElecTrqCalcDiag_f32" FLOAT32_IEEE BSW_A2L_Ident_Float 1 100 -3.4E+38 3.4E+38 ECU_ADDRESS 0x00000000 /end MEASUREMENT
/begin CHARACTERISTIC CAL_Cspf_DataVer_u16 "CAL_Cspf_DataVer_u16" VALUE 0x00000000 Scalar_UWORD 0 BSW_A2L_Ident_Int 0 65535 /end CHARACTERISTIC
/begin MEASUREMENT VAR_MCF_AgRem_f32 "VAR_MCF_AgRem_f32" FLOAT32_IEEE BSW_A2L_Ident_Float 1 100 -3.4E+38 3.4E+38 ECU_ADDRESS 0x00000000 /end MEASUREMENT
/begin CHARACTERISTIC CAL_DEM_Disbl_DFC_Cpld_Rx_SelfTest_Fail_u8 "CAL_DEM_Disbl_DFC_Cpld_Rx_SelfTest_Fail_u8" VALUE 0x00000000 Scalar_UBYTE 0 BSW_A2L_Ident_Int 0 255 /end CHARACTERISTIC
/begin CHARACTERISTIC CAL_Tpc_Powersave2Mode_u8 "CAL_Tpc_Powersave2Mode_u8" VALUE 0x00000000 Scalar_UBYTE 0 BSW_A2L_Ident_Int 0 255 /end CHARACTERISTIC
/begin CHARACTERISTIC CAL_PcfDia_PosLowset_f32 "CAL_PcfDia_PosLowset_f32" VALUE 0x00000000 Scalar_FLOAT32_IEEE 0 BSW_A2L_Ident_Float -3.4E+38 3.4E+38 /end CHARACTERISTIC
/begin MEASUREMENT VAR_flgRecVCU02_u8 "VAR_flgRecVCU02_u8" UBYTE BSW_A2L_Ident_Int 1 100 0 255 ECU_ADDRESS 0x00000000 /end MEASUREMENT
/begin CHARACTERISTIC CAL_Vcf_TrqDecRatio_f32 "CAL_Vcf_TrqDecRatio_f32" VALUE 0x00000000 Scalar_FLOAT32_IEEE 0 BSW_A2L_Ident_Float -3.4E+38 3.4E+38 /end CHARACTERISTIC
/begin CHARACTERISTIC CAL_DEM_Disbl_DFC_TPC_iDcLnkOvcWarn_u8 "CAL_DEM_Disbl_DFC_TPC_iDcLnkOvcWarn_u8" VALUE 0x00000000 Scalar_UBYTE 0 BSW_A2L_Ident_Int 0 255 /end CHARACTERISTIC
/begin CHARACTERISTIC CAL_DEM_Disbl_DFC_RCF_PsiOvErr_u8 "CAL_DEM_Disbl_DFC_RCF_PsiOvErr_u8" VALUE 0x00000000 Scalar_UBYTE 0 BSW_A2L_Ident_Int 0 255 /end CHARACTERISTIC
/begin MEASUREMENT VAR_TpcTmp_GenTrqLimTdbcWoRamp_f32 "VAR_TpcTmp_GenTrqLimTdbcWoRamp_f32" FLOAT32_IEEE BSW_A2L_Ident_Float 1 100 -3.4E+38 3.4E+38 ECU_ADDRESS 0x00000000 /end MEASUREMENT
/begin CHARACTERISTIC CAL_PcfSig_iSENCnvFac_f32 "CAL_PcfSig_iSENCnvFac_f32" VALUE 0x00000000 Scalar_FLOAT32_IEEE 0 BSW_A2L_Ident_Float -3.4E+38 3.4E+38 /end CHARACTERISTIC
/begin CHARACTERISTIC CAL_MDF_stFrwhlWiIs_u8 "CAL_MDF_stFrwhlWiIs_u8" VALUE 0x00000000 Scalar_UBYTE 0 BSW_A2L_Ident_Int 0 255 /end CHARACTERISTIC
/begin MEASUREMENT VAR_TpcSmp_SpdOvHiLimErrState_u8 "VAR_TpcSmp_SpdOvHiLimErrState_u8" UBYTE BSW_A2L_Ident_Int 1 100 0 255 ECU_ADDRESS 0x00000000 /end MEASUREMENT
/begin CHARACTERISTIC CAL_Hspf_TmpCoolanTjFltFrq_f32 "CAL_Hspf_TmpCoolanTjFltFrq_f32" VALUE 0x00000000 Scalar_FLOAT32_IEEE 0 BSW_A2L_Ident_Float -3.4E+38 3.4E+38 /end CHARACTERISTIC
/begin CHARACTERISTIC CAL_MCF_flgTabZeroCtl_b "CAL_MCF_flgTabZeroCtl_b" VALUE 0x00000000 Scalar_BOOLEAN 0 BSW_A2L_Ident_Int 0 1 /end CHARACTERISTIC
/begin CHARACTERISTIC CAL_MCF_HalfFreq_f32 "CAL_MCF_HalfFreq_f32" VALUE 0x00000000 Scalar_FLOAT32_IEEE 0 BSW_A2L_Ident_Float -3.4E+38 3.4E+38 /end CHARACTERISTIC
/begin CHARACTERISTIC CAL_Scf_uAllwPwrDcha_f32 "CAL_Scf_uAllwPwrDcha_f32" VALUE 0x00000000 Scalar_FLOAT32_IEEE 0 BSW_A2L_Ident_Float -3.4E+38 3.4E+38 /end CHARACTERISTIC
/begin CHARACTERISTIC CAL_PcfDia_AimInPRdd_f32 "CAL_PcfDia_AimInPRdd_f32" VALUE 0x00000000 Scalar_FLOAT32_IEEE 0 BSW_A2L_Ident_Float -3.4E+38 3.4E+38 /end CHARACTERISTIC
/begin CHARACTERISTIC CAL_TpcSmp_nCtlExtReq_u8 "CAL_TpcSmp_nCtlExtReq_u8" VALUE 0x00000000 Scalar_UBYTE 0 BSW_A2L_Ident_Int 0 255 /end CHARACTERISTIC
/begin MEASUREMENT VAR_PcfStm_flgPCInitToOutP_b "VAR_PcfStm_flgPCInitToOutP_b" UBYTE BSW_A2L_Ident_Int 1 100 0 1 ECU_ADDRESS 0x00000000 /end MEASUREMENT
/begin CHARACTERISTIC CAL_MCF_uqki_f32 "CAL_MCF_uqki_f32" VALUE 0x00000000 Scalar_FLOAT32_IEEE 0 BSW_A2L_Ident_Float -3.4E+38 3.4E+38 /end CHARACTERISTIC
/begin CHARACTERISTIC CAL_FRP_NSetPRngErrOutCtl_b "CAL_FRP_NSetPRngErrOutCtl_b" VALUE 0x00000000 Scalar_BOOLEAN 0 BSW_A2L_Ident_Int 0 1 /end CHARACTERISTIC
/begin CHARACTERISTIC CAL_Cspf_TrqMaxNCtL_f32 "CAL_Cspf_TrqMaxNCtL_f32" VALUE 0x00000000 Scalar_FLOAT32_IEEE 0 BSW_A2L_Ident_Float -3.4E+38 3.4E+38 /end CHARACTERISTIC
/begin CHARACTERISTIC CAL_DEM_FIM_DFC_IOHWAB_Nen33Fail_au8 "CAL_DEM_FIM_DFC_IOHWAB_Nen33Fail_au8" VAL_BLK 0x00000000 Scalar_UBYTE 0 FID_Verb 0 255 NUMBER 10 /end CHARACTERISTIC
/begin MEASUREMENT VAR_Cspf_TraidcCurr_f32 "VAR_Cspf_TraidcCurr_f32" FLOAT32_IEEE BSW_A2L_Ident_Float 1 100 -3.4E+38 3.4E+38 ECU_ADDRESS 0x00000000 /end MEASUREMENT
/begin MEASUREMENT VAR_RCF_flgDefaultToWait_b "VAR_RCF_flgDefaultToWait_b" UBYTE BSW_A2L_Ident_Int 1 100 0 1 ECU_ADDRESS 0x00000000 /end MEASUREMENT
/begin MEASUREMENT VAR_Vcf_CntAdding_u8 "VAR_Vcf_CntAdding_u8" UBYTE BSW_A2L_Ident_Int 1 100 0 255 ECU_ADDRESS 0x00000000 /end MEASUREMENT
/begin CHARACTERISTIC CAL_TpcTmp_tDbcTraSave1ToSave2_f32 "CAL_TpcTmp_tDbcTraSave1ToSave2_f32" VALUE 0x00000000 Scalar_FLOAT32_IEEE 0 BSW_A2L_Ident_Float -3.4E+38 3.4E+38 /end CHARACTERISTIC
/begin CHARACTERISTIC CAL_VADC_RDC_offset_u16 "CAL_VADC_RDC_offset_u16" VALUE 0x00000000 Scalar_UWORD 0 BSW_A2L_Ident_Int 0 65535 /end CHARACTERISTIC
/begin MEASUREMENT VAR_3phPWMWL_Period_f32 "VAR_3phPWMWL_Period_f32" FLOAT32_IEEE BSW_A2L_Ident_Float 1 100 -3.4E+38 3.4E+38 ECU_ADDRESS 0x00000000 /end MEASUREMENT
/begin CHARACTERISTIC CAL_DEM_FIM_DFC_IOHWAB_KL30SevUnderVolFail_au8 "CAL_DEM_FIM_DFC_IOHWAB_KL30SevUnderVolFail_au8" VAL_BLK 0x00000000 Scalar_UBYTE 0 FID_Verb 0 255 NUMBER 10 /end CHARACTERISTIC
/begin MEASUREMENT VAR_WCoolantTj_f32 "VAR_WCoolantTj_f32" FLOAT32_IEEE BSW_A2L_Ident_Float 1 100 -3.4E+38 3.4E+38 ECU_ADDRESS 0x00000000 /end MEASUREMENT
/begin MEASUREMENT VAR_RCF_stOfsFrwhlBwd_u8 "VAR_RCF_stOfsFrwhlBwd_u8" UBYTE BSW_A2L_Ident_Int 1 100 0 255 ECU_ADDRESS 0x00000000 /end MEASUREMENT
/begin CHARACTERISTIC CAL_TpcMot_SttrTempAdds_f32 "CAL_TpcMot_SttrTempAdds_f32" VALUE 0x00000000 Scalar_FLOAT32_IEEE 0 BSW_A2L_Ident_Float -3.4E+38 3.4E+38 /end CHARACTERISTIC
/begin MEASUREMENT VAR_TRSP_RslvExciPRngErr_b "VAR_TRSP_RslvExciPRngErr_b" UBYTE BSW_A2L_Ident_Int 1 100 0 1 ECU_ADDRESS 0x00000000 /end MEASUREMENT
/begin MEASUREMENT VAR_MCF_SCF_flgInitEn_b "VAR_MCF_SCF_flgInitEn_b" UBYTE BSW_A2L_Ident_Int 1 100 0 1 ECU_ADDRESS 0x00000000 /end MEASUREMENT
/begin CHARACTERISTIC CAL_DEM_Disbl_DFC_IOHWAB_CrashFail_u8 "CAL_DEM_Disbl_DFC_IOHWAB_CrashFail_u8" VALUE 0x00000000 Scalar_UBYTE 0 BSW_A2L_Ident_Int 0 255 /end CHARACTERISTIC
/begin MEASUREMENT VAR_Adc_RES_Buffer_CUR_MCU_u16 "VAR_Adc_RES_Buffer_CUR_MCU_u16" UWORD BSW_A2L_Ident_Int 1 100 0 65535 ECU_ADDRESS 0x00000000 /end MEASUREMENT
/begin MEASUREMENT VAR_RCF_flgDefaultToFrewhlBwd_b "VAR_RCF_flgDefaultToFrewhlBwd_b" UBYTE BSW_A2L_Ident_Int 1 100 0 1 ECU_ADDRESS 0x00000000 /end MEASUREMENT
/begin MEASUREMENT VAR_TpcTmp_TIGBTOvHiErrState_u8 "VAR_TpcTmp_TIGBTOvHiErrState_u8" UBYTE BSW_A2L_Ident_Int 1 100 0 255 ECU_ADDRESS 0x00000000 /end MEASUREMENT
/begin CHARACTERISTIC CAL_PcfDia_AimOutPRdd_f32 "CAL_PcfDia_AimOutPRdd_f32" VALUE 0x00000000 Scalar_FLOAT32_IEEE 0 BSW_A2L_Ident_Float -3.4E+38 3.4E+38 /end CHARACTERISTIC
/begin CHARACTERISTIC CAL_DEM_Disbl_DFC_IOHWAB_KL30OverVolErr_u8 "CAL_DEM_Disbl_DFC_IOHWAB_KL30OverVolErr_u8" VALUE 0x00000000 Scalar_UBYTE 0 BSW_A2L_Ident_Int 0 255 /end CHARACTERISTIC
/begin MEASUREMENT VAR_DEM_Event_TPC_TIGBTOvHiWarn_Status_u8 "VAR_DEM_Event_TPC_TIGBTOvHiWarn_Status_u8" UBYTE BSW_A2L_Ident_Int 1 100 0 255 ECU_ADDRESS 0x00000000 /end MEASUREMENT
/begin CHARACTERISTIC CAL_Cspf_uKl30Flt_f32 "CAL_Cspf_uKl30Flt_f32" VALUE 0x00000000 Scalar_FLOAT32_IEEE 0 BSW_A2L_Ident_Float -3.4E+38 3.4E+38 /end CHARACTERISTIC
/begin CHARACTERISTIC CAL_BCC_iThetaOffsetGen_f32 "CAL_BCC_iThetaOffsetGen_f32" VALUE 0x00000000 Scalar_FLOAT32_IEEE 0 BSW_A2L_Ident_Float -3.4E+38 3.4E+38 /end CHARACTERISTIC
/begin CHARACTERISTIC CAL_Vcf_cnCtlNrm_f32 "CAL_Vcf_cnCtlNrm_f32" VALUE 0x00000000 Scalar_FLOAT32_IEEE 0 BSW_A2L_Ident_Float -3.4E+38 3.4E+38 /end CHARACTERISTIC
/begin CHARACTERISTIC CAL_TpcSmp_GenOvrVoltKi_f32 "CAL_TpcSmp_GenOvrVoltKi_f32" VALUE 0x00000000 Scalar_FLOAT32_IEEE 0 BSW_A2L_Ident_Float -3.4E+38 3.4E+38 /end CHARACTERISTIC
/begin MEASUREMENT VAR_TpcTmp_TIGBTOvHiWarnState_u8 "VAR_TpcTmp_TIGBTOvHiWarnState_u8" UBYTE BSW_A2L_Ident_Int 1 100 0 255 ECU_ADDRESS 0x00000000 /end MEASUREMENT
/begin CHARACTERISTIC CAL_PcfDia_flgLocked_b "CAL_PcfDia_flgLocked_b" VALUE 0x00000000 Scalar_BOOLEAN 0 BSW_A2L_Ident_Int 0 1 /end CHARACTERISTIC
/begin MEASUREMENT VAR_tpccod_flgMaxDertExCTrq_b "VAR_tpccod_flgMaxDertExCTrq_b" UBYTE BSW_A2L_Ident_Int 1 100 0 1 ECU_ADDRESS 0x00000000 /end MEASUREMENT
/begin CHARACTERISTIC CAL_TjLv1Act_f32 "CAL_TjLv1Act_f32" VALUE 0x00000000 Scalar_FLOAT32_IEEE 0 BSW_A2L_Ident_Float -3.4E+38 3.4E+38 /end CHARACTERISTIC
/begin CHARACTERISTIC CAL_DEM_FIM_DFC_Cpld_NEN_InFail_au8 "CAL_DEM_FIM_DFC_Cpld_NEN_InFail_au8" VAL_BLK 0x00000000 Scalar_UBYTE 0 FID_Verb 0 255 NUMBER 10 /end CHARACTERISTIC
/begin CHARACTERISTIC CAL_PcfSig_flgKL15Swt_b "CAL_PcfSig_flgKL15Swt_b" VALUE 0x00000000 Scalar_BOOLEAN 0 BSW_A2L_Ident_Int 0 1 /end CHARACTERISTIC
/begin CHARACTERISTIC CAL_TRSP_RslvSqrtCountTrh_s16 "CAL_TRSP_RslvSqrtCountTrh_s16" VALUE 0x00000000 Scalar_SWORD 0 BSW_A2L_Ident_Int -32768 32767 /end CHARACTERISTIC
/begin MEASUREMENT VAR_NvM_TLC_TrqReason_au8 "VAR_NvM_TLC_TrqReason_au8" UBYTE BSW_A2L_Ident_Int 1 100 0 255 ARRAY_SIZE 6 ECU_ADDRESS 0x00000000 /end MEASUREMENT
/begin CHARACTERISTIC CAL_Scf_uSubHiVoltVal_f32 "CAL_Scf_uSubHiVoltVal_f32" VALUE 0x00000000 Scalar_FLOAT32_IEEE 0 BSW_A2L_Ident_Float -3.4E+38 3.4E+38 /end CHARACTERISTIC
/begin CHARACTERISTIC CAL_Hspf_VerMatchSucceed_u8 "CAL_Hspf_VerMatchSucceed_u8" VALUE 0x00000000 Scalar_UBYTE 0 BSW_A2L_Ident_Int 0 255 /end CHARACTERISTIC
/begin CHARACTERISTIC CAL_DEM_FIM_DFC_Cpld_IphaOC_au8 "CAL_DEM_FIM_DFC_Cpld_IphaOC_au8" VAL_BLK 0x00000000 Scalar_UBYTE 0 FID_Verb 0 255 NUMBER 10 /end CHARACTERISTIC
/begin CHARACTERISTIC CAL_MDF_IsMaxSet_f32 "CAL_MDF_IsMaxSet_f32" VALUE 0x00000000 Scalar_FLOAT32_IEEE 0 BSW_A2L_Ident_Float -3.4E+38 3.4E+38 /end CHARACTERISTIC
/begin CHARACTERISTIC CAL_TpcSmp_GenOvrCurtypLim_f32 "CAL_TpcSmp_GenOvrCurtypLim_f32" VALUE 0x00000000 Scalar_FLOAT32_IEEE 0 BSW_A2L_Ident_Float -3.4E+38 3.4E+38 /end CHARACTERISTIC
/begin MEASUREMENT VAR_CDD_Rslv_CosMin_f32 "VAR_CDD_Rslv_CosMin_f32" FLOAT32_IEEE BSW_A2L_Ident_Float 1 100 -3.4E+38 3.4E+38 ECU_ADDRESS 0x00000000 /end MEASUREMENT
/begin CHARACTERISTIC CAL_MDF_Inactive_u8 "CAL_MDF_Inactive_u8" VALUE 0x00000000 Scalar_UBYTE 0 BSW_A2L_Ident_Int 0 255 /end CHARACTERISTIC
/begin MEASUREMENT VAR_FRP_FaultInfo_u32 "VAR_FRP_FaultInfo_u32" ULONG BSW_A2L_Ident_Int 1 100 0 4294967295 ECU_ADDRESS 0x00000000 /end MEASUREMENT
/begin CHARACTERISTIC CAL_PcfDia_cntNorAct_u16 "CAL_PcfDia_cntNorAct_u16" VALUE 0x00000000 Scalar_UWORD 0 BSW_A2L_Ident_Int 0 65535 /end CHARACTERISTIC
/begin CHARACTERISTIC CAL_TpcTmp_tIGBTTraNormalToSave1_f32 "CAL_TpcTmp_tIGBTTraNormalToSave1_f32" VALUE 0x00000000 Scalar_FLOAT32_IEEE 0 BSW_A2L_Ident_Float -3.4E+38 3.4E+38 /end CHARACTERISTIC
/begin MEASUREMENT VAR_PcfCtl_PosPIDOut_f32 "VAR_PcfCtl_PosPIDOut_f32" FLOAT32_IEEE BSW_A2L_Ident_Float 1 100 -3.4E+38 3.4E+38 ECU_ADDRESS 0x00000000 /end MEASUREMENT
/begin MEASUREMENT VAR_RDC_flgSpdHorL_b "VAR_RDC_flgSpdHorL_b" UBYTE BSW_A2L_Ident_Int 1 100 0 1 ECU_ADDRESS 0x00000000 /end MEASUREMENT
/begin MEASUREMENT VAR_RCF_flgInactToBwdClb_b "VAR_RCF_flgInactToBwdClb_b" UBYTE BSW_A2L_Ident_Int 1 100 0 1 ECU_ADDRESS 0x00000000 /end MEASUREMENT
/begin CHARACTERISTIC CAL_DEM_FIM_DFC_TPC_TDbcOvHiWarn_au8 "CAL_DEM_FIM_DFC_TPC_TDbcOvHiWarn_au8" VAL_BLK 0x00000000 Scalar_UBYTE 0 FID_Verb 0 255 NUMBER 10 /end CHARACTERISTIC
/begin CHARACTERISTIC CAL_DEM_FIM_DFC_TPC_TDbcWLoLimFail_au8 "CAL_DEM_FIM_DFC_TPC_TDbcWLoLimFail_au8" VAL_BLK 0x00000000 Scalar_UBYTE 0 FID_Verb 0 255 NUMBER 10 /end CHARACTERISTIC
/begin CHARACTERISTIC CAL_MCF_uqkp_f32 "CAL_MCF_uqkp_f32" VALUE 0x00000000 Scalar_FLOAT32_IEEE 0 BSW_A2L_Ident_Float -3.4E+38 3.4E+38 /end CHARACTERISTIC
/begin CHARACTERISTIC CAL_DEM_Disbl_DFC_RSL_ExcErr_u8 "CAL_DEM_Disbl_DFC_RSL_ExcErr_u8" VALUE 0x00000000 Scalar_UBYTE 0 BSW_A2L_Ident_Int 0 255 /end CHARACTERISTIC
/begin CHARACTERISTIC CAL_TpcTmp_DbcRiseChgTempUpDiff_f32 "CAL_TpcTmp_DbcRiseChgTempUpDiff_f32" VALUE 0x00000000 Scalar_FLOAT32_IEEE 0 BSW_A2L_Ident_Float -3.4E+38 3.4E+38 /end CHARACTERISTIC
/begin CHARACTERISTIC CAL_DEM_FIM_DFC_SCF_LowPwrShtDwnOvTiFail_au8 "CAL_DEM_FIM_DFC_SCF_LowPwrShtDwnOvTiFail_au8" VAL_BLK 0x00000000 Scalar_UBYTE 0 FID_Verb 0 255 NUMBER 10 /end CHARACTERISTIC
/begin CHARACTERISTIC CAL_TpcTmp_IGBTRiseTempKp_f32 "CAL_TpcTmp_IGBTRiseTempKp_f32" VALUE 0x00000000 Scalar_FLOAT32_IEEE 0 BSW_A2L_Ident_Float -3.4E+38 3.4E+38 /end CHARACTERISTIC
/begin MEASUREMENT VAR_STM0_SWC_20ms_Task_Core0_u32 "VAR_STM0_SWC_20ms_Task_Core0_u32" ULONG BSW_A2L_Ident_Int 1 100 0 4294967295 ECU_ADDRESS 0x00000000 /end MEASUREMENT
/begin MEASUREMENT VAR_DEM_Event_MDF_OpenCirNoPsblErr_Status_u8 "VAR_DEM_Event_MDF_OpenCirNoPsblErr_Status_u8" UBYTE BSW_A2L_Ident_Int 1 100 0 255 ECU_ADDRESS 0x00000000 /end MEASUREMENT
/begin MEASUREMENT VAR_TpcTmp_TDbcOvHiWarnState_u8 "VAR_TpcTmp_TDbcOvHiWarnState_u8" UBYTE BSW_A2L_Ident_Int 1 100 0 255 ECU_ADDRESS 0x00000000 /end MEASUREMENT
/begin MEASUREMENT VAR_Scf_flgPostDrvReqWiDcha_b "VAR_Scf_flgPostDrvReqWiDcha_b" UBYTE BSW_A2L_Ident_Int 1 100 0 1 ECU_ADDRESS 0x00000000 /end MEASUREMENT
/begin MEASUREMENT VAR_flgRecBMS01_u8 "VAR_flgRecBMS01_u8" UBYTE BSW_A2L_Ident_Int 1 100 0 255 ECU_ADDRESS 0x00000000 /end MEASUREMENT
/begin CHARACTERISTIC CAL_TCF_TempStrMin_f32 "CAL_TCF_TempStrMin_f32" VALUE 0x00000000 Scalar_FLOAT32_IEEE 0 BSW_A2L_Ident_Float -3.4E+38 3.4E+38 /end CHARACTERISTIC
/begin MEASUREMENT VAR_NvM_EPC_flgSLWD_au8 "VAR_NvM_EPC_flgSLWD_au8" UBYTE BSW_A2L_Ident_Int 1 100 0 255 ARRAY_SIZE 4 ECU_ADDRESS 0x00000000 /end MEASUREMENT
/begin CHARACTERISTIC CAL_Cspf_KpHighNCtL_f32 "CAL_Cspf_KpHighNCtL_f32" VALUE 0x00000000 Scalar_FLOAT32_IEEE 0 BSW_A2L_Ident_Float -3.4E+38 3.4E+38 /end CHARACTERISTIC
/begin MEASUREMENT VAR_Scf_flgShtDwnByVcu_b "VAR_Scf_flgShtDwnByVcu_b" UBYTE BSW_A2L_Ident_Int 1 100 0 1 ECU_ADDRESS 0x00000000 /end MEASUREMENT
/begin CHARACTERISTIC CAL_DEM_Disbl_DFC_TPC_TDbcVHiLimFail_u8 "CAL_DEM_Disbl_DFC_TPC_TDbcVHiLimFail_u8" VALUE 0x00000000 Scalar_UBYTE 0 BSW_A2L_Ident_Int 0 255 /end CHARACTERISTIC
/begin MEASUREMENT VAR_TpcMot_GenTrqLimTsttrWoRamp_f32 "VAR_TpcMot_GenTrqLimTsttrWoRamp_f32" FLOAT32_IEEE BSW_A2L_Ident_Float 1 100 -3.4E+38 3.4E+38 ECU_ADDRESS 0x00000000 /end MEASUREMENT
/begin MEASUREMENT VAR_TpcCod_ElecTrqCalcOvrCurt_f32 "VAR_TpcCod_ElecTrqCalcOvrCurt_f32" FLOAT32_IEEE BSW_A2L_Ident_Float 1 100 -3.4E+38 3.4E+38 ECU_ADDRESS 0x00000000 /end MEASUREMENT
/begin CHARACTERISTIC CAL_Vcf_ReqTrqMechTrqDif_f32 "CAL_Vcf_ReqTrqMechTrqDif_f32" VALUE 0x00000000 Scalar_FLOAT32_IEEE 0 BSW_A2L_Ident_Float -3.4E+38 3.4E+38 /end CHARACTERISTIC
/begin CHARACTERISTIC CAL_DEM_FIM_DFC_ADC_UPhaseBISTFail_au8 "CAL_DEM_FIM_DFC_ADC_UPhaseBISTFail_au8" VAL_BLK 0x00000000 Scalar_UBYTE 0 FID_Verb 0 255 NUMBER 10 /end CHARACTERISTIC
/begin MEASUREMENT VAR_RCF_flgClbToFail_b "VAR_RCF_flgClbToFail_b" UBYTE BSW_A2L_Ident_Int 1 100 0 1 ECU_ADDRESS 0x00000000 /end MEASUREMENT
/begin CHARACTERISTIC CAL_DEM_FIM_DFC_TPC_uDcLnkUnVLimFail_au8 "CAL_DEM_FIM_DFC_TPC_uDcLnkUnVLimFail_au8" VAL_BLK 0x00000000 Scalar_UBYTE 0 FID_Verb 0 255 NUMBER 10 /end CHARACTERISTIC
/begin CHARACTERISTIC CAL_Cspf_FailCode1_u8 "CAL_Cspf_FailCode1_u8" VALUE 0x00000000 Scalar_UBYTE 0 BSW_A2L_Ident_Int 0 255 /end CHARACTERISTIC
/begin MEASUREMENT VAR_TpcTmp_flgTrqLimTdrvboardActv_b "VAR_TpcTmp_flgTrqLimTdrvboardActv_b" UBYTE BSW_A2L_Ident_Int 1 100 0 1 ECU_ADDRESS 0x00000000 /end MEASUREMENT
/begin CHARACTERISTIC CAL_Scf_flgPcfAllowPwmRunSwt_b "CAL_Scf_flgPcfAllowPwmRunSwt_b" VALUE 0x00000000 Scalar_BOOLEAN 0 BSW_A2L_Ident_Int 0 1 /end CHARACTERISTIC
/begin CHARACTERISTIC CAL_DEM_FIM_DFC_IOHWAB_VDD5_D_SampFail_au8 "CAL_DEM_FIM_DFC_IOHWAB_VDD5_D_SampFail_au8" VAL_BLK 0x00000000 Scalar_UBYTE 0 FID_Verb 0 255 NUMBER 10 /end CHARACTERISTIC
/begin CHARACTERISTIC CAL_MPC_TrqMechCutOffFrq_f32 "CAL_MPC_TrqMechCutOffFrq_f32" VALUE 0x00000000 Scalar_FLOAT32_IEEE 0 BSW_A2L_Ident_Float -3.4E+38 3.4E+38 /end CHARACTERISTIC
/begin MEASUREMENT VAR_flgRecVCU04_u8 "VAR_flgRecVCU04_u8" UBYTE BSW_A2L_Ident_Int 1 100 0 255 ECU_ADDRESS 0x00000000 /end MEASUREMENT
/begin CHARACTERISTIC CAL_DEM_Disbl_DFC_SCF_DisChgOvTiFail_u8 "CAL_DEM_Disbl_DFC_SCF_DisChgOvTiFail_u8" VALUE 0x00000000 Scalar_UBYTE 0 BSW_A2L_Ident_Int 0 255 /end CHARACTERISTIC
/begin MEASUREMENT VAR_DEM_Event_HvMcu_UartCheckFailErr_Status_u8 "VAR_DEM_Event_HvMcu_UartCheckFailErr_Status_u8" UBYTE BSW_A2L_Ident_Int 1 100 0 255 ECU_ADDRESS 0x00000000 /end MEASUREMENT
/begin CHARACTERISTIC CAL_TRSP_RslvSensVoltHiLim_u16 "CAL_TRSP_RslvSensVoltHiLim_u16" VALUE 0x00000000 Scalar_UWORD 0 BSW_A2L_Ident_Int 0 65535 /end CHARACTERISTIC
/begin CHARACTERISTIC CAL_STM_UxptTrqLim_f32 "CAL_STM_UxptTrqLim_f32" VALUE 0x00000000 Scalar_FLOAT32_IEEE 0 BSW_A2L_Ident_Float -3.4E+38 3.4E+38 /end CHARACTERISTIC
/begin MEASUREMENT VAR_RCF_stDiagOfsClb_u8 "VAR_RCF_stDiagOfsClb_u8" UBYTE BSW_A2L_Ident_Int 1 100 0 255 ECU_ADDRESS 0x00000000 /end MEASUREMENT
/begin CHARACTERISTIC CAL_DEM_FIM_DFC_TPC_uDcLnkOvWarn_au8 "CAL_DEM_FIM_DFC_TPC_uDcLnkOvWarn_au8" VAL_BLK 0x00000000 Scalar_UBYTE 0 FID_Verb 0 255 NUMBER 10 /end CHARACTERISTIC
/begin MEASUREMENT VAR_ADM_BMSVoltRngErr_b "VAR_ADM_BMSVoltRngErr_b" UBYTE BSW_A2L_Ident_Int 1 100 0 1 ECU_ADDRESS 0x00000000 /end MEASUREMENT
/begin CHARACTERISTIC CAL_TRSP_RslvRngSinNLoLim_u16 "CAL_TRSP_RslvRngSinNLoLim_u16" VALUE 0x00000000 Scalar_UWORD 0 BSW_A2L_Ident_Int 0 65535 /end CHARACTERISTIC
/begin MEASUREMENT VAR_MCF_iqAct_f32 "VAR_MCF_iqAct_f32" FLOAT32_IEEE BSW_A2L_Ident_Float 1 100 -3.4E+38 3.4E+38 ECU_ADDRESS 0x00000000 /end MEASUREMENT
/begin MEASUREMENT VAR_ADM_flgCrash_b "VAR_ADM_flgCrash_b" UBYTE BSW_A2L_Ident_Int 1 100 0 1 ECU_ADDRESS 0x00000000 /end MEASUREMENT
/begin CHARACTERISTIC CAL_Vcf_flgOpenHoldFcn_b "CAL_Vcf_flgOpenHoldFcn_b" VALUE 0x00000000 Scalar_BOOLEAN 0 BSW_A2L_Ident_Int 0 1 /end CHARACTERISTIC
/begin CHARACTERISTIC CAL_DEM_FIM_DFC_IOHWAB_KL30SevOverVolFail_au8 "CAL_DEM_FIM_DFC_IOHWAB_KL30SevOverVolFail_au8" VAL_BLK 0x00000000 Scalar_UBYTE 0 FID_Verb 0 255 NUMBER 10 /end CHARACTERISTIC
/begin MEASUREMENT VAR_VTjpwr_f32 "VAR_VTjpwr_f32" FLOAT32_IEEE BSW_A2L_Ident_Float 1 100 -3.4E+38 3.4E+38 ECU_ADDRESS 0x00000000 /end MEASUREMENT
/begin CHARACTERISTIC CAL_Scf_nSafeLoSpdMaxLim_f32 "CAL_Scf_nSafeLoSpdMaxLim_f32" VALUE 0x00000000 Scalar_FLOAT32_IEEE 0 BSW_A2L_Ident_Float -3.4E+38 3.4E+38 /end CHARACTERISTIC
/begin CHARACTERISTIC CAL_Cspf_tStrrTemp1Flt_f32 "CAL_Cspf_tStrrTemp1Flt_f32" VALUE 0x00000000 Scalar_FLOAT32_IEEE 0 BSW_A2L_Ident_Float -3.4E+38 3.4E+38 /end CHARACTERISTIC
/begin CHARACTERISTIC CAL_MCF_cofFltWe_f32 "CAL_MCF_cofFltWe_f32" VALUE 0x00000000 Scalar_FLOAT32_IEEE 0 BSW_A2L_Ident_Float -3.4E+38 3.4E+38 /end CHARACTERISTIC
/begin CHARACTERISTIC CAL_DEM_Disbl_DFC_RCF_FwlBwdOvTiErr_u8 "CAL_DEM_Disbl_DFC_RCF_FwlBwdOvTiErr_u8" VALUE 0x00000000 Scalar_UBYTE 0 BSW_A2L_Ident_Int 0 255 /end CHARACTERISTIC
/begin CHARACTERISTIC CAL_TRSP_VCurrRngLoLim_f32 "CAL_TRSP_VCurrRngLoLim_f32" VALUE 0x00000000 Scalar_FLOAT32_IEEE 0 BSW_A2L_Ident_Float -3.4E+38 3.4E+38 /end CHARACTERISTIC
/begin CHARACTERISTIC CAL_PcfDia_IdcLockedHi_f32 "CAL_PcfDia_IdcLockedHi_f32" VALUE 0x00000000 Scalar_FLOAT32_IEEE 0 BSW_A2L_Ident_Float -3.4E+38 3.4E+38 /end CHARACTERISTIC
/begin CHARACTERISTIC CAL_TDC_trqIncMax_f32 "CAL_TDC_trqIncMax_f32" VALUE 0x00000000 Scalar_FLOAT32_IEEE 0 BSW_A2L_Ident_Float -3.4E+38 3.4E+38 /end CHARACTERISTIC
/begin CHARACTERISTIC CAL_MCF_FlgUseSatuEOL_b "CAL_MCF_FlgUseSatuEOL_b" VALUE 0x00000000 Scalar_BOOLEAN 0 BSW_A2L_Ident_Int 0 1 /end CHARACTERISTIC
/begin CHARACTERISTIC CAL_TpcTmp_IgbtChgTempUpDiff_f32 "CAL_TpcTmp_IgbtChgTempUpDiff_f32" VALUE 0x00000000 Scalar_FLOAT32_IEEE 0 BSW_A2L_Ident_Float -3.4E+38 3.4E+38 /end CHARACTERISTIC
/begin MEASUREMENT VAR_Scf_flgWakeLoss_b "VAR_Scf_flgWakeLoss_b" UBYTE BSW_A2L_Ident_Int 1 100 0 1 ECU_ADDRESS 0x00000000 /end MEASUREMENT
/begin CHARACTERISTIC CAL_FRP_BMSVoltRngErrOutCtl_b "CAL_FRP_BMSVoltRngErrOutCtl_b" VALUE 0x00000000 Scalar_BOOLEAN 0 BSW_A2L_Ident_Int 0 1 /end CHARACTERISTIC
/begin CHARACTERISTIC CAL_MCF_DisChaisqDes_f32 "CAL_MCF_DisChaisqDes_f32" VALUE 0x00000000 Scalar_FLOAT32_IEEE 0 BSW_A2L_Ident_Float -3.4E+38 3.4E+38 /end CHARACTERISTIC
/begin CHARACTERISTIC CAL_TpcSmp_FacGenOvrCurt_u8 "CAL_TpcSmp_FacGenOvrCurt_u8" VALUE 0x00000000 Scalar_UBYTE 0 BSW_A2L_Ident_Int 0 255 /end CHARACTERISTIC
/begin MEASUREMENT VAR_TpcTmp_CofDertTRiseDbc_f32 "VAR_TpcTmp_CofDertTRiseDbc_f32" FLOAT32_IEEE BSW_A2L_Ident_Float 1 100 -3.4E+38 3.4E+38 ECU_ADDRESS 0x00000000 /end MEASUREMENT
/begin CHARACTERISTIC CAL_Cspf_TrqDmpMax_f32 "CAL_Cspf_TrqDmpMax_f32" VALUE 0x00000000 Scalar_FLOAT32_IEEE 0 BSW_A2L_Ident_Float -3.4E+38 3.4E+38 /end CHARACTERISTIC
/begin CHARACTERISTIC CAL_POWER_UBSBC_Threhold_V4_f32 "CAL_POWER_UBSBC_Threhold_V4_f32" VALUE 0x00000000 Scalar_FLOAT32_IEEE 0 BSW_A2L_Ident_Float -3.4E+38 3.4E+38 /end CHARACTERISTIC
/begin MEASUREMENT VAR_tpcsmp_posOutputjudge_f32 "VAR_tpcsmp_posOutputjudge_f32" FLOAT32_IEEE BSW_A2L_Ident_Float 1 100 -3.4E+38 3.4E+38 ECU_ADDRESS 0x00000000 /end MEASUREMENT
/begin MEASUREMENT VAR_TpcMot_CofDertTRiseSttr_f32 "VAR_TpcMot_CofDertTRiseSttr_f32" FLOAT32_IEEE BSW_A2L_Ident_Float 1 100 -3.4E+38 3.4E+38 ECU_ADDRESS 0x00000000 /end MEASUREMENT
/begin MEASUREMENT VAR_DEM_Event_SCF_RunToDischarErr_Status_u8 "VAR_DEM_Event_SCF_RunToDischarErr_Status_u8" UBYTE BSW_A2L_Ident_Int 1 100 0 255 ECU_ADDRESS 0x00000000 /end MEASUREMENT
/begin CHARACTERISTIC CAL_Scf_nRunTostb_f32 "CAL_Scf_nRunTostb_f32" VALUE 0x00000000 Scalar_FLOAT32_IEEE 0 BSW_A2L_Ident_Float -3.4E+38 3.4E+38 /end CHARACTERISTIC
/begin CHARACTERISTIC CAL_TpcCod_PosSpdHold_f32 "CAL_TpcCod_PosSpdHold_f32" VALUE 0x00000000 Scalar_FLOAT32_IEEE 0 BSW_A2L_Ident_Float -3.4E+38 3.4E+38 /end CHARACTERISTIC
/begin CHARACTERISTIC CAL_Vcf_GearLvN_u8 "CAL_Vcf_GearLvN_u8" VALUE 0x00000000 Scalar_UBYTE 0 BSW_A2L_Ident_Int 0 255 /end CHARACTERISTIC
/begin CHARACTERISTIC CAL_TRSP_OfstRngHiLim_f32 "CAL_TRSP_OfstRngHiLim_f32" VALUE 0x00000000 Scalar_FLOAT32_IEEE 0 BSW_A2L_Ident_Float -3.4E+38 3.4E+38 /end CHARACTERISTIC
/begin MEASUREMENT VAR_Hspf_tDBCTempV_f32 "VAR_Hspf_tDBCTempV_f32" FLOAT32_IEEE BSW_A2L_Ident_Float 1 100 -3.4E+38 3.4E+38 ECU_ADDRESS 0x00000000 /end MEASUREMENT
/begin CHARACTERISTIC CAL_TjrthLv4ildl_f32 "CAL_TjrthLv4ildl_f32" VALUE 0x00000000 Scalar_FLOAT32_IEEE 0 BSW_A2L_Ident_Float -3.4E+38 3.4E+38 /end CHARACTERISTIC
/begin CHARACTERISTIC CAL_DEM_FIM_DFC_RSL_LOTErr_au8 "CAL_DEM_FIM_DFC_RSL_LOTErr_au8" VAL_BLK 0x00000000 Scalar_UBYTE 0 FID_Verb 0 255 NUMBER 10 /end CHARACTERISTIC
/begin CHARACTERISTIC CAL_RCF_tHiEstAlOfs_u32 "CAL_RCF_tHiEstAlOfs_u32" VALUE 0x00000000 Scalar_ULONG 0 BSW_A2L_Ident_Int 0 4294967295 /end CHARACTERISTIC
/begin CHARACTERISTIC CAL_RCF_cntOfValBwd_u32 "CAL_RCF_cntOfValBwd_u32" VALUE 0x00000000 Scalar_ULONG 0 BSW_A2L_Ident_Int 0 4294967295 /end CHARACTERISTIC
/begin MEASUREMENT VAR_DEM_Event_TPC_SpdOvHiWarn_Status_u8 "VAR_DEM_Event_TPC_SpdOvHiWarn_Status_u8" UBYTE BSW_A2L_Ident_Int 1 100 0 255 ECU_ADDRESS 0x00000000 /end MEASUREMENT
/begin MEASUREMENT VAR_MDF_PhaseFaultChk_b "VAR_MDF_PhaseFaultChk_b" UBYTE BSW_A2L_Ident_Int 1 100 0 1 ECU_ADDRESS 0x00000000 /end MEASUREMENT
/begin CHARACTERISTIC CAL_PcfSig_flgNVMSLFnhSwt_b "CAL_PcfSig_flgNVMSLFnhSwt_b" VALUE 0x00000000 Scalar_BOOLEAN 0 BSW_A2L_Ident_Int 0 1 /end CHARACTERISTIC
/begin CHARACTERISTIC CAL_DEM_Disbl_DFC_IOHWAB_VDD5_D_SampFail_u8 "CAL_DEM_Disbl_DFC_IOHWAB_VDD5_D_SampFail_u8" VALUE 0x00000000 Scalar_UBYTE 0 BSW_A2L_Ident_Int 0 255 /end CHARACTERISTIC
/begin MEASUREMENT VAR_MDF_ICtlRatState_u8 "VAR_MDF_ICtlRatState_u8" UBYTE BSW_A2L_Ident_Int 1 100 0 255 ECU_ADDRESS 0x00000000 /end MEASUREMENT
/begin MEASUREMENT VAR_Cspf_TraCpldVer_u16 "VAR_Cspf_TraCpldVer_u16" UWORD BSW_A2L_Ident_Int 1 100 0 65535 ECU_ADDRESS 0x00000000 /end MEASUREMENT
/begin CHARACTERISTIC CAL_Cspf_flgNSetPSwt_b "CAL_Cspf_flgNSetPSwt_b" VALUE 0x00000000 Scalar_BOOLEAN 0 BSW_A2L_Ident_Int 0 1 /end CHARACTERISTIC
/begin CHARACTERISTIC CAL_PcfCtl_intPIDuplim_f32 "CAL_PcfCtl_intPIDuplim_f32" VALUE 0x00000000 Scalar_FLOAT32_IEEE 0 BSW_A2L_Ident_Float -3.4E+38 3.4E+38 /end CHARACTERISTIC
/begin CHARACTERISTIC CAL_Hspf_INVOpenChkSubCnt_s8 "CAL_Hspf_INVOpenChkSubCnt_s8" VALUE 0x00000000 Scalar_BYTE 0 BSW_A2L_Ident_Int -128 127 /end CHARACTERISTIC
/begin CHARACTERISTIC CAL_DEM_Disbl_DFC_TPC_uDcLnkOvVLimFail_u8 "CAL_DEM_Disbl_DFC_TPC_uDcLnkOvVLimFail_u8" VALUE 0x00000000 Scalar_UBYTE 0 BSW_A2L_Ident_Int 0 255 /end CHARACTERISTIC
/begin CHARACTERISTIC CAL_Scf_flgIntVcuComErr_b "CAL_Scf_flgIntVcuComErr_b" VALUE 0x00000000 Scalar_BOOLEAN 0 BSW_A2L_Ident_Int 0 1 /end CHARACTERISTIC
/begin MEASUREMENT VAR_TCF_FSEstTrq_u16 "VAR_TCF_FSEstTrq_u16" UWORD BSW_A2L_Ident_Int 1 100 0 65535 ECU_ADDRESS 0x00000000 /end MEASUREMENT
/begin MEASUREMENT VAR_IoHwAb_Adc_Phy_IUVW_P_REF_f32 "VAR_IoHwAb_Adc_Phy_IUVW_P_REF_f32" FLOAT32_IEEE BSW_A2L_Ident_Float 1 100 -3.4E+38 3.4E+38 ECU_ADDRESS 0x00000000 /end MEASUREMENT
/begin MEASUREMENT VAR_PcfStm_flgFaultToBPC_b "VAR_PcfStm_flgFaultToBPC_b" UBYTE BSW_A2L_Ident_Int 1 100 0 1 ECU_ADDRESS 0x00000000 /end MEASUREMENT
/begin CHARACTERISTIC CAL_BCC_iDcEstflt_f32 "CAL_BCC_iDcEstflt_f32" VALUE 0x00000000 Scalar_FLOAT32_IEEE 0 BSW_A2L_Ident_Float -3.4E+38 3.4E+38 /end CHARACTERISTIC
/begin CHARACTERISTIC CAL_DEM_Disbl_DFC_MDF_OpenCirNoPsblErr_u8 "CAL_DEM_Disbl_DFC_MDF_OpenCirNoPsblErr_u8" VALUE 0x00000000 Scalar_UBYTE 0 BSW_A2L_Ident_Int 0 255 /end CHARACTERISTIC
/begin MEASUREMENT VAR_TpcSmp_flgElecPwrLimOvrCurtActv_b "VAR_TpcSmp_flgElecPwrLimOvrCurtActv_b" UBYTE BSW_A2L_Ident_Int 1 100 0 1 ECU_ADDRESS 0x00000000 /end MEASUREMENT
/begin CHARACTERISTIC CAL_MCF_udDecoupki_f32 "CAL_MCF_udDecoupki_f32" VALUE 0x00000000 Scalar_FLOAT32_IEEE 0 BSW_A2L_Ident_Float -3.4E+38 3.4E+38 /end CHARACTERISTIC
/begin MEASUREMENT VAR_VADC_RDC_ISR_offset_u16 "VAR_VADC_RDC_ISR_offset_u16" UWORD BSW_A2L_Ident_Int 1 100 0 65535 ECU_ADDRESS 0x00000000 /end MEASUREMENT
/begin MEASUREMENT VAR_TCF_PwrTrqTubeL1_f32 "VAR_TCF_PwrTrqTubeL1_f32" FLOAT32_IEEE BSW_A2L_Ident_Float 1 100 -3.4E+38 3.4E+38 ECU_ADDRESS 0x00000000 /end MEASUREMENT
/begin MEASUREMENT VAR_Bsw_tDBCTempV_u16 "VAR_Bsw_tDBCTempV_u16" UWORD BSW_A2L_Ident_Int 1 100 0 65535 ECU_ADDRESS 0x00000000 /end MEASUREMENT
/begin MEASUREMENT VAR_RCF_flgstEstToWait_b "VAR_RCF_flgstEstToWait_b" UBYTE BSW_A2L_Ident_Int 1 100 0 1 ECU_ADDRESS 0x00000000 /end MEASUREMENT
/begin MEASUREMENT VAR_MDF_offsetDeltaObs_f32 "VAR_MDF_offsetDeltaObs_f32" FLOAT32_IEEE BSW_A2L_Ident_Float 1 100 -3.4E+38 3.4E+38 ECU_ADDRESS 0x00000000 /end MEASUREMENT
/begin CHARACTERISTIC CAL_PcfDia_LockedNum_u16 "CAL_PcfDia_LockedNum_u16" VALUE 0x00000000 Scalar_UWORD 0 BSW_A2L_Ident_Int 0 65535 /end CHARACTERISTIC
/begin CHARACTERISTIC CAL_ADM_BMSLowerThr_f32 "CAL_ADM_BMSLowerThr_f32" VALUE 0x00000000 Scalar_FLOAT32_IEEE 0 BSW_A2L_Ident_Float -3.4E+38 3.4E+38 /end CHARACTERISTIC
/begin MEASUREMENT VAR_TpcSmp_TrqMinCanSet_f32 "VAR_TpcSmp_TrqMinCanSet_f32" FLOAT32_IEEE BSW_A2L_Ident_Float 1 100 -3.4E+38 3.4E+38 ECU_ADDRESS 0x00000000 /end MEASUREMENT
/begin MEASUREMENT VAR_MCF_uqRv_f32 "VAR_MCF_uqRv_f32" FLOAT32_IEEE BSW_A2L_Ident_Float 1 100 -3.4E+38 3.4E+38 ECU_ADDRESS 0x00000000 /end MEASUREMENT
/begin MEASUREMENT VAR_DEM_Event_RCF_FwlBwdOvTiErr_Status_u8 "VAR_DEM_Event_RCF_FwlBwdOvTiErr_Status_u8" UBYTE BSW_A2L_Ident_Int 1 100 0 255 ECU_ADDRESS 0x00000000 /end MEASUREMENT
/begin CHARACTERISTIC CAL_CddEparkTEST_ManualMosduty_f32 "CAL_CddEparkTEST_ManualMosduty_f32" VALUE 0x00000000 Scalar_FLOAT32_IEEE 0 BSW_A2L_Ident_Float -3.4E+38 3.4E+38 /end CHARACTERISTIC
/begin CHARACTERISTIC CAL_RCF_nCalcSec2_f32 "CAL_RCF_nCalcSec2_f32" VALUE 0x00000000 Scalar_FLOAT32_IEEE 0 BSW_A2L_Ident_Float -3.4E+38 3.4E+38 /end CHARACTERISTIC
/begin CHARACTERISTIC CAL_TRSP_iPhasSensVoltDebTrh_s16 "CAL_TRSP_iPhasSensVoltDebTrh_s16" VALUE 0x00000000 Scalar_SWORD 0 BSW_A2L_Ident_Int -32768 32767 /end CHARACTERISTIC
/begin MEASUREMENT VAR_DEM_Event_MDF_EmacBlkdErr_Status_u8 "VAR_DEM_Event_MDF_EmacBlkdErr_Status_u8" UBYTE BSW_A2L_Ident_Int 1 100 0 255 ECU_ADDRESS 0x00000000 /end MEASUREMENT
/begin CHARACTERISTIC CAL_MCF_flgHarmInIsThetaTab11ZR_b "CAL_MCF_flgHarmInIsThetaTab11ZR_b" VALUE 0x00000000 Scalar_BOOLEAN 0 BSW_A2L_Ident_Int 0 1 /end CHARACTERISTIC
/begin MEASUREMENT VAR_tpcsmp_yi_f32 "VAR_tpcsmp_yi_f32" FLOAT32_IEEE BSW_A2L_Ident_Float 1 100 -3.4E+38 3.4E+38 ECU_ADDRESS 0x00000000 /end MEASUREMENT
/begin CHARACTERISTIC CAL_TpcTmp_tDbcTempUHiLim_f32 "CAL_TpcTmp_tDbcTempUHiLim_f32" VALUE 0x00000000 Scalar_FLOAT32_IEEE 0 BSW_A2L_Ident_Float -3.4E+38 3.4E+38 /end CHARACTERISTIC
/begin MEASUREMENT VAR_UilTjtIGBT_f32 "VAR_UilTjtIGBT_f32" FLOAT32_IEEE BSW_A2L_Ident_Float 1 100 -3.4E+38 3.4E+38 ECU_ADDRESS 0x00000000 /end MEASUREMENT
/begin CHARACTERISTIC CAL_DEM_FIM_DFC_Cpld_SPIComFail_au8 "CAL_DEM_FIM_DFC_Cpld_SPIComFail_au8" VAL_BLK 0x00000000 Scalar_UBYTE 0 FID_Verb 0 255 NUMBER 10 /end CHARACTERISTIC
/begin CHARACTERISTIC CAL_Vcf_spdThredDmpPos_f32 "CAL_Vcf_spdThredDmpPos_f32" VALUE 0x00000000 Scalar_FLOAT32_IEEE 0 BSW_A2L_Ident_Float -3.4E+38 3.4E+38 /end CHARACTERISTIC
/begin MEASUREMENT VAR_PcfSig_UBRPcf_f32 "VAR_PcfSig_UBRPcf_f32" FLOAT32_IEEE BSW_A2L_Ident_Float 1 100 -3.4E+38 3.4E+38 ECU_ADDRESS 0x00000000 /end MEASUREMENT
/begin CHARACTERISTIC CAL_Hvmcu_ComErr_Cycle_u16 "CAL_Hvmcu_ComErr_Cycle_u16" VALUE 0x00000000 Scalar_UWORD 0 BSW_A2L_Ident_Int 0 65535 /end CHARACTERISTIC
/begin MEASUREMENT VAR_TpcMot_tRiseSttr_f32 "VAR_TpcMot_tRiseSttr_f32" FLOAT32_IEEE BSW_A2L_Ident_Float 1 100 -3.4E+38 3.4E+38 ECU_ADDRESS 0x00000000 /end MEASUREMENT
/begin MEASUREMENT VAR_TRSP_UCurrRngErr_b "VAR_TRSP_UCurrRngErr_b" UBYTE BSW_A2L_Ident_Int 1 100 0 1 ECU_ADDRESS 0x00000000 /end MEASUREMENT
/begin MEASUREMENT VAR_SWD_AgRslvDelta_f32 "VAR_SWD_AgRslvDelta_f32" FLOAT32_IEEE BSW_A2L_Ident_Float 1 100 -3.4E+38 3.4E+38 ECU_ADDRESS 0x00000000 /end MEASUREMENT
/begin MEASUREMENT VAR_tpccod_flgMinDertOvrUdc_b "VAR_tpccod_flgMinDertOvrUdc_b" UBYTE BSW_A2L_Ident_Int 1 100 0 1 ECU_ADDRESS 0x00000000 /end MEASUREMENT
/begin MEASUREMENT VAR_Scf_flgTranRunToStb_b "VAR_Scf_flgTranRunToStb_b" UBYTE BSW_A2L_Ident_Int 1 100 0 1 ECU_ADDRESS 0x00000000 /end MEASUREMENT
/begin CHARACTERISTIC CAL_TRSP_ReqTrqErrRst_b "CAL_TRSP_ReqTrqErrRst_b" VALUE 0x00000000 Scalar_BOOLEAN 0 BSW_A2L_Ident_Int 0 1 /end CHARACTERISTIC
/begin CHARACTERISTIC CAL_DEM_FIM_DFC_PCF_StallRetryErr_au8 "CAL_DEM_FIM_DFC_PCF_StallRetryErr_au8" VAL_BLK 0x00000000 Scalar_UBYTE 0 FID_Verb 0 255 NUMBER 10 /end CHARACTERISTIC
/begin CHARACTERISTIC CAL_DEM_FIM_DFC_TPC_SpdOvHiWarn_au8 "CAL_DEM_FIM_DFC_TPC_SpdOvHiWarn_au8" VAL_BLK 0x00000000 Scalar_UBYTE 0 FID_Verb 0 255 NUMBER 10 /end CHARACTERISTIC
/begin MEASUREMENT VAR_Vcf_flgDmpActv_b "VAR_Vcf_flgDmpActv_b" UBYTE BSW_A2L_Ident_Int 1 100 0 1 ECU_ADDRESS 0x00000000 /end MEASUREMENT
/begin MEASUREMENT VAR_PcfSig_NVMSLFnh_b "VAR_PcfSig_NVMSLFnh_b" UBYTE BSW_A2L_Ident_Int 1 100 0 1 ECU_ADDRESS 0x00000000 /end MEASUREMENT
/begin MEASUREMENT VAR_TpcMot_flgStartExcLimRamp_b "VAR_TpcMot_flgStartExcLimRamp_b" UBYTE BSW_A2L_Ident_Int 1 100 0 1 ECU_ADDRESS 0x00000000 /end MEASUREMENT
/begin CHARACTERISTIC CAL_DEM_FIM_DFC_TPC_TDbcULoLimFail_au8 "CAL_DEM_FIM_DFC_TPC_TDbcULoLimFail_au8" VAL_BLK 0x00000000 Scalar_UBYTE 0 FID_Verb 0 255 NUMBER 10 /end CHARACTERISTIC
/begin CHARACTERISTIC CAL_DEM_FIM_DFC_IOHWAB_18VLwBrgSampFail_au8 "CAL_DEM_FIM_DFC_IOHWAB_18VLwBrgSampFail_au8" VAL_BLK 0x00000000 Scalar_UBYTE 0 FID_Verb 0 255 NUMBER 10 /end CHARACTERISTIC
/begin MEASUREMENT VAR_RESET_Reason_List_au8 "VAR_RESET_Reason_List_au8" UBYTE BSW_A2L_Ident_Int 1 100 0 255 ARRAY_SIZE 16 ECU_ADDRESS 0x00000000 /end MEASUREMENT
/begin MEASUREMENT VAR_Vcf_SlopeChangePer_u8 "VAR_Vcf_SlopeChangePer_u8" UBYTE BSW_A2L_Ident_Int 1 100 0 255 ECU_ADDRESS 0x00000000 /end MEASUREMENT
/begin MEASUREMENT VAR_DEM_Event_MDF_EmacBlkdWarn_Status_u8 "VAR_DEM_Event_MDF_EmacBlkdWarn_Status_u8" UBYTE BSW_A2L_Ident_Int 1 100 0 255 ECU_ADDRESS 0x00000000 /end MEASUREMENT
/begin MEASUREMENT VAR_DEM_Event_IOHWAB_VDD5_D_SampFail_Status_u8 "VAR_DEM_Event_IOHWAB_VDD5_D_SampFail_Status_u8" UBYTE BSW_A2L_Ident_Int 1 100 0 255 ECU_ADDRESS 0x00000000 /end MEASUREMENT
/begin MEASUREMENT VAR_DEM_EventList_au8 "VAR_DEM_EventList_au8" UBYTE DFC_Verb 1 100 0 255 ARRAY_SIZE 24 ECU_ADDRESS 0x00000000 /end MEASUREMENT
/begin CHARACTERISTIC CAL_Pwm3phT_ClosedThreshold_f32 "CAL_Pwm3phT_ClosedThreshold_f32" VALUE 0x00000000 Scalar_FLOAT32_IEEE 0 BSW_A2L_Ident_Float -3.4E+38 3.4E+38 /end CHARACTERISTIC
/begin MEASUREMENT VAR_L2Sampling_ExciBackP_u16 "VAR_L2Sampling_ExciBackP_u16" UWORD BSW_A2L_Ident_Int 1 100 0 65535 ECU_ADDRESS 0x00000000 /end MEASUREMENT
/begin MEASUREMENT VAR_TRSP_RslvSqrtChkRslt_b "VAR_TRSP_RslvSqrtChkRslt_b" UBYTE BSW_A2L_Ident_Int 1 100 0 1 ECU_ADDRESS 0x00000000 /end MEASUREMENT
/begin MEASUREMENT VAR_DEM_Event_TPC_TDbcVLoLimFail_Status_u8 "VAR_DEM_Event_TPC_TDbcVLoLimFail_Status_u8" UBYTE BSW_A2L_Ident_Int 1 100 0 255 ECU_ADDRESS 0x00000000 /end MEASUREMENT
/begin CHARACTERISTIC CAL_DEM_Disbl_DFC_RSL_LOTErr_u8 "CAL_DEM_Disbl_DFC_RSL_LOTErr_u8" VALUE 0x00000000 Scalar_UBYTE 0 BSW_A2L_Ident_Int 0 255 /end CHARACTERISTIC
/begin MEASUREMENT VAR_DEM_EvtFailed_and_Passed_TOPC_au8 "VAR_DEM_EvtFailed_and_Passed_TOPC_au8" UBYTE BSW_A2L_Ident_Int 1 100 0 255 ARRAY_SIZE 24 ECU_ADDRESS 0x00000000 /end MEASUREMENT
/begin CHARACTERISTIC CAL_DEM_Disbl_DFC_IOHWAB_DcLnkOverVolFail_u8 "CAL_DEM_Disbl_DFC_IOHWAB_DcLnkOverVolFail_u8" VALUE 0x00000000 Scalar_UBYTE 0 BSW_A2L_Ident_Int 0 255 /end CHARACTERISTIC
/begin CHARACTERISTIC CAL_TpcCod_MotorSampErr_b "CAL_TpcCod_MotorSampErr_b" VALUE 0x00000000 Scalar_BOOLEAN 0 BSW_A2L_Ident_Int 0 1 /end CHARACTERISTIC
/begin MEASUREMENT VAR_DEM_Event_IOHWAB_TCoolantSampFail_Status_u8 "VAR_DEM_Event_IOHWAB_TCoolantSampFail_Status_u8" UBYTE BSW_A2L_Ident_Int 1 100 0 255 ECU_ADDRESS 0x00000000 /end MEASUREMENT
/begin CHARACTERISTIC CAL_DEM_Disbl_DFC_RCF_OfsClbFail_u8 "CAL_DEM_Disbl_DFC_RCF_OfsClbFail_u8" VALUE 0x00000000 Scalar_UBYTE 0 BSW_A2L_Ident_Int 0 255 /end CHARACTERISTIC
/begin CHARACTERISTIC CAL_RDC_RslDosFaultValMax_s16 "CAL_RDC_RslDosFaultValMax_s16" VALUE 0x00000000 Scalar_SWORD 0 BSW_A2L_Ident_Int -32768 32767 /end CHARACTERISTIC
/begin CHARACTERISTIC CAL_TRSP_3V3CPLDVoltDebTrh_s16 "CAL_TRSP_3V3CPLDVoltDebTrh_s16" VALUE 0x00000000 Scalar_SWORD 0 BSW_A2L_Ident_Int -32768 32767 /end CHARACTERISTIC
/begin MEASUREMENT VAR_STM0_TimeData_AdcISR_u32 "VAR_STM0_TimeData_AdcISR_u32" ULONG BSW_A2L_Ident_Int 1 100 0 4294967295 ECU_ADDRESS 0x00000000 /end MEASUREMENT
/begin CHARACTERISTIC CAL_TpcTmp_DBCTempMinus_f32 "CAL_TpcTmp_DBCTempMinus_f32" VALUE 0x00000000 Scalar_FLOAT32_IEEE 0 BSW_A2L_Ident_Float -3.4E+38 3.4E+38 /end CHARACTERISTIC
/begin MEASUREMENT VAR_tpccod_flgMaxDertOvrUdc_b "VAR_tpccod_flgMaxDertOvrUdc_b" UBYTE BSW_A2L_Ident_Int 1 100 0 1 ECU_ADDRESS 0x00000000 /end MEASUREMENT
/begin CHARACTERISTIC CAL_Cspf_TrqSetP_f32 "CAL_Cspf_TrqSetP_f32" VALUE 0x00000000 Scalar_FLOAT32_IEEE 0 BSW_A2L_Ident_Float -3.4E+38 3.4E+38 /end CHARACTERISTIC
/begin MEASUREMENT VAR_PcfCtl_AimPosPID_f32 "VAR_PcfCtl_AimPosPID_f32" FLOAT32_IEEE BSW_A2L_Ident_Float 1 100 -3.4E+38 3.4E+38 ECU_ADDRESS 0x00000000 /end MEASUREMENT
/begin MEASUREMENT VAR_DEM_Event_IgbtDrv_UpBrgFaultBFail_Status_u8 "VAR_DEM_Event_IgbtDrv_UpBrgFaultBFail_Status_u8" UBYTE BSW_A2L_Ident_Int 1 100 0 255 ECU_ADDRESS 0x00000000 /end MEASUREMENT
/begin MEASUREMENT VAR_PcfDia_flgAllowPwmRun_b "VAR_PcfDia_flgAllowPwmRun_b" UBYTE BSW_A2L_Ident_Int 1 100 0 1 ECU_ADDRESS 0x00000000 /end MEASUREMENT
/begin MEASUREMENT VAR_Cspf_TrabDernStrTemp_u8 "VAR_Cspf_TrabDernStrTemp_u8" UBYTE BSW_A2L_Ident_Int 1 100 0 255 ECU_ADDRESS 0x00000000 /end MEASUREMENT
/begin CHARACTERISTIC CAL_MDF_UdcThreshCirNoPsbl_f32 "CAL_MDF_UdcThreshCirNoPsbl_f32" VALUE 0x00000000 Scalar_FLOAT32_IEEE 0 BSW_A2L_Ident_Float -3.4E+38 3.4E+38 /end CHARACTERISTIC
/begin CHARACTERISTIC CAL_DEM_Disbl_DFC_IOHWAB_5VQcoSampFail_u8 "CAL_DEM_Disbl_DFC_IOHWAB_5VQcoSampFail_u8" VALUE 0x00000000 Scalar_UBYTE 0 BSW_A2L_Ident_Int 0 255 /end CHARACTERISTIC
/begin MEASUREMENT VAR_VCF_flgHoldModeReq_b "VAR_VCF_flgHoldModeReq_b" UBYTE BSW_A2L_Ident_Int 1 100 0 1 ECU_ADDRESS 0x00000000 /end MEASUREMENT
/begin MEASUREMENT VAR_ADM_flgDchgReq_b "VAR_ADM_flgDchgReq_b" UBYTE BSW_A2L_Ident_Int 1 100 0 1 ECU_ADDRESS 0x00000000 /end MEASUREMENT
/begin CHARACTERISTIC CAL_TpcTmp_IgbtRiseChgTempUpDiff_f32 "CAL_TpcTmp_IgbtRiseChgTempUpDiff_f32" VALUE 0x00000000 Scalar_FLOAT32_IEEE 0 BSW_A2L_Ident_Float -3.4E+38 3.4E+38 /end CHARACTERISTIC
/begin CHARACTERISTIC CAL_PcfCtl_SLdeltaAimOutP_f32 "CAL_PcfCtl_SLdeltaAimOutP_f32" VALUE 0x00000000 Scalar_FLOAT32_IEEE 0 BSW_A2L_Ident_Float -3.4E+38 3.4E+38 /end CHARACTERISTIC
/begin MEASUREMENT VAR_Scf_flgTranPostDrvToSutDwn_b "VAR_Scf_flgTranPostDrvToSutDwn_b" UBYTE BSW_A2L_Ident_Int 1 100 0 1 ECU_ADDRESS 0x00000000 /end MEASUREMENT
/begin MEASUREMENT VAR_flgRecVCU05_u8 "VAR_flgRecVCU05_u8" UBYTE BSW_A2L_Ident_Int 1 100 0 255 ECU_ADDRESS 0x00000000 /end MEASUREMENT
/begin CHARACTERISTIC CAL_DEM_Disbl_DFC_IOHWAB_12VSampErr_u8 "CAL_DEM_Disbl_DFC_IOHWAB_12VSampErr_u8" VALUE 0x00000000 Scalar_UBYTE 0 BSW_A2L_Ident_Int 0 255 /end CHARACTERISTIC
/begin CHARACTERISTIC CAL_TRSP_ReqTrqHiLim_f32 "CAL_TRSP_ReqTrqHiLim_f32" VALUE 0x00000000 Scalar_FLOAT32_IEEE 0 BSW_A2L_Ident_Float -3.4E+38 3.4E+38 /end CHARACTERISTIC
/begin MEASUREMENT VAR_MCF_Is_f32 "VAR_MCF_Is_f32" FLOAT32_IEEE BSW_A2L_Ident_Float 1 100 -3.4E+38 3.4E+38 ECU_ADDRESS 0x00000000 /end MEASUREMENT
/begin CHARACTERISTIC CAL_FRP_OffsetRngErrrOutCtl_b "CAL_FRP_OffsetRngErrrOutCtl_b" VALUE 0x00000000 Scalar_BOOLEAN 0 BSW_A2L_Ident_Int 0 1 /end CHARACTERISTIC
/begin CHARACTERISTIC CAL_TpcTmp_tDbcTempVHiLim_f32 "CAL_TpcTmp_tDbcTempVHiLim_f32" VALUE 0x00000000 Scalar_FLOAT32_IEEE 0 BSW_A2L_Ident_Float -3.4E+38 3.4E+38 /end CHARACTERISTIC
/begin MEASUREMENT VAR_RCF_flgAccToClbFreFwd_b "VAR_RCF_flgAccToClbFreFwd_b" UBYTE BSW_A2L_Ident_Int 1 100 0 1 ECU_ADDRESS 0x00000000 /end MEASUREMENT
/begin MEASUREMENT VAR_tpcsmp_KiProductSum_f32 "VAR_tpcsmp_KiProductSum_f32" FLOAT32_IEEE BSW_A2L_Ident_Float 1 100 -3.4E+38 3.4E+38 ECU_ADDRESS 0x00000000 /end MEASUREMENT
/begin CHARACTERISTIC CAL_TpcTmp_DbcRiseChgTempDownDiff_f32 "CAL_TpcTmp_DbcRiseChgTempDownDiff_f32" VALUE 0x00000000 Scalar_FLOAT32_IEEE 0 BSW_A2L_Ident_Float -3.4E+38 3.4E+38 /end CHARACTERISTIC
/begin MEASUREMENT VAR_TRSP_VCurrRngChkRslt_b "VAR_TRSP_VCurrRngChkRslt_b" UBYTE BSW_A2L_Ident_Int 1 100 0 1 ECU_ADDRESS 0x00000000 /end MEASUREMENT
/begin MEASUREMENT VAR_tpcsmp_KpProduct_f32 "VAR_tpcsmp_KpProduct_f32" FLOAT32_IEEE BSW_A2L_Ident_Float 1 100 -3.4E+38 3.4E+38 ECU_ADDRESS 0x00000000 /end MEASUREMENT
/begin CHARACTERISTIC CAL_DEM_FIM_DFC_IOHWAB_12VSampErr_au8 "CAL_DEM_FIM_DFC_IOHWAB_12VSampErr_au8" VAL_BLK 0x00000000 Scalar_UBYTE 0 FID_Verb 0 255 NUMBER 10 /end CHARACTERISTIC
/begin CHARACTERISTIC CAL_MCF_DycUSet_f32 "CAL_MCF_DycUSet_f32" VALUE 0x00000000 Scalar_FLOAT32_IEEE 0 BSW_A2L_Ident_Float -3.4E+38 3.4E+38 /end CHARACTERISTIC
/begin MEASUREMENT VAR_DEM_Event_HvMcu_DisChrgDutyErr_Status_u8 "VAR_DEM_Event_HvMcu_DisChrgDutyErr_Status_u8" UBYTE BSW_A2L_Ident_Int 1 100 0 255 ECU_ADDRESS 0x00000000 /end MEASUREMENT
/begin MEASUREMENT VAR_MDF_bOpenCirNoPsblFault_b "VAR_MDF_bOpenCirNoPsblFault_b" UBYTE BSW_A2L_Ident_Int 1 100 0 1 ECU_ADDRESS 0x00000000 /end MEASUREMENT
/begin CHARACTERISTIC CAL_DEM_FIM_DFC_TPC_TDrvBoardOvHiWarn_au8 "CAL_DEM_FIM_DFC_TPC_TDrvBoardOvHiWarn_au8" VAL_BLK 0x00000000 Scalar_UBYTE 0 FID_Verb 0 255 NUMBER 10 /end CHARACTERISTIC
/begin CHARACTERISTIC CAL_DEM_Disbl_DFC_TPC_TDbcOvLoWarn_u8 "CAL_DEM_Disbl_DFC_TPC_TDbcOvLoWarn_u8" VALUE 0x00000000 Scalar_UBYTE 0 BSW_A2L_Ident_Int 0 255 /end CHARACTERISTIC
/begin MEASUREMENT VAR_DEM_Event_PCF_SenOvErr_Status_u8 "VAR_DEM_Event_PCF_SenOvErr_Status_u8" UBYTE BSW_A2L_Ident_Int 1 100 0 255 ECU_ADDRESS 0x00000000 /end MEASUREMENT
/begin CHARACTERISTIC CAL_TCF_TempStrMax_f32 "CAL_TCF_TempStrMax_f32" VALUE 0x00000000 Scalar_FLOAT32_IEEE 0 BSW_A2L_Ident_Float -3.4E+38 3.4E+38 /end CHARACTERISTIC
/begin CHARACTERISTIC CAL_TpcBlk_MtrBlkSpdHighSet_f32 "CAL_TpcBlk_MtrBlkSpdHighSet_f32" VALUE 0x00000000 Scalar_FLOAT32_IEEE 0 BSW_A2L_Ident_Float -3.4E+38 3.4E+38 /end CHARACTERISTIC
/begin MEASUREMENT VAR_MDF_flagOperOutdRngChk_b "VAR_MDF_flagOperOutdRngChk_b" UBYTE BSW_A2L_Ident_Int 1 100 0 1 ECU_ADDRESS 0x00000000 /end MEASUREMENT
/begin MEASUREMENT VAR_PcfStm_SLenMos_b "VAR_PcfStm_SLenMos_b" UBYTE BSW_A2L_Ident_Int 1 100 0 1 ECU_ADDRESS 0x00000000 /end MEASUREMENT
/begin CHARACTERISTIC CAL_ADM_flgDchgReq_b "CAL_ADM_flgDchgReq_b" VALUE 0x00000000 Scalar_BOOLEAN 0 BSW_A2L_Ident_Int 0 1 /end CHARACTERISTIC
/begin CHARACTERISTIC CAL_DEM_Disbl_DFC_IOHWAB_12VNarrSampErr_u8 "CAL_DEM_Disbl_DFC_IOHWAB_12VNarrSampErr_u8" VALUE 0x00000000 Scalar_UBYTE 0 BSW_A2L_Ident_Int 0 255 /end CHARACTERISTIC
/begin MEASUREMENT VAR_TpcTmp_TIgbtStableDiff_u16 "VAR_TpcTmp_TIgbtStableDiff_u16" UWORD BSW_A2L_Ident_Int 1 100 0 65535 ECU_ADDRESS 0x00000000 /end MEASUREMENT
/begin MEASUREMENT VAR_BCC_iDcLnkEstFlt_f32 "VAR_BCC_iDcLnkEstFlt_f32" FLOAT32_IEEE BSW_A2L_Ident_Float 1 100 -3.4E+38 3.4E+38 ECU_ADDRESS 0x00000000 /end MEASUREMENT
/begin CHARACTERISTIC CAL_PcfDia_IdcLockedHiHyst_f32 "CAL_PcfDia_IdcLockedHiHyst_f32" VALUE 0x00000000 Scalar_FLOAT32_IEEE 0 BSW_A2L_Ident_Float -3.4E+38 3.4E+38 /end CHARACTERISTIC
/begin MEASUREMENT VAR_DEM_Event_MDF_OperOutdRngErr_Status_u8 "VAR_DEM_Event_MDF_OperOutdRngErr_Status_u8" UBYTE BSW_A2L_Ident_Int 1 100 0 255 ECU_ADDRESS 0x00000000 /end MEASUREMENT
/begin CHARACTERISTIC CAL_TpcTmp_tDbcTraSave1ToNormal_f32 "CAL_TpcTmp_tDbcTraSave1ToNormal_f32" VALUE 0x00000000 Scalar_FLOAT32_IEEE 0 BSW_A2L_Ident_Float -3.4E+38 3.4E+38 /end CHARACTERISTIC
/begin CHARACTERISTIC CAL_TjrthLv4dhdl_f32 "CAL_TjrthLv4dhdl_f32" VALUE 0x00000000 Scalar_FLOAT32_IEEE 0 BSW_A2L_Ident_Float -3.4E+38 3.4E+38 /end CHARACTERISTIC
/begin CHARACTERISTIC CAL_TpcTmp_tRiseIGBTTraSave1ToSave2_f32 "CAL_TpcTmp_tRiseIGBTTraSave1ToSave2_f32" VALUE 0x00000000 Scalar_FLOAT32_IEEE 0 BSW_A2L_Ident_Float -3.4E+38 3.4E+38 /end CHARACTERISTIC
/begin CHARACTERISTIC CAL_Cspf_flguDcLnkSlowFltSwt_b "CAL_Cspf_flguDcLnkSlowFltSwt_b" VALUE 0x00000000 Scalar_BOOLEAN 0 BSW_A2L_Ident_Int 0 1 /end CHARACTERISTIC
/begin MEASUREMENT VAR_DEM_Event_IOHWAB_DcLnkOverVolFail_Status_u8 "VAR_DEM_Event_IOHWAB_DcLnkOverVolFail_Status_u8" UBYTE BSW_A2L_Ident_Int 1 100 0 255 ECU_ADDRESS 0x00000000 /end MEASUREMENT
/begin CHARACTERISTIC CAL_TpcSmp_SystemEffiElec_f32 "CAL_TpcSmp_SystemEffiElec_f32" VALUE 0x00000000 Scalar_FLOAT32_IEEE 0 BSW_A2L_Ident_Float -3.4E+38 3.4E+38 /end CHARACTERISTIC
/begin MEASUREMENT VAR_TpcSmp_iDcLnkMax_f32 "VAR_TpcSmp_iDcLnkMax_f32" FLOAT32_IEEE BSW_A2L_Ident_Float 1 100 -3.4E+38 3.4E+38 ECU_ADDRESS 0x00000000 /end MEASUREMENT
/begin MEASUREMENT VAR_PcfStm_BCflgModeReq_b "VAR_PcfStm_BCflgModeReq_b" UBYTE BSW_A2L_Ident_Int 1 100 0 1 ECU_ADDRESS 0x00000000 /end MEASUREMENT
/begin MEASUREMENT VAR_MCF_PCUHeaterPower_f32 "VAR_MCF_PCUHeaterPower_f32" FLOAT32_IEEE BSW_A2L_Ident_Float 1 100 -3.4E+38 3.4E+38 ECU_ADDRESS 0x00000000 /end MEASUREMENT
/begin CHARACTERISTIC CAL_TpcCod_NegTrqDirStop_f32 "CAL_TpcCod_NegTrqDirStop_f32" VALUE 0x00000000 Scalar_FLOAT32_IEEE 0 BSW_A2L_Ident_Float -3.4E+38 3.4E+38 /end CHARACTERISTIC
/begin MEASUREMENT VAR_TpcTmp_CofDertTIGBTSave2_f32 "VAR_TpcTmp_CofDertTIGBTSave2_f32" FLOAT32_IEEE BSW_A2L_Ident_Float 1 100 -3.4E+38 3.4E+38 ECU_ADDRESS 0x00000000 /end MEASUREMENT
/begin MEASUREMENT VAR_RCF_flgInactToFwdClb_b "VAR_RCF_flgInactToFwdClb_b" UBYTE BSW_A2L_Ident_Int 1 100 0 1 ECU_ADDRESS 0x00000000 /end MEASUREMENT
/begin MEASUREMENT VAR_PcfSig_IdcPcf_f32 "VAR_PcfSig_IdcPcf_f32" FLOAT32_IEEE BSW_A2L_Ident_Float 1 100 -3.4E+38 3.4E+38 ECU_ADDRESS 0x00000000 /end MEASUREMENT
/begin MEASUREMENT VAR_Bsw_tCoolantTemp_f32 "VAR_Bsw_tCoolantTemp_f32" FLOAT32_IEEE BSW_A2L_Ident_Float 1 100 -3.4E+38 3.4E+38 ECU_ADDRESS 0x00000000 /end MEASUREMENT
/begin MEASUREMENT VAR_MDF_AlOfsNoPlausState_u8 "VAR_MDF_AlOfsNoPlausState_u8" UBYTE BSW_A2L_Ident_Int 1 100 0 255 ECU_ADDRESS 0x00000000 /end MEASUREMENT
/begin MEASUREMENT VAR_DEM_Event_HvMcu_ComErr_Status_u8 "VAR_DEM_Event_HvMcu_ComErr_Status_u8" UBYTE BSW_A2L_Ident_Int 1 100 0 255 ECU_ADDRESS 0x00000000 /end MEASUREMENT
/begin MEASUREMENT VAR_TRSP_18VHSVoltRngErr_b "VAR_TRSP_18VHSVoltRngErr_b" UBYTE BSW_A2L_Ident_Int 1 100 0 1 ECU_ADDRESS 0x00000000 /end MEASUREMENT
/begin CHARACTERISTIC CAL_Scf_flgIntVcuComSwt_b "CAL_Scf_flgIntVcuComSwt_b" VALUE 0x00000000 Scalar_BOOLEAN 0 BSW_A2L_Ident_Int 0 1 /end CHARACTERISTIC
/begin MEASUREMENT VAR_DEM_Event_TPC_uDcLnkUnVLimFail_Status_u8 "VAR_DEM_Event_TPC_uDcLnkUnVLimFail_Status_u8" UBYTE BSW_A2L_Ident_Int 1 100 0 255 ECU_ADDRESS 0x00000000 /end MEASUREMENT
/begin CHARACTERISTIC CAL_TRSP_VCurrRngHiLim_f32 "CAL_TRSP_VCurrRngHiLim_f32" VALUE 0x00000000 Scalar_FLOAT32_IEEE 0 BSW_A2L_Ident_Float -3.4E+38 3.4E+38 /end CHARACTERISTIC
/begin MEASUREMENT VAR_TpcSmp_iDcLnkMin_f32 "VAR_TpcSmp_iDcLnkMin_f32" FLOAT32_IEEE BSW_A2L_Ident_Float 1 100 -3.4E+38 3.4E+38 ECU_ADDRESS 0x00000000 /end MEASUREMENT
/begin CHARACTERISTIC CAL_PcfSig_AngMotPos_f32 "CAL_PcfSig_AngMotPos_f32" VALUE 0x00000000 Scalar_FLOAT32_IEEE 0 BSW_A2L_Ident_Float -3.4E+38 3.4E+38 /end CHARACTERISTIC
/begin CHARACTERISTIC CAL_DEM_FIM_DFC_IOHWAB_KL30OverVolErr_au8 "CAL_DEM_FIM_DFC_IOHWAB_KL30OverVolErr_au8" VAL_BLK 0x00000000 Scalar_UBYTE 0 FID_Verb 0 255 NUMBER 10 /end CHARACTERISTIC
/begin MEASUREMENT VAR_Cspf_TraflgOfsClbSuc_u8 "VAR_Cspf_TraflgOfsClbSuc_u8" UBYTE BSW_A2L_Ident_Int 1 100 0 255 ECU_ADDRESS 0x00000000 /end MEASUREMENT
/begin CHARACTERISTIC CAL_Cspf_FailCode4_u8 "CAL_Cspf_FailCode4_u8" VALUE 0x00000000 Scalar_UBYTE 0 BSW_A2L_Ident_Int 0 255 /end CHARACTERISTIC
/begin CHARACTERISTIC CAL_MCF_KpUdEOL_f32 "CAL_MCF_KpUdEOL_f32" VALUE 0x00000000 Scalar_FLOAT32_IEEE 0 BSW_A2L_Ident_Float -3.4E+38 3.4E+38 /end CHARACTERISTIC
/begin CHARACTERISTIC CAL_TjrthLv4dlil_f32 "CAL_TjrthLv4dlil_f32" VALUE 0x00000000 Scalar_FLOAT32_IEEE 0 BSW_A2L_Ident_Float -3.4E+38 3.4E+38 /end CHARACTERISTIC
/begin CHARACTERISTIC CAL_PcfSig_VehSpd_f32 "CAL_PcfSig_VehSpd_f32" VALUE 0x00000000 Scalar_FLOAT32_IEEE 0 BSW_A2L_Ident_Float -3.4E+38 3.4E+38 /end CHARACTERISTIC
/begin MEASUREMENT VAR_TpcSmp_SpdOvHiWarnState_u8 "VAR_TpcSmp_SpdOvHiWarnState_u8" UBYTE BSW_A2L_Ident_Int 1 100 0 255 ECU_ADDRESS 0x00000000 /end MEASUREMENT
/begin CHARACTERISTIC CAL_Cspf_iDActSlowFlt_f32 "CAL_Cspf_iDActSlowFlt_f32" VALUE 0x00000000 Scalar_FLOAT32_IEEE 0 BSW_A2L_Ident_Float -3.4E+38 3.4E+38 /end CHARACTERISTIC
/begin CHARACTERISTIC CAL_TRSP_CurrSumLim_f32 "CAL_TRSP_CurrSumLim_f32" VALUE 0x00000000 Scalar_FLOAT32_IEEE 0 BSW_A2L_Ident_Float -3.4E+38 3.4E+38 /end CHARACTERISTIC
/begin MEASUREMENT VAR_PcfSig_flgBrake_b "VAR_PcfSig_flgBrake_b" UBYTE BSW_A2L_Ident_Int 1 100 0 1 ECU_ADDRESS 0x00000000 /end MEASUREMENT
/begin CHARACTERISTIC CAL_MCF_isdfwKp_f32 "CAL_MCF_isdfwKp_f32" VALUE 0x00000000 Scalar_FLOAT32_IEEE 0 BSW_A2L_Ident_Float -3.4E+38 3.4E+38 /end CHARACTERISTIC
/begin MEASUREMENT VAR_TpcTmp_tCoolantOperationMode_u8 "VAR_TpcTmp_tCoolantOperationMode_u8" UBYTE BSW_A2L_Ident_Int 1 100 0 255 ECU_ADDRESS 0x00000000 /end MEASUREMENT
/begin CHARACTERISTIC CAL_Cspf_stGateDrv_u8 "CAL_Cspf_stGateDrv_u8" VALUE 0x00000000 Scalar_UBYTE 0 BSW_A2L_Ident_Int 0 255 /end CHARACTERISTIC
/begin MEASUREMENT VAR_DEM_Event_IgbtDrv_ComErr_Status_u8 "VAR_DEM_Event_IgbtDrv_ComErr_Status_u8" UBYTE BSW_A2L_Ident_Int 1 100 0 255 ECU_ADDRESS 0x00000000 /end MEASUREMENT
/begin MEASUREMENT VAR_DEM_AllEvtFailedList_au8 "VAR_DEM_AllEvtFailedList_au8" UBYTE BSW_A2L_Ident_Int 1 100 0 255 ARRAY_SIZE 128 ECU_ADDRESS 0x00000000 /end MEASUREMENT
/begin CHARACTERISTIC CAL_TRSP_1V8CPLDVoltCountTrh_s16 "CAL_TRSP_1V8CPLDVoltCountTrh_s16" VALUE 0x00000000 Scalar_SWORD 0 BSW_A2L_Ident_Int -32768 32767 /end CHARACTERISTIC
/begin CHARACTERISTIC CAL_DEM_FIM_DFC_Cpld_ExdClkInFail_au8 "CAL_DEM_FIM_DFC_Cpld_ExdClkInFail_au8" VAL_BLK 0x00000000 Scalar_UBYTE 0 FID_Verb 0 255 NUMBER 10 /end CHARACTERISTIC
/begin MEASUREMENT VAR_TpcTmp_CofDertTRiseIGBTSave2_f32 "VAR_TpcTmp_CofDertTRiseIGBTSave2_f32" FLOAT32_IEEE BSW_A2L_Ident_Float 1 100 -3.4E+38 3.4E+38 ECU_ADDRESS 0x00000000 /end MEASUREMENT
/begin CHARACTERISTIC CAL_TpcTmp_tDbcTempWHiLim_f32 "CAL_TpcTmp_tDbcTempWHiLim_f32" VALUE 0x00000000 Scalar_FLOAT32_IEEE 0 BSW_A2L_Ident_Float -3.4E+38 3.4E+38 /end CHARACTERISTIC
/begin CHARACTERISTIC CAL_IOHWAB_DIO_AN29_IUVW_P_REF_DEM_f32 "CAL_IOHWAB_DIO_AN29_IUVW_P_REF_DEM_f32" VALUE 0x00000000 Scalar_FLOAT32_IEEE 0 BSW_A2L_Ident_Float -3.4E+38 3.4E+38 /end CHARACTERISTIC
/begin MEASUREMENT VAR_DMA_Sin_Max_u16 "VAR_DMA_Sin_Max_u16" UWORD BSW_A2L_Ident_Int 1 100 0 65535 ECU_ADDRESS 0x00000000 /end MEASUREMENT
/begin MEASUREMENT VAR_STM0_SWC_1000ms_Task_Core0_u32 "VAR_STM0_SWC_1000ms_Task_Core0_u32" ULONG BSW_A2L_Ident_Int 1 100 0 4294967295 ECU_ADDRESS 0x00000000 /end MEASUREMENT
/begin MEASUREMENT VAR_TpcFuv_FimTrqLimLv1_b "VAR_TpcFuv_FimTrqLimLv1_b" UBYTE BSW_A2L_Ident_Int 1 100 0 1 ECU_ADDRESS 0x00000000 /end MEASUREMENT
/begin MEASUREMENT VAR_RCF_OfsClbAngBwd_f32 "VAR_RCF_OfsClbAngBwd_f32" FLOAT32_IEEE BSW_A2L_Ident_Float 1 100 -3.4E+38 3.4E+38 ECU_ADDRESS 0x00000000 /end MEASUREMENT
/begin MEASUREMENT VAR_PcfDia_flgSenVerFail_b "VAR_PcfDia_flgSenVerFail_b" UBYTE BSW_A2L_Ident_Int 1 100 0 1 ECU_ADDRESS 0x00000000 /end MEASUREMENT
/begin CHARACTERISTIC CAL_PcfSig_PosOffset_f32 "CAL_PcfSig_PosOffset_f32" VALUE 0x00000000 Scalar_FLOAT32_IEEE 0 BSW_A2L_Ident_Float -3.4E+38 3.4E+38 /end CHARACTERISTIC
/begin CHARACTERISTIC CAL_DEM_Disbl_DFC_TPC_TIGBTOvLoWarn_u8 "CAL_DEM_Disbl_DFC_TPC_TIGBTOvLoWarn_u8" VALUE 0x00000000 Scalar_UBYTE 0 BSW_A2L_Ident_Int 0 255 /end CHARACTERISTIC
/begin CHARACTERISTIC CAL_RdcRslExcFaultDebounce_u8 "CAL_RdcRslExcFaultDebounce_u8" VALUE 0x00000000 Scalar_UBYTE 0 BSW_A2L_Ident_Int 0 255 /end CHARACTERISTIC
/begin CHARACTERISTIC CAL_PcfDia_flgRetrySwt_b "CAL_PcfDia_flgRetrySwt_b" VALUE 0x00000000 Scalar_BOOLEAN 0 BSW_A2L_Ident_Int 0 1 /end CHARACTERISTIC
/begin CHARACTERISTIC CAL_TRSP_UBRVoltCountTrh_s16 "CAL_TRSP_UBRVoltCountTrh_s16" VALUE 0x00000000 Scalar_SWORD 0 BSW_A2L_Ident_Int -32768 32767 /end CHARACTERISTIC
/begin CHARACTERISTIC CAL_TpcMot_tSttrTraSave2ToOverheating_f32 "CAL_TpcMot_tSttrTraSave2ToOverheating_f32" VALUE 0x00000000 Scalar_FLOAT32_IEEE 0 BSW_A2L_Ident_Float -3.4E+38 3.4E+38 /end CHARACTERISTIC
/begin MEASUREMENT VAR_Vcf_TranstoHoldIn_b "VAR_Vcf_TranstoHoldIn_b" UBYTE BSW_A2L_Ident_Int 1 100 0 1 ECU_ADDRESS 0x00000000 /end MEASUREMENT
/begin CHARACTERISTIC CAL_TpcTmp_IgbtChgTempDownDiff_f32 "CAL_TpcTmp_IgbtChgTempDownDiff_f32" VALUE 0x00000000 Scalar_FLOAT32_IEEE 0 BSW_A2L_Ident_Float -3.4E+38 3.4E+38 /end CHARACTERISTIC
/begin CHARACTERISTIC CAL_MCF_TrqInvMax_f32 "CAL_MCF_TrqInvMax_f32" VALUE 0x00000000 Scalar_FLOAT32_IEEE 0 BSW_A2L_Ident_Float -3.4E+38 3.4E+38 /end CHARACTERISTIC
/begin CHARACTERISTIC CAL_MCF_KiBetaZeroCtl_f32 "CAL_MCF_KiBetaZeroCtl_f32" VALUE 0x00000000 Scalar_FLOAT32_IEEE 0 BSW_A2L_Ident_Float -3.4E+38 3.4E+38 /end CHARACTERISTIC
/begin CHARACTERISTIC CAL_MCF_flgNWS_b "CAL_MCF_flgNWS_b" VALUE 0x00000000 Scalar_BOOLEAN 0 BSW_A2L_Ident_Int 0 1 /end CHARACTERISTIC
/begin MEASUREMENT VAR_PcfDia_flgRunTiOv_b "VAR_PcfDia_flgRunTiOv_b" UBYTE BSW_A2L_Ident_Int 1 100 0 1 ECU_ADDRESS 0x00000000 /end MEASUREMENT
/begin MEASUREMENT VAR_FS_BswFaultInfo_u32 "VAR_FS_BswFaultInfo_u32" ULONG BSW_A2L_Ident_Int 1 100 0 4294967295 ECU_ADDRESS 0x00000000 /end MEASUREMENT
/begin MEASUREMENT VAR_Hspf_uKl30_f32 "VAR_Hspf_uKl30_f32" FLOAT32_IEEE BSW_A2L_Ident_Float 1 100 -3.4E+38 3.4E+38 ECU_ADDRESS 0x00000000 /end MEASUREMENT
/begin MEASUREMENT VAR_RCF_flgFailToDefault_b "VAR_RCF_flgFailToDefault_b" UBYTE BSW_A2L_Ident_Int 1 100 0 1 ECU_ADDRESS 0x00000000 /end MEASUREMENT
/begin MEASUREMENT VAR_Cspf_TrabDernCAN_u8 "VAR_Cspf_TrabDernCAN_u8" UBYTE BSW_A2L_Ident_Int 1 100 0 255 ECU_ADDRESS 0x00000000 /end MEASUREMENT
/begin MEASUREMENT VAR_STM_UintndSpdMonRslt_b "VAR_STM_UintndSpdMonRslt_b" UBYTE BSW_A2L_Ident_Int 1 100 0 1 ECU_ADDRESS 0x00000000 /end MEASUREMENT
/begin CHARACTERISTIC CAL_Vcf_CofHoldTrq_f32 "CAL_Vcf_CofHoldTrq_f32" VALUE 0x00000000 Scalar_FLOAT32_IEEE 0 BSW_A2L_Ident_Float -3.4E+38 3.4E+38 /end CHARACTERISTIC
/begin MEASUREMENT VAR_MDF_OpenCirNoPsblState_u8 "VAR_MDF_OpenCirNoPsblState_u8" UBYTE BSW_A2L_Ident_Int 1 100 0 255 ECU_ADDRESS 0x00000000 /end MEASUREMENT
/begin MEASUREMENT VAR_Tpcblk_TrqLim01_f32 "VAR_Tpcblk_TrqLim01_f32" FLOAT32_IEEE BSW_A2L_Ident_Float 1 100 -3.4E+38 3.4E+38 ECU_ADDRESS 0x00000000 /end MEASUREMENT
/begin MEASUREMENT VAR_DEM_Event_PCF_UnexpPosErr_Status_u8 "VAR_DEM_Event_PCF_UnexpPosErr_Status_u8" UBYTE BSW_A2L_Ident_Int 1 100 0 255 ECU_ADDRESS 0x00000000 /end MEASUREMENT
/begin CHARACTERISTIC CAL_RDC_RslDosFaultValMin_s16 "CAL_RDC_RslDosFaultValMin_s16" VALUE 0x00000000 Scalar_SWORD 0 BSW_A2L_Ident_Int -32768 32767 /end CHARACTERISTIC
/begin CHARACTERISTIC CAL_MDF_trqOfsNoPlausFault_f32 "CAL_MDF_trqOfsNoPlausFault_f32" VALUE 0x00000000 Scalar_FLOAT32_IEEE 0 BSW_A2L_Ident_Float -3.4E+38 3.4E+38 /end CHARACTERISTIC
/begin CHARACTERISTIC CAL_DEM_Disbl_DFC_Epark_OverCurFail_u8 "CAL_DEM_Disbl_DFC_Epark_OverCurFail_u8" VALUE 0x00000000 Scalar_UBYTE 0 BSW_A2L_Ident_Int 0 255 /end CHARACTERISTIC
/begin MEASUREMENT VAR_Scf_flgFimDchaFailr_b "VAR_Scf_flgFimDchaFailr_b" UBYTE BSW_A2L_Ident_Int 1 100 0 1 ECU_ADDRESS 0x00000000 /end MEASUREMENT
/begin MEASUREMENT VAR_Cpu_LoadCalc_f32 "VAR_Cpu_LoadCalc_f32" FLOAT32_IEEE BSW_A2L_Ident_Float 1 100 -3.4E+38 3.4E+38 ECU_ADDRESS 0x00000000 /end MEASUREMENT
/begin CHARACTERISTIC CAL_Cspf_flgbDernDbcTempSwt_b "CAL_Cspf_flgbDernDbcTempSwt_b" VALUE 0x00000000 Scalar_BOOLEAN 0 BSW_A2L_Ident_Int 0 1 /end CHARACTERISTIC
/begin MEASUREMENT VAR_TpcTmp_ElecTrqLimTdrvboard_f32 "VAR_TpcTmp_ElecTrqLimTdrvboard_f32" FLOAT32_IEEE BSW_A2L_Ident_Float 1 100 -3.4E+38 3.4E+38 ECU_ADDRESS 0x00000000 /end MEASUREMENT
/begin CHARACTERISTIC CAL_MCF_iWCnvFac_f32 "CAL_MCF_iWCnvFac_f32" VALUE 0x00000000 Scalar_FLOAT32_IEEE 0 BSW_A2L_Ident_Float -3.4E+38 3.4E+38 /end CHARACTERISTIC
/begin CHARACTERISTIC CAL_DEM_Disbl_DFC_IOHWAB_Cpld3v3SampFail_u8 "CAL_DEM_Disbl_DFC_IOHWAB_Cpld3v3SampFail_u8" VALUE 0x00000000 Scalar_UBYTE 0 BSW_A2L_Ident_Int 0 255 /end CHARACTERISTIC
/begin CHARACTERISTIC CAL_Scf_cntDisChgOvTi_u16 "CAL_Scf_cntDisChgOvTi_u16" VALUE 0x00000000 Scalar_UWORD 0 BSW_A2L_Ident_Int 0 65535 /end CHARACTERISTIC
/begin CHARACTERISTIC CAL_TjLv3Pas_f32 "CAL_TjLv3Pas_f32" VALUE 0x00000000 Scalar_FLOAT32_IEEE 0 BSW_A2L_Ident_Float -3.4E+38 3.4E+38 /end CHARACTERISTIC
/begin MEASUREMENT VAR_DEM_Event_TPC_iDcLnkOvCLimFail_Status_u8 "VAR_DEM_Event_TPC_iDcLnkOvCLimFail_Status_u8" UBYTE BSW_A2L_Ident_Int 1 100 0 255 ECU_ADDRESS 0x00000000 /end MEASUREMENT
/begin MEASUREMENT VAR_TpcSmp_iDcLnkOvcWarnState_u8 "VAR_TpcSmp_iDcLnkOvcWarnState_u8" UBYTE BSW_A2L_Ident_Int 1 100 0 255 ECU_ADDRESS 0x00000000 /end MEASUREMENT
/begin CHARACTERISTIC CAL_Cspf_flgcTrqSLopeSwt_b "CAL_Cspf_flgcTrqSLopeSwt_b" VALUE 0x00000000 Scalar_BOOLEAN 0 BSW_A2L_Ident_Int 0 1 /end CHARACTERISTIC
/begin CHARACTERISTIC CAL_STM_UxptNLim_f32 "CAL_STM_UxptNLim_f32" VALUE 0x00000000 Scalar_FLOAT32_IEEE 0 BSW_A2L_Ident_Float -3.4E+38 3.4E+38 /end CHARACTERISTIC
/begin CHARACTERISTIC CAL_RDC_Nset_f32 "CAL_RDC_Nset_f32" VALUE 0x00000000 Scalar_FLOAT32_IEEE 0 BSW_A2L_Ident_Float -3.4E+38 3.4E+38 /end CHARACTERISTIC
/begin CHARACTERISTIC CAL_Cspf_flgFailCode2Swt_b "CAL_Cspf_flgFailCode2Swt_b" VALUE 0x00000000 Scalar_BOOLEAN 0 BSW_A2L_Ident_Int 0 1 /end CHARACTERISTIC
/begin MEASUREMENT VAR_TpcTmp_CofDertTRiseDbcSave1_f32 "VAR_TpcTmp_CofDertTRiseDbcSave1_f32" FLOAT32_IEEE BSW_A2L_Ident_Float 1 100 -3.4E+38 3.4E+38 ECU_ADDRESS 0x00000000 /end MEASUREMENT
/begin CHARACTERISTIC CAL_Cspf_FailCode6_u8 "CAL_Cspf_FailCode6_u8" VALUE 0x00000000 Scalar_UBYTE 0 BSW_A2L_Ident_Int 0 255 /end CHARACTERISTIC
/begin MEASUREMENT VAR_TCF_CurrAgTrqflt_f32 "VAR_TCF_CurrAgTrqflt_f32" FLOAT32_IEEE BSW_A2L_Ident_Float 1 100 -3.4E+38 3.4E+38 ECU_ADDRESS 0x00000000 /end MEASUREMENT
/begin CHARACTERISTIC CAL_MDF_nAbsPhaseFault_f32 "CAL_MDF_nAbsPhaseFault_f32" VALUE 0x00000000 Scalar_FLOAT32_IEEE 0 BSW_A2L_Ident_Float -3.4E+38 3.4E+38 /end CHARACTERISTIC
/begin MEASUREMENT VAR_Cspf_TraUT30Curr_f32 "VAR_Cspf_TraUT30Curr_f32" FLOAT32_IEEE BSW_A2L_Ident_Float 1 100 -3.4E+38 3.4E+38 ECU_ADDRESS 0x00000000 /end MEASUREMENT
/begin CHARACTERISTIC CAL_PcfDia_UdcCANLowSet_f32 "CAL_PcfDia_UdcCANLowSet_f32" VALUE 0x00000000 Scalar_FLOAT32_IEEE 0 BSW_A2L_Ident_Float -3.4E+38 3.4E+38 /end CHARACTERISTIC
/begin MEASUREMENT VAR_Vcf_TrqSrtPInside_f32 "VAR_Vcf_TrqSrtPInside_f32" FLOAT32_IEEE BSW_A2L_Ident_Float 1 100 -3.4E+38 3.4E+38 ECU_ADDRESS 0x00000000 /end MEASUREMENT
/begin CHARACTERISTIC CAL_Cspf_bDernDrvBoardTemp_u16 "CAL_Cspf_bDernDrvBoardTemp_u16" VALUE 0x00000000 Scalar_UWORD 0 BSW_A2L_Ident_Int 0 65535 /end CHARACTERISTIC
/begin CHARACTERISTIC CAL_PcfCtl_SoftDyc_f32 "CAL_PcfCtl_SoftDyc_f32" VALUE 0x00000000 Scalar_FLOAT32_IEEE 0 BSW_A2L_Ident_Float -3.4E+38 3.4E+38 /end CHARACTERISTIC
/begin CHARACTERISTIC CAL_Vcf_UnLoLimSlope_u8 "CAL_Vcf_UnLoLimSlope_u8" VALUE 0x00000000 Scalar_UBYTE 0 BSW_A2L_Ident_Int 0 255 /end CHARACTERISTIC
/begin CHARACTERISTIC CAL_PcfStm_flgUseFaultRec_b "CAL_PcfStm_flgUseFaultRec_b" VALUE 0x00000000 Scalar_BOOLEAN 0 BSW_A2L_Ident_Int 0 1 /end CHARACTERISTIC
/begin CHARACTERISTIC CAL_TRSP_iPhasSensVoltHiLim_u16 "CAL_TRSP_iPhasSensVoltHiLim_u16" VALUE 0x00000000 Scalar_UWORD 0 BSW_A2L_Ident_Int 0 65535 /end CHARACTERISTIC
/begin CHARACTERISTIC CAL_Cspf_flgbDernExcMaxSwt_b "CAL_Cspf_flgbDernExcMaxSwt_b" VALUE 0x00000000 Scalar_BOOLEAN 0 BSW_A2L_Ident_Int 0 1 /end CHARACTERISTIC
/begin MEASUREMENT VAR_RCF_OfsFlt4600Fwd_f32 "VAR_RCF_OfsFlt4600Fwd_f32" FLOAT32_IEEE BSW_A2L_Ident_Float 1 100 -3.4E+38 3.4E+38 ECU_ADDRESS 0x00000000 /end MEASUREMENT
/begin CHARACTERISTIC CAL_Hspf_MotorOpenChkCntHiLim_u8 "CAL_Hspf_MotorOpenChkCntHiLim_u8" VALUE 0x00000000 Scalar_UBYTE 0 BSW_A2L_Ident_Int 0 255 /end CHARACTERISTIC
/begin MEASUREMENT VAR_DEM_Event_Cpld_ExdClkInFail_Status_u8 "VAR_DEM_Event_Cpld_ExdClkInFail_Status_u8" UBYTE BSW_A2L_Ident_Int 1 100 0 255 ECU_ADDRESS 0x00000000 /end MEASUREMENT
/begin CHARACTERISTIC CAL_TRSP_UBRWIDECnvFac_f32 "CAL_TRSP_UBRWIDECnvFac_f32" VALUE 0x00000000 Scalar_FLOAT32_IEEE 0 BSW_A2L_Ident_Float -3.4E+38 3.4E+38 /end CHARACTERISTIC
/begin MEASUREMENT VAR_L2Sampling_UB_SBC_MON_u16 "VAR_L2Sampling_UB_SBC_MON_u16" UWORD BSW_A2L_Ident_Int 1 100 0 65535 ECU_ADDRESS 0x00000000 /end MEASUREMENT
/begin MEASUREMENT VAR_PcfStm_flgFaultToParkCtl_b "VAR_PcfStm_flgFaultToParkCtl_b" UBYTE BSW_A2L_Ident_Int 1 100 0 1 ECU_ADDRESS 0x00000000 /end MEASUREMENT
/begin CHARACTERISTIC CAL_TpcMot_tSttrTraNormalToSave1_f32 "CAL_TpcMot_tSttrTraNormalToSave1_f32" VALUE 0x00000000 Scalar_FLOAT32_IEEE 0 BSW_A2L_Ident_Float -3.4E+38 3.4E+38 /end CHARACTERISTIC
/begin MEASUREMENT VAR_STM0_BSW_2ms_Task_Core0_u32 "VAR_STM0_BSW_2ms_Task_Core0_u32" ULONG BSW_A2L_Ident_Int 1 100 0 4294967295 ECU_ADDRESS 0x00000000 /end MEASUREMENT
/begin MEASUREMENT VAR_DEM_AllFID_Statues_au8 "VAR_DEM_AllFID_Statues_au8" UBYTE BSW_A2L_Ident_Int 1 100 0 255 ARRAY_SIZE 163 ECU_ADDRESS 0x00000000 /end MEASUREMENT
/begin MEASUREMENT VAR_MCF_MPC_Lq_f32 "VAR_MCF_MPC_Lq_f32" FLOAT32_IEEE BSW_A2L_Ident_Float 1 100 -3.4E+38 3.4E+38 ECU_ADDRESS 0x00000000 /end MEASUREMENT
/begin CHARACTERISTIC CAL_PcfCtl_PosKp_f32 "CAL_PcfCtl_PosKp_f32" VALUE 0x00000000 Scalar_FLOAT32_IEEE 0 BSW_A2L_Ident_Float -3.4E+38 3.4E+38 /end CHARACTERISTIC
/begin CHARACTERISTIC CAL_TpcSmp_ElecUdrVoltKi_f32 "CAL_TpcSmp_ElecUdrVoltKi_f32" VALUE 0x00000000 Scalar_FLOAT32_IEEE 0 BSW_A2L_Ident_Float -3.4E+38 3.4E+38 /end CHARACTERISTIC
/begin CHARACTERISTIC CAL_Cspf_IdcMax_f32 "CAL_Cspf_IdcMax_f32" VALUE 0x00000000 Scalar_FLOAT32_IEEE 0 BSW_A2L_Ident_Float -3.4E+38 3.4E+38 /end CHARACTERISTIC
/begin CHARACTERISTIC CAL_RDC_RslDosOffMax_s16 "CAL_RDC_RslDosOffMax_s16" VALUE 0x00000000 Scalar_SWORD 0 BSW_A2L_Ident_Int -32768 32767 /end CHARACTERISTIC
/begin MEASUREMENT VAR_Cspf_TraTrqAbsMin_f32 "VAR_Cspf_TraTrqAbsMin_f32" FLOAT32_IEEE BSW_A2L_Ident_Float 1 100 -3.4E+38 3.4E+38 ECU_ADDRESS 0x00000000 /end MEASUREMENT
/begin MEASUREMENT VAR_TRSP_WCurrRngChkRslt_b "VAR_TRSP_WCurrRngChkRslt_b" UBYTE BSW_A2L_Ident_Int 1 100 0 1 ECU_ADDRESS 0x00000000 /end MEASUREMENT
/begin CHARACTERISTIC CAL_MCF_OffsetInternal_f32 "CAL_MCF_OffsetInternal_f32" VALUE 0x00000000 Scalar_FLOAT32_IEEE 0 BSW_A2L_Ident_Float -3.4E+38 3.4E+38 /end CHARACTERISTIC
/begin MEASUREMENT VAR_DEM_Event_RCF_EstOfsErr_Status_u8 "VAR_DEM_Event_RCF_EstOfsErr_Status_u8" UBYTE BSW_A2L_Ident_Int 1 100 0 255 ECU_ADDRESS 0x00000000 /end MEASUREMENT
/begin CHARACTERISTIC CAL_Scf_WithoutStatorCurrent_u8 "CAL_Scf_WithoutStatorCurrent_u8" VALUE 0x00000000 Scalar_UBYTE 0 BSW_A2L_Ident_Int 0 255 /end CHARACTERISTIC
/begin CHARACTERISTIC CAL_Cspf_NDiffMax_f32 "CAL_Cspf_NDiffMax_f32" VALUE 0x00000000 Scalar_FLOAT32_IEEE 0 BSW_A2L_Ident_Float -3.4E+38 3.4E+38 /end CHARACTERISTIC
/begin CHARACTERISTIC CAL_TjrthLv4ilntc_f32 "CAL_TjrthLv4ilntc_f32" VALUE 0x00000000 Scalar_FLOAT32_IEEE 0 BSW_A2L_Ident_Float -3.4E+38 3.4E+38 /end CHARACTERISTIC
/begin CHARACTERISTIC CAL_Cspf_NSetP_f32 "CAL_Cspf_NSetP_f32" VALUE 0x00000000 Scalar_FLOAT32_IEEE 0 BSW_A2L_Ident_Float -3.4E+38 3.4E+38 /end CHARACTERISTIC
/begin CHARACTERISTIC CAL_TpcSmp_CntGenOvrVolt_u8 "CAL_TpcSmp_CntGenOvrVolt_u8" VALUE 0x00000000 Scalar_UBYTE 0 BSW_A2L_Ident_Int 0 255 /end CHARACTERISTIC
/begin CHARACTERISTIC CAL_CddDPT_byte_au8 "CAL_CddDPT_byte_au8" VAL_BLK 0x00000000 Scalar_UBYTE 0 BSW_A2L_Ident_Int 0 255 NUMBER 6 /end CHARACTERISTIC
/begin CHARACTERISTIC CAL_MCF_KiAlphaZeroCtl_f32 "CAL_MCF_KiAlphaZeroCtl_f32" VALUE 0x00000000 Scalar_FLOAT32_IEEE 0 BSW_A2L_Ident_Float -3.4E+38 3.4E+38 /end CHARACTERISTIC
/begin CHARACTERISTIC CAL_TpcSmp_GenOvrVoltKp_f32 "CAL_TpcSmp_GenOvrVoltKp_f32" VALUE 0x00000000 Scalar_FLOAT32_IEEE 0 BSW_A2L_Ident_Float -3.4E+38 3.4E+38 /end CHARACTERISTIC
/begin MEASUREMENT VAR_Scf_flgPostDrvDone_b "VAR_Scf_flgPostDrvDone_b" UBYTE BSW_A2L_Ident_Int 1 100 0 1 ECU_ADDRESS 0x00000000 /end MEASUREMENT
/begin CHARACTERISTIC CAL_MCF_flgUse1113ZR_b "CAL_MCF_flgUse1113ZR_b" VALUE 0x00000000 Scalar_BOOLEAN 0 BSW_A2L_Ident_Int 0 1 /end CHARACTERISTIC
/begin MEASUREMENT VAR_IoHwAb_Adc_Phy_12V_Narr_f32 "VAR_IoHwAb_Adc_Phy_12V_Narr_f32" FLOAT32_IEEE BSW_A2L_Ident_Float 1 100 -3.4E+38 3.4E+38 ECU_ADDRESS 0x00000000 /end MEASUREMENT
/begin MEASUREMENT VAR_TRSP_RslvRngErr_b "VAR_TRSP_RslvRngErr_b" UBYTE BSW_A2L_Ident_Int 1 100 0 1 ECU_ADDRESS 0x00000000 /end MEASUREMENT
/begin CHARACTERISTIC CAL_Vcf_nAccChgLoLim_f32 "CAL_Vcf_nAccChgLoLim_f32" VALUE 0x00000000 Scalar_FLOAT32_IEEE 0 BSW_A2L_Ident_Float -3.4E+38 3.4E+38 /end CHARACTERISTIC
/begin CHARACTERISTIC CAL_DEM_Disbl_DFC_IOHWAB_IphaOCFail_u8 "CAL_DEM_Disbl_DFC_IOHWAB_IphaOCFail_u8" VALUE 0x00000000 Scalar_UBYTE 0 BSW_A2L_Ident_Int 0 255 /end CHARACTERISTIC
/begin CHARACTERISTIC CAL_Vcf_CrawltrqUp_f32 "CAL_Vcf_CrawltrqUp_f32" VALUE 0x00000000 Scalar_FLOAT32_IEEE 0 BSW_A2L_Ident_Float -3.4E+38 3.4E+38 /end CHARACTERISTIC
/begin MEASUREMENT VAR_PcfDia_flgRetryShield_b "VAR_PcfDia_flgRetryShield_b" UBYTE BSW_A2L_Ident_Int 1 100 0 1 ECU_ADDRESS 0x00000000 /end MEASUREMENT
/begin CHARACTERISTIC CAL_Vcf_PosDmpMaxTrq_f32 "CAL_Vcf_PosDmpMaxTrq_f32" VALUE 0x00000000 Scalar_FLOAT32_IEEE 0 BSW_A2L_Ident_Float -3.4E+38 3.4E+38 /end CHARACTERISTIC
/begin CHARACTERISTIC CAL_MCF_ratNarrWave_f32 "CAL_MCF_ratNarrWave_f32" VALUE 0x00000000 Scalar_FLOAT32_IEEE 0 BSW_A2L_Ident_Float -3.4E+38 3.4E+38 /end CHARACTERISTIC
/begin MEASUREMENT VAR_DEM_Event_Epark_SampFail_Status_u8 "VAR_DEM_Event_Epark_SampFail_Status_u8" UBYTE BSW_A2L_Ident_Int 1 100 0 255 ECU_ADDRESS 0x00000000 /end MEASUREMENT
/begin CHARACTERISTIC CAL_SWD_MotorPole_u8 "CAL_SWD_MotorPole_u8" VALUE 0x00000000 Scalar_UBYTE 0 BSW_A2L_Ident_Int 0 255 /end CHARACTERISTIC
/begin CHARACTERISTIC CAL_MDF_stFrwhlWoIs_u8 "CAL_MDF_stFrwhlWoIs_u8" VALUE 0x00000000 Scalar_UBYTE 0 BSW_A2L_Ident_Int 0 255 /end CHARACTERISTIC
/begin CHARACTERISTIC CAL_ADM_VoltAbsDiffThr_f32 "CAL_ADM_VoltAbsDiffThr_f32" VALUE 0x00000000 Scalar_FLOAT32_IEEE 0 BSW_A2L_Ident_Float -3.4E+38 3.4E+38 /end CHARACTERISTIC
/begin MEASUREMENT VAR_TRSP_iPhasSensVoltRngErr_b "VAR_TRSP_iPhasSensVoltRngErr_b" UBYTE BSW_A2L_Ident_Int 1 100 0 1 ECU_ADDRESS 0x00000000 /end MEASUREMENT
/begin CHARACTERISTIC CAL_TjrthLv4ihil_f32 "CAL_TjrthLv4ihil_f32" VALUE 0x00000000 Scalar_FLOAT32_IEEE 0 BSW_A2L_Ident_Float -3.4E+38 3.4E+38 /end CHARACTERISTIC
/begin MEASUREMENT VAR_DEM_Event_ADC_UPhaseBISTFail_Status_u8 "VAR_DEM_Event_ADC_UPhaseBISTFail_Status_u8" UBYTE BSW_A2L_Ident_Int 1 100 0 255 ECU_ADDRESS 0x00000000 /end MEASUREMENT
/begin MEASUREMENT VAR_TRSP_RslvSinPRngErr_b "VAR_TRSP_RslvSinPRngErr_b" UBYTE BSW_A2L_Ident_Int 1 100 0 1 ECU_ADDRESS 0x00000000 /end MEASUREMENT
/begin MEASUREMENT VAR_DEM_Event_IOHWAB_3V3MCU_SampFail_Status_u8 "VAR_DEM_Event_IOHWAB_3V3MCU_SampFail_Status_u8" UBYTE BSW_A2L_Ident_Int 1 100 0 255 ECU_ADDRESS 0x00000000 /end MEASUREMENT
/begin CHARACTERISTIC CAL_PcfDia_nMechHi_f32 "CAL_PcfDia_nMechHi_f32" VALUE 0x00000000 Scalar_FLOAT32_IEEE 0 BSW_A2L_Ident_Float -3.4E+38 3.4E+38 /end CHARACTERISTIC
/begin CHARACTERISTIC CAL_TpcSmp_ElecOvrCurtKp_f32 "CAL_TpcSmp_ElecOvrCurtKp_f32" VALUE 0x00000000 Scalar_FLOAT32_IEEE 0 BSW_A2L_Ident_Float -3.4E+38 3.4E+38 /end CHARACTERISTIC
/begin CHARACTERISTIC CAL_Cspf_flgIsFltSwt_b "CAL_Cspf_flgIsFltSwt_b" VALUE 0x00000000 Scalar_BOOLEAN 0 BSW_A2L_Ident_Int 0 1 /end CHARACTERISTIC
/begin CHARACTERISTIC CAL_DEM_FIM_DFC_Cpld_DI_ExdClk_InFail_au8 "CAL_DEM_FIM_DFC_Cpld_DI_ExdClk_InFail_au8" VAL_BLK 0x00000000 Scalar_UBYTE 0 FID_Verb 0 255 NUMBER 10 /end CHARACTERISTIC
/begin CHARACTERISTIC CAL_MDF_IsThreshCirNoPsbl_f32 "CAL_MDF_IsThreshCirNoPsbl_f32" VALUE 0x00000000 Scalar_FLOAT32_IEEE 0 BSW_A2L_Ident_Float -3.4E+38 3.4E+38 /end CHARACTERISTIC
/begin CHARACTERISTIC CAL_PcfSig_PosCnvFac_f32 "CAL_PcfSig_PosCnvFac_f32" VALUE 0x00000000 Scalar_FLOAT32_IEEE 0 BSW_A2L_Ident_Float -3.4E+38 3.4E+38 /end CHARACTERISTIC
/begin MEASUREMENT VAR_Cspf_TraFailCode5_u8 "VAR_Cspf_TraFailCode5_u8" UBYTE BSW_A2L_Ident_Int 1 100 0 255 ECU_ADDRESS 0x00000000 /end MEASUREMENT
/begin CHARACTERISTIC CAL_DEM_FIM_DFC_IOHWAB_12VWideSampErr_au8 "CAL_DEM_FIM_DFC_IOHWAB_12VWideSampErr_au8" VAL_BLK 0x00000000 Scalar_UBYTE 0 FID_Verb 0 255 NUMBER 10 /end CHARACTERISTIC
/begin CHARACTERISTIC CAL_MCF_stChangePha_u8 "CAL_MCF_stChangePha_u8" VALUE 0x00000000 Scalar_UBYTE 0 BSW_A2L_Ident_Int 0 255 /end CHARACTERISTIC
/begin CHARACTERISTIC CAL_DEM_FIM_DFC_IOHWAB_Cpld1v8SampFail_au8 "CAL_DEM_FIM_DFC_IOHWAB_Cpld1v8SampFail_au8" VAL_BLK 0x00000000 Scalar_UBYTE 0 FID_Verb 0 255 NUMBER 10 /end CHARACTERISTIC
/begin MEASUREMENT VAR_tpccod_flgMaxDertOvrIdc_b "VAR_tpccod_flgMaxDertOvrIdc_b" UBYTE BSW_A2L_Ident_Int 1 100 0 1 ECU_ADDRESS 0x00000000 /end MEASUREMENT
/begin CHARACTERISTIC CAL_TRSP_RslvSensVoltCountTrh_s16 "CAL_TRSP_RslvSensVoltCountTrh_s16" VALUE 0x00000000 Scalar_SWORD 0 BSW_A2L_Ident_Int -32768 32767 /end CHARACTERISTIC
/begin CHARACTERISTIC CAL_MCF_UpLimPIZeroCtl_f32 "CAL_MCF_UpLimPIZeroCtl_f32" VALUE 0x00000000 Scalar_FLOAT32_IEEE 0 BSW_A2L_Ident_Float -3.4E+38 3.4E+38 /end CHARACTERISTIC
/begin CHARACTERISTIC CAL_Cspf_IsFlt_f32 "CAL_Cspf_IsFlt_f32" VALUE 0x00000000 Scalar_FLOAT32_IEEE 0 BSW_A2L_Ident_Float -3.4E+38 3.4E+38 /end CHARACTERISTIC
/begin MEASUREMENT VAR_Cspf_TrastMode_u8 "VAR_Cspf_TrastMode_u8" UBYTE BSW_A2L_Ident_Int 1 100 0 255 ECU_ADDRESS 0x00000000 /end MEASUREMENT
/begin CHARACTERISTIC CAL_TRSP_RslvSqrtDebTrh_s16 "CAL_TRSP_RslvSqrtDebTrh_s16" VALUE 0x00000000 Scalar_SWORD 0 BSW_A2L_Ident_Int -32768 32767 /end CHARACTERISTIC
/begin MEASUREMENT VAR_DEM_Event_TPC_TSttrOvLoWarn_Status_u8 "VAR_DEM_Event_TPC_TSttrOvLoWarn_Status_u8" UBYTE BSW_A2L_Ident_Int 1 100 0 255 ECU_ADDRESS 0x00000000 /end MEASUREMENT
/begin MEASUREMENT VAR_FRP_AppFaultInfo_u32 "VAR_FRP_AppFaultInfo_u32" ULONG BSW_A2L_Ident_Int 1 100 0 4294967295 ECU_ADDRESS 0x00000000 /end MEASUREMENT
/begin MEASUREMENT VAR_TRSP_RslvCosNRngErr_b "VAR_TRSP_RslvCosNRngErr_b" UBYTE BSW_A2L_Ident_Int 1 100 0 1 ECU_ADDRESS 0x00000000 /end MEASUREMENT
/begin CHARACTERISTIC CAL_Scf_FLOATZERO_f32 "CAL_Scf_FLOATZERO_f32" VALUE 0x00000000 Scalar_FLOAT32_IEEE 0 BSW_A2L_Ident_Float -3.4E+38 3.4E+38 /end CHARACTERISTIC
/begin CHARACTERISTIC CAL_Vcf_Drv_go_alOffsetcalReq_u8 "CAL_Vcf_Drv_go_alOffsetcalReq_u8" VALUE 0x00000000 Scalar_UBYTE 0 BSW_A2L_Ident_Int 0 255 /end CHARACTERISTIC
/begin MEASUREMENT VAR_Cspf_TrabReadyHV_u8 "VAR_Cspf_TrabReadyHV_u8" UBYTE BSW_A2L_Ident_Int 1 100 0 255 ECU_ADDRESS 0x00000000 /end MEASUREMENT
/begin CHARACTERISTIC CAL_Vcf_OvHiLimSlope_u8 "CAL_Vcf_OvHiLimSlope_u8" VALUE 0x00000000 Scalar_UBYTE 0 BSW_A2L_Ident_Int 0 255 /end CHARACTERISTIC
/begin CHARACTERISTIC CAL_DEM_FIM_DFC_HvMcu_DisChrgFail_au8 "CAL_DEM_FIM_DFC_HvMcu_DisChrgFail_au8" VAL_BLK 0x00000000 Scalar_UBYTE 0 FID_Verb 0 255 NUMBER 10 /end CHARACTERISTIC
/begin CHARACTERISTIC CAL_TRSP_iPhaVOffset_f32 "CAL_TRSP_iPhaVOffset_f32" VALUE 0x00000000 Scalar_FLOAT32_IEEE 0 BSW_A2L_Ident_Float -3.4E+38 3.4E+38 /end CHARACTERISTIC
/begin CHARACTERISTIC CAL_RCF_cntOfValFwd_u32 "CAL_RCF_cntOfValFwd_u32" VALUE 0x00000000 Scalar_ULONG 0 BSW_A2L_Ident_Int 0 4294967295 /end CHARACTERISTIC
/begin CHARACTERISTIC CAL_RCF_nAlRtrDesAcc_f32 "CAL_RCF_nAlRtrDesAcc_f32" VALUE 0x00000000 Scalar_FLOAT32_IEEE 0 BSW_A2L_Ident_Float -3.4E+38 3.4E+38 /end CHARACTERISTIC
/begin CHARACTERISTIC CAL_RDC_IsrTimeCmpsa_u16 "CAL_RDC_IsrTimeCmpsa_u16" VALUE 0x00000000 Scalar_UWORD 0 BSW_A2L_Ident_Int 0 65535 /end CHARACTERISTIC
/begin MEASUREMENT VAR_MPC_frqPwmVF_f32 "VAR_MPC_frqPwmVF_f32" FLOAT32_IEEE BSW_A2L_Ident_Float 1 100 -3.4E+38 3.4E+38 ECU_ADDRESS 0x00000000 /end MEASUREMENT
/begin CHARACTERISTIC CAL_PcfCtl_SLRunDyc_f32 "CAL_PcfCtl_SLRunDyc_f32" VALUE 0x00000000 Scalar_FLOAT32_IEEE 0 BSW_A2L_Ident_Float -3.4E+38 3.4E+38 /end CHARACTERISTIC
/begin CHARACTERISTIC CAL_DEM_FIM_DFC_TPC_iDcLnkOvCLimFail_au8 "CAL_DEM_FIM_DFC_TPC_iDcLnkOvCLimFail_au8" VAL_BLK 0x00000000 Scalar_UBYTE 0 FID_Verb 0 255 NUMBER 10 /end CHARACTERISTIC
/begin CHARACTERISTIC CAL_Hspf_CltInletTempFltFrq_f32 "CAL_Hspf_CltInletTempFltFrq_f32" VALUE 0x00000000 Scalar_FLOAT32_IEEE 0 BSW_A2L_Ident_Float -3.4E+38 3.4E+38 /end CHARACTERISTIC
/begin CHARACTERISTIC CAL_DEM_FIM_DFC_TPC_TIGBTOvHiWarn_au8 "CAL_DEM_FIM_DFC_TPC_TIGBTOvHiWarn_au8" VAL_BLK 0x00000000 Scalar_UBYTE 0 FID_Verb 0 255 NUMBER 10 /end CHARACTERISTIC
/begin CHARACTERISTIC CAL_RCF_nCalcSec3_f32 "CAL_RCF_nCalcSec3_f32" VALUE 0x00000000 Scalar_FLOAT32_IEEE 0 BSW_A2L_Ident_Float -3.4E+38 3.4E+38 /end CHARACTERISTIC
/begin CHARACTERISTIC CAL_PcfStm_SLMotorAcctimeLimt_u16 "CAL_PcfStm_SLMotorAcctimeLimt_u16" VALUE 0x00000000 Scalar_UWORD 0 BSW_A2L_Ident_Int 0 65535 /end CHARACTERISTIC
/begin CHARACTERISTIC CAL_Tpc_TrqReduceRevStep_f32 "CAL_Tpc_TrqReduceRevStep_f32" VALUE 0x00000000 Scalar_FLOAT32_IEEE 0 BSW_A2L_Ident_Float -3.4E+38 3.4E+38 /end CHARACTERISTIC
/begin CHARACTERISTIC CAL_Cspf_FailCode3_u8 "CAL_Cspf_FailCode3_u8" VALUE 0x00000000 Scalar_UBYTE 0 BSW_A2L_Ident_Int 0 255 /end CHARACTERISTIC
/begin MEASUREMENT VAR_TpcTmp_TDbcRiseStableDiff_u16 "VAR_TpcTmp_TDbcRiseStableDiff_u16" UWORD BSW_A2L_Ident_Int 1 100 0 65535 ECU_ADDRESS 0x00000000 /end MEASUREMENT
/begin MEASUREMENT VAR_Scf_flgbt15first_b "VAR_Scf_flgbt15first_b" UBYTE BSW_A2L_Ident_Int 1 100 0 1 ECU_ADDRESS 0x00000000 /end MEASUREMENT
/begin MEASUREMENT VAR_IoHwAb_Adc_Phy_IUVW_N_REF_f32 "VAR_IoHwAb_Adc_Phy_IUVW_N_REF_f32" FLOAT32_IEEE BSW_A2L_Ident_Float 1 100 -3.4E+38 3.4E+38 ECU_ADDRESS 0x00000000 /end MEASUREMENT
/begin MEASUREMENT VAR_TRSP_RslvCos_f32 "VAR_TRSP_RslvCos_f32" FLOAT32_IEEE BSW_A2L_Ident_Float 1 100 -3.4E+38 3.4E+38 ECU_ADDRESS 0x00000000 /end MEASUREMENT
/begin CHARACTERISTIC CAL_RDC_NRestrict_f32 "CAL_RDC_NRestrict_f32" VALUE 0x00000000 Scalar_FLOAT32_IEEE 0 BSW_A2L_Ident_Float -3.4E+38 3.4E+38 /end CHARACTERISTIC
/begin CHARACTERISTIC CAL_TRSP_RslvSensVoltErrRst_b "CAL_TRSP_RslvSensVoltErrRst_b" VALUE 0x00000000 Scalar_BOOLEAN 0 BSW_A2L_Ident_Int 0 1 /end CHARACTERISTIC
/begin CHARACTERISTIC CAL_DEM_FIM_DFC_PCF_IdcOvErr_au8 "CAL_DEM_FIM_DFC_PCF_IdcOvErr_au8" VAL_BLK 0x00000000 Scalar_UBYTE 0 FID_Verb 0 255 NUMBER 10 /end CHARACTERISTIC
/begin CHARACTERISTIC CAL_Vcf_TrqFbkLMax_f32 "CAL_Vcf_TrqFbkLMax_f32" VALUE 0x00000000 Scalar_FLOAT32_IEEE 0 BSW_A2L_Ident_Float -3.4E+38 3.4E+38 /end CHARACTERISTIC
/begin MEASUREMENT VAR_PcfStm_MotDir_b "VAR_PcfStm_MotDir_b" UBYTE BSW_A2L_Ident_Int 1 100 0 1 ECU_ADDRESS 0x00000000 /end MEASUREMENT
/begin MEASUREMENT VAR_Cspf_TraHvMcuVer_u16 "VAR_Cspf_TraHvMcuVer_u16" UWORD BSW_A2L_Ident_Int 1 100 0 65535 ECU_ADDRESS 0x00000000 /end MEASUREMENT
/begin MEASUREMENT VAR_PwmDutyCyclePhaseV_f32 "VAR_PwmDutyCyclePhaseV_f32" FLOAT32_IEEE BSW_A2L_Ident_Float 1 100 -3.4E+38 3.4E+38 ECU_ADDRESS 0x00000000 /end MEASUREMENT
/begin MEASUREMENT VAR_MCF_uAlphaDeadCpn_f32 "VAR_MCF_uAlphaDeadCpn_f32" FLOAT32_IEEE BSW_A2L_Ident_Float 1 100 -3.4E+38 3.4E+38 ECU_ADDRESS 0x00000000 /end MEASUREMENT
/begin CHARACTERISTIC CAL_TpcTmp_tCoolantTraSave1ToSave2_f32 "CAL_TpcTmp_tCoolantTraSave1ToSave2_f32" VALUE 0x00000000 Scalar_FLOAT32_IEEE 0 BSW_A2L_Ident_Float -3.4E+38 3.4E+38 /end CHARACTERISTIC
/begin MEASUREMENT VAR_TRSP_VCurrRngErr_b "VAR_TRSP_VCurrRngErr_b" UBYTE BSW_A2L_Ident_Int 1 100 0 1 ECU_ADDRESS 0x00000000 /end MEASUREMENT
/begin CHARACTERISTIC CAL_Scf_uTnetHysToPostDrv_f32 "CAL_Scf_uTnetHysToPostDrv_f32" VALUE 0x00000000 Scalar_FLOAT32_IEEE 0 BSW_A2L_Ident_Float -3.4E+38 3.4E+38 /end CHARACTERISTIC
/begin CHARACTERISTIC CAL_MCF_uQDesEOL_f32 "CAL_MCF_uQDesEOL_f32" VALUE 0x00000000 Scalar_FLOAT32_IEEE 0 BSW_A2L_Ident_Float -3.4E+38 3.4E+38 /end CHARACTERISTIC
/begin MEASUREMENT VAR_RCF_flgFwdorBwdToDefault_b "VAR_RCF_flgFwdorBwdToDefault_b" UBYTE BSW_A2L_Ident_Int 1 100 0 1 ECU_ADDRESS 0x00000000 /end MEASUREMENT
/begin CHARACTERISTIC CAL_Vcf_CrawlNsetD_f32 "CAL_Vcf_CrawlNsetD_f32" VALUE 0x00000000 Scalar_FLOAT32_IEEE 0 BSW_A2L_Ident_Float -3.4E+38 3.4E+38 /end CHARACTERISTIC
/begin MEASUREMENT VAR_RCF_OfsFlt3800Bwd_f32 "VAR_RCF_OfsFlt3800Bwd_f32" FLOAT32_IEEE BSW_A2L_Ident_Float 1 100 -3.4E+38 3.4E+38 ECU_ADDRESS 0x00000000 /end MEASUREMENT
/begin MEASUREMENT VAR_Bsw_tStrrTemp1_u16 "VAR_Bsw_tStrrTemp1_u16" UWORD BSW_A2L_Ident_Int 1 100 0 65535 ECU_ADDRESS 0x00000000 /end MEASUREMENT
/begin MEASUREMENT VAR_Cspf_TraisCurr_f32 "VAR_Cspf_TraisCurr_f32" FLOAT32_IEEE BSW_A2L_Ident_Float 1 100 -3.4E+38 3.4E+38 ECU_ADDRESS 0x00000000 /end MEASUREMENT
/begin MEASUREMENT VAR_3phPWMUL_Period_f32 "VAR_3phPWMUL_Period_f32" FLOAT32_IEEE BSW_A2L_Ident_Float 1 100 -3.4E+38 3.4E+38 ECU_ADDRESS 0x00000000 /end MEASUREMENT
/begin MEASUREMENT VAR_DEM_Event_Event_NvM_WriteErr_Status_u8 "VAR_DEM_Event_Event_NvM_WriteErr_Status_u8" UBYTE BSW_A2L_Ident_Int 1 100 0 255 ECU_ADDRESS 0x00000000 /end MEASUREMENT
/begin CHARACTERISTIC CAL_Vcf_BwdHoldInSpdLim_f32 "CAL_Vcf_BwdHoldInSpdLim_f32" VALUE 0x00000000 Scalar_FLOAT32_IEEE 0 BSW_A2L_Ident_Float -3.4E+38 3.4E+38 /end CHARACTERISTIC
/begin CHARACTERISTIC CAL_PcfDia_nMotLockedLow_f32 "CAL_PcfDia_nMotLockedLow_f32" VALUE 0x00000000 Scalar_FLOAT32_IEEE 0 BSW_A2L_Ident_Float -3.4E+38 3.4E+38 /end CHARACTERISTIC
/begin MEASUREMENT VAR_Bsw_Wake_b "VAR_Bsw_Wake_b" UBYTE BSW_A2L_Ident_Int 1 100 0 1 ECU_ADDRESS 0x00000000 /end MEASUREMENT
/begin CHARACTERISTIC CAL_TpcTmp_CoolTempMinus_f32 "CAL_TpcTmp_CoolTempMinus_f32" VALUE 0x00000000 Scalar_FLOAT32_IEEE 0 BSW_A2L_Ident_Float -3.4E+38 3.4E+38 /end CHARACTERISTIC
/begin MEASUREMENT VAR_TpcTmp_TDbcVHiLimErrState_u8 "VAR_TpcTmp_TDbcVHiLimErrState_u8" UBYTE BSW_A2L_Ident_Int 1 100 0 255 ECU_ADDRESS 0x00000000 /end MEASUREMENT
/begin MEASUREMENT VAR_RDC_ArctanAgRtr_f32 "VAR_RDC_ArctanAgRtr_f32" FLOAT32_IEEE BSW_A2L_Ident_Float 1 100 -3.4E+38 3.4E+38 ECU_ADDRESS 0x00000000 /end MEASUREMENT
/begin MEASUREMENT VAR_TRSP_RslvSinNRngErr_b "VAR_TRSP_RslvSinNRngErr_b" UBYTE BSW_A2L_Ident_Int 1 100 0 1 ECU_ADDRESS 0x00000000 /end MEASUREMENT
/begin CHARACTERISTIC CAL_DEM_FIM_DFC_IOHWAB_IphaOCFail_au8 "CAL_DEM_FIM_DFC_IOHWAB_IphaOCFail_au8" VAL_BLK 0x00000000 Scalar_UBYTE 0 FID_Verb 0 255 NUMBER 10 /end CHARACTERISTIC
/begin MEASUREMENT VAR_TRSP_WCurrRngErr_b "VAR_TRSP_WCurrRngErr_b" UBYTE BSW_A2L_Ident_Int 1 100 0 1 ECU_ADDRESS 0x00000000 /end MEASUREMENT
/begin CHARACTERISTIC CAL_PcfSig_iSENFltCoe_f32 "CAL_PcfSig_iSENFltCoe_f32" VALUE 0x00000000 Scalar_FLOAT32_IEEE 0 BSW_A2L_Ident_Float -3.4E+38 3.4E+38 /end CHARACTERISTIC
/begin CHARACTERISTIC CAL_TpcBlk_MtrBlkIsFirstSet_f32 "CAL_TpcBlk_MtrBlkIsFirstSet_f32" VALUE 0x00000000 Scalar_FLOAT32_IEEE 0 BSW_A2L_Ident_Float -3.4E+38 3.4E+38 /end CHARACTERISTIC
/begin MEASUREMENT VAR_TCF_TrqCalcMonRslt_b "VAR_TCF_TrqCalcMonRslt_b" UBYTE BSW_A2L_Ident_Int 1 100 0 1 ECU_ADDRESS 0x00000000 /end MEASUREMENT
/begin CHARACTERISTIC CAL_TpcTmp_tDBCTrqLimRamp_f32 "CAL_TpcTmp_tDBCTrqLimRamp_f32" VALUE 0x00000000 Scalar_FLOAT32_IEEE 0 BSW_A2L_Ident_Float -3.4E+38 3.4E+38 /end CHARACTERISTIC
/begin MEASUREMENT VAR_DEM_Event_TPC_TDbcOvLoWarn_Status_u8 "VAR_DEM_Event_TPC_TDbcOvLoWarn_Status_u8" UBYTE BSW_A2L_Ident_Int 1 100 0 255 ECU_ADDRESS 0x00000000 /end MEASUREMENT
/begin MEASUREMENT VAR_MCF_usPeak_f32 "VAR_MCF_usPeak_f32" FLOAT32_IEEE BSW_A2L_Ident_Float 1 100 -3.4E+38 3.4E+38 ECU_ADDRESS 0x00000000 /end MEASUREMENT
/begin CHARACTERISTIC CAL_PcfDia_MinPosOutP_f32 "CAL_PcfDia_MinPosOutP_f32" VALUE 0x00000000 Scalar_FLOAT32_IEEE 0 BSW_A2L_Ident_Float -3.4E+38 3.4E+38 /end CHARACTERISTIC
/begin CHARACTERISTIC CAL_MCF_DownLimitIMotHeat_f32 "CAL_MCF_DownLimitIMotHeat_f32" VALUE 0x00000000 Scalar_FLOAT32_IEEE 0 BSW_A2L_Ident_Float -3.4E+38 3.4E+38 /end CHARACTERISTIC
/begin MEASUREMENT VAR_IoHwAb_Adc_Phy_5V_Qco_f32 "VAR_IoHwAb_Adc_Phy_5V_Qco_f32" FLOAT32_IEEE BSW_A2L_Ident_Float 1 100 -3.4E+38 3.4E+38 ECU_ADDRESS 0x00000000 /end MEASUREMENT
/begin CHARACTERISTIC CAL_RCF_nMaxStartAcc_f32 "CAL_RCF_nMaxStartAcc_f32" VALUE 0x00000000 Scalar_FLOAT32_IEEE 0 BSW_A2L_Ident_Float -3.4E+38 3.4E+38 /end CHARACTERISTIC
/begin MEASUREMENT VAR_IgbtDrv_Level_NFLTA_u8 "VAR_IgbtDrv_Level_NFLTA_u8" UBYTE BSW_A2L_Ident_Int 1 100 0 255 ECU_ADDRESS 0x00000000 /end MEASUREMENT
/begin CHARACTERISTIC CAL_Cspf_TraTrqMax_f32 "CAL_Cspf_TraTrqMax_f32" VALUE 0x00000000 Scalar_FLOAT32_IEEE 0 BSW_A2L_Ident_Float -3.4E+38 3.4E+38 /end CHARACTERISTIC
/begin CHARACTERISTIC CAL_Cspf_flgstDisChgSwt_b "CAL_Cspf_flgstDisChgSwt_b" VALUE 0x00000000 Scalar_BOOLEAN 0 BSW_A2L_Ident_Int 0 1 /end CHARACTERISTIC
/begin MEASUREMENT VAR_tpcsmp_PwrLossGen_f32 "VAR_tpcsmp_PwrLossGen_f32" FLOAT32_IEEE BSW_A2L_Ident_Float 1 100 -3.4E+38 3.4E+38 ECU_ADDRESS 0x00000000 /end MEASUREMENT
/begin MEASUREMENT VAR_Vcf_AsrRatioUnLolim_b "VAR_Vcf_AsrRatioUnLolim_b" UBYTE BSW_A2L_Ident_Int 1 100 0 1 ECU_ADDRESS 0x00000000 /end MEASUREMENT
/begin MEASUREMENT VAR_TpcTmp_CofDertTRiseDbcSave2_f32 "VAR_TpcTmp_CofDertTRiseDbcSave2_f32" FLOAT32_IEEE BSW_A2L_Ident_Float 1 100 -3.4E+38 3.4E+38 ECU_ADDRESS 0x00000000 /end MEASUREMENT
/begin CHARACTERISTIC CAL_DEM_Disbl_DFC_PCF_SelfcheckErr_u8 "CAL_DEM_Disbl_DFC_PCF_SelfcheckErr_u8" VALUE 0x00000000 Scalar_UBYTE 0 BSW_A2L_Ident_Int 0 255 /end CHARACTERISTIC
/begin CHARACTERISTIC CAL_PcfDia_tMosLowSet_f32 "CAL_PcfDia_tMosLowSet_f32" VALUE 0x00000000 Scalar_FLOAT32_IEEE 0 BSW_A2L_Ident_Float -3.4E+38 3.4E+38 /end CHARACTERISTIC
/begin MEASUREMENT VAR_DEM_Event_HSPF_stIphaOffCalFail_Status_u8 "VAR_DEM_Event_HSPF_stIphaOffCalFail_Status_u8" UBYTE BSW_A2L_Ident_Int 1 100 0 255 ECU_ADDRESS 0x00000000 /end MEASUREMENT
/begin CHARACTERISTIC CAL_MCF_flgUseisdqSet_b "CAL_MCF_flgUseisdqSet_b" VALUE 0x00000000 Scalar_BOOLEAN 0 BSW_A2L_Ident_Int 0 1 /end CHARACTERISTIC
/begin CHARACTERISTIC CAL_TRSP_RslvExciErrRst_b "CAL_TRSP_RslvExciErrRst_b" VALUE 0x00000000 Scalar_BOOLEAN 0 BSW_A2L_Ident_Int 0 1 /end CHARACTERISTIC
/begin CHARACTERISTIC CAL_Pwm3ph_AdcTriggleOffset_u16 "CAL_Pwm3ph_AdcTriggleOffset_u16" VALUE 0x00000000 Scalar_UWORD 0 BSW_A2L_Ident_Int 0 65535 /end CHARACTERISTIC
/begin CHARACTERISTIC CAL_MPC_udActCutOffFrq_f32 "CAL_MPC_udActCutOffFrq_f32" VALUE 0x00000000 Scalar_FLOAT32_IEEE 0 BSW_A2L_Ident_Float -3.4E+38 3.4E+38 /end CHARACTERISTIC
/begin MEASUREMENT VAR_MDF_EmacBlkdState_u8 "VAR_MDF_EmacBlkdState_u8" UBYTE BSW_A2L_Ident_Int 1 100 0 255 ECU_ADDRESS 0x00000000 /end MEASUREMENT
/begin MEASUREMENT VAR_MDF_3PhaUnbalanceObs_f32 "VAR_MDF_3PhaUnbalanceObs_f32" FLOAT32_IEEE BSW_A2L_Ident_Float 1 100 -3.4E+38 3.4E+38 ECU_ADDRESS 0x00000000 /end MEASUREMENT
/begin MEASUREMENT VAR_flgRecVCU03_u8 "VAR_flgRecVCU03_u8" UBYTE BSW_A2L_Ident_Int 1 100 0 255 ECU_ADDRESS 0x00000000 /end MEASUREMENT
/begin CHARACTERISTIC CAL_MCF_FlgUseSetDyc_b "CAL_MCF_FlgUseSetDyc_b" VALUE 0x00000000 Scalar_BOOLEAN 0 BSW_A2L_Ident_Int 0 1 /end CHARACTERISTIC
/begin MEASUREMENT VAR_tpccod_flgMinDertTDrvBoard_b "VAR_tpccod_flgMinDertTDrvBoard_b" UBYTE BSW_A2L_Ident_Int 1 100 0 1 ECU_ADDRESS 0x00000000 /end MEASUREMENT
/begin MEASUREMENT VAR_PcfStm_SLActDir_b "VAR_PcfStm_SLActDir_b" UBYTE BSW_A2L_Ident_Int 1 100 0 1 ECU_ADDRESS 0x00000000 /end MEASUREMENT
/begin MEASUREMENT VAR_L2Sampling_RslvSinN_VADC_Max1_u16 "VAR_L2Sampling_RslvSinN_VADC_Max1_u16" UWORD BSW_A2L_Ident_Int 1 100 0 65535 ECU_ADDRESS 0x00000000 /end MEASUREMENT
/begin CHARACTERISTIC CAL_Cspf_bReadyHV_u8 "CAL_Cspf_bReadyHV_u8" VALUE 0x00000000 Scalar_UBYTE 0 BSW_A2L_Ident_Int 0 255 /end CHARACTERISTIC
/begin CHARACTERISTIC CAL_MDF_tOperOutdRngSelState_b "CAL_MDF_tOperOutdRngSelState_b" VALUE 0x00000000 Scalar_BOOLEAN 0 BSW_A2L_Ident_Int 0 1 /end CHARACTERISTIC
/begin MEASUREMENT VAR_TpcTmp_flgTrqLimTcoolantActv_b "VAR_TpcTmp_flgTrqLimTcoolantActv_b" UBYTE BSW_A2L_Ident_Int 1 100 0 1 ECU_ADDRESS 0x00000000 /end MEASUREMENT
/begin MEASUREMENT VAR_MCF_agOffset_f32 "VAR_MCF_agOffset_f32" FLOAT32_IEEE BSW_A2L_Ident_Float 1 100 -3.4E+38 3.4E+38 ECU_ADDRESS 0x00000000 /end MEASUREMENT
/begin MEASUREMENT VAR_PcfDia_flgstallPause_b "VAR_PcfDia_flgstallPause_b" UBYTE BSW_A2L_Ident_Int 1 100 0 1 ECU_ADDRESS 0x00000000 /end MEASUREMENT
/begin CHARACTERISTIC CAL_DEM_FIM_DFC_SCF_RunToDischarErr_au8 "CAL_DEM_FIM_DFC_SCF_RunToDischarErr_au8" VAL_BLK 0x00000000 Scalar_UBYTE 0 FID_Verb 0 255 NUMBER 10 /end CHARACTERISTIC
/begin CHARACTERISTIC CAL_MCF_udkp_f32 "CAL_MCF_udkp_f32" VALUE 0x00000000 Scalar_FLOAT32_IEEE 0 BSW_A2L_Ident_Float -3.4E+38 3.4E+38 /end CHARACTERISTIC
/begin CHARACTERISTIC CAL_PcfDia_UdcMotManSet_f32 "CAL_PcfDia_UdcMotManSet_f32" VALUE 0x00000000 Scalar_FLOAT32_IEEE 0 BSW_A2L_Ident_Float -3.4E+38 3.4E+38 /end CHARACTERISTIC
/begin MEASUREMENT VAR_Scf_flgTranPreDrvToDrv_b "VAR_Scf_flgTranPreDrvToDrv_b" UBYTE BSW_A2L_Ident_Int 1 100 0 1 ECU_ADDRESS 0x00000000 /end MEASUREMENT
/begin MEASUREMENT VAR_TpcMot_tRiseSttrOperationMode_u8 "VAR_TpcMot_tRiseSttrOperationMode_u8" UBYTE BSW_A2L_Ident_Int 1 100 0 255 ECU_ADDRESS 0x00000000 /end MEASUREMENT
/begin MEASUREMENT VAR_TRSP_iSum_f32 "VAR_TRSP_iSum_f32" FLOAT32_IEEE BSW_A2L_Ident_Float 1 100 -3.4E+38 3.4E+38 ECU_ADDRESS 0x00000000 /end MEASUREMENT
/begin CHARACTERISTIC CAL_POWER_UBSBC_Threhold_V6_f32 "CAL_POWER_UBSBC_Threhold_V6_f32" VALUE 0x00000000 Scalar_FLOAT32_IEEE 0 BSW_A2L_Ident_Float -3.4E+38 3.4E+38 /end CHARACTERISTIC
/begin CHARACTERISTIC CAL_TRSP_RslvRngDebTrh_s16 "CAL_TRSP_RslvRngDebTrh_s16" VALUE 0x00000000 Scalar_SWORD 0 BSW_A2L_Ident_Int -32768 32767 /end CHARACTERISTIC
/begin MEASUREMENT VAR_Cspf_TrabDernDrvBoardTemp_u16 "VAR_Cspf_TrabDernDrvBoardTemp_u16" UWORD BSW_A2L_Ident_Int 1 100 0 65535 ECU_ADDRESS 0x00000000 /end MEASUREMENT
/begin CHARACTERISTIC CAL_MCF_DownLimPIZeroCtl_f32 "CAL_MCF_DownLimPIZeroCtl_f32" VALUE 0x00000000 Scalar_FLOAT32_IEEE 0 BSW_A2L_Ident_Float -3.4E+38 3.4E+38 /end CHARACTERISTIC
/begin MEASUREMENT VAR_DSADC_Rdc_Sin_s16 "VAR_DSADC_Rdc_Sin_s16" SWORD BSW_A2L_Ident_Int 1 100 -32768 32767 ECU_ADDRESS 0x00000000 /end MEASUREMENT
/begin CHARACTERISTIC CAL_DEM_Disbl_DFC_MDF_EmacBlkdErr_u8 "CAL_DEM_Disbl_DFC_MDF_EmacBlkdErr_u8" VALUE 0x00000000 Scalar_UBYTE 0 BSW_A2L_Ident_Int 0 255 /end CHARACTERISTIC
/begin MEASUREMENT VAR_PcfStm_flgDiaAutoP_b "VAR_PcfStm_flgDiaAutoP_b" UBYTE BSW_A2L_Ident_Int 1 100 0 1 ECU_ADDRESS 0x00000000 /end MEASUREMENT
/begin MEASUREMENT VAR_Cspf_TraTrqCurr_f32 "VAR_Cspf_TraTrqCurr_f32" FLOAT32_IEEE BSW_A2L_Ident_Float 1 100 -3.4E+38 3.4E+38 ECU_ADDRESS 0x00000000 /end MEASUREMENT
/begin MEASUREMENT VAR_IoHwAb_Adc_Phy_1V3_MCU_f32 "VAR_IoHwAb_Adc_Phy_1V3_MCU_f32" FLOAT32_IEEE BSW_A2L_Ident_Float 1 100 -3.4E+38 3.4E+38 ECU_ADDRESS 0x00000000 /end MEASUREMENT
/begin MEASUREMENT VAR_MCF_UsUseRateDes_f32 "VAR_MCF_UsUseRateDes_f32" FLOAT32_IEEE BSW_A2L_Ident_Float 1 100 -3.4E+38 3.4E+38 ECU_ADDRESS 0x00000000 /end MEASUREMENT
/begin CHARACTERISTIC CAL_DEM_FIM_DFC_Epark_PosMonSampFail_au8 "CAL_DEM_FIM_DFC_Epark_PosMonSampFail_au8" VAL_BLK 0x00000000 Scalar_UBYTE 0 FID_Verb 0 255 NUMBER 10 /end CHARACTERISTIC
/begin CHARACTERISTIC CAL_Hspf_cntIPhCalOffTolCnt_u16 "CAL_Hspf_cntIPhCalOffTolCnt_u16" VALUE 0x00000000 Scalar_UWORD 0 BSW_A2L_Ident_Int 0 65535 /end CHARACTERISTIC
/begin CHARACTERISTIC CAL_Hspf_bt15ChkCntLoLim_s8 "CAL_Hspf_bt15ChkCntLoLim_s8" VALUE 0x00000000 Scalar_BYTE 0 BSW_A2L_Ident_Int -128 127 /end CHARACTERISTIC
/begin MEASUREMENT VAR_RCF_OfsFlt4400Bwd_f32 "VAR_RCF_OfsFlt4400Bwd_f32" FLOAT32_IEEE BSW_A2L_Ident_Float 1 100 -3.4E+38 3.4E+38 ECU_ADDRESS 0x00000000 /end MEASUREMENT
/begin CHARACTERISTIC CAL_DEM_FIM_DFC_TPC_TDbcVHiLimFail_au8 "CAL_DEM_FIM_DFC_TPC_TDbcVHiLimFail_au8" VAL_BLK 0x00000000 Scalar_UBYTE 0 FID_Verb 0 255 NUMBER 10 /end CHARACTERISTIC
/begin CHARACTERISTIC CAL_MDF_nThresAlOfsNoPlauseFaultMax_f32 "CAL_MDF_nThresAlOfsNoPlauseFaultMax_f32" VALUE 0x00000000 Scalar_FLOAT32_IEEE 0 BSW_A2L_Ident_Float -3.4E+38 3.4E+38 /end CHARACTERISTIC
/begin CHARACTERISTIC CAL_MCF_flgUseUsdqSet_b "CAL_MCF_flgUseUsdqSet_b" VALUE 0x00000000 Scalar_BOOLEAN 0 BSW_A2L_Ident_Int 0 1 /end CHARACTERISTIC
/begin CHARACTERISTIC CAL_DEM_Disbl_DFC_RCF_FwlFwdOvTiErr_u8 "CAL_DEM_Disbl_DFC_RCF_FwlFwdOvTiErr_u8" VALUE 0x00000000 Scalar_UBYTE 0 BSW_A2L_Ident_Int 0 255 /end CHARACTERISTIC
/begin CHARACTERISTIC CAL_TpcTmp_CoolChgTempDownDiff_f32 "CAL_TpcTmp_CoolChgTempDownDiff_f32" VALUE 0x00000000 Scalar_FLOAT32_IEEE 0 BSW_A2L_Ident_Float -3.4E+38 3.4E+38 /end CHARACTERISTIC
/begin CHARACTERISTIC CAL_DEM_FIM_DFC_TPC_TIGBTOvLoWarn_au8 "CAL_DEM_FIM_DFC_TPC_TIGBTOvLoWarn_au8" VAL_BLK 0x00000000 Scalar_UBYTE 0 FID_Verb 0 255 NUMBER 10 /end CHARACTERISTIC
/begin CHARACTERISTIC CAL_PcfStm_SLRunTimesLimt_u8 "CAL_PcfStm_SLRunTimesLimt_u8" VALUE 0x00000000 Scalar_UBYTE 0 BSW_A2L_Ident_Int 0 255 /end CHARACTERISTIC
/begin MEASUREMENT VAR_TRSP_1V8CPLDVoltRngErr_b "VAR_TRSP_1V8CPLDVoltRngErr_b" UBYTE BSW_A2L_Ident_Int 1 100 0 1 ECU_ADDRESS 0x00000000 /end MEASUREMENT
/begin CHARACTERISTIC CAL_VADC_RDC_ISR_offset_u16 "CAL_VADC_RDC_ISR_offset_u16" VALUE 0x00000000 Scalar_UWORD 0 BSW_A2L_Ident_Int 0 65535 /end CHARACTERISTIC
/begin CHARACTERISTIC CAL_FRP_UintndTrqErrOutCtl_b "CAL_FRP_UintndTrqErrOutCtl_b" VALUE 0x00000000 Scalar_BOOLEAN 0 BSW_A2L_Ident_Int 0 1 /end CHARACTERISTIC
/begin CHARACTERISTIC CAL_DEM_Clear_DTC_Flag_u8 "CAL_DEM_Clear_DTC_Flag_u8" VALUE 0x00000000 Scalar_UBYTE 0 BSW_A2L_Ident_Int 0 255 /end CHARACTERISTIC
/begin CHARACTERISTIC CAL_TpcTmp_tDbcTempWLoLim_f32 "CAL_TpcTmp_tDbcTempWLoLim_f32" VALUE 0x00000000 Scalar_FLOAT32_IEEE 0 BSW_A2L_Ident_Float -3.4E+38 3.4E+38 /end CHARACTERISTIC
/begin MEASUREMENT VAR_TpcMot_tSttrTempFlt_f32 "VAR_TpcMot_tSttrTempFlt_f32" FLOAT32_IEEE BSW_A2L_Ident_Float 1 100 -3.4E+38 3.4E+38 ECU_ADDRESS 0x00000000 /end MEASUREMENT
/begin MEASUREMENT VAR_PcfStm_enMos_b "VAR_PcfStm_enMos_b" UBYTE BSW_A2L_Ident_Int 1 100 0 1 ECU_ADDRESS 0x00000000 /end MEASUREMENT
/begin CHARACTERISTIC CAL_DEM_FIM_DFC_PCF_SelfcheckErr_au8 "CAL_DEM_FIM_DFC_PCF_SelfcheckErr_au8" VAL_BLK 0x00000000 Scalar_UBYTE 0 FID_Verb 0 255 NUMBER 10 /end CHARACTERISTIC
/begin CHARACTERISTIC CAL_PcfDia_nMotLockedLowHyst_f32 "CAL_PcfDia_nMotLockedLowHyst_f32" VALUE 0x00000000 Scalar_FLOAT32_IEEE 0 BSW_A2L_Ident_Float -3.4E+38 3.4E+38 /end CHARACTERISTIC
/begin CHARACTERISTIC CAL_MPC_Rs_f32 "CAL_MPC_Rs_f32" VALUE 0x00000000 Scalar_FLOAT32_IEEE 0 BSW_A2L_Ident_Float -3.4E+38 3.4E+38 /end CHARACTERISTIC
/begin MEASUREMENT VAR_TRSP_RslvSensVoltRngChkRslt_b "VAR_TRSP_RslvSensVoltRngChkRslt_b" UBYTE BSW_A2L_Ident_Int 1 100 0 1 ECU_ADDRESS 0x00000000 /end MEASUREMENT
/begin CHARACTERISTIC CAL_Cspf_flgbDernCoolantTempSwt_b "CAL_Cspf_flgbDernCoolantTempSwt_b" VALUE 0x00000000 Scalar_BOOLEAN 0 BSW_A2L_Ident_Int 0 1 /end CHARACTERISTIC
/begin COMPU_METHOD RTE_A2L_Ident_Float "Q = V" RAT_FUNC "%8.6" "" COEFFS 0 1 0 0 0 1 /end COMPU_METHOD
/begin COMPU_METHOD BSW_A2L_Ident_Float "Q = V" RAT_FUNC "%8.6" "" COEFFS 0 1 0 0 0 1 /end COMPU_METHOD
/begin COMPU_METHOD BSW_A2L_Ident_Int "Q = V" RAT_FUNC "%8.0" "" COEFFS 0 1 0 0 0 1 /end COMPU_METHOD
/begin COMPU_METHOD DFC_Verb "" TAB_VERB " % 2.1" " - " COMPU_TAB_REF DFC_LIST /end COMPU_METHOD
/begin COMPU_VTAB DFC_LIST "" TAB_VERB 127 1 "ADC_UPhaseBISTFail" 2 "ADC_VPhaseBISTFail" 3 "ADC_WPhaseBISTFail" 4 "CANSM_E_BUS_OFF_NETWORK_0" 5 "CANSM_E_BUS_OFF_NETWORK_1" 6 "Can_Timeout" 7 "Cpld_AliveChkErr" 8 "Cpld_DI_ExdClk_InFail" 9 "Cpld_ExdClkInFail" 10 "Cpld_IphaOC" 11 "Cpld_NEN_InFail" 12 "Cpld_ParityChkErr" 13 "Cpld_Rx_SelfTest_Fail" 14 "Cpld_SPIComFail" 15 "Cpld_SZTKT_InFail" 16 "Cpld_Short_Circuit_HS_InFail" 17 "Cpld_Short_Circuit_LS_InFail" 18 "Cpld_UdcOverVolFail" 19 "Cpld_UnderVol_HS_InFail" 20 "Cpld_UnderVol_LS_InFail" 21 "Epark_OverCurFail" 22 "Epark_PosMonSampFail" 23 "Epark_PosSampFail" 24 "Epark_SampFail" 25 "Event_NvM_ReadErr" 26 "Event_NvM_WriteErr" 27 "FR_StorageErr" 28 "HSPF_InvOpenErr" 29 "HSPF_MotorOpenErr" 30 "HSPF_VerMatchFailureErr" 31 "HSPF_stIphaOffCalFail" 32 "HSPF_tDBCTempCmpErr" 33 "HvMcu_ComErr" 34 "HvMcu_DisChrgDutyErr" 35 "HvMcu_DisChrgFail" 36 "HvMcu_DisChrgFreqErr" 37 "HvMcu_EmerPowerSapErr" 38 "HvMcu_UartCheckFailErr" 39 "HvMcu_UartLostFrameErr" 40 "HvMcu_UdcCheckErr" 41 "HvMcu_UdcOverFlagLimit" 42 "HvMcu_UdcOverVolErr" 43 "IOHWAB_12VNarrSampErr" 44 "IOHWAB_12VSampErr" 45 "IOHWAB_12VWideSampErr" 46 "IOHWAB_18VLwBrgSampFail" 47 "IOHWAB_18VUpBrgSampFail" 48 "IOHWAB_1V3MCU_SampFail" 49 "IOHWAB_3V3MCU_SampFail" 50 "IOHWAB_5VQcoSampFail" 51 "IOHWAB_5VQt1SampFail" 52 "IOHWAB_5VQt2SampFail" 53 "IOHWAB_Cpld1v8SampFail" 54 "IOHWAB_Cpld3v3SampFail" 55 "IOHWAB_CrashFail" 56 "IOHWAB_DcLnkOverVolFail" 57 "IOHWAB_IphaOCFail" 58 "IOHWAB_KL30OverVolErr" 59 "IOHWAB_KL30SevOverVolFail" 60 "IOHWAB_KL30SevUnderVolFail" 61 "IOHWAB_KL30UnderVolErr" 62 "IOHWAB_Nen33Fail" 63 "IOHWAB_SttrSenorShrFail" 64 "IOHWAB_SttrTemp1SampFail" 65 "IOHWAB_SttrTemp2SampFail" 66 "IOHWAB_TCoolantSampFail" 67 "IOHWAB_VDD5_D_SampFail" 68 "IgbtDrv_ComErr" 69 "IgbtDrv_LwBrgFaultAFail" 70 "IgbtDrv_LwBrgFaultBFail" 71 "IgbtDrv_UpBrgFaultAFail" 72 "IgbtDrv_UpBrgFaultBFail" 73 "MDF_AlOfsNoPlausErr" 74 "MDF_DiashCirNoPsblErr" 75 "MDF_EmacBlkdErr" 76 "MDF_EmacBlkdWarn" 77 "MDF_ICtlRatErr" 78 "MDF_IsOvHiErr" 79 "MDF_OpenCirNoPsblErr" 80 "MDF_OperOutdRngErr" 81 "MDF_PhaseLossFaultErr" 82 "MDF_PrfElDrvErr" 83 "PCF_ActOvTiErr" 84 "PCF_IdcOvErr" 85 "PCF_SelfcheckErr" 86 "PCF_SenClbErr" 87 "PCF_SenOvErr" 88 "PCF_StallRetryErr" 89 "PCF_StallWarn" 90 "PCF_UnexpPosErr" 91 "RCF_AccOvTiErr" 92 "RCF_EstOfsErr" 93 "RCF_FwlBwdOvTiErr" 94 "RCF_FwlFwdOvTiErr" 95 "RCF_OfsClbFail" 96 "RCF_PsiOvErr" 97 "RSL_DOSErr" 98 "RSL_ExcErr" 99 "RSL_LOSErr" 100 "RSL_LOTErr" 101 "SCF_DisChgOvTiFail" 102 "SCF_LowPwrShtDwnOvTiFail" 103 "SCF_RunToDischarErr" 104 "TPC_SpdOvHiLimFail" 105 "TPC_SpdOvHiWarn" 106 "TPC_TCoolantOvHiWarn" 107 "TPC_TDbcOvHiWarn" 108 "TPC_TDbcOvLoWarn" 109 "TPC_TDbcUHiLimFail" 110 "TPC_TDbcULoLimFail" 111 "TPC_TDbcVHiLimFail" 112 "TPC_TDbcVLoLimFail" 113 "TPC_TDbcWHiLimFail" 114 "TPC_TDbcWLoLimFail" 115 "TPC_TDrvBoardOvHiWarn" 116 "TPC_TIGBTOvHiLimErr" 117 "TPC_TIGBTOvHiWarn" 118 "TPC_TIGBTOvLoWarn" 119 "TPC_TSttrOvHiLimFail" 120 "TPC_TSttrOvHiWarn" 121 "TPC_TSttrOvLoWarn" 122 "TPC_iDcLnkOvCLimFail" 123 "TPC_iDcLnkOvcWarn" 124 "TPC_uDcLnkOvVLimFail" 125 "TPC_uDcLnkOvWarn" 126 "TPC_uDcLnkUnVLimFail" 127 "TPC_uDcLnkUnvWarn" DEFAULT_VALUE "---" /end COMPU_VTAB
/begin COMPU_METHOD FID_Verb "" TAB_VERB " % 2.1" " - " COMPU_TAB_REF FID_LIST /end COMPU_METHOD
/begin COMPU_VTAB FID_LIST "" TAB_VERB 162 1 "FIM_ADC_UPhaseBISTFail" 2 "FIM_ADC_VPhaseBISTFail" 3 "FIM_ADC_WPhaseBISTFail" 4 "FIM_CANSM_E_BUS_OFF_NETWORK_0" 5 "FIM_Can_Timeout" 6 "FIM_CpldErr" 7 "FIM_Cpld_AliveChkErr" 8 "FIM_Cpld_DI_ExdClk_InFail" 9 "FIM_Cpld_ExdClkInFail" 10 "FIM_Cpld_IphaOC" 11 "FIM_Cpld_NEN_InFail" 12 "FIM_Cpld_ParityChkErr" 13 "FIM_Cpld_SPIComFail" 14 "FIM_Cpld_SZTKT_InFail" 15 "FIM_Cpld_Short_Circuit_HS_InFail" 16 "FIM_Cpld_Short_Circuit_LS_InFail" 17 "FIM_Cpld_UdcOverVolFail" 18 "FIM_Cpld_UnderVol_HS_InFail" 19 "FIM_Cpld_UnderVol_LS_InFail" 20 "FIM_Epark_OverCurFail" 21 "FIM_Epark_PosMonSampFail" 22 "FIM_Epark_PosSampFail" 23 "FIM_Epark_SampFail" 24 "FIM_Event_NvM_ReadErr" 25 "FIM_Event_NvM_WriteErr" 26 "FIM_FRStoErr" 27 "FIM_FR_StorageErr" 28 "FIM_HSPF_InvOpenErr" 29 "FIM_HSPF_MotorOpenErr" 30 "FIM_HSPF_VerMatchFailureErr" 31 "FIM_HSPF_stIphaOffCalFail" 32 "FIM_HSPF_tDBCTempCmpErr" 33 "FIM_HvMcu_ComErr" 34 "FIM_HvMcu_DisChrgDutyErr" 35 "FIM_HvMcu_DisChrgFail" 36 "FIM_HvMcu_DisChrgFreqErr" 37 "FIM_HvMcu_EmerPowerSapErr" 38 "FIM_HvMcu_UartCheckFailErr" 39 "FIM_HvMcu_UartLostFrameErr" 40 "FIM_HvMcu_UdcCheckErr" 41 "FIM_HvMcu_UdcOverVolErr" 42 "FIM_HvmcuErr" 43 "FIM_IGBTOvTempErr" 44 "FIM_IGBTOvTempWarn" 45 "FIM_IOHWAB_12VNarrSampErr" 46 "FIM_IOHWAB_12VSampErr" 47 "FIM_IOHWAB_12VWideSampErr" 48 "FIM_IOHWAB_18VLwBrgSampFail" 49 "FIM_IOHWAB_18VUpBrgSampFail" 50 "FIM_IOHWAB_1V3MCU_SampFail" 51 "FIM_IOHWAB_3V3MCU_SampFail" 52 "FIM_IOHWAB_5VQcoSampFail" 53 "FIM_IOHWAB_5VQt1SampFail" 54 "FIM_IOHWAB_5VQt2SampFail" 55 "FIM_IOHWAB_Cpld1v8SampFail" 56 "FIM_IOHWAB_Cpld3v3SampFail" 57 "FIM_IOHWAB_CrashFail" 58 "FIM_IOHWAB_DcLnkOverVolFail" 59 "FIM_IOHWAB_IphaOCFail" 60 "FIM_IOHWAB_KL30OverVolErr" 61 "FIM_IOHWAB_KL30SevOverVolFail" 62 "FIM_IOHWAB_KL30SevUnderVolFail" 63 "FIM_IOHWAB_KL30UnderVolErr" 64 "FIM_IOHWAB_Nen33Fail" 65 "FIM_IOHWAB_SttrSenorShrFail" 66 "FIM_IOHWAB_SttrTemp1SampFail" 67 "FIM_IOHWAB_SttrTemp2SampFail" 68 "FIM_IOHWAB_TCoolantSampFail" 69 "FIM_IOHWAB_VDD5_D_SampFail" 70 "FIM_IgbtDrvErr" 71 "FIM_IgbtDrv_ComErr" 72 "FIM_IgbtDrv_LwBrgFaultAFail" 73 "FIM_IgbtDrv_LwBrgFaultBFail" 74 "FIM_IgbtDrv_UpBrgFaultAFail" 75 "FIM_IgbtDrv_UpBrgFaultBFail" 76 "FIM_IohwabSampErr" 77 "FIM_Lamp" 78 "FIM_LowPowerOvVErr" 79 "FIM_LowPowerUnVErr" 80 "FIM_MDF_AlOfsNoPlausErr" 81 "FIM_MDF_DiashCirNoPsblErr" 82 "FIM_MDF_EmacBlkdErr" 83 "FIM_MDF_EmacBlkdWarn" 84 "FIM_MDF_ICtlRatErr" 85 "FIM_MDF_IsOvHiErr" 86 "FIM_MDF_OpenCirNoPsblErr" 87 "FIM_MDF_OperOutdRngErr" 88 "FIM_MDF_PhaseLossFaultErr" 89 "FIM_MDF_PrfElDrvErr" 90 "FIM_MtrOvTempErr" 91 "FIM_MtrOvTempWarn" 92 "FIM_PCF_ActOvTiErr" 93 "FIM_PCF_IdcOvErr" 94 "FIM_PCF_SelfcheckErr" 95 "FIM_PCF_SenClbErr" 96 "FIM_PCF_SenOvErr" 97 "FIM_PCF_StallRetryErr" 98 "FIM_PCF_StallWarn" 99 "FIM_PCF_UnexpPosErr" 100 "FIM_PwrLimLvFour" 101 "FIM_PwrLimLvOne" 102 "FIM_PwrLimLvThree" 103 "FIM_PwrLimLvTwo" 104 "FIM_RCF_AccOvTiErr" 105 "FIM_RCF_EstOfsErr" 106 "FIM_RCF_FwlBwdOvTiErr" 107 "FIM_RCF_FwlFwdOvTiErr" 108 "FIM_RCF_OfsClbFail" 109 "FIM_RCF_PsiOvErr" 110 "FIM_RSL_DOSErr" 111 "FIM_RSL_ExcErr" 112 "FIM_RSL_LOSErr" 113 "FIM_RSL_LOTErr" 114 "FIM_ReqFailrMod" 115 "FIM_RslvOpen" 116 "FIM_SCF_DisChgOvTiFail" 117 "FIM_SCF_LowPwrShtDwnOvTiFail" 118 "FIM_SCF_RunToDischarErr" 119 "FIM_SpdOvHiErr" 120 "FIM_SpdOvHiWarn" 121 "FIM_Sttr1Err" 122 "FIM_Sttr2Err" 123 "FIM_TPC_SpdOvHiLimFail" 124 "FIM_TPC_SpdOvHiWarn" 125 "FIM_TPC_TCoolantOvHiWarn" 126 "FIM_TPC_TDbcOvHiWarn" 127 "FIM_TPC_TDbcOvLoWarn" 128 "FIM_TPC_TDbcUHiLimFail" 129 "FIM_TPC_TDbcULoLimFail" 130 "FIM_TPC_TDbcVHiLimFail" 131 "FIM_TPC_TDbcVLoLimFail" 132 "FIM_TPC_TDbcWHiLimFail" 133 "FIM_TPC_TDbcWLoLimFail" 134 "FIM_TPC_TDrvBoardOvHiWarn" 135 "FIM_TPC_TIGBTOvHiLimErr" 136 "FIM_TPC_TIGBTOvHiWarn" 137 "FIM_TPC_TIGBTOvLoWarn" 138 "FIM_TPC_TSttrOvHiLimFail" 139 "FIM_TPC_TSttrOvHiWarn" 140 "FIM_TPC_TSttrOvLoWarn" 141 "FIM_TPC_iDcLnkOvCLimFail" 142 "FIM_TPC_iDcLnkOvcWarn" 143 "FIM_TPC_uDcLnkOvVLimFail" 144 "FIM_TPC_uDcLnkOvWarn" 145 "FIM_TPC_uDcLnkUnVLimFail" 146 "FIM_TPC_uDcLnkUnvWarn" 147 "FIM_TrqLimLvFour" 148 "FIM_TrqLimLvOne" 149 "FIM_TrqLimLvThree" 150 "FIM_TrqLimLvTwo" 151 "FIM_Unused" 152 "FIM_VCUComTimeOut" 153 "FIM_flgDchaFailr" 154 "FIM_flgFaultLvFive" 155 "FIM_flgFaultLvFour" 156 "FIM_iDcLnkOvcErr" 157 "FIM_iDcLnkOvcWarn" 158 "FIM_uDcLnkOvErr" 159 "FIM_uDcLnkOvWarn" 160 "FIM_uDcLnkUnvErr" 161 "FIM_uDcLnkUnvWarn" 162 "FiM_FlagforFR" DEFAULT_VALUE "---" /end COMPU_VTAB
/end MODULE
/end PROJECT
