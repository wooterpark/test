/******************************************************************************
* ASAP2 file: a2ltoolkit.a2l
******************************************************************************/
/* Version 1.31 */
ASAP2_VERSION 1 31
/begin PROJECT ProjectName "A2LTOOLKIT_A2L"
/begin HEADER "A2LTOOLKIT_A2L" /end HEADER
/begin MODULE ModuleName "A2LTOOLKIT_A2L"
/begin MOD_PAR "A2LTOOLKIT_A2L" /end MOD_PAR
/begin MOD_COMMON "A2LTOOLKIT_A2L" BYTE_ORDER MSB_LAST /end MOD_COMMON
/begin RECORD_LAYOUT Scalar_BOOLEAN FNC_VALUES 1 UBYTE COLUMN_DIR DIRECT /end RECORD_LAYOUT
/begin RECORD_LAYOUT Scalar_UBYTE FNC_VALUES 1 UBYTE COLUMN_DIR DIRECT /end RECORD_LAYOUT
/begin RECORD_LAYOUT Scalar_BYTE FNC_VALUES 1 SBYTE COLUMN_DIR DIRECT /end RECORD_LAYOUT
/begin RECORD_LAYOUT Scalar_UWORD FNC_VALUES 1 UWORD COLUMN_DIR DIRECT /end RECORD_LAYOUT
/begin RECORD_LAYOUT Scalar_SWORD FNC_VALUES 1 SWORD COLUMN_DIR DIRECT /end RECORD_LAYOUT
/begin RECORD_LAYOUT Scalar_ULONG FNC_VALUES 1 ULONG COLUMN_DIR DIRECT /end RECORD_LAYOUT
/begin RECORD_LAYOUT Scalar_FLOAT32_IEEE FNC_VALUES 1 FLOAT32_IEEE COLUMN_DIR DIRECT /end RECORD_LAYOUT
/begin RECORD_LAYOUT Scalar_FLOAT64_IEEE FNC_VALUES 1 FLOAT64_IEEE COLUMN_DIR DIRECT /end RECORD_LAYOUT
/begin MEASUREMENT VAR_Cpld_Rx_Analys_u32 "VAR_Cpld_Rx_Analys_u32" ULONG BSW_A2L_Ident_Int 1 100 0 4294967295 ECU_ADDRESS 0x00000000 /end MEASUREMENT
/begin MEASUREMENT VAR_Cpld_State_Fault_Debounce_u8 "VAR_Cpld_State_Fault_Debounce_u8" UBYTE BSW_A2L_Ident_Int 1 100 0 255 ECU_ADDRESS 0x00000000 /end MEASUREMENT
/begin MEASUREMENT VAR_AdcInitSBC_u16 "VAR_AdcInitSBC_u16" UWORD BSW_A2L_Ident_Int 1 100 0 65535 ECU_ADDRESS 0x00000000 /end MEASUREMENT
/begin MEASUREMENT VAR_AdcInitSBC_Res_u16 "VAR_AdcInitSBC_Res_u16" UWORD BSW_A2L_Ident_Int 1 100 0 65535 ECU_ADDRESS 0x00000000 /end MEASUREMENT
/begin MEASUREMENT VAR_AdcInitSBC_f32 "VAR_AdcInitSBC_f32" FLOAT32_IEEE BSW_A2L_Ident_Float 1 100 -3.4E+38 3.4E+38 ECU_ADDRESS 0x00000000 /end MEASUREMENT
/begin MEASUREMENT VAR_SS1_OC_u8 "VAR_SS1_OC_u8" UBYTE BSW_A2L_Ident_Int 1 100 0 255 ECU_ADDRESS 0x00000000 /end MEASUREMENT
/begin MEASUREMENT VAR_Pwm_Fault_Flag_u16 "VAR_Pwm_Fault_Flag_u16" UWORD BSW_A2L_Ident_Int 1 100 0 65535 ECU_ADDRESS 0x00000000 /end MEASUREMENT
/begin MEASUREMENT VAR_IgbtDrv_Det_ReportError_u8 "VAR_IgbtDrv_Det_ReportError_u8" UBYTE BSW_A2L_Ident_Int 1 100 0 255 ECU_ADDRESS 0x00000000 /end MEASUREMENT
/begin MEASUREMENT VAR_PcfDia_flgFault_b "VAR_PcfDia_flgFault_b" UBYTE BSW_A2L_Ident_Int 1 100 0 1 ECU_ADDRESS 0x00000000 /end MEASUREMENT
/begin CHARACTERISTIC CAL_MPC_IsCutOffFrq_f32 "CAL_MPC_IsCutOffFrq_f32" VALUE 0x00000000 Scalar_FLOAT32_IEEE 0 BSW_A2L_Ident_Float -3.4E+38 3.4E+38 /end CHARACTERISTIC
/begin MEASUREMENT VAR_DEM_Event_IOHWAB_12VSampErr_Status_u8 "VAR_DEM_Event_IOHWAB_12VSampErr_Status_u8" UBYTE BSW_A2L_Ident_Int 1 100 0 255 ECU_ADDRESS 0x00000000 /end MEASUREMENT
/begin MEASUREMENT VAR_RCF_stEstAlRtrOfs_u8 "VAR_RCF_stEstAlRtrOfs_u8" UBYTE BSW_A2L_Ident_Int 1 100 0 255 ECU_ADDRESS 0x00000000 /end MEASUREMENT
/begin MEASUREMENT VAR_RCF_flgWaitToAcc_b "VAR_RCF_flgWaitToAcc_b" UBYTE BSW_A2L_Ident_Int 1 100 0 1 ECU_ADDRESS 0x00000000 /end MEASUREMENT
/begin MEASUREMENT VAR_Scf_flgTranPreDrvToFault_b "VAR_Scf_flgTranPreDrvToFault_b" UBYTE BSW_A2L_Ident_Int 1 100 0 1 ECU_ADDRESS 0x00000000 /end MEASUREMENT
/begin CHARACTERISTIC CAL_PcfCtl_flgManual_b "CAL_PcfCtl_flgManual_b" VALUE 0x00000000 Scalar_BOOLEAN 0 BSW_A2L_Ident_Int 0 1 /end CHARACTERISTIC
/begin CHARACTERISTIC CAL_DEM_FIM_DFC_RSL_LOSErr_au8 "CAL_DEM_FIM_DFC_RSL_LOSErr_au8" VAL_BLK 0x00000000 Scalar_UBYTE 0 FID_Verb 0 255 NUMBER 10 /end CHARACTERISTIC
/begin MEASUREMENT VAR_Cspf_TraFailCode6_u8 "VAR_Cspf_TraFailCode6_u8" UBYTE BSW_A2L_Ident_Int 1 100 0 255 ECU_ADDRESS 0x00000000 /end MEASUREMENT
/begin CHARACTERISTIC CAL_DEM_Disbl_DFC_PCF_ActOvTiErr_u8 "CAL_DEM_Disbl_DFC_PCF_ActOvTiErr_u8" VALUE 0x00000000 Scalar_UBYTE 0 BSW_A2L_Ident_Int 0 255 /end CHARACTERISTIC
/begin CHARACTERISTIC CAL_Cspf_UdcMin_f32 "CAL_Cspf_UdcMin_f32" VALUE 0x00000000 Scalar_FLOAT32_IEEE 0 BSW_A2L_Ident_Float -3.4E+38 3.4E+38 /end CHARACTERISTIC
/begin CHARACTERISTIC CAL_MCF_uDclnkSet_f32 "CAL_MCF_uDclnkSet_f32" VALUE 0x00000000 Scalar_FLOAT32_IEEE 0 BSW_A2L_Ident_Float -3.4E+38 3.4E+38 /end CHARACTERISTIC
/begin MEASUREMENT VAR_NvM_AngAutoClbOffset_f32 "VAR_NvM_AngAutoClbOffset_f32" FLOAT32_IEEE BSW_A2L_Ident_Float 1 100 -3.4E+38 3.4E+38 ECU_ADDRESS 0x00000000 /end MEASUREMENT
/begin CHARACTERISTIC CAL_DEM_Disbl_DFC_HvMcu_DisChrgFreqErr_u8 "CAL_DEM_Disbl_DFC_HvMcu_DisChrgFreqErr_u8" VALUE 0x00000000 Scalar_UBYTE 0 BSW_A2L_Ident_Int 0 255 /end CHARACTERISTIC
/begin MEASUREMENT VAR_RCF_OfsFlt4000Bwd_f32 "VAR_RCF_OfsFlt4000Bwd_f32" FLOAT32_IEEE BSW_A2L_Ident_Float 1 100 -3.4E+38 3.4E+38 ECU_ADDRESS 0x00000000 /end MEASUREMENT
/begin CHARACTERISTIC CAL_TRSP_RslvRngCosPHiLim_u16 "CAL_TRSP_RslvRngCosPHiLim_u16" VALUE 0x00000000 Scalar_UWORD 0 BSW_A2L_Ident_Int 0 65535 /end CHARACTERISTIC
/begin CHARACTERISTIC CAL_RCF_nCalcSec4_f32 "CAL_RCF_nCalcSec4_f32" VALUE 0x00000000 Scalar_FLOAT32_IEEE 0 BSW_A2L_Ident_Float -3.4E+38 3.4E+38 /end CHARACTERISTIC
/begin CHARACTERISTIC CAL_TpcSmp_CurtModeSelc_b "CAL_TpcSmp_CurtModeSelc_b" VALUE 0x00000000 Scalar_BOOLEAN 0 BSW_A2L_Ident_Int 0 1 /end CHARACTERISTIC
/begin MEASUREMENT VAR_Hspf_tDrvBoardTemp_f32 "VAR_Hspf_tDrvBoardTemp_f32" FLOAT32_IEEE BSW_A2L_Ident_Float 1 100 -3.4E+38 3.4E+38 ECU_ADDRESS 0x00000000 /end MEASUREMENT
/begin MEASUREMENT VAR_TCF_CurrAgTrqTubeL1_f32 "VAR_TCF_CurrAgTrqTubeL1_f32" FLOAT32_IEEE BSW_A2L_Ident_Float 1 100 -3.4E+38 3.4E+38 ECU_ADDRESS 0x00000000 /end MEASUREMENT
/begin CHARACTERISTIC CAL_TpcTmp_DBCRiseTempMinus_f32 "CAL_TpcTmp_DBCRiseTempMinus_f32" VALUE 0x00000000 Scalar_FLOAT32_IEEE 0 BSW_A2L_Ident_Float -3.4E+38 3.4E+38 /end CHARACTERISTIC
/begin CHARACTERISTIC CAL_DEM_Disbl_DFC_Cpld_IphaOC_u8 "CAL_DEM_Disbl_DFC_Cpld_IphaOC_u8" VALUE 0x00000000 Scalar_UBYTE 0 BSW_A2L_Ident_Int 0 255 /end CHARACTERISTIC
/begin CHARACTERISTIC CAL_MCF_DeltaPower_f32 "CAL_MCF_DeltaPower_f32" VALUE 0x00000000 Scalar_FLOAT32_IEEE 0 BSW_A2L_Ident_Float -3.4E+38 3.4E+38 /end CHARACTERISTIC
/begin MEASUREMENT VAR_tpccod_flgMinDertStrTemp_b "VAR_tpccod_flgMinDertStrTemp_b" UBYTE BSW_A2L_Ident_Int 1 100 0 1 ECU_ADDRESS 0x00000000 /end MEASUREMENT
/begin MEASUREMENT VAR_TRSP_UBRWIDE_f32 "VAR_TRSP_UBRWIDE_f32" FLOAT32_IEEE BSW_A2L_Ident_Float 1 100 -3.4E+38 3.4E+38 ECU_ADDRESS 0x00000000 /end MEASUREMENT
/begin CHARACTERISTIC CAL_DEM_Disbl_DFC_ADC_UPhaseBISTFail_u8 "CAL_DEM_Disbl_DFC_ADC_UPhaseBISTFail_u8" VALUE 0x00000000 Scalar_UBYTE 0 BSW_A2L_Ident_Int 0 255 /end CHARACTERISTIC
/begin MEASUREMENT VAR_PcfDia_flgNPCActPos_b "VAR_PcfDia_flgNPCActPos_b" UBYTE BSW_A2L_Ident_Int 1 100 0 1 ECU_ADDRESS 0x00000000 /end MEASUREMENT
/begin CHARACTERISTIC CAL_TpcSmp_flgUsePwrLossGen_b "CAL_TpcSmp_flgUsePwrLossGen_b" VALUE 0x00000000 Scalar_BOOLEAN 0 BSW_A2L_Ident_Int 0 1 /end CHARACTERISTIC
/begin CHARACTERISTIC CAL_PcfSig_flgP_b "CAL_PcfSig_flgP_b" VALUE 0x00000000 Scalar_BOOLEAN 0 BSW_A2L_Ident_Int 0 1 /end CHARACTERISTIC
/begin CHARACTERISTIC CAL_Tpcmot_TrqDiffExc_f32 "CAL_Tpcmot_TrqDiffExc_f32" VALUE 0x00000000 Scalar_FLOAT32_IEEE 0 BSW_A2L_Ident_Float -3.4E+38 3.4E+38 /end CHARACTERISTIC
/begin MEASUREMENT VAR_Vcf_TrqDmp_f32 "VAR_Vcf_TrqDmp_f32" FLOAT32_IEEE BSW_A2L_Ident_Float 1 100 -3.4E+38 3.4E+38 ECU_ADDRESS 0x00000000 /end MEASUREMENT
/begin CHARACTERISTIC CAL_RCF_AlRtrOfsDvtMax_f32 "CAL_RCF_AlRtrOfsDvtMax_f32" VALUE 0x00000000 Scalar_FLOAT32_IEEE 0 BSW_A2L_Ident_Float -3.4E+38 3.4E+38 /end CHARACTERISTIC
/begin MEASUREMENT VAR_MCF_MPC_Ld_f32 "VAR_MCF_MPC_Ld_f32" FLOAT32_IEEE BSW_A2L_Ident_Float 1 100 -3.4E+38 3.4E+38 ECU_ADDRESS 0x00000000 /end MEASUREMENT
/begin MEASUREMENT VAR_TpcSmp_ElecPwrAlowMax_f32 "VAR_TpcSmp_ElecPwrAlowMax_f32" FLOAT32_IEEE BSW_A2L_Ident_Float 1 100 -3.4E+38 3.4E+38 ECU_ADDRESS 0x00000000 /end MEASUREMENT
/begin CHARACTERISTIC CAL_Cspf_flgtDBCTempWFltSwt_b "CAL_Cspf_flgtDBCTempWFltSwt_b" VALUE 0x00000000 Scalar_BOOLEAN 0 BSW_A2L_Ident_Int 0 1 /end CHARACTERISTIC
/begin CHARACTERISTIC CAL_Cspf_flgTrqMaxNCtLSwt_b "CAL_Cspf_flgTrqMaxNCtLSwt_b" VALUE 0x00000000 Scalar_BOOLEAN 0 BSW_A2L_Ident_Int 0 1 /end CHARACTERISTIC
/begin CHARACTERISTIC CAL_DEM_FIM_DFC_HSPF_MotorOpenErr_au8 "CAL_DEM_FIM_DFC_HSPF_MotorOpenErr_au8" VAL_BLK 0x00000000 Scalar_UBYTE 0 FID_Verb 0 255 NUMBER 10 /end CHARACTERISTIC
/begin CHARACTERISTIC CAL_Vcf_FwdHoldOutSpdLim_f32 "CAL_Vcf_FwdHoldOutSpdLim_f32" VALUE 0x00000000 Scalar_FLOAT32_IEEE 0 BSW_A2L_Ident_Float -3.4E+38 3.4E+38 /end CHARACTERISTIC
/begin CHARACTERISTIC CAL_RCF_nOfsClbMaxBwd_f32 "CAL_RCF_nOfsClbMaxBwd_f32" VALUE 0x00000000 Scalar_FLOAT32_IEEE 0 BSW_A2L_Ident_Float -3.4E+38 3.4E+38 /end CHARACTERISTIC
/begin MEASUREMENT VAR_tpcsmp_KiProduct_f32 "VAR_tpcsmp_KiProduct_f32" FLOAT32_IEEE BSW_A2L_Ident_Float 1 100 -3.4E+38 3.4E+38 ECU_ADDRESS 0x00000000 /end MEASUREMENT
/begin CHARACTERISTIC CAL_DEM_Disbl_DFC_IOHWAB_5VQt1SampFail_u8 "CAL_DEM_Disbl_DFC_IOHWAB_5VQt1SampFail_u8" VALUE 0x00000000 Scalar_UBYTE 0 BSW_A2L_Ident_Int 0 255 /end CHARACTERISTIC
/begin CHARACTERISTIC CAL_TRSP_Diff_UBR_SBCLim_f32 "CAL_TRSP_Diff_UBR_SBCLim_f32" VALUE 0x00000000 Scalar_FLOAT32_IEEE 0 BSW_A2L_Ident_Float -3.4E+38 3.4E+38 /end CHARACTERISTIC
/begin CHARACTERISTIC CAL_Vcf_BetLimSlope_u8 "CAL_Vcf_BetLimSlope_u8" VALUE 0x00000000 Scalar_UBYTE 0 BSW_A2L_Ident_Int 0 255 /end CHARACTERISTIC
/begin CHARACTERISTIC CAL_TRSP_CurrSumErrRst_b "CAL_TRSP_CurrSumErrRst_b" VALUE 0x00000000 Scalar_BOOLEAN 0 BSW_A2L_Ident_Int 0 1 /end CHARACTERISTIC
/begin CHARACTERISTIC CAL_Vcf_HoldModVcuReq_u8 "CAL_Vcf_HoldModVcuReq_u8" VALUE 0x00000000 Scalar_UBYTE 0 BSW_A2L_Ident_Int 0 255 /end CHARACTERISTIC
/begin MEASUREMENT VAR_VdlTjtIGBT_f32 "VAR_VdlTjtIGBT_f32" FLOAT32_IEEE BSW_A2L_Ident_Float 1 100 -3.4E+38 3.4E+38 ECU_ADDRESS 0x00000000 /end MEASUREMENT
/begin CHARACTERISTIC CAL_Hspf_MototOpenChkSubCnt_s8 "CAL_Hspf_MototOpenChkSubCnt_s8" VALUE 0x00000000 Scalar_BYTE 0 BSW_A2L_Ident_Int -128 127 /end CHARACTERISTIC
/begin MEASUREMENT VAR_TpcMot_ElecPwrRef_f32 "VAR_TpcMot_ElecPwrRef_f32" FLOAT32_IEEE BSW_A2L_Ident_Float 1 100 -3.4E+38 3.4E+38 ECU_ADDRESS 0x00000000 /end MEASUREMENT
/begin CHARACTERISTIC CAL_PcfSig_flgstBeltSwt_b "CAL_PcfSig_flgstBeltSwt_b" VALUE 0x00000000 Scalar_BOOLEAN 0 BSW_A2L_Ident_Int 0 1 /end CHARACTERISTIC
/begin CHARACTERISTIC CAL_DEM_FIM_DFC_IOHWAB_18VUpBrgSampFail_au8 "CAL_DEM_FIM_DFC_IOHWAB_18VUpBrgSampFail_au8" VAL_BLK 0x00000000 Scalar_UBYTE 0 FID_Verb 0 255 NUMBER 10 /end CHARACTERISTIC
/begin CHARACTERISTIC CAL_RCF_nExtClbFrewhlBwd_f32 "CAL_RCF_nExtClbFrewhlBwd_f32" VALUE 0x00000000 Scalar_FLOAT32_IEEE 0 BSW_A2L_Ident_Float -3.4E+38 3.4E+38 /end CHARACTERISTIC
/begin MEASUREMENT VAR_MCF_iW_f32 "VAR_MCF_iW_f32" FLOAT32_IEEE BSW_A2L_Ident_Float 1 100 -3.4E+38 3.4E+38 ECU_ADDRESS 0x00000000 /end MEASUREMENT
/begin CHARACTERISTIC CAL_Cspf_FailCode8_u8 "CAL_Cspf_FailCode8_u8" VALUE 0x00000000 Scalar_UBYTE 0 BSW_A2L_Ident_Int 0 255 /end CHARACTERISTIC
/begin CHARACTERISTIC CAL_DEM_Disbl_DFC_IgbtDrv_LwBrgFaultAFail_u8 "CAL_DEM_Disbl_DFC_IgbtDrv_LwBrgFaultAFail_u8" VALUE 0x00000000 Scalar_UBYTE 0 BSW_A2L_Ident_Int 0 255 /end CHARACTERISTIC
/begin MEASUREMENT VAR_Shut_Of_Path_State_u16 "VAR_Shut_Of_Path_State_u16" UWORD BSW_A2L_Ident_Int 1 100 0 65535 ECU_ADDRESS 0x00000000 /end MEASUREMENT
/begin CHARACTERISTIC CAL_MCF_FrqRmp_f32 "CAL_MCF_FrqRmp_f32" VALUE 0x00000000 Scalar_FLOAT32_IEEE 0 BSW_A2L_Ident_Float -3.4E+38 3.4E+38 /end CHARACTERISTIC
/begin MEASUREMENT VAR_PcfCtl_PosKp_f32 "VAR_PcfCtl_PosKp_f32" FLOAT32_IEEE BSW_A2L_Ident_Float 1 100 -3.4E+38 3.4E+38 ECU_ADDRESS 0x00000000 /end MEASUREMENT
/begin MEASUREMENT VAR_Cspf_TrastDischg_u8 "VAR_Cspf_TrastDischg_u8" UBYTE BSW_A2L_Ident_Int 1 100 0 255 ECU_ADDRESS 0x00000000 /end MEASUREMENT
/begin CHARACTERISTIC CAL_TpcSmp_iDcLnkOvCElecLim_f32 "CAL_TpcSmp_iDcLnkOvCElecLim_f32" VALUE 0x00000000 Scalar_FLOAT32_IEEE 0 BSW_A2L_Ident_Float -3.4E+38 3.4E+38 /end CHARACTERISTIC
/begin CHARACTERISTIC CAL_TjLv2Act_f32 "CAL_TjLv2Act_f32" VALUE 0x00000000 Scalar_FLOAT32_IEEE 0 BSW_A2L_Ident_Float -3.4E+38 3.4E+38 /end CHARACTERISTIC
/begin MEASUREMENT VAR_UihTjtIGBT_f32 "VAR_UihTjtIGBT_f32" FLOAT32_IEEE BSW_A2L_Ident_Float 1 100 -3.4E+38 3.4E+38 ECU_ADDRESS 0x00000000 /end MEASUREMENT
/begin MEASUREMENT VAR_Scf_flgWakeNormal_b "VAR_Scf_flgWakeNormal_b" UBYTE BSW_A2L_Ident_Int 1 100 0 1 ECU_ADDRESS 0x00000000 /end MEASUREMENT
/begin CHARACTERISTIC CAL_TpcSmp_FacGenOvrVolt_u8 "CAL_TpcSmp_FacGenOvrVolt_u8" VALUE 0x00000000 Scalar_UBYTE 0 BSW_A2L_Ident_Int 0 255 /end CHARACTERISTIC
/begin MEASUREMENT VAR_TpcTmp_tRiseIGBTFlt_f32 "VAR_TpcTmp_tRiseIGBTFlt_f32" FLOAT32_IEEE BSW_A2L_Ident_Float 1 100 -3.4E+38 3.4E+38 ECU_ADDRESS 0x00000000 /end MEASUREMENT
/begin MEASUREMENT VAR_Hspf_stVerChk_u8 "VAR_Hspf_stVerChk_u8" UBYTE BSW_A2L_Ident_Int 1 100 0 255 ECU_ADDRESS 0x00000000 /end MEASUREMENT
/begin CHARACTERISTIC CAL_TpcTmp_CoolTempDecDiff_f32 "CAL_TpcTmp_CoolTempDecDiff_f32" VALUE 0x00000000 Scalar_FLOAT32_IEEE 0 BSW_A2L_Ident_Float -3.4E+38 3.4E+38 /end CHARACTERISTIC
/begin MEASUREMENT VAR_TpcMot_CofDertTRiseSttrSave2_f32 "VAR_TpcMot_CofDertTRiseSttrSave2_f32" FLOAT32_IEEE BSW_A2L_Ident_Float 1 100 -3.4E+38 3.4E+38 ECU_ADDRESS 0x00000000 /end MEASUREMENT
/begin CHARACTERISTIC CAL_Cspf_flgUdcMaxSwt_b "CAL_Cspf_flgUdcMaxSwt_b" VALUE 0x00000000 Scalar_BOOLEAN 0 BSW_A2L_Ident_Int 0 1 /end CHARACTERISTIC
/begin CHARACTERISTIC CAL_DEM_Disbl_DFC_HvMcu_UartLostFrameErr_u8 "CAL_DEM_Disbl_DFC_HvMcu_UartLostFrameErr_u8" VALUE 0x00000000 Scalar_UBYTE 0 BSW_A2L_Ident_Int 0 255 /end CHARACTERISTIC
/begin CHARACTERISTIC CAL_DEM_FIM_DFC_HvMcu_UdcOverVolErr_au8 "CAL_DEM_FIM_DFC_HvMcu_UdcOverVolErr_au8" VAL_BLK 0x00000000 Scalar_UBYTE 0 FID_Verb 0 255 NUMBER 10 /end CHARACTERISTIC
/begin MEASUREMENT VAR_TRSP_OfstRngChkRslt_b "VAR_TRSP_OfstRngChkRslt_b" UBYTE BSW_A2L_Ident_Int 1 100 0 1 ECU_ADDRESS 0x00000000 /end MEASUREMENT
/begin CHARACTERISTIC CAL_ADM_L2Com_HiPrecVolt_b "CAL_ADM_L2Com_HiPrecVolt_b" VALUE 0x00000000 Scalar_BOOLEAN 0 BSW_A2L_Ident_Int 0 1 /end CHARACTERISTIC
/begin MEASUREMENT VAR_Cspf_Traisq_f32 "VAR_Cspf_Traisq_f32" FLOAT32_IEEE BSW_A2L_Ident_Float 1 100 -3.4E+38 3.4E+38 ECU_ADDRESS 0x00000000 /end MEASUREMENT
/begin CHARACTERISTIC CAL_TRSP_CurrSumDebTrh_s16 "CAL_TRSP_CurrSumDebTrh_s16" VALUE 0x00000000 Scalar_SWORD 0 BSW_A2L_Ident_Int -32768 32767 /end CHARACTERISTIC
/begin CHARACTERISTIC CAL_DEM_Disbl_DFC_RSL_LOSErr_u8 "CAL_DEM_Disbl_DFC_RSL_LOSErr_u8" VALUE 0x00000000 Scalar_UBYTE 0 BSW_A2L_Ident_Int 0 255 /end CHARACTERISTIC
/begin CHARACTERISTIC CAL_DEM_FIM_DFC_TPC_TSttrOvHiLimFail_au8 "CAL_DEM_FIM_DFC_TPC_TSttrOvHiLimFail_au8" VAL_BLK 0x00000000 Scalar_UBYTE 0 FID_Verb 0 255 NUMBER 10 /end CHARACTERISTIC
/begin MEASUREMENT VAR_TpcFuv_ElecPwrLimDiag_f32 "VAR_TpcFuv_ElecPwrLimDiag_f32" FLOAT32_IEEE BSW_A2L_Ident_Float 1 100 -3.4E+38 3.4E+38 ECU_ADDRESS 0x00000000 /end MEASUREMENT
/begin CHARACTERISTIC CAL_FRP_TrqCalcErrOutCtl_b "CAL_FRP_TrqCalcErrOutCtl_b" VALUE 0x00000000 Scalar_BOOLEAN 0 BSW_A2L_Ident_Int 0 1 /end CHARACTERISTIC
/begin MEASUREMENT VAR_tpcsmp_negOutputjudge_f32 "VAR_tpcsmp_negOutputjudge_f32" FLOAT32_IEEE BSW_A2L_Ident_Float 1 100 -3.4E+38 3.4E+38 ECU_ADDRESS 0x00000000 /end MEASUREMENT
/begin CHARACTERISTIC CAL_Cspf_flgbDernOvrIdcSwt_b "CAL_Cspf_flgbDernOvrIdcSwt_b" VALUE 0x00000000 Scalar_BOOLEAN 0 BSW_A2L_Ident_Int 0 1 /end CHARACTERISTIC
/begin CHARACTERISTIC CAL_MPC_flgUseLdq_b "CAL_MPC_flgUseLdq_b" VALUE 0x00000000 Scalar_BOOLEAN 0 BSW_A2L_Ident_Int 0 1 /end CHARACTERISTIC
/begin CHARACTERISTIC CAL_PcfDia_flgLockedlSwt_b "CAL_PcfDia_flgLockedlSwt_b" VALUE 0x00000000 Scalar_BOOLEAN 0 BSW_A2L_Ident_Int 0 1 /end CHARACTERISTIC
/begin CHARACTERISTIC CAL_MDF_nAbsThreshCirNoPsbl_f32 "CAL_MDF_nAbsThreshCirNoPsbl_f32" VALUE 0x00000000 Scalar_FLOAT32_IEEE 0 BSW_A2L_Ident_Float -3.4E+38 3.4E+38 /end CHARACTERISTIC
/begin CHARACTERISTIC CAL_TRSP_RslvRngSinPLoLim_u16 "CAL_TRSP_RslvRngSinPLoLim_u16" VALUE 0x00000000 Scalar_UWORD 0 BSW_A2L_Ident_Int 0 65535 /end CHARACTERISTIC
/begin CHARACTERISTIC CAL_Tpcmot_CofuDclnk_u8 "CAL_Tpcmot_CofuDclnk_u8" VALUE 0x00000000 Scalar_UBYTE 0 BSW_A2L_Ident_Int 0 255 /end CHARACTERISTIC
/begin CHARACTERISTIC CAL_Vcf_AutoHoldSpd_f32 "CAL_Vcf_AutoHoldSpd_f32" VALUE 0x00000000 Scalar_FLOAT32_IEEE 0 BSW_A2L_Ident_Float -3.4E+38 3.4E+38 /end CHARACTERISTIC
/begin MEASUREMENT VAR_TpcTmp_tDbcMax_f32 "VAR_TpcTmp_tDbcMax_f32" FLOAT32_IEEE BSW_A2L_Ident_Float 1 100 -3.4E+38 3.4E+38 ECU_ADDRESS 0x00000000 /end MEASUREMENT
/begin MEASUREMENT VAR_TpcSmp_iDcLnkOvCLimErrState_u8 "VAR_TpcSmp_iDcLnkOvCLimErrState_u8" UBYTE BSW_A2L_Ident_Int 1 100 0 255 ECU_ADDRESS 0x00000000 /end MEASUREMENT
/begin CHARACTERISTIC CAL_MCF_flgVF_b "CAL_MCF_flgVF_b" VALUE 0x00000000 Scalar_BOOLEAN 0 BSW_A2L_Ident_Int 0 1 /end CHARACTERISTIC
/begin MEASUREMENT VAR_TpcTmp_ElecTrqLimTIGBTWoRamp_f32 "VAR_TpcTmp_ElecTrqLimTIGBTWoRamp_f32" FLOAT32_IEEE BSW_A2L_Ident_Float 1 100 -3.4E+38 3.4E+38 ECU_ADDRESS 0x00000000 /end MEASUREMENT
/begin MEASUREMENT VAR_RCF_OfsFlt4600Bwd_f32 "VAR_RCF_OfsFlt4600Bwd_f32" FLOAT32_IEEE BSW_A2L_Ident_Float 1 100 -3.4E+38 3.4E+38 ECU_ADDRESS 0x00000000 /end MEASUREMENT
/begin CHARACTERISTIC CAL_RCF_nOfsClbMaxFwd_f32 "CAL_RCF_nOfsClbMaxFwd_f32" VALUE 0x00000000 Scalar_FLOAT32_IEEE 0 BSW_A2L_Ident_Float -3.4E+38 3.4E+38 /end CHARACTERISTIC
/begin MEASUREMENT VAR_DEM_Event_IOHWAB_5VQcoSampFail_Status_u8 "VAR_DEM_Event_IOHWAB_5VQcoSampFail_Status_u8" UBYTE BSW_A2L_Ident_Int 1 100 0 255 ECU_ADDRESS 0x00000000 /end MEASUREMENT
/begin CHARACTERISTIC CAL_Tpc_OverheatingMode_u8 "CAL_Tpc_OverheatingMode_u8" VALUE 0x00000000 Scalar_UBYTE 0 BSW_A2L_Ident_Int 0 255 /end CHARACTERISTIC
/begin MEASUREMENT VAR_Vcf_KpNCtl_f32 "VAR_Vcf_KpNCtl_f32" FLOAT32_IEEE BSW_A2L_Ident_Float 1 100 -3.4E+38 3.4E+38 ECU_ADDRESS 0x00000000 /end MEASUREMENT
/begin CHARACTERISTIC CAL_FRP_RslvExciRngErrOutCtl_b "CAL_FRP_RslvExciRngErrOutCtl_b" VALUE 0x00000000 Scalar_BOOLEAN 0 BSW_A2L_Ident_Int 0 1 /end CHARACTERISTIC
/begin CHARACTERISTIC CAL_DEM_Disbl_DFC_MDF_EmacBlkdWarn_u8 "CAL_DEM_Disbl_DFC_MDF_EmacBlkdWarn_u8" VALUE 0x00000000 Scalar_UBYTE 0 BSW_A2L_Ident_Int 0 255 /end CHARACTERISTIC
/begin CHARACTERISTIC CAL_DEM_FIM_DFC_MDF_EmacBlkdWarn_au8 "CAL_DEM_FIM_DFC_MDF_EmacBlkdWarn_au8" VAL_BLK 0x00000000 Scalar_UBYTE 0 FID_Verb 0 255 NUMBER 10 /end CHARACTERISTIC
/begin CHARACTERISTIC CAL_DEM_Disbl_DFC_IOHWAB_18VUpBrgSampFail_u8 "CAL_DEM_Disbl_DFC_IOHWAB_18VUpBrgSampFail_u8" VALUE 0x00000000 Scalar_UBYTE 0 BSW_A2L_Ident_Int 0 255 /end CHARACTERISTIC
/begin CHARACTERISTIC CAL_FRP_CurrSumErrOutCtl_b "CAL_FRP_CurrSumErrOutCtl_b" VALUE 0x00000000 Scalar_BOOLEAN 0 BSW_A2L_Ident_Int 0 1 /end CHARACTERISTIC
/begin MEASUREMENT VAR_RCF_OfsFlt3600Bwd_f32 "VAR_RCF_OfsFlt3600Bwd_f32" FLOAT32_IEEE BSW_A2L_Ident_Float 1 100 -3.4E+38 3.4E+38 ECU_ADDRESS 0x00000000 /end MEASUREMENT
/begin CHARACTERISTIC CAL_TpcTmp_tRiseIGBTTraSave1ToNormal_f32 "CAL_TpcTmp_tRiseIGBTTraSave1ToNormal_f32" VALUE 0x00000000 Scalar_FLOAT32_IEEE 0 BSW_A2L_Ident_Float -3.4E+38 3.4E+38 /end CHARACTERISTIC
/begin MEASUREMENT VAR_TpcSmp_GenPwrLimOvrVolt_f32 "VAR_TpcSmp_GenPwrLimOvrVolt_f32" FLOAT32_IEEE BSW_A2L_Ident_Float 1 100 -3.4E+38 3.4E+38 ECU_ADDRESS 0x00000000 /end MEASUREMENT
/begin CHARACTERISTIC CAL_PcfStm_SLRetryTimesLimt_u8 "CAL_PcfStm_SLRetryTimesLimt_u8" VALUE 0x00000000 Scalar_UBYTE 0 BSW_A2L_Ident_Int 0 255 /end CHARACTERISTIC
/begin CHARACTERISTIC CAL_TpcCod_TrqRelay_f32 "CAL_TpcCod_TrqRelay_f32" VALUE 0x00000000 Scalar_FLOAT32_IEEE 0 BSW_A2L_Ident_Float -3.4E+38 3.4E+38 /end CHARACTERISTIC
/begin CHARACTERISTIC CAL_RCF_nOfsClbMinBwd_f32 "CAL_RCF_nOfsClbMinBwd_f32" VALUE 0x00000000 Scalar_FLOAT32_IEEE 0 BSW_A2L_Ident_Float -3.4E+38 3.4E+38 /end CHARACTERISTIC
/begin MEASUREMENT VAR_TpcTmp_TDbcULoLimErrState_u8 "VAR_TpcTmp_TDbcULoLimErrState_u8" UBYTE BSW_A2L_Ident_Int 1 100 0 255 ECU_ADDRESS 0x00000000 /end MEASUREMENT
/begin CHARACTERISTIC CAL_DEM_FIM_DFC_IOHWAB_1V3MCU_SampFail_au8 "CAL_DEM_FIM_DFC_IOHWAB_1V3MCU_SampFail_au8" VAL_BLK 0x00000000 Scalar_UBYTE 0 FID_Verb 0 255 NUMBER 10 /end CHARACTERISTIC
/begin MEASUREMENT VAR_MCF_PowerDcLnk_f32 "VAR_MCF_PowerDcLnk_f32" FLOAT32_IEEE BSW_A2L_Ident_Float 1 100 -3.4E+38 3.4E+38 ECU_ADDRESS 0x00000000 /end MEASUREMENT
/begin CHARACTERISTIC CAL_DEM_FIM_DFC_MDF_IsOvHiErr_au8 "CAL_DEM_FIM_DFC_MDF_IsOvHiErr_au8" VAL_BLK 0x00000000 Scalar_UBYTE 0 FID_Verb 0 255 NUMBER 10 /end CHARACTERISTIC
/begin MEASUREMENT VAR_ADM_HiPrecVolt_f32 "VAR_ADM_HiPrecVolt_f32" FLOAT32_IEEE BSW_A2L_Ident_Float 1 100 -3.4E+38 3.4E+38 ECU_ADDRESS 0x00000000 /end MEASUREMENT
/begin CHARACTERISTIC CAL_TpcFuv_CofTrqLimLv3_f32 "CAL_TpcFuv_CofTrqLimLv3_f32" VALUE 0x00000000 Scalar_FLOAT32_IEEE 0 BSW_A2L_Ident_Float -3.4E+38 3.4E+38 /end CHARACTERISTIC
/begin CHARACTERISTIC CAL_DEM_Disbl_DFC_TPC_TSttrOvHiWarn_u8 "CAL_DEM_Disbl_DFC_TPC_TSttrOvHiWarn_u8" VALUE 0x00000000 Scalar_UBYTE 0 BSW_A2L_Ident_Int 0 255 /end CHARACTERISTIC
/begin MEASUREMENT VAR_L2Sampling_RslvCosP_VADC_Min1_u16 "VAR_L2Sampling_RslvCosP_VADC_Min1_u16" UWORD BSW_A2L_Ident_Int 1 100 0 65535 ECU_ADDRESS 0x00000000 /end MEASUREMENT
/begin CHARACTERISTIC CAL_Cspf_flgUdcMinSwt_b "CAL_Cspf_flgUdcMinSwt_b" VALUE 0x00000000 Scalar_BOOLEAN 0 BSW_A2L_Ident_Int 0 1 /end CHARACTERISTIC
/begin MEASUREMENT VAR_TpcCod_flgMotorElecMode_b "VAR_TpcCod_flgMotorElecMode_b" UBYTE BSW_A2L_Ident_Int 1 100 0 1 ECU_ADDRESS 0x00000000 /end MEASUREMENT
/begin CHARACTERISTIC CAL_DEM_FIM_DFC_PCF_ActOvTiErr_au8 "CAL_DEM_FIM_DFC_PCF_ActOvTiErr_au8" VAL_BLK 0x00000000 Scalar_UBYTE 0 FID_Verb 0 255 NUMBER 10 /end CHARACTERISTIC
/begin MEASUREMENT VAR_Scf_DisChaUdcAfterDebounce_f32 "VAR_Scf_DisChaUdcAfterDebounce_f32" FLOAT32_IEEE BSW_A2L_Ident_Float 1 100 -3.4E+38 3.4E+38 ECU_ADDRESS 0x00000000 /end MEASUREMENT
/begin CHARACTERISTIC CAL_MCF_nDpwmOff_f32 "CAL_MCF_nDpwmOff_f32" VALUE 0x00000000 Scalar_FLOAT32_IEEE 0 BSW_A2L_Ident_Float -3.4E+38 3.4E+38 /end CHARACTERISTIC
/begin MEASUREMENT VAR_PcfSig_stDoor_b "VAR_PcfSig_stDoor_b" UBYTE BSW_A2L_Ident_Int 1 100 0 1 ECU_ADDRESS 0x00000000 /end MEASUREMENT
/begin CHARACTERISTIC CAL_ADM_flgCrashSwt_b "CAL_ADM_flgCrashSwt_b" VALUE 0x00000000 Scalar_BOOLEAN 0 BSW_A2L_Ident_Int 0 1 /end CHARACTERISTIC
/begin MEASUREMENT VAR_Cspf_TrabDernOvridc_u8 "VAR_Cspf_TrabDernOvridc_u8" UBYTE BSW_A2L_Ident_Int 1 100 0 255 ECU_ADDRESS 0x00000000 /end MEASUREMENT
/begin CHARACTERISTIC CAL_DEM_Disbl_DFC_HvMcu_EmerPowerSapErr_u8 "CAL_DEM_Disbl_DFC_HvMcu_EmerPowerSapErr_u8" VALUE 0x00000000 Scalar_UBYTE 0 BSW_A2L_Ident_Int 0 255 /end CHARACTERISTIC
/begin MEASUREMENT VAR_Bsw_tDBCTempW_u16 "VAR_Bsw_tDBCTempW_u16" UWORD BSW_A2L_Ident_Int 1 100 0 65535 ECU_ADDRESS 0x00000000 /end MEASUREMENT
/begin CHARACTERISTIC CAL_DEM_FIM_DFC_MDF_PhaseLossFaultErr_au8 "CAL_DEM_FIM_DFC_MDF_PhaseLossFaultErr_au8" VAL_BLK 0x00000000 Scalar_UBYTE 0 FID_Verb 0 255 NUMBER 10 /end CHARACTERISTIC
/begin CHARACTERISTIC CAL_Hvmcu_ComErr_Rate_u16 "CAL_Hvmcu_ComErr_Rate_u16" VALUE 0x00000000 Scalar_UWORD 0 BSW_A2L_Ident_Int 0 65535 /end CHARACTERISTIC
/begin CHARACTERISTIC CAL_DEM_FIM_DFC_RCF_PsiOvErr_au8 "CAL_DEM_FIM_DFC_RCF_PsiOvErr_au8" VAL_BLK 0x00000000 Scalar_UBYTE 0 FID_Verb 0 255 NUMBER 10 /end CHARACTERISTIC
/begin CHARACTERISTIC CAL_TpcTmp_IGBTTempMinus_f32 "CAL_TpcTmp_IGBTTempMinus_f32" VALUE 0x00000000 Scalar_FLOAT32_IEEE 0 BSW_A2L_Ident_Float -3.4E+38 3.4E+38 /end CHARACTERISTIC
/begin CHARACTERISTIC CAL_DEM_Disbl_DFC_IOHWAB_12VWideSampErr_u8 "CAL_DEM_Disbl_DFC_IOHWAB_12VWideSampErr_u8" VALUE 0x00000000 Scalar_UBYTE 0 BSW_A2L_Ident_Int 0 255 /end CHARACTERISTIC
/begin CHARACTERISTIC CAL_Vcf_BwdHoldOutSpdLim_f32 "CAL_Vcf_BwdHoldOutSpdLim_f32" VALUE 0x00000000 Scalar_FLOAT32_IEEE 0 BSW_A2L_Ident_Float -3.4E+38 3.4E+38 /end CHARACTERISTIC
/begin MEASUREMENT VAR_TpcTmp_TIGBTOvLoWarnState_u8 "VAR_TpcTmp_TIGBTOvLoWarnState_u8" UBYTE BSW_A2L_Ident_Int 1 100 0 255 ECU_ADDRESS 0x00000000 /end MEASUREMENT
/begin MEASUREMENT VAR_DEM_Event_IOHWAB_1V3MCU_SampFail_Status_u8 "VAR_DEM_Event_IOHWAB_1V3MCU_SampFail_Status_u8" UBYTE BSW_A2L_Ident_Int 1 100 0 255 ECU_ADDRESS 0x00000000 /end MEASUREMENT
/begin CHARACTERISTIC CAL_TjrthLv4dlih_f32 "CAL_TjrthLv4dlih_f32" VALUE 0x00000000 Scalar_FLOAT32_IEEE 0 BSW_A2L_Ident_Float -3.4E+38 3.4E+38 /end CHARACTERISTIC
/begin CHARACTERISTIC CAL_TjrthLv4dhdh_f32 "CAL_TjrthLv4dhdh_f32" VALUE 0x00000000 Scalar_FLOAT32_IEEE 0 BSW_A2L_Ident_Float -3.4E+38 3.4E+38 /end CHARACTERISTIC
/begin CHARACTERISTIC CAL_RCF_UsBetaScalSet_f32 "CAL_RCF_UsBetaScalSet_f32" VALUE 0x00000000 Scalar_FLOAT32_IEEE 0 BSW_A2L_Ident_Float -3.4E+38 3.4E+38 /end CHARACTERISTIC
/begin CHARACTERISTIC CAL_TCF_LoSpdDirStop_f32 "CAL_TCF_LoSpdDirStop_f32" VALUE 0x00000000 Scalar_FLOAT32_IEEE 0 BSW_A2L_Ident_Float -3.4E+38 3.4E+38 /end CHARACTERISTIC
/begin CHARACTERISTIC CAL_PcfSig_flgTestPSwt_b "CAL_PcfSig_flgTestPSwt_b" VALUE 0x00000000 Scalar_BOOLEAN 0 BSW_A2L_Ident_Int 0 1 /end CHARACTERISTIC
/begin MEASUREMENT VAR_RCF_flgSucdToDefault_b "VAR_RCF_flgSucdToDefault_b" UBYTE BSW_A2L_Ident_Int 1 100 0 1 ECU_ADDRESS 0x00000000 /end MEASUREMENT
/begin CHARACTERISTIC CAL_BCC_AgGenCoe_f32 "CAL_BCC_AgGenCoe_f32" VALUE 0x00000000 Scalar_FLOAT32_IEEE 0 BSW_A2L_Ident_Float -3.4E+38 3.4E+38 /end CHARACTERISTIC
/begin MEASUREMENT VAR_Cspf_Traisd_f32 "VAR_Cspf_Traisd_f32" FLOAT32_IEEE BSW_A2L_Ident_Float 1 100 -3.4E+38 3.4E+38 ECU_ADDRESS 0x00000000 /end MEASUREMENT
/begin CHARACTERISTIC CAL_TpcTmp_tCoolantTraSave1ToNormal_f32 "CAL_TpcTmp_tCoolantTraSave1ToNormal_f32" VALUE 0x00000000 Scalar_FLOAT32_IEEE 0 BSW_A2L_Ident_Float -3.4E+38 3.4E+38 /end CHARACTERISTIC
/begin MEASUREMENT VAR_Bsw_Motor_Open_b "VAR_Bsw_Motor_Open_b" UBYTE BSW_A2L_Ident_Int 1 100 0 1 ECU_ADDRESS 0x00000000 /end MEASUREMENT
/begin MEASUREMENT VAR_Vcf_trqDesAdDmp_f32 "VAR_Vcf_trqDesAdDmp_f32" FLOAT32_IEEE BSW_A2L_Ident_Float 1 100 -3.4E+38 3.4E+38 ECU_ADDRESS 0x00000000 /end MEASUREMENT
/begin MEASUREMENT VAR_TpcSmp_flgLinearDertOvrCurtElec_b "VAR_TpcSmp_flgLinearDertOvrCurtElec_b" UBYTE BSW_A2L_Ident_Int 1 100 0 1 ECU_ADDRESS 0x00000000 /end MEASUREMENT
/begin MEASUREMENT VAR_RCF_flgstEstTostDef_b "VAR_RCF_flgstEstTostDef_b" UBYTE BSW_A2L_Ident_Int 1 100 0 1 ECU_ADDRESS 0x00000000 /end MEASUREMENT
/begin MEASUREMENT VAR_MDF_bstGateDrvShCir_b "VAR_MDF_bstGateDrvShCir_b" UBYTE BSW_A2L_Ident_Int 1 100 0 1 ECU_ADDRESS 0x00000000 /end MEASUREMENT
/begin CHARACTERISTIC CAL_DEM_FIM_DFC_RCF_OfsClbFail_au8 "CAL_DEM_FIM_DFC_RCF_OfsClbFail_au8" VAL_BLK 0x00000000 Scalar_UBYTE 0 FID_Verb 0 255 NUMBER 10 /end CHARACTERISTIC
/begin MEASUREMENT VAR_TRSP_iV_f32 "VAR_TRSP_iV_f32" FLOAT32_IEEE BSW_A2L_Ident_Float 1 100 -3.4E+38 3.4E+38 ECU_ADDRESS 0x00000000 /end MEASUREMENT
/begin CHARACTERISTIC CAL_DEM_Disbl_DFC_Cpld_ParityChkErr_u8 "CAL_DEM_Disbl_DFC_Cpld_ParityChkErr_u8" VALUE 0x00000000 Scalar_UBYTE 0 BSW_A2L_Ident_Int 0 255 /end CHARACTERISTIC
/begin CHARACTERISTIC CAL_DEM_Disbl_DFC_Cpld_AliveChkErr_u8 "CAL_DEM_Disbl_DFC_Cpld_AliveChkErr_u8" VALUE 0x00000000 Scalar_UBYTE 0 BSW_A2L_Ident_Int 0 255 /end CHARACTERISTIC
/begin MEASUREMENT VAR_DEM_Event_RSL_ExcErr_Status_u8 "VAR_DEM_Event_RSL_ExcErr_Status_u8" UBYTE BSW_A2L_Ident_Int 1 100 0 255 ECU_ADDRESS 0x00000000 /end MEASUREMENT
/begin CHARACTERISTIC CAL_DEM_FIM_DFC_HSPF_tDBCTempCmpErr_au8 "CAL_DEM_FIM_DFC_HSPF_tDBCTempCmpErr_au8" VAL_BLK 0x00000000 Scalar_UBYTE 0 FID_Verb 0 255 NUMBER 10 /end CHARACTERISTIC
/begin MEASUREMENT VAR_tpcsmp_yiDelay_f32 "VAR_tpcsmp_yiDelay_f32" FLOAT32_IEEE BSW_A2L_Ident_Float 1 100 -3.4E+38 3.4E+38 ECU_ADDRESS 0x00000000 /end MEASUREMENT
/begin CHARACTERISTIC CAL_TpcSmp_uDcLnkMaxMax_f32 "CAL_TpcSmp_uDcLnkMaxMax_f32" VALUE 0x00000000 Scalar_FLOAT32_IEEE 0 BSW_A2L_Ident_Float -3.4E+38 3.4E+38 /end CHARACTERISTIC
/begin MEASUREMENT VAR_Rdc_Sin_s16 "VAR_Rdc_Sin_s16" SWORD BSW_A2L_Ident_Int 1 100 -32768 32767 ECU_ADDRESS 0x00000000 /end MEASUREMENT
/begin CHARACTERISTIC CAL_Scf_curSenChgToDrv_f32 "CAL_Scf_curSenChgToDrv_f32" VALUE 0x00000000 Scalar_FLOAT32_IEEE 0 BSW_A2L_Ident_Float -3.4E+38 3.4E+38 /end CHARACTERISTIC
/begin CHARACTERISTIC CAL_Scf_UdcLnkAbsDiffLim_f32 "CAL_Scf_UdcLnkAbsDiffLim_f32" VALUE 0x00000000 Scalar_FLOAT32_IEEE 0 BSW_A2L_Ident_Float -3.4E+38 3.4E+38 /end CHARACTERISTIC
/begin CHARACTERISTIC CAL_DEM_FIM_DFC_IOHWAB_5VQt2SampFail_au8 "CAL_DEM_FIM_DFC_IOHWAB_5VQt2SampFail_au8" VAL_BLK 0x00000000 Scalar_UBYTE 0 FID_Verb 0 255 NUMBER 10 /end CHARACTERISTIC
/begin MEASUREMENT VAR_Vcf_AsrSlipFlg1_b "VAR_Vcf_AsrSlipFlg1_b" UBYTE BSW_A2L_Ident_Int 1 100 0 1 ECU_ADDRESS 0x00000000 /end MEASUREMENT
/begin CHARACTERISTIC CAL_Cspf_flgKpHighNCtLSwt_b "CAL_Cspf_flgKpHighNCtLSwt_b" VALUE 0x00000000 Scalar_BOOLEAN 0 BSW_A2L_Ident_Int 0 1 /end CHARACTERISTIC
/begin MEASUREMENT VAR_DEM_Event_MDF_ICtlRatErr_Status_u8 "VAR_DEM_Event_MDF_ICtlRatErr_Status_u8" UBYTE BSW_A2L_Ident_Int 1 100 0 255 ECU_ADDRESS 0x00000000 /end MEASUREMENT
/begin MEASUREMENT VAR_IoHwAb_Adc_Phy_5V_QUC_f32 "VAR_IoHwAb_Adc_Phy_5V_QUC_f32" FLOAT32_IEEE BSW_A2L_Ident_Float 1 100 -3.4E+38 3.4E+38 ECU_ADDRESS 0x00000000 /end MEASUREMENT
/begin MEASUREMENT VAR_TpcFuv_FimTrqLimLv3_b "VAR_TpcFuv_FimTrqLimLv3_b" UBYTE BSW_A2L_Ident_Int 1 100 0 1 ECU_ADDRESS 0x00000000 /end MEASUREMENT
/begin CHARACTERISTIC CAL_DEM_FIM_DFC_CANSM_E_BUS_OFF_NETWORK_1_au8 "CAL_DEM_FIM_DFC_CANSM_E_BUS_OFF_NETWORK_1_au8" VAL_BLK 0x00000000 Scalar_UBYTE 0 FID_Verb 0 255 NUMBER 10 /end CHARACTERISTIC
/begin MEASUREMENT VAR_DEM_Event_RSL_DOSErr_Status_u8 "VAR_DEM_Event_RSL_DOSErr_Status_u8" UBYTE BSW_A2L_Ident_Int 1 100 0 255 ECU_ADDRESS 0x00000000 /end MEASUREMENT
/begin CHARACTERISTIC CAL_FRP_RslvRngErrOutCtl_b "CAL_FRP_RslvRngErrOutCtl_b" VALUE 0x00000000 Scalar_BOOLEAN 0 BSW_A2L_Ident_Int 0 1 /end CHARACTERISTIC
/begin CHARACTERISTIC CAL_RCF_TrqDesAcc_f32 "CAL_RCF_TrqDesAcc_f32" VALUE 0x00000000 Scalar_FLOAT32_IEEE 0 BSW_A2L_Ident_Float -3.4E+38 3.4E+38 /end CHARACTERISTIC
/begin CHARACTERISTIC CAL_TCF_TrqCalcMonErrRst_b "CAL_TCF_TrqCalcMonErrRst_b" VALUE 0x00000000 Scalar_BOOLEAN 0 BSW_A2L_Ident_Int 0 1 /end CHARACTERISTIC
/begin MEASUREMENT VAR_Cspf_TrabDernN_u8 "VAR_Cspf_TrabDernN_u8" UBYTE BSW_A2L_Ident_Int 1 100 0 255 ECU_ADDRESS 0x00000000 /end MEASUREMENT
/begin MEASUREMENT VAR_IOControl_u8 "VAR_IOControl_u8" UBYTE BSW_A2L_Ident_Int 1 100 0 255 ECU_ADDRESS 0x00000000 /end MEASUREMENT
/begin MEASUREMENT VAR_RCF_flgWaitToBwdClb_b "VAR_RCF_flgWaitToBwdClb_b" UBYTE BSW_A2L_Ident_Int 1 100 0 1 ECU_ADDRESS 0x00000000 /end MEASUREMENT
/begin CHARACTERISTIC CAL_PcfSig_nMotFltCoe_f32 "CAL_PcfSig_nMotFltCoe_f32" VALUE 0x00000000 Scalar_FLOAT32_IEEE 0 BSW_A2L_Ident_Float -3.4E+38 3.4E+38 /end CHARACTERISTIC
/begin MEASUREMENT VAR_TpcTmp_tRiseIGBTOperationMode_u8 "VAR_TpcTmp_tRiseIGBTOperationMode_u8" UBYTE BSW_A2L_Ident_Int 1 100 0 255 ECU_ADDRESS 0x00000000 /end MEASUREMENT
/begin CHARACTERISTIC CAL_DEM_Disbl_DFC_IOHWAB_SttrSenorShrFail_u8 "CAL_DEM_Disbl_DFC_IOHWAB_SttrSenorShrFail_u8" VALUE 0x00000000 Scalar_UBYTE 0 BSW_A2L_Ident_Int 0 255 /end CHARACTERISTIC
/begin MEASUREMENT VAR_PcfStm_flgSLCToStandby_b "VAR_PcfStm_flgSLCToStandby_b" UBYTE BSW_A2L_Ident_Int 1 100 0 1 ECU_ADDRESS 0x00000000 /end MEASUREMENT
/begin MEASUREMENT VAR_STM1_TimeData_FS_L2_u32 "VAR_STM1_TimeData_FS_L2_u32" ULONG BSW_A2L_Ident_Int 1 100 0 4294967295 ECU_ADDRESS 0x00000000 /end MEASUREMENT
/begin MEASUREMENT VAR_TCF_MotorMode_u8 "VAR_TCF_MotorMode_u8" UBYTE BSW_A2L_Ident_Int 1 100 0 255 ECU_ADDRESS 0x00000000 /end MEASUREMENT
/begin CHARACTERISTIC CAL_MCF_stPwmMode_u8 "CAL_MCF_stPwmMode_u8" VALUE 0x00000000 Scalar_UBYTE 0 BSW_A2L_Ident_Int 0 255 /end CHARACTERISTIC
/begin CHARACTERISTIC CAL_DEM_Disbl_DFC_HvMcu_UdcCheckErr_u8 "CAL_DEM_Disbl_DFC_HvMcu_UdcCheckErr_u8" VALUE 0x00000000 Scalar_UBYTE 0 BSW_A2L_Ident_Int 0 255 /end CHARACTERISTIC
/begin CHARACTERISTIC CAL_DEM_FIM_DFC_IOHWAB_5VQcoSampFail_au8 "CAL_DEM_FIM_DFC_IOHWAB_5VQcoSampFail_au8" VAL_BLK 0x00000000 Scalar_UBYTE 0 FID_Verb 0 255 NUMBER 10 /end CHARACTERISTIC
/begin CHARACTERISTIC CAL_DEM_Disbl_DFC_Cpld_SPIComFail_u8 "CAL_DEM_Disbl_DFC_Cpld_SPIComFail_u8" VALUE 0x00000000 Scalar_UBYTE 0 BSW_A2L_Ident_Int 0 255 /end CHARACTERISTIC
/begin CHARACTERISTIC CAL_Hspf_iPhaHighSet_u16 "CAL_Hspf_iPhaHighSet_u16" VALUE 0x00000000 Scalar_UWORD 0 BSW_A2L_Ident_Int 0 65535 /end CHARACTERISTIC
/begin MEASUREMENT VAR_DEM_Event_PCF_SelfcheckErr_Status_u8 "VAR_DEM_Event_PCF_SelfcheckErr_Status_u8" UBYTE BSW_A2L_Ident_Int 1 100 0 255 ECU_ADDRESS 0x00000000 /end MEASUREMENT
/begin MEASUREMENT VAR_MCF_MPC_LdSubLq_f32 "VAR_MCF_MPC_LdSubLq_f32" FLOAT32_IEEE BSW_A2L_Ident_Float 1 100 -3.4E+38 3.4E+38 ECU_ADDRESS 0x00000000 /end MEASUREMENT
/begin CHARACTERISTIC CAL_TRSP_flgChangPha_b "CAL_TRSP_flgChangPha_b" VALUE 0x00000000 Scalar_BOOLEAN 0 BSW_A2L_Ident_Int 0 1 /end CHARACTERISTIC
/begin MEASUREMENT VAR_FRP_FaultReact_b "VAR_FRP_FaultReact_b" UBYTE BSW_A2L_Ident_Int 1 100 0 1 ECU_ADDRESS 0x00000000 /end MEASUREMENT
/begin MEASUREMENT VAR_PcfSig_Pos1_f32 "VAR_PcfSig_Pos1_f32" FLOAT32_IEEE BSW_A2L_Ident_Float 1 100 -3.4E+38 3.4E+38 ECU_ADDRESS 0x00000000 /end MEASUREMENT
/begin CHARACTERISTIC CAL_BCC_flgEnableTj_b "CAL_BCC_flgEnableTj_b" VALUE 0x00000000 Scalar_BOOLEAN 0 BSW_A2L_Ident_Int 0 1 /end CHARACTERISTIC
/begin MEASUREMENT VAR_TpcSmp_uDcLnkUnVLimErrState_u8 "VAR_TpcSmp_uDcLnkUnVLimErrState_u8" UBYTE BSW_A2L_Ident_Int 1 100 0 255 ECU_ADDRESS 0x00000000 /end MEASUREMENT
/begin CHARACTERISTIC CAL_Vcf_BrkLgt_b "CAL_Vcf_BrkLgt_b" VALUE 0x00000000 Scalar_BOOLEAN 0 BSW_A2L_Ident_Int 0 1 /end CHARACTERISTIC
/begin MEASUREMENT VAR_CDD_Rslv_SinMax_f32 "VAR_CDD_Rslv_SinMax_f32" FLOAT32_IEEE BSW_A2L_Ident_Float 1 100 -3.4E+38 3.4E+38 ECU_ADDRESS 0x00000000 /end MEASUREMENT
/begin CHARACTERISTIC CAL_TpcSmp_CntGenOvrCurt_u8 "CAL_TpcSmp_CntGenOvrCurt_u8" VALUE 0x00000000 Scalar_UBYTE 0 BSW_A2L_Ident_Int 0 255 /end CHARACTERISTIC
/begin CHARACTERISTIC CAL_Hspf_MotorOpenChkCntLoLim_s8 "CAL_Hspf_MotorOpenChkCntLoLim_s8" VALUE 0x00000000 Scalar_BYTE 0 BSW_A2L_Ident_Int -128 127 /end CHARACTERISTIC
/begin CHARACTERISTIC CAL_RDC_SpdHiHyst_f32 "CAL_RDC_SpdHiHyst_f32" VALUE 0x00000000 Scalar_FLOAT32_IEEE 0 BSW_A2L_Ident_Float -3.4E+38 3.4E+38 /end CHARACTERISTIC
/begin CHARACTERISTIC CAL_Vcf_Crawltrqadd2_f32 "CAL_Vcf_Crawltrqadd2_f32" VALUE 0x00000000 Scalar_FLOAT32_IEEE 0 BSW_A2L_Ident_Float -3.4E+38 3.4E+38 /end CHARACTERISTIC
/begin CHARACTERISTIC CAL_RDC_RslDosOffMin_s16 "CAL_RDC_RslDosOffMin_s16" VALUE 0x00000000 Scalar_SWORD 0 BSW_A2L_Ident_Int -32768 32767 /end CHARACTERISTIC
/begin MEASUREMENT VAR_DEM_Event_TPC_TIGBTOvLoWarn_Status_u8 "VAR_DEM_Event_TPC_TIGBTOvLoWarn_Status_u8" UBYTE BSW_A2L_Ident_Int 1 100 0 255 ECU_ADDRESS 0x00000000 /end MEASUREMENT
/begin CHARACTERISTIC CAL_PcfCtl_ManualEn_b "CAL_PcfCtl_ManualEn_b" VALUE 0x00000000 Scalar_BOOLEAN 0 BSW_A2L_Ident_Int 0 1 /end CHARACTERISTIC
/begin CHARACTERISTIC CAL_POWER_UBSBC_Parem_Vol_f32 "CAL_POWER_UBSBC_Parem_Vol_f32" VALUE 0x00000000 Scalar_FLOAT32_IEEE 0 BSW_A2L_Ident_Float -3.4E+38 3.4E+38 /end CHARACTERISTIC
/begin MEASUREMENT VAR_L2Sampling_ExciBackN_u16 "VAR_L2Sampling_ExciBackN_u16" UWORD BSW_A2L_Ident_Int 1 100 0 65535 ECU_ADDRESS 0x00000000 /end MEASUREMENT
/begin CHARACTERISTIC CAL_TRSP_RslvRngExciLoLim_u16 "CAL_TRSP_RslvRngExciLoLim_u16" VALUE 0x00000000 Scalar_UWORD 0 BSW_A2L_Ident_Int 0 65535 /end CHARACTERISTIC
/begin MEASUREMENT VAR_TpcSmp_ErrGenOvrCurt_f32 "VAR_TpcSmp_ErrGenOvrCurt_f32" FLOAT32_IEEE BSW_A2L_Ident_Float 1 100 -3.4E+38 3.4E+38 ECU_ADDRESS 0x00000000 /end MEASUREMENT
/begin CHARACTERISTIC CAL_Cspf_flgbDernCANSwt_b "CAL_Cspf_flgbDernCANSwt_b" VALUE 0x00000000 Scalar_BOOLEAN 0 BSW_A2L_Ident_Int 0 1 /end CHARACTERISTIC
/begin CHARACTERISTIC CAL_ADC_DClink_Sample_gain_f32 "CAL_ADC_DClink_Sample_gain_f32" VALUE 0x00000000 Scalar_FLOAT32_IEEE 0 BSW_A2L_Ident_Float -3.4E+38 3.4E+38 /end CHARACTERISTIC
/begin CHARACTERISTIC CAL_TRSP_18VHSVoltErrRst_b "CAL_TRSP_18VHSVoltErrRst_b" VALUE 0x00000000 Scalar_BOOLEAN 0 BSW_A2L_Ident_Int 0 1 /end CHARACTERISTIC
/begin MEASUREMENT VAR_TpcSmp_flgElecPwrLimUdrVoltActv_b "VAR_TpcSmp_flgElecPwrLimUdrVoltActv_b" UBYTE BSW_A2L_Ident_Int 1 100 0 1 ECU_ADDRESS 0x00000000 /end MEASUREMENT
/begin CHARACTERISTIC CAL_TpcTmp_IGBTTempRiseDiff_f32 "CAL_TpcTmp_IGBTTempRiseDiff_f32" VALUE 0x00000000 Scalar_FLOAT32_IEEE 0 BSW_A2L_Ident_Float -3.4E+38 3.4E+38 /end CHARACTERISTIC
/begin MEASUREMENT VAR_IoHwAb_Adc_Phy_18V_LS_f32 "VAR_IoHwAb_Adc_Phy_18V_LS_f32" FLOAT32_IEEE BSW_A2L_Ident_Float 1 100 -3.4E+38 3.4E+38 ECU_ADDRESS 0x00000000 /end MEASUREMENT
/begin MEASUREMENT VAR_Scf_flgTranDrvToPostDrv_b "VAR_Scf_flgTranDrvToPostDrv_b" UBYTE BSW_A2L_Ident_Int 1 100 0 1 ECU_ADDRESS 0x00000000 /end MEASUREMENT
/begin MEASUREMENT VAR_DEM_Event_Cpld_IphaOC_Status_u8 "VAR_DEM_Event_Cpld_IphaOC_Status_u8" UBYTE BSW_A2L_Ident_Int 1 100 0 255 ECU_ADDRESS 0x00000000 /end MEASUREMENT
/begin MEASUREMENT VAR_DEM_Event_TPC_TDbcULoLimFail_Status_u8 "VAR_DEM_Event_TPC_TDbcULoLimFail_Status_u8" UBYTE BSW_A2L_Ident_Int 1 100 0 255 ECU_ADDRESS 0x00000000 /end MEASUREMENT
/begin MEASUREMENT VAR_DEM_Event_HvMcu_UdcOverVolErr_Status_u8 "VAR_DEM_Event_HvMcu_UdcOverVolErr_Status_u8" UBYTE BSW_A2L_Ident_Int 1 100 0 255 ECU_ADDRESS 0x00000000 /end MEASUREMENT
/begin MEASUREMENT VAR_MCF_Rdc_nWoFlt_f32 "VAR_MCF_Rdc_nWoFlt_f32" FLOAT32_IEEE BSW_A2L_Ident_Float 1 100 -3.4E+38 3.4E+38 ECU_ADDRESS 0x00000000 /end MEASUREMENT
/begin CHARACTERISTIC CAL_DEM_FIM_DFC_TPC_TDbcOvLoWarn_au8 "CAL_DEM_FIM_DFC_TPC_TDbcOvLoWarn_au8" VAL_BLK 0x00000000 Scalar_UBYTE 0 FID_Verb 0 255 NUMBER 10 /end CHARACTERISTIC
/begin CHARACTERISTIC CAL_PcfSig_GernMot_f32 "CAL_PcfSig_GernMot_f32" VALUE 0x00000000 Scalar_FLOAT32_IEEE 0 BSW_A2L_Ident_Float -3.4E+38 3.4E+38 /end CHARACTERISTIC
/begin MEASUREMENT VAR_MCF_agRtrEe_f32 "VAR_MCF_agRtrEe_f32" FLOAT32_IEEE BSW_A2L_Ident_Float 1 100 -3.4E+38 3.4E+38 ECU_ADDRESS 0x00000000 /end MEASUREMENT
/begin CHARACTERISTIC CAL_DEM_Disbl_DFC_HvMcu_DisChrgDutyErr_u8 "CAL_DEM_Disbl_DFC_HvMcu_DisChrgDutyErr_u8" VALUE 0x00000000 Scalar_UBYTE 0 BSW_A2L_Ident_Int 0 255 /end CHARACTERISTIC
/begin CHARACTERISTIC CAL_MPC_Rcmp_f32 "CAL_MPC_Rcmp_f32" VALUE 0x00000000 Scalar_FLOAT32_IEEE 0 BSW_A2L_Ident_Float -3.4E+38 3.4E+38 /end CHARACTERISTIC
/begin MEASUREMENT VAR_Cspf_TraTempCurrStr1_f32 "VAR_Cspf_TraTempCurrStr1_f32" FLOAT32_IEEE BSW_A2L_Ident_Float 1 100 -3.4E+38 3.4E+38 ECU_ADDRESS 0x00000000 /end MEASUREMENT
/begin MEASUREMENT VAR_TpcSmp_ElecTrqLimOvrSpd_f32 "VAR_TpcSmp_ElecTrqLimOvrSpd_f32" FLOAT32_IEEE BSW_A2L_Ident_Float 1 100 -3.4E+38 3.4E+38 ECU_ADDRESS 0x00000000 /end MEASUREMENT
/begin MEASUREMENT VAR_CDD_Rslv_TimeGp_f32 "VAR_CDD_Rslv_TimeGp_f32" FLOAT32_IEEE BSW_A2L_Ident_Float 1 100 -3.4E+38 3.4E+38 ECU_ADDRESS 0x00000000 /end MEASUREMENT
/begin CHARACTERISTIC CAL_PcfStm_flgUseBlindCtl_b "CAL_PcfStm_flgUseBlindCtl_b" VALUE 0x00000000 Scalar_BOOLEAN 0 BSW_A2L_Ident_Int 0 1 /end CHARACTERISTIC
/begin CHARACTERISTIC CAL_Tpc_TrqRiseRevStep_f32 "CAL_Tpc_TrqRiseRevStep_f32" VALUE 0x00000000 Scalar_FLOAT32_IEEE 0 BSW_A2L_Ident_Float -3.4E+38 3.4E+38 /end CHARACTERISTIC
/begin CHARACTERISTIC CAL_Scf_nSafeTestMaxLim_f32 "CAL_Scf_nSafeTestMaxLim_f32" VALUE 0x00000000 Scalar_FLOAT32_IEEE 0 BSW_A2L_Ident_Float -3.4E+38 3.4E+38 /end CHARACTERISTIC
/begin CHARACTERISTIC CAL_RCF_flgReAutoClbSuc_b "CAL_RCF_flgReAutoClbSuc_b" VALUE 0x00000000 Scalar_BOOLEAN 0 BSW_A2L_Ident_Int 0 1 /end CHARACTERISTIC
/begin CHARACTERISTIC CAL_Vcf_nAccChgHiLim_f32 "CAL_Vcf_nAccChgHiLim_f32" VALUE 0x00000000 Scalar_FLOAT32_IEEE 0 BSW_A2L_Ident_Float -3.4E+38 3.4E+38 /end CHARACTERISTIC
/begin MEASUREMENT VAR_VihTjtIGBT_f32 "VAR_VihTjtIGBT_f32" FLOAT32_IEEE BSW_A2L_Ident_Float 1 100 -3.4E+38 3.4E+38 ECU_ADDRESS 0x00000000 /end MEASUREMENT
/begin CHARACTERISTIC CAL_PcfDia_flgBCLockedSwt_b "CAL_PcfDia_flgBCLockedSwt_b" VALUE 0x00000000 Scalar_BOOLEAN 0 BSW_A2L_Ident_Int 0 1 /end CHARACTERISTIC
/begin CHARACTERISTIC CAL_ADM_DchgMode_u8 "CAL_ADM_DchgMode_u8" VALUE 0x00000000 Scalar_UBYTE 0 BSW_A2L_Ident_Int 0 255 /end CHARACTERISTIC
/begin MEASUREMENT VAR_TpcMot_ElecTrqLimTsttr_f32 "VAR_TpcMot_ElecTrqLimTsttr_f32" FLOAT32_IEEE BSW_A2L_Ident_Float 1 100 -3.4E+38 3.4E+38 ECU_ADDRESS 0x00000000 /end MEASUREMENT
/begin CHARACTERISTIC CAL_DEM_FIM_DFC_TPC_TDbcVLoLimFail_au8 "CAL_DEM_FIM_DFC_TPC_TDbcVLoLimFail_au8" VAL_BLK 0x00000000 Scalar_UBYTE 0 FID_Verb 0 255 NUMBER 10 /end CHARACTERISTIC
/begin MEASUREMENT VAR_TpcTmp_GenTrqLimTIGBT_f32 "VAR_TpcTmp_GenTrqLimTIGBT_f32" FLOAT32_IEEE BSW_A2L_Ident_Float 1 100 -3.4E+38 3.4E+38 ECU_ADDRESS 0x00000000 /end MEASUREMENT
/begin CHARACTERISTIC CAL_MDF_3PhaUnbalance_f32 "CAL_MDF_3PhaUnbalance_f32" VALUE 0x00000000 Scalar_FLOAT32_IEEE 0 BSW_A2L_Ident_Float -3.4E+38 3.4E+38 /end CHARACTERISTIC
/begin CHARACTERISTIC CAL_Hspf_DBCTempROCLimChkCnt_u8 "CAL_Hspf_DBCTempROCLimChkCnt_u8" VALUE 0x00000000 Scalar_UBYTE 0 BSW_A2L_Ident_Int 0 255 /end CHARACTERISTIC
/begin CHARACTERISTIC CAL_MCF_uDUpLimEOL_f32 "CAL_MCF_uDUpLimEOL_f32" VALUE 0x00000000 Scalar_FLOAT32_IEEE 0 BSW_A2L_Ident_Float -3.4E+38 3.4E+38 /end CHARACTERISTIC
/begin CHARACTERISTIC CAL_MDF_tiOffsetSteady_f32 "CAL_MDF_tiOffsetSteady_f32" VALUE 0x00000000 Scalar_FLOAT32_IEEE 0 BSW_A2L_Ident_Float -3.4E+38 3.4E+38 /end CHARACTERISTIC
/begin CHARACTERISTIC CAL_RCF_tMaxEstAlOfs_u32 "CAL_RCF_tMaxEstAlOfs_u32" VALUE 0x00000000 Scalar_ULONG 0 BSW_A2L_Ident_Int 0 4294967295 /end CHARACTERISTIC
/begin CHARACTERISTIC CAL_Vcf_spdThredDmpNeg_f32 "CAL_Vcf_spdThredDmpNeg_f32" VALUE 0x00000000 Scalar_FLOAT32_IEEE 0 BSW_A2L_Ident_Float -3.4E+38 3.4E+38 /end CHARACTERISTIC
/begin CHARACTERISTIC CAL_Cspf_flgFailCode4Swt_b "CAL_Cspf_flgFailCode4Swt_b" VALUE 0x00000000 Scalar_BOOLEAN 0 BSW_A2L_Ident_Int 0 1 /end CHARACTERISTIC
/begin CHARACTERISTIC CAL_TRSP_WCurrRngHiLim_f32 "CAL_TRSP_WCurrRngHiLim_f32" VALUE 0x00000000 Scalar_FLOAT32_IEEE 0 BSW_A2L_Ident_Float -3.4E+38 3.4E+38 /end CHARACTERISTIC
/begin MEASUREMENT VAR_DEM_Event_HSPF_InvOpenErr_Status_u8 "VAR_DEM_Event_HSPF_InvOpenErr_Status_u8" UBYTE BSW_A2L_Ident_Int 1 100 0 255 ECU_ADDRESS 0x00000000 /end MEASUREMENT
/begin CHARACTERISTIC CAL_Scf_uDisChgOutTim_f32 "CAL_Scf_uDisChgOutTim_f32" VALUE 0x00000000 Scalar_FLOAT32_IEEE 0 BSW_A2L_Ident_Float -3.4E+38 3.4E+38 /end CHARACTERISTIC
/begin CHARACTERISTIC CAL_Vcf_GearD_u8 "CAL_Vcf_GearD_u8" VALUE 0x00000000 Scalar_UBYTE 0 BSW_A2L_Ident_Int 0 255 /end CHARACTERISTIC
/begin CHARACTERISTIC CAL_DEM_Disbl_DFC_TPC_TDbcWLoLimFail_u8 "CAL_DEM_Disbl_DFC_TPC_TDbcWLoLimFail_u8" VALUE 0x00000000 Scalar_UBYTE 0 BSW_A2L_Ident_Int 0 255 /end CHARACTERISTIC
/begin CHARACTERISTIC CAL_DEM_FIM_DFC_TPC_uDcLnkOvVLimFail_au8 "CAL_DEM_FIM_DFC_TPC_uDcLnkOvVLimFail_au8" VAL_BLK 0x00000000 Scalar_UBYTE 0 FID_Verb 0 255 NUMBER 10 /end CHARACTERISTIC
/begin CHARACTERISTIC CAL_Cspf_flgtCoolantTempFltSwt_b "CAL_Cspf_flgtCoolantTempFltSwt_b" VALUE 0x00000000 Scalar_BOOLEAN 0 BSW_A2L_Ident_Int 0 1 /end CHARACTERISTIC
/begin CHARACTERISTIC CAL_DEM_Disbl_DFC_TPC_TSttrOvLoWarn_u8 "CAL_DEM_Disbl_DFC_TPC_TSttrOvLoWarn_u8" VALUE 0x00000000 Scalar_UBYTE 0 BSW_A2L_Ident_Int 0 255 /end CHARACTERISTIC
/begin MEASUREMENT VAR_DEM_Event_CANSM_E_BUS_OFF_NETWORK_0_Status_u8 "VAR_DEM_Event_CANSM_E_BUS_OFF_NETWORK_0_Status_u8" UBYTE BSW_A2L_Ident_Int 1 100 0 255 ECU_ADDRESS 0x00000000 /end MEASUREMENT
/begin MEASUREMENT VAR_RCF_stAgRtrOfsCal_u8 "VAR_RCF_stAgRtrOfsCal_u8" UBYTE BSW_A2L_Ident_Int 1 100 0 255 ECU_ADDRESS 0x00000000 /end MEASUREMENT
/begin CHARACTERISTIC CAL_POWER_UBSBC_Threhold_V2_f32 "CAL_POWER_UBSBC_Threhold_V2_f32" VALUE 0x00000000 Scalar_FLOAT32_IEEE 0 BSW_A2L_Ident_Float -3.4E+38 3.4E+38 /end CHARACTERISTIC
/begin CHARACTERISTIC CAL_Vcf_MotorDrvSpd_f32 "CAL_Vcf_MotorDrvSpd_f32" VALUE 0x00000000 Scalar_FLOAT32_IEEE 0 BSW_A2L_Ident_Float -3.4E+38 3.4E+38 /end CHARACTERISTIC
/begin CHARACTERISTIC CAL_MCF_flgDpwm_b "CAL_MCF_flgDpwm_b" VALUE 0x00000000 Scalar_BOOLEAN 0 BSW_A2L_Ident_Int 0 1 /end CHARACTERISTIC
/begin CHARACTERISTIC CAL_DEM_Disbl_DFC_IOHWAB_Nen33Fail_u8 "CAL_DEM_Disbl_DFC_IOHWAB_Nen33Fail_u8" VALUE 0x00000000 Scalar_UBYTE 0 BSW_A2L_Ident_Int 0 255 /end CHARACTERISTIC
/begin CHARACTERISTIC CAL_MDF_FwWoIs_f32 "CAL_MDF_FwWoIs_f32" VALUE 0x00000000 Scalar_FLOAT32_IEEE 0 BSW_A2L_Ident_Float -3.4E+38 3.4E+38 /end CHARACTERISTIC
/begin CHARACTERISTIC CAL_TCF_TempStrPlossFact_f32 "CAL_TCF_TempStrPlossFact_f32" VALUE 0x00000000 Scalar_FLOAT32_IEEE 0 BSW_A2L_Ident_Float -3.4E+38 3.4E+38 /end CHARACTERISTIC
/begin MEASUREMENT VAR_tpccod_flgMaxDertMtrSpd_b "VAR_tpccod_flgMaxDertMtrSpd_b" UBYTE BSW_A2L_Ident_Int 1 100 0 1 ECU_ADDRESS 0x00000000 /end MEASUREMENT
/begin CHARACTERISTIC CAL_PcfSig_flgBrakeSwt_b "CAL_PcfSig_flgBrakeSwt_b" VALUE 0x00000000 Scalar_BOOLEAN 0 BSW_A2L_Ident_Int 0 1 /end CHARACTERISTIC
/begin MEASUREMENT VAR_TpcTmp_TDrvBoardOvHiWarnState_u8 "VAR_TpcTmp_TDrvBoardOvHiWarnState_u8" UBYTE BSW_A2L_Ident_Int 1 100 0 255 ECU_ADDRESS 0x00000000 /end MEASUREMENT
/begin MEASUREMENT VAR_3phPWMWH_Period_f32 "VAR_3phPWMWH_Period_f32" FLOAT32_IEEE BSW_A2L_Ident_Float 1 100 -3.4E+38 3.4E+38 ECU_ADDRESS 0x00000000 /end MEASUREMENT
/begin CHARACTERISTIC CAL_Hspf_VerMatchUncheck_u8 "CAL_Hspf_VerMatchUncheck_u8" VALUE 0x00000000 Scalar_UBYTE 0 BSW_A2L_Ident_Int 0 255 /end CHARACTERISTIC
/begin CHARACTERISTIC CAL_Vcf_SpdDebounce_f32 "CAL_Vcf_SpdDebounce_f32" VALUE 0x00000000 Scalar_FLOAT32_IEEE 0 BSW_A2L_Ident_Float -3.4E+38 3.4E+38 /end CHARACTERISTIC
/begin MEASUREMENT VAR_DEM_Event_Cpld_SZTKT_InFail_Status_u8 "VAR_DEM_Event_Cpld_SZTKT_InFail_Status_u8" UBYTE BSW_A2L_Ident_Int 1 100 0 255 ECU_ADDRESS 0x00000000 /end MEASUREMENT
/begin MEASUREMENT VAR_NvM_BSW_NVM_SLFnh_au8 "VAR_NvM_BSW_NVM_SLFnh_au8" UBYTE BSW_A2L_Ident_Int 1 100 0 255 ARRAY_SIZE 1 ECU_ADDRESS 0x00000000 /end MEASUREMENT
/begin MEASUREMENT VAR_TRSP_RslvSqrtErr_b "VAR_TRSP_RslvSqrtErr_b" UBYTE BSW_A2L_Ident_Int 1 100 0 1 ECU_ADDRESS 0x00000000 /end MEASUREMENT
/begin CHARACTERISTIC CAL_MCF_trqDpwmOff_f32 "CAL_MCF_trqDpwmOff_f32" VALUE 0x00000000 Scalar_FLOAT32_IEEE 0 BSW_A2L_Ident_Float -3.4E+38 3.4E+38 /end CHARACTERISTIC
/begin CHARACTERISTIC CAL_Scf_nPsmThresToDrv_f32 "CAL_Scf_nPsmThresToDrv_f32" VALUE 0x00000000 Scalar_FLOAT32_IEEE 0 BSW_A2L_Ident_Float -3.4E+38 3.4E+38 /end CHARACTERISTIC
/begin MEASUREMENT VAR_L2Sampling_RslvCosP_VADC_u16 "VAR_L2Sampling_RslvCosP_VADC_u16" UWORD BSW_A2L_Ident_Int 1 100 0 65535 ECU_ADDRESS 0x00000000 /end MEASUREMENT
/begin CHARACTERISTIC CAL_Scf_nPsmThresToPostDrv_f32 "CAL_Scf_nPsmThresToPostDrv_f32" VALUE 0x00000000 Scalar_FLOAT32_IEEE 0 BSW_A2L_Ident_Float -3.4E+38 3.4E+38 /end CHARACTERISTIC
/begin MEASUREMENT VAR_DEM_Event_PCF_ActOvTiErr_Status_u8 "VAR_DEM_Event_PCF_ActOvTiErr_Status_u8" UBYTE BSW_A2L_Ident_Int 1 100 0 255 ECU_ADDRESS 0x00000000 /end MEASUREMENT
/begin MEASUREMENT VAR_MDF_bFaultPwrCmp_b "VAR_MDF_bFaultPwrCmp_b" UBYTE BSW_A2L_Ident_Int 1 100 0 1 ECU_ADDRESS 0x00000000 /end MEASUREMENT
/begin MEASUREMENT VAR_L2Sampling_RslvSinN_VADC_Min1_u16 "VAR_L2Sampling_RslvSinN_VADC_Min1_u16" UWORD BSW_A2L_Ident_Int 1 100 0 65535 ECU_ADDRESS 0x00000000 /end MEASUREMENT
/begin MEASUREMENT VAR_PcfSig_TestTimes_u16 "VAR_PcfSig_TestTimes_u16" UWORD BSW_A2L_Ident_Int 1 100 0 65535 ECU_ADDRESS 0x00000000 /end MEASUREMENT
/begin CHARACTERISTIC CAL_Cspf_flgstTrqEmMaxSwt_b "CAL_Cspf_flgstTrqEmMaxSwt_b" VALUE 0x00000000 Scalar_BOOLEAN 0 BSW_A2L_Ident_Int 0 1 /end CHARACTERISTIC
/begin MEASUREMENT VAR_DEM_Event_IOHWAB_KL30OverVolErr_Status_u8 "VAR_DEM_Event_IOHWAB_KL30OverVolErr_Status_u8" UBYTE BSW_A2L_Ident_Int 1 100 0 255 ECU_ADDRESS 0x00000000 /end MEASUREMENT
/begin CHARACTERISTIC CAL_Vcf_GearLvD_u8 "CAL_Vcf_GearLvD_u8" VALUE 0x00000000 Scalar_UBYTE 0 BSW_A2L_Ident_Int 0 255 /end CHARACTERISTIC
/begin CHARACTERISTIC CAL_Cspf_TrqDmpLim_f32 "CAL_Cspf_TrqDmpLim_f32" VALUE 0x00000000 Scalar_FLOAT32_IEEE 0 BSW_A2L_Ident_Float -3.4E+38 3.4E+38 /end CHARACTERISTIC
/begin MEASUREMENT VAR_Cspf_TraagRtrELecSnsr_f32 "VAR_Cspf_TraagRtrELecSnsr_f32" FLOAT32_IEEE BSW_A2L_Ident_Float 1 100 -3.4E+38 3.4E+38 ECU_ADDRESS 0x00000000 /end MEASUREMENT
/begin CHARACTERISTIC CAL_Cspf_flgstTrqEmMinSwt_b "CAL_Cspf_flgstTrqEmMinSwt_b" VALUE 0x00000000 Scalar_BOOLEAN 0 BSW_A2L_Ident_Int 0 1 /end CHARACTERISTIC
/begin MEASUREMENT VAR_TCF_BlendTrq_f32 "VAR_TCF_BlendTrq_f32" FLOAT32_IEEE BSW_A2L_Ident_Float 1 100 -3.4E+38 3.4E+38 ECU_ADDRESS 0x00000000 /end MEASUREMENT
/begin CHARACTERISTIC CAL_MCF_isSet_f32 "CAL_MCF_isSet_f32" VALUE 0x00000000 Scalar_FLOAT32_IEEE 0 BSW_A2L_Ident_Float -3.4E+38 3.4E+38 /end CHARACTERISTIC
/begin CHARACTERISTIC CAL_DEM_Disbl_DFC_HvMcu_UartCheckFailErr_u8 "CAL_DEM_Disbl_DFC_HvMcu_UartCheckFailErr_u8" VALUE 0x00000000 Scalar_UBYTE 0 BSW_A2L_Ident_Int 0 255 /end CHARACTERISTIC
/begin CHARACTERISTIC CAL_PowerMotHeat_f32 "CAL_PowerMotHeat_f32" VALUE 0x00000000 Scalar_FLOAT32_IEEE 0 BSW_A2L_Ident_Float -3.4E+38 3.4E+38 /end CHARACTERISTIC
/begin MEASUREMENT VAR_DEM_Event_RCF_PsiOvErr_Status_u8 "VAR_DEM_Event_RCF_PsiOvErr_Status_u8" UBYTE BSW_A2L_Ident_Int 1 100 0 255 ECU_ADDRESS 0x00000000 /end MEASUREMENT
/begin MEASUREMENT VAR_tpcsmp_PwrLoss_f32 "VAR_tpcsmp_PwrLoss_f32" FLOAT32_IEEE BSW_A2L_Ident_Float 1 100 -3.4E+38 3.4E+38 ECU_ADDRESS 0x00000000 /end MEASUREMENT
/begin CHARACTERISTIC CAL_Vcf_FwdHoldInSpdLim_f32 "CAL_Vcf_FwdHoldInSpdLim_f32" VALUE 0x00000000 Scalar_FLOAT32_IEEE 0 BSW_A2L_Ident_Float -3.4E+38 3.4E+38 /end CHARACTERISTIC
/begin CHARACTERISTIC CAL_MCF_TrqOffDeadCpn_f32 "CAL_MCF_TrqOffDeadCpn_f32" VALUE 0x00000000 Scalar_FLOAT32_IEEE 0 BSW_A2L_Ident_Float -3.4E+38 3.4E+38 /end CHARACTERISTIC
/begin MEASUREMENT VAR_TpcMot_TSttrOvLoWarnState_u8 "VAR_TpcMot_TSttrOvLoWarnState_u8" UBYTE BSW_A2L_Ident_Int 1 100 0 255 ECU_ADDRESS 0x00000000 /end MEASUREMENT
/begin CHARACTERISTIC CAL_Cspf_bDernStrTemp_u8 "CAL_Cspf_bDernStrTemp_u8" VALUE 0x00000000 Scalar_UBYTE 0 BSW_A2L_Ident_Int 0 255 /end CHARACTERISTIC
/begin MEASUREMENT VAR_PcfSig_IUBPcf_f32 "VAR_PcfSig_IUBPcf_f32" FLOAT32_IEEE BSW_A2L_Ident_Float 1 100 -3.4E+38 3.4E+38 ECU_ADDRESS 0x00000000 /end MEASUREMENT
/begin CHARACTERISTIC CAL_Cspf_agRtrEe_f32 "CAL_Cspf_agRtrEe_f32" VALUE 0x00000000 Scalar_FLOAT32_IEEE 0 BSW_A2L_Ident_Float -3.4E+38 3.4E+38 /end CHARACTERISTIC
/begin CHARACTERISTIC CAL_TpcTmp_IgbtRiseChgTempDownDiff_f32 "CAL_TpcTmp_IgbtRiseChgTempDownDiff_f32" VALUE 0x00000000 Scalar_FLOAT32_IEEE 0 BSW_A2L_Ident_Float -3.4E+38 3.4E+38 /end CHARACTERISTIC
/begin MEASUREMENT VAR_TpcTmp_tRiseDbc_f32 "VAR_TpcTmp_tRiseDbc_f32" FLOAT32_IEEE BSW_A2L_Ident_Float 1 100 -3.4E+38 3.4E+38 ECU_ADDRESS 0x00000000 /end MEASUREMENT
/begin CHARACTERISTIC CAL_MCF_udOverGain_f32 "CAL_MCF_udOverGain_f32" VALUE 0x00000000 Scalar_FLOAT32_IEEE 0 BSW_A2L_Ident_Float -3.4E+38 3.4E+38 /end CHARACTERISTIC
/begin CHARACTERISTIC CAL_DEM_Disbl_DFC_TPC_TDbcWHiLimFail_u8 "CAL_DEM_Disbl_DFC_TPC_TDbcWHiLimFail_u8" VALUE 0x00000000 Scalar_UBYTE 0 BSW_A2L_Ident_Int 0 255 /end CHARACTERISTIC
/begin CHARACTERISTIC CAL_DEM_FIM_DFC_MDF_DiashCirNoPsblErr_au8 "CAL_DEM_FIM_DFC_MDF_DiashCirNoPsblErr_au8" VAL_BLK 0x00000000 Scalar_UBYTE 0 FID_Verb 0 255 NUMBER 10 /end CHARACTERISTIC
/begin CHARACTERISTIC CAL_Vcf_AccPedSet_f32 "CAL_Vcf_AccPedSet_f32" VALUE 0x00000000 Scalar_FLOAT32_IEEE 0 BSW_A2L_Ident_Float -3.4E+38 3.4E+38 /end CHARACTERISTIC
/begin MEASUREMENT VAR_PcfSig_flgKL15_b "VAR_PcfSig_flgKL15_b" UBYTE BSW_A2L_Ident_Int 1 100 0 1 ECU_ADDRESS 0x00000000 /end MEASUREMENT
/begin MEASUREMENT VAR_L2Sampling_RslvSinP_VADC_Min1_u16 "VAR_L2Sampling_RslvSinP_VADC_Min1_u16" UWORD BSW_A2L_Ident_Int 1 100 0 65535 ECU_ADDRESS 0x00000000 /end MEASUREMENT
/begin CHARACTERISTIC CAL_Hspf_tStrrTmp1FltFrq_f32 "CAL_Hspf_tStrrTmp1FltFrq_f32" VALUE 0x00000000 Scalar_FLOAT32_IEEE 0 BSW_A2L_Ident_Float -3.4E+38 3.4E+38 /end CHARACTERISTIC
/begin MEASUREMENT VAR_TpcMot_TrqElecExCOrg_f32 "VAR_TpcMot_TrqElecExCOrg_f32" FLOAT32_IEEE BSW_A2L_Ident_Float 1 100 -3.4E+38 3.4E+38 ECU_ADDRESS 0x00000000 /end MEASUREMENT
/begin CHARACTERISTIC CAL_PcfSig_deltaAimInP_f32 "CAL_PcfSig_deltaAimInP_f32" VALUE 0x00000000 Scalar_FLOAT32_IEEE 0 BSW_A2L_Ident_Float -3.4E+38 3.4E+38 /end CHARACTERISTIC
/begin MEASUREMENT VAR_MCF_iU_f32 "VAR_MCF_iU_f32" FLOAT32_IEEE BSW_A2L_Ident_Float 1 100 -3.4E+38 3.4E+38 ECU_ADDRESS 0x00000000 /end MEASUREMENT
/begin CHARACTERISTIC CAL_Vcf_TrqFbkLMin_f32 "CAL_Vcf_TrqFbkLMin_f32" VALUE 0x00000000 Scalar_FLOAT32_IEEE 0 BSW_A2L_Ident_Float -3.4E+38 3.4E+38 /end CHARACTERISTIC
/begin CHARACTERISTIC CAL_Hspf_iDcLnkEstFltFrq_f32 "CAL_Hspf_iDcLnkEstFltFrq_f32" VALUE 0x00000000 Scalar_FLOAT32_IEEE 0 BSW_A2L_Ident_Float -3.4E+38 3.4E+38 /end CHARACTERISTIC
/begin CHARACTERISTIC CAL_TpcCod_NegSpdDirStop_f32 "CAL_TpcCod_NegSpdDirStop_f32" VALUE 0x00000000 Scalar_FLOAT32_IEEE 0 BSW_A2L_Ident_Float -3.4E+38 3.4E+38 /end CHARACTERISTIC
/begin CHARACTERISTIC CAL_Pwm3ph_DutyMax_f32 "CAL_Pwm3ph_DutyMax_f32" VALUE 0x00000000 Scalar_FLOAT32_IEEE 0 BSW_A2L_Ident_Float -3.4E+38 3.4E+38 /end CHARACTERISTIC
/begin MEASUREMENT VAR_PcfSig_flgP_b "VAR_PcfSig_flgP_b" UBYTE BSW_A2L_Ident_Int 1 100 0 1 ECU_ADDRESS 0x00000000 /end MEASUREMENT
/begin CHARACTERISTIC CAL_DEM_Disbl_DFC_CANSM_E_BUS_OFF_NETWORK_0_u8 "CAL_DEM_Disbl_DFC_CANSM_E_BUS_OFF_NETWORK_0_u8" VALUE 0x00000000 Scalar_UBYTE 0 BSW_A2L_Ident_Int 0 255 /end CHARACTERISTIC
/begin CHARACTERISTIC CAL_TRSP_CurrRngErrRst_b "CAL_TRSP_CurrRngErrRst_b" VALUE 0x00000000 Scalar_BOOLEAN 0 BSW_A2L_Ident_Int 0 1 /end CHARACTERISTIC
/begin CHARACTERISTIC CAL_Cspf_CodeVer_u16 "CAL_Cspf_CodeVer_u16" VALUE 0x00000000 Scalar_UWORD 0 BSW_A2L_Ident_Int 0 65535 /end CHARACTERISTIC
/begin MEASUREMENT VAR_DEM_Event_SCF_LowPwrShtDwnOvTiFail_Status_u8 "VAR_DEM_Event_SCF_LowPwrShtDwnOvTiFail_Status_u8" UBYTE BSW_A2L_Ident_Int 1 100 0 255 ECU_ADDRESS 0x00000000 /end MEASUREMENT
/begin CHARACTERISTIC CAL_MCF_flgUseZeroCtl_b "CAL_MCF_flgUseZeroCtl_b" VALUE 0x00000000 Scalar_BOOLEAN 0 BSW_A2L_Ident_Int 0 1 /end CHARACTERISTIC
/begin CHARACTERISTIC CAL_Cspf_tCoolantTempFlt_f32 "CAL_Cspf_tCoolantTempFlt_f32" VALUE 0x00000000 Scalar_FLOAT32_IEEE 0 BSW_A2L_Ident_Float -3.4E+38 3.4E+38 /end CHARACTERISTIC
/begin CHARACTERISTIC CAL_DEM_FIM_DFC_Epark_SampFail_au8 "CAL_DEM_FIM_DFC_Epark_SampFail_au8" VAL_BLK 0x00000000 Scalar_UBYTE 0 FID_Verb 0 255 NUMBER 10 /end CHARACTERISTIC
/begin CHARACTERISTIC CAL_DEM_Disbl_DFC_HSPF_MotorOpenErr_u8 "CAL_DEM_Disbl_DFC_HSPF_MotorOpenErr_u8" VALUE 0x00000000 Scalar_UBYTE 0 BSW_A2L_Ident_Int 0 255 /end CHARACTERISTIC
/begin CHARACTERISTIC CAL_Cspf_flgIdcMinSwt_b "CAL_Cspf_flgIdcMinSwt_b" VALUE 0x00000000 Scalar_BOOLEAN 0 BSW_A2L_Ident_Int 0 1 /end CHARACTERISTIC
/begin CHARACTERISTIC CAL_RCF_WithoutStatorCurrent_u8 "CAL_RCF_WithoutStatorCurrent_u8" VALUE 0x00000000 Scalar_UBYTE 0 BSW_A2L_Ident_Int 0 255 /end CHARACTERISTIC
/begin CHARACTERISTIC CAL_Vcf_StandByReq_u8 "CAL_Vcf_StandByReq_u8" VALUE 0x00000000 Scalar_UBYTE 0 BSW_A2L_Ident_Int 0 255 /end CHARACTERISTIC
/begin CHARACTERISTIC CAL_ADM_flgstModeReqSwt_b "CAL_ADM_flgstModeReqSwt_b" VALUE 0x00000000 Scalar_BOOLEAN 0 BSW_A2L_Ident_Int 0 1 /end CHARACTERISTIC
/begin MEASUREMENT VAR_DEM_FidTraceEvents_au8 "VAR_DEM_FidTraceEvents_au8" UBYTE BSW_A2L_Ident_Int 1 100 0 255 ARRAY_SIZE 127 ECU_ADDRESS 0x00000000 /end MEASUREMENT
/begin CHARACTERISTIC CAL_DEM_FIM_DFC_Cpld_UnderVol_LS_InFail_au8 "CAL_DEM_FIM_DFC_Cpld_UnderVol_LS_InFail_au8" VAL_BLK 0x00000000 Scalar_UBYTE 0 FID_Verb 0 255 NUMBER 10 /end CHARACTERISTIC
/begin MEASUREMENT VAR_RCF_flgAccToSucd_b "VAR_RCF_flgAccToSucd_b" UBYTE BSW_A2L_Ident_Int 1 100 0 1 ECU_ADDRESS 0x00000000 /end MEASUREMENT
/begin MEASUREMENT VAR_Scf_flgTranStbToRun_b "VAR_Scf_flgTranStbToRun_b" UBYTE BSW_A2L_Ident_Int 1 100 0 1 ECU_ADDRESS 0x00000000 /end MEASUREMENT
/begin MEASUREMENT VAR_TRSP_UBRVoltRngErr_b "VAR_TRSP_UBRVoltRngErr_b" UBYTE BSW_A2L_Ident_Int 1 100 0 1 ECU_ADDRESS 0x00000000 /end MEASUREMENT
/begin MEASUREMENT VAR_MDF_offsetDeltaFlt_f32 "VAR_MDF_offsetDeltaFlt_f32" FLOAT32_IEEE BSW_A2L_Ident_Float 1 100 -3.4E+38 3.4E+38 ECU_ADDRESS 0x00000000 /end MEASUREMENT
/begin CHARACTERISTIC CAL_DEM_Disbl_DFC_PCF_StallWarn_u8 "CAL_DEM_Disbl_DFC_PCF_StallWarn_u8" VALUE 0x00000000 Scalar_UBYTE 0 BSW_A2L_Ident_Int 0 255 /end CHARACTERISTIC
/begin MEASUREMENT VAR_DEM_EvtFailedList_au8 "VAR_DEM_EvtFailedList_au8" UBYTE BSW_A2L_Ident_Int 1 100 0 255 ARRAY_SIZE 24 ECU_ADDRESS 0x00000000 /end MEASUREMENT
/begin MEASUREMENT VAR_TRSP_RslvSensVoltRngErr_b "VAR_TRSP_RslvSensVoltRngErr_b" UBYTE BSW_A2L_Ident_Int 1 100 0 1 ECU_ADDRESS 0x00000000 /end MEASUREMENT
/begin CHARACTERISTIC CAL_TjrthLv4ilil_f32 "CAL_TjrthLv4ilil_f32" VALUE 0x00000000 Scalar_FLOAT32_IEEE 0 BSW_A2L_Ident_Float -3.4E+38 3.4E+38 /end CHARACTERISTIC
/begin CHARACTERISTIC CAL_Cspf_nSlowFlt_f32 "CAL_Cspf_nSlowFlt_f32" VALUE 0x00000000 Scalar_FLOAT32_IEEE 0 BSW_A2L_Ident_Float -3.4E+38 3.4E+38 /end CHARACTERISTIC
/begin MEASUREMENT VAR_TpcSmp_uDcLnkOvVLimErrState_u8 "VAR_TpcSmp_uDcLnkOvVLimErrState_u8" UBYTE BSW_A2L_Ident_Int 1 100 0 255 ECU_ADDRESS 0x00000000 /end MEASUREMENT
/begin MEASUREMENT VAR_PcfSig_flgIoc_b "VAR_PcfSig_flgIoc_b" UBYTE BSW_A2L_Ident_Int 1 100 0 1 ECU_ADDRESS 0x00000000 /end MEASUREMENT
/begin MEASUREMENT VAR_TLF35584_InitFinish_Flag_b "VAR_TLF35584_InitFinish_Flag_b" UBYTE BSW_A2L_Ident_Int 1 100 0 1 ECU_ADDRESS 0x00000000 /end MEASUREMENT
/begin MEASUREMENT VAR_MCF_isdFW_f32 "VAR_MCF_isdFW_f32" FLOAT32_IEEE BSW_A2L_Ident_Float 1 100 -3.4E+38 3.4E+38 ECU_ADDRESS 0x00000000 /end MEASUREMENT
/begin MEASUREMENT VAR_L2Sampling_RslvSinP_VADC_Max1_u16 "VAR_L2Sampling_RslvSinP_VADC_Max1_u16" UWORD BSW_A2L_Ident_Int 1 100 0 65535 ECU_ADDRESS 0x00000000 /end MEASUREMENT
/begin CHARACTERISTIC CAL_TjrthLv4ilih_f32 "CAL_TjrthLv4ilih_f32" VALUE 0x00000000 Scalar_FLOAT32_IEEE 0 BSW_A2L_Ident_Float -3.4E+38 3.4E+38 /end CHARACTERISTIC
/begin MEASUREMENT VAR_TpcMot_TrqGenExC_f32 "VAR_TpcMot_TrqGenExC_f32" FLOAT32_IEEE BSW_A2L_Ident_Float 1 100 -3.4E+38 3.4E+38 ECU_ADDRESS 0x00000000 /end MEASUREMENT
/begin CHARACTERISTIC CAL_TpcCod_FlgUseTrqLimRampSet_b "CAL_TpcCod_FlgUseTrqLimRampSet_b" VALUE 0x00000000 Scalar_BOOLEAN 0 BSW_A2L_Ident_Int 0 1 /end CHARACTERISTIC
/begin MEASUREMENT VAR_TCF_Pinput_f32 "VAR_TCF_Pinput_f32" FLOAT32_IEEE BSW_A2L_Ident_Float 1 100 -3.4E+38 3.4E+38 ECU_ADDRESS 0x00000000 /end MEASUREMENT
/begin CHARACTERISTIC CAL_RCF_cntMovAveFilBwd_u16 "CAL_RCF_cntMovAveFilBwd_u16" VALUE 0x00000000 Scalar_UWORD 0 BSW_A2L_Ident_Int 0 65535 /end CHARACTERISTIC
/begin CHARACTERISTIC CAL_FRP_TrqSetPRngErrOutCtl_b "CAL_FRP_TrqSetPRngErrOutCtl_b" VALUE 0x00000000 Scalar_BOOLEAN 0 BSW_A2L_Ident_Int 0 1 /end CHARACTERISTIC
/begin MEASUREMENT VAR_tpccod_flgMaxDertTDrvBoard_b "VAR_tpccod_flgMaxDertTDrvBoard_b" UBYTE BSW_A2L_Ident_Int 1 100 0 1 ECU_ADDRESS 0x00000000 /end MEASUREMENT
/begin CHARACTERISTIC CAL_PcfCtl_PosKi_f32 "CAL_PcfCtl_PosKi_f32" VALUE 0x00000000 Scalar_FLOAT32_IEEE 0 BSW_A2L_Ident_Float -3.4E+38 3.4E+38 /end CHARACTERISTIC
/begin MEASUREMENT VAR_TpcFuv_GenPwrLimDiag_f32 "VAR_TpcFuv_GenPwrLimDiag_f32" FLOAT32_IEEE BSW_A2L_Ident_Float 1 100 -3.4E+38 3.4E+38 ECU_ADDRESS 0x00000000 /end MEASUREMENT
/begin MEASUREMENT VAR_TRSP_UCurrRngChkRslt_b "VAR_TRSP_UCurrRngChkRslt_b" UBYTE BSW_A2L_Ident_Int 1 100 0 1 ECU_ADDRESS 0x00000000 /end MEASUREMENT
/begin CHARACTERISTIC CAL_Scf_IntDchaSwt_b "CAL_Scf_IntDchaSwt_b" VALUE 0x00000000 Scalar_BOOLEAN 0 BSW_A2L_Ident_Int 0 1 /end CHARACTERISTIC
/begin CHARACTERISTIC CAL_PcfSig_stDoor_u8 "CAL_PcfSig_stDoor_u8" VALUE 0x00000000 Scalar_UBYTE 0 BSW_A2L_Ident_Int 0 255 /end CHARACTERISTIC
/begin MEASUREMENT VAR_DEM_Event_PCF_IdcOvErr_Status_u8 "VAR_DEM_Event_PCF_IdcOvErr_Status_u8" UBYTE BSW_A2L_Ident_Int 1 100 0 255 ECU_ADDRESS 0x00000000 /end MEASUREMENT
/begin MEASUREMENT VAR_tpccod_flgMaxDertTCoolant_b "VAR_tpccod_flgMaxDertTCoolant_b" UBYTE BSW_A2L_Ident_Int 1 100 0 1 ECU_ADDRESS 0x00000000 /end MEASUREMENT
/begin CHARACTERISTIC CAL_Hspf_CrashChkCntHiLim_u8 "CAL_Hspf_CrashChkCntHiLim_u8" VALUE 0x00000000 Scalar_UBYTE 0 BSW_A2L_Ident_Int 0 255 /end CHARACTERISTIC
/begin MEASUREMENT VAR_TpcCod_CoolantFlowReq_f32 "VAR_TpcCod_CoolantFlowReq_f32" FLOAT32_IEEE BSW_A2L_Ident_Float 1 100 -3.4E+38 3.4E+38 ECU_ADDRESS 0x00000000 /end MEASUREMENT
/begin CHARACTERISTIC CAL_Hspf_TmpUFltFrq_f32 "CAL_Hspf_TmpUFltFrq_f32" VALUE 0x00000000 Scalar_FLOAT32_IEEE 0 BSW_A2L_Ident_Float -3.4E+38 3.4E+38 /end CHARACTERISTIC
/begin CHARACTERISTIC CAL_Scf_ShtDwnReqByVcuSwt_b "CAL_Scf_ShtDwnReqByVcuSwt_b" VALUE 0x00000000 Scalar_BOOLEAN 0 BSW_A2L_Ident_Int 0 1 /end CHARACTERISTIC
/begin CHARACTERISTIC CAL_MCF_KpMotHeat_f32 "CAL_MCF_KpMotHeat_f32" VALUE 0x00000000 Scalar_FLOAT32_IEEE 0 BSW_A2L_Ident_Float -3.4E+38 3.4E+38 /end CHARACTERISTIC
/begin CHARACTERISTIC CAL_PcfDia_flgFaultSwt_b "CAL_PcfDia_flgFaultSwt_b" VALUE 0x00000000 Scalar_BOOLEAN 0 BSW_A2L_Ident_Int 0 1 /end CHARACTERISTIC
/begin MEASUREMENT VAR_TCF_TrqDir_u8 "VAR_TCF_TrqDir_u8" UBYTE BSW_A2L_Ident_Int 1 100 0 255 ECU_ADDRESS 0x00000000 /end MEASUREMENT
/begin MEASUREMENT VAR_Cspf_TrastTrqEmMin_u8 "VAR_Cspf_TrastTrqEmMin_u8" UBYTE BSW_A2L_Ident_Int 1 100 0 255 ECU_ADDRESS 0x00000000 /end MEASUREMENT
/begin CHARACTERISTIC CAL_Scf_nSubPsmSpdVal_f32 "CAL_Scf_nSubPsmSpdVal_f32" VALUE 0x00000000 Scalar_FLOAT32_IEEE 0 BSW_A2L_Ident_Float -3.4E+38 3.4E+38 /end CHARACTERISTIC
/begin CHARACTERISTIC CAL_DEM_Disbl_DFC_PCF_SenClbErr_u8 "CAL_DEM_Disbl_DFC_PCF_SenClbErr_u8" VALUE 0x00000000 Scalar_UBYTE 0 BSW_A2L_Ident_Int 0 255 /end CHARACTERISTIC
/begin CHARACTERISTIC CAL_Hspf_VerMatchTimeOutErr_u8 "CAL_Hspf_VerMatchTimeOutErr_u8" VALUE 0x00000000 Scalar_UBYTE 0 BSW_A2L_Ident_Int 0 255 /end CHARACTERISTIC
/begin CHARACTERISTIC CAL_Hvmcu_UdcOvLi_Value_f32 "CAL_Hvmcu_UdcOvLi_Value_f32" VALUE 0x00000000 Scalar_FLOAT32_IEEE 0 BSW_A2L_Ident_Float -3.4E+38 3.4E+38 /end CHARACTERISTIC
/begin MEASUREMENT VAR_PcfStm_flgEnAutoInP_b "VAR_PcfStm_flgEnAutoInP_b" UBYTE BSW_A2L_Ident_Int 1 100 0 1 ECU_ADDRESS 0x00000000 /end MEASUREMENT
/begin CHARACTERISTIC CAL_DEM_Disbl_DFC_IOHWAB_KL30SevUnderVolFail_u8 "CAL_DEM_Disbl_DFC_IOHWAB_KL30SevUnderVolFail_u8" VALUE 0x00000000 Scalar_UBYTE 0 BSW_A2L_Ident_Int 0 255 /end CHARACTERISTIC
/begin CHARACTERISTIC CAL_Tpc_NormalMode_u8 "CAL_Tpc_NormalMode_u8" VALUE 0x00000000 Scalar_UBYTE 0 BSW_A2L_Ident_Int 0 255 /end CHARACTERISTIC
/begin CHARACTERISTIC CAL_Vcf_Crawltrqadd1_f32 "CAL_Vcf_Crawltrqadd1_f32" VALUE 0x00000000 Scalar_FLOAT32_IEEE 0 BSW_A2L_Ident_Float -3.4E+38 3.4E+38 /end CHARACTERISTIC
/begin MEASUREMENT VAR_PcfSig_PosAimOutP_f32 "VAR_PcfSig_PosAimOutP_f32" FLOAT32_IEEE BSW_A2L_Ident_Float 1 100 -3.4E+38 3.4E+38 ECU_ADDRESS 0x00000000 /end MEASUREMENT
/begin CHARACTERISTIC CAL_Cspf_flgOfsClbSucSwt_b "CAL_Cspf_flgOfsClbSucSwt_b" VALUE 0x00000000 Scalar_BOOLEAN 0 BSW_A2L_Ident_Int 0 1 /end CHARACTERISTIC
/begin CHARACTERISTIC CAL_PcfDia_tMosHighSet_f32 "CAL_PcfDia_tMosHighSet_f32" VALUE 0x00000000 Scalar_FLOAT32_IEEE 0 BSW_A2L_Ident_Float -3.4E+38 3.4E+38 /end CHARACTERISTIC
/begin MEASUREMENT VAR_Cspf_TraiGBTTempU_f32 "VAR_Cspf_TraiGBTTempU_f32" FLOAT32_IEEE BSW_A2L_Ident_Float 1 100 -3.4E+38 3.4E+38 ECU_ADDRESS 0x00000000 /end MEASUREMENT
/begin CHARACTERISTIC CAL_Vcf_OvCrawlDspd_f32 "CAL_Vcf_OvCrawlDspd_f32" VALUE 0x00000000 Scalar_FLOAT32_IEEE 0 BSW_A2L_Ident_Float -3.4E+38 3.4E+38 /end CHARACTERISTIC
/begin CHARACTERISTIC CAL_MDF_nDidMin_f32 "CAL_MDF_nDidMin_f32" VALUE 0x00000000 Scalar_FLOAT32_IEEE 0 BSW_A2L_Ident_Float -3.4E+38 3.4E+38 /end CHARACTERISTIC
/begin CHARACTERISTIC CAL_TpcTmp_CoolTempRiseDiff_f32 "CAL_TpcTmp_CoolTempRiseDiff_f32" VALUE 0x00000000 Scalar_FLOAT32_IEEE 0 BSW_A2L_Ident_Float -3.4E+38 3.4E+38 /end CHARACTERISTIC
/begin MEASUREMENT VAR_Vcf_CrawlFlg_b "VAR_Vcf_CrawlFlg_b" UBYTE BSW_A2L_Ident_Int 1 100 0 1 ECU_ADDRESS 0x00000000 /end MEASUREMENT
/begin CHARACTERISTIC CAL_Cspf_flgFailCode5Swt_b "CAL_Cspf_flgFailCode5Swt_b" VALUE 0x00000000 Scalar_BOOLEAN 0 BSW_A2L_Ident_Int 0 1 /end CHARACTERISTIC
/begin MEASUREMENT VAR_flgRecVCU06_u8 "VAR_flgRecVCU06_u8" UBYTE BSW_A2L_Ident_Int 1 100 0 255 ECU_ADDRESS 0x00000000 /end MEASUREMENT
/begin MEASUREMENT VAR_PcfDia_flgUdcLoErr_b "VAR_PcfDia_flgUdcLoErr_b" UBYTE BSW_A2L_Ident_Int 1 100 0 1 ECU_ADDRESS 0x00000000 /end MEASUREMENT
/begin MEASUREMENT VAR_Scf_flgTranNormalToDcha_b "VAR_Scf_flgTranNormalToDcha_b" UBYTE BSW_A2L_Ident_Int 1 100 0 1 ECU_ADDRESS 0x00000000 /end MEASUREMENT
/begin CHARACTERISTIC CAL_ADM_VoltCmpChkErrCntThr_s16 "CAL_ADM_VoltCmpChkErrCntThr_s16" VALUE 0x00000000 Scalar_SWORD 0 BSW_A2L_Ident_Int -32768 32767 /end CHARACTERISTIC
/begin CHARACTERISTIC CAL_RCF_nCalcSec8_f32 "CAL_RCF_nCalcSec8_f32" VALUE 0x00000000 Scalar_FLOAT32_IEEE 0 BSW_A2L_Ident_Float -3.4E+38 3.4E+38 /end CHARACTERISTIC
/begin CHARACTERISTIC CAL_BCC_dycLowLimt_f32 "CAL_BCC_dycLowLimt_f32" VALUE 0x00000000 Scalar_FLOAT32_IEEE 0 BSW_A2L_Ident_Float -3.4E+38 3.4E+38 /end CHARACTERISTIC
/begin MEASUREMENT VAR_Bsw_Crash_b "VAR_Bsw_Crash_b" UBYTE BSW_A2L_Ident_Int 1 100 0 1 ECU_ADDRESS 0x00000000 /end MEASUREMENT
/begin MEASUREMENT VAR_Cspf_TraTempCurrCooL_f32 "VAR_Cspf_TraTempCurrCooL_f32" FLOAT32_IEEE BSW_A2L_Ident_Float 1 100 -3.4E+38 3.4E+38 ECU_ADDRESS 0x00000000 /end MEASUREMENT
/begin MEASUREMENT VAR_TCF_idAct_f32 "VAR_TCF_idAct_f32" FLOAT32_IEEE BSW_A2L_Ident_Float 1 100 -3.4E+38 3.4E+38 ECU_ADDRESS 0x00000000 /end MEASUREMENT
/begin CHARACTERISTIC CAL_DEM_FIM_DFC_SCF_DisChgOvTiFail_au8 "CAL_DEM_FIM_DFC_SCF_DisChgOvTiFail_au8" VAL_BLK 0x00000000 Scalar_UBYTE 0 FID_Verb 0 255 NUMBER 10 /end CHARACTERISTIC
/begin MEASUREMENT VAR_ADM_VoltCmpChkErr_b "VAR_ADM_VoltCmpChkErr_b" UBYTE BSW_A2L_Ident_Int 1 100 0 1 ECU_ADDRESS 0x00000000 /end MEASUREMENT
/begin CHARACTERISTIC CAL_Cspf_flgiDcLnkEstFltSwt_b "CAL_Cspf_flgiDcLnkEstFltSwt_b" VALUE 0x00000000 Scalar_BOOLEAN 0 BSW_A2L_Ident_Int 0 1 /end CHARACTERISTIC
/begin CHARACTERISTIC CAL_SWD_Radian_u16 "CAL_SWD_Radian_u16" VALUE 0x00000000 Scalar_UWORD 0 BSW_A2L_Ident_Int 0 65535 /end CHARACTERISTIC
/begin MEASUREMENT VAR_Bsw_tStrrTemp2_u16 "VAR_Bsw_tStrrTemp2_u16" UWORD BSW_A2L_Ident_Int 1 100 0 65535 ECU_ADDRESS 0x00000000 /end MEASUREMENT
/begin CHARACTERISTIC CAL_DEM_FIM_DFC_Cpld_UnderVol_HS_InFail_au8 "CAL_DEM_FIM_DFC_Cpld_UnderVol_HS_InFail_au8" VAL_BLK 0x00000000 Scalar_UBYTE 0 FID_Verb 0 255 NUMBER 10 /end CHARACTERISTIC
/begin MEASUREMENT VAR_PcfStm_flgEnAutoOutP_b "VAR_PcfStm_flgEnAutoOutP_b" UBYTE BSW_A2L_Ident_Int 1 100 0 1 ECU_ADDRESS 0x00000000 /end MEASUREMENT
/begin CHARACTERISTIC CAL_Cspf_flgHvMcuVerSwt_b "CAL_Cspf_flgHvMcuVerSwt_b" VALUE 0x00000000 Scalar_BOOLEAN 0 BSW_A2L_Ident_Int 0 1 /end CHARACTERISTIC
/begin CHARACTERISTIC CAL_Cspf_TrqMax_f32 "CAL_Cspf_TrqMax_f32" VALUE 0x00000000 Scalar_FLOAT32_IEEE 0 BSW_A2L_Ident_Float -3.4E+38 3.4E+38 /end CHARACTERISTIC
/begin CHARACTERISTIC CAL_TpcBlk_BlkTimSet_u16 "CAL_TpcBlk_BlkTimSet_u16" VALUE 0x00000000 Scalar_UWORD 0 BSW_A2L_Ident_Int 0 65535 /end CHARACTERISTIC
/begin MEASUREMENT VAR_L2Sampling_Exci18VLS_MON_u16 "VAR_L2Sampling_Exci18VLS_MON_u16" UWORD BSW_A2L_Ident_Int 1 100 0 65535 ECU_ADDRESS 0x00000000 /end MEASUREMENT
/begin MEASUREMENT VAR_TpcCod_GenTrqLim_f32 "VAR_TpcCod_GenTrqLim_f32" FLOAT32_IEEE BSW_A2L_Ident_Float 1 100 -3.4E+38 3.4E+38 ECU_ADDRESS 0x00000000 /end MEASUREMENT
/begin CHARACTERISTIC CAL_PcfCtl_ManualDty_f32 "CAL_PcfCtl_ManualDty_f32" VALUE 0x00000000 Scalar_FLOAT32_IEEE 0 BSW_A2L_Ident_Float -3.4E+38 3.4E+38 /end CHARACTERISTIC
/begin CHARACTERISTIC CAL_RDC_flgNrealOrNset_b "CAL_RDC_flgNrealOrNset_b" VALUE 0x00000000 Scalar_BOOLEAN 0 BSW_A2L_Ident_Int 0 1 /end CHARACTERISTIC
/begin MEASUREMENT VAR_DEM_Event_Cpld_UdcOverVolFail_Status_u8 "VAR_DEM_Event_Cpld_UdcOverVolFail_Status_u8" UBYTE BSW_A2L_Ident_Int 1 100 0 255 ECU_ADDRESS 0x00000000 /end MEASUREMENT
/begin MEASUREMENT VAR_PcfDia_flgHwIdcOv_b "VAR_PcfDia_flgHwIdcOv_b" UBYTE BSW_A2L_Ident_Int 1 100 0 1 ECU_ADDRESS 0x00000000 /end MEASUREMENT
/begin CHARACTERISTIC CAL_TCF_MotorPole_u8 "CAL_TCF_MotorPole_u8" VALUE 0x00000000 Scalar_UBYTE 0 BSW_A2L_Ident_Int 0 255 /end CHARACTERISTIC
/begin CHARACTERISTIC CAL_MDF_tiAlfOfsNoPlauseFault_f32 "CAL_MDF_tiAlfOfsNoPlauseFault_f32" VALUE 0x00000000 Scalar_FLOAT32_IEEE 0 BSW_A2L_Ident_Float -3.4E+38 3.4E+38 /end CHARACTERISTIC
/begin CHARACTERISTIC CAL_MCF_FlgUseDeadCpn_b "CAL_MCF_FlgUseDeadCpn_b" VALUE 0x00000000 Scalar_BOOLEAN 0 BSW_A2L_Ident_Int 0 1 /end CHARACTERISTIC
/begin CHARACTERISTIC CAL_MCF_SpdOffActiveHeat_f32 "CAL_MCF_SpdOffActiveHeat_f32" VALUE 0x00000000 Scalar_FLOAT32_IEEE 0 BSW_A2L_Ident_Float -3.4E+38 3.4E+38 /end CHARACTERISTIC
/begin MEASUREMENT VAR_RDC_flgLotErr_b "VAR_RDC_flgLotErr_b" UBYTE BSW_A2L_Ident_Int 1 100 0 1 ECU_ADDRESS 0x00000000 /end MEASUREMENT
/begin MEASUREMENT VAR_STM_UintndTrqMonRslt_b "VAR_STM_UintndTrqMonRslt_b" UBYTE BSW_A2L_Ident_Int 1 100 0 1 ECU_ADDRESS 0x00000000 /end MEASUREMENT
/begin CHARACTERISTIC CAL_Cspf_IdcMin_f32 "CAL_Cspf_IdcMin_f32" VALUE 0x00000000 Scalar_FLOAT32_IEEE 0 BSW_A2L_Ident_Float -3.4E+38 3.4E+38 /end CHARACTERISTIC
/begin MEASUREMENT VAR_CheckSumValue_u8 "VAR_CheckSumValue_u8" UBYTE BSW_A2L_Ident_Int 1 100 0 255 ECU_ADDRESS 0x00000000 /end MEASUREMENT
/begin CHARACTERISTIC CAL_Cspf_TrqMin_f32 "CAL_Cspf_TrqMin_f32" VALUE 0x00000000 Scalar_FLOAT32_IEEE 0 BSW_A2L_Ident_Float -3.4E+38 3.4E+38 /end CHARACTERISTIC
/begin MEASUREMENT VAR_TRSP_RslvExciNRngErr_b "VAR_TRSP_RslvExciNRngErr_b" UBYTE BSW_A2L_Ident_Int 1 100 0 1 ECU_ADDRESS 0x00000000 /end MEASUREMENT
/begin MEASUREMENT VAR_RCF_flgEnblOfsClbFrwhl_b "VAR_RCF_flgEnblOfsClbFrwhl_b" UBYTE BSW_A2L_Ident_Int 1 100 0 1 ECU_ADDRESS 0x00000000 /end MEASUREMENT
/begin CHARACTERISTIC CAL_BCC_iThetaOffset_f32 "CAL_BCC_iThetaOffset_f32" VALUE 0x00000000 Scalar_FLOAT32_IEEE 0 BSW_A2L_Ident_Float -3.4E+38 3.4E+38 /end CHARACTERISTIC
/begin CHARACTERISTIC CAL_RCF_agReferenceBwd_f32 "CAL_RCF_agReferenceBwd_f32" VALUE 0x00000000 Scalar_FLOAT32_IEEE 0 BSW_A2L_Ident_Float -3.4E+38 3.4E+38 /end CHARACTERISTIC
/begin MEASUREMENT VAR_STM0_SWC_10ms_Task_Core0_u32 "VAR_STM0_SWC_10ms_Task_Core0_u32" ULONG BSW_A2L_Ident_Int 1 100 0 4294967295 ECU_ADDRESS 0x00000000 /end MEASUREMENT
/begin CHARACTERISTIC CAL_MCF_DeadTimeCpn_f32 "CAL_MCF_DeadTimeCpn_f32" VALUE 0x00000000 Scalar_FLOAT32_IEEE 0 BSW_A2L_Ident_Float -3.4E+38 3.4E+38 /end CHARACTERISTIC
/begin CHARACTERISTIC CAL_Tpcmot_flgOpenExcLimRamp_b "CAL_Tpcmot_flgOpenExcLimRamp_b" VALUE 0x00000000 Scalar_BOOLEAN 0 BSW_A2L_Ident_Int 0 1 /end CHARACTERISTIC
/begin MEASUREMENT VAR_MCF_uBetaDeadCpn_f32 "VAR_MCF_uBetaDeadCpn_f32" FLOAT32_IEEE BSW_A2L_Ident_Float 1 100 -3.4E+38 3.4E+38 ECU_ADDRESS 0x00000000 /end MEASUREMENT
/begin CHARACTERISTIC CAL_TpcTmp_tCoolantTraNormalToSave1_f32 "CAL_TpcTmp_tCoolantTraNormalToSave1_f32" VALUE 0x00000000 Scalar_FLOAT32_IEEE 0 BSW_A2L_Ident_Float -3.4E+38 3.4E+38 /end CHARACTERISTIC
/begin MEASUREMENT VAR_TpcTmp_TCoolantOvHiWarnState_u8 "VAR_TpcTmp_TCoolantOvHiWarnState_u8" UBYTE BSW_A2L_Ident_Int 1 100 0 255 ECU_ADDRESS 0x00000000 /end MEASUREMENT
/begin MEASUREMENT VAR_3phPWMVH_Duty_f32 "VAR_3phPWMVH_Duty_f32" FLOAT32_IEEE BSW_A2L_Ident_Float 1 100 -3.4E+38 3.4E+38 ECU_ADDRESS 0x00000000 /end MEASUREMENT
/begin CHARACTERISTIC CAL_TpcCod_NTCLowTemp_f32 "CAL_TpcCod_NTCLowTemp_f32" VALUE 0x00000000 Scalar_FLOAT32_IEEE 0 BSW_A2L_Ident_Float -3.4E+38 3.4E+38 /end CHARACTERISTIC
/begin MEASUREMENT VAR_TpcTmp_CofDertTDbcSave1_f32 "VAR_TpcTmp_CofDertTDbcSave1_f32" FLOAT32_IEEE BSW_A2L_Ident_Float 1 100 -3.4E+38 3.4E+38 ECU_ADDRESS 0x00000000 /end MEASUREMENT
/begin MEASUREMENT VAR_MDF_bEMBlkChk_b "VAR_MDF_bEMBlkChk_b" UBYTE BSW_A2L_Ident_Int 1 100 0 1 ECU_ADDRESS 0x00000000 /end MEASUREMENT
/begin MEASUREMENT VAR_MDF_PhaseFaultState_u8 "VAR_MDF_PhaseFaultState_u8" UBYTE BSW_A2L_Ident_Int 1 100 0 255 ECU_ADDRESS 0x00000000 /end MEASUREMENT
/begin CHARACTERISTIC CAL_RCF_UsAlfaScalSet_f32 "CAL_RCF_UsAlfaScalSet_f32" VALUE 0x00000000 Scalar_FLOAT32_IEEE 0 BSW_A2L_Ident_Float -3.4E+38 3.4E+38 /end CHARACTERISTIC
/begin CHARACTERISTIC CAL_MCF_uqDecoupki_f32 "CAL_MCF_uqDecoupki_f32" VALUE 0x00000000 Scalar_FLOAT32_IEEE 0 BSW_A2L_Ident_Float -3.4E+38 3.4E+38 /end CHARACTERISTIC
/begin MEASUREMENT VAR_MCF_EmfBack_f32 "VAR_MCF_EmfBack_f32" FLOAT32_IEEE BSW_A2L_Ident_Float 1 100 -3.4E+38 3.4E+38 ECU_ADDRESS 0x00000000 /end MEASUREMENT
/begin CHARACTERISTIC CAL_MDF_PwrDcLinkEstFlt_f32 "CAL_MDF_PwrDcLinkEstFlt_f32" VALUE 0x00000000 Scalar_FLOAT32_IEEE 0 BSW_A2L_Ident_Float -3.4E+38 3.4E+38 /end CHARACTERISTIC
/begin MEASUREMENT VAR_MCF_HSPF_stIphaOffCal_u8 "VAR_MCF_HSPF_stIphaOffCal_u8" UBYTE BSW_A2L_Ident_Int 1 100 0 255 ECU_ADDRESS 0x00000000 /end MEASUREMENT
/begin CHARACTERISTIC CAL_FRP_RslvSensVolRngErrOutCtl_b "CAL_FRP_RslvSensVolRngErrOutCtl_b" VALUE 0x00000000 Scalar_BOOLEAN 0 BSW_A2L_Ident_Int 0 1 /end CHARACTERISTIC
/begin CHARACTERISTIC CAL_TpcMot_flgPwrRefSwt_b "CAL_TpcMot_flgPwrRefSwt_b" VALUE 0x00000000 Scalar_BOOLEAN 0 BSW_A2L_Ident_Int 0 1 /end CHARACTERISTIC
/begin CHARACTERISTIC CAL_TjrthLv4dldl_f32 "CAL_TjrthLv4dldl_f32" VALUE 0x00000000 Scalar_FLOAT32_IEEE 0 BSW_A2L_Ident_Float -3.4E+38 3.4E+38 /end CHARACTERISTIC
/begin MEASUREMENT VAR_DEM_Event_IOHWAB_Cpld1v8SampFail_Status_u8 "VAR_DEM_Event_IOHWAB_Cpld1v8SampFail_Status_u8" UBYTE BSW_A2L_Ident_Int 1 100 0 255 ECU_ADDRESS 0x00000000 /end MEASUREMENT
/begin CHARACTERISTIC CAL_DEM_Disbl_DFC_Epark_PosSampFail_u8 "CAL_DEM_Disbl_DFC_Epark_PosSampFail_u8" VALUE 0x00000000 Scalar_UBYTE 0 BSW_A2L_Ident_Int 0 255 /end CHARACTERISTIC
/begin CHARACTERISTIC CAL_Vcf_TrqFbkLMaxNeg_f32 "CAL_Vcf_TrqFbkLMaxNeg_f32" VALUE 0x00000000 Scalar_FLOAT32_IEEE 0 BSW_A2L_Ident_Float -3.4E+38 3.4E+38 /end CHARACTERISTIC
/begin MEASUREMENT VAR_PcfStm_flgActJudgeToSLRun_b "VAR_PcfStm_flgActJudgeToSLRun_b" UBYTE BSW_A2L_Ident_Int 1 100 0 1 ECU_ADDRESS 0x00000000 /end MEASUREMENT
/begin CHARACTERISTIC CAL_Hspf_stPreDrvCtl_u8 "CAL_Hspf_stPreDrvCtl_u8" VALUE 0x00000000 Scalar_UBYTE 0 BSW_A2L_Ident_Int 0 255 /end CHARACTERISTIC
/begin MEASUREMENT VAR_Scf_flgTranPostDrvToPreDrv_b "VAR_Scf_flgTranPostDrvToPreDrv_b" UBYTE BSW_A2L_Ident_Int 1 100 0 1 ECU_ADDRESS 0x00000000 /end MEASUREMENT
/begin MEASUREMENT VAR_IgbtDrv_Level_NFLTB_u8 "VAR_IgbtDrv_Level_NFLTB_u8" UBYTE BSW_A2L_Ident_Int 1 100 0 255 ECU_ADDRESS 0x00000000 /end MEASUREMENT
/begin CHARACTERISTIC CAL_Cspf_agOffset_f32 "CAL_Cspf_agOffset_f32" VALUE 0x00000000 Scalar_FLOAT32_IEEE 0 BSW_A2L_Ident_Float -3.4E+38 3.4E+38 /end CHARACTERISTIC
/begin CHARACTERISTIC CAL_RdcRslExcFaultMin_f32 "CAL_RdcRslExcFaultMin_f32" VALUE 0x00000000 Scalar_FLOAT32_IEEE 0 BSW_A2L_Ident_Float -3.4E+38 3.4E+38 /end CHARACTERISTIC
/begin MEASUREMENT VAR_TRSP_iU_f32 "VAR_TRSP_iU_f32" FLOAT32_IEEE BSW_A2L_Ident_Float 1 100 -3.4E+38 3.4E+38 ECU_ADDRESS 0x00000000 /end MEASUREMENT
/begin CHARACTERISTIC CAL_DEM_FIM_DFC_Epark_PosSampFail_au8 "CAL_DEM_FIM_DFC_Epark_PosSampFail_au8" VAL_BLK 0x00000000 Scalar_UBYTE 0 FID_Verb 0 255 NUMBER 10 /end CHARACTERISTIC
/begin MEASUREMENT VAR_L2Sampling_DycVMon_f32 "VAR_L2Sampling_DycVMon_f32" FLOAT32_IEEE BSW_A2L_Ident_Float 1 100 -3.4E+38 3.4E+38 ECU_ADDRESS 0x00000000 /end MEASUREMENT
/begin CHARACTERISTIC CAL_TpcMot_SttrTempKp_f32 "CAL_TpcMot_SttrTempKp_f32" VALUE 0x00000000 Scalar_FLOAT32_IEEE 0 BSW_A2L_Ident_Float -3.4E+38 3.4E+38 /end CHARACTERISTIC
/begin CHARACTERISTIC CAL_MDF_tiPhaFaultDelay_f32 "CAL_MDF_tiPhaFaultDelay_f32" VALUE 0x00000000 Scalar_FLOAT32_IEEE 0 BSW_A2L_Ident_Float -3.4E+38 3.4E+38 /end CHARACTERISTIC
/begin MEASUREMENT VAR_IoHwAb_Adc_Phy_5V_Qt1_f32 "VAR_IoHwAb_Adc_Phy_5V_Qt1_f32" FLOAT32_IEEE BSW_A2L_Ident_Float 1 100 -3.4E+38 3.4E+38 ECU_ADDRESS 0x00000000 /end MEASUREMENT
/begin CHARACTERISTIC CAL_MPC_Lq_f32 "CAL_MPC_Lq_f32" VALUE 0x00000000 Scalar_FLOAT32_IEEE 0 BSW_A2L_Ident_Float -3.4E+38 3.4E+38 /end CHARACTERISTIC
/begin MEASUREMENT VAR_flgRecVCU07_u8 "VAR_flgRecVCU07_u8" UBYTE BSW_A2L_Ident_Int 1 100 0 255 ECU_ADDRESS 0x00000000 /end MEASUREMENT
/begin CHARACTERISTIC CAL_TpcMot_tSttrTraSave1ToNormal_f32 "CAL_TpcMot_tSttrTraSave1ToNormal_f32" VALUE 0x00000000 Scalar_FLOAT32_IEEE 0 BSW_A2L_Ident_Float -3.4E+38 3.4E+38 /end CHARACTERISTIC
/begin MEASUREMENT VAR_PcfSig_VDD5Pcf_f32 "VAR_PcfSig_VDD5Pcf_f32" FLOAT32_IEEE BSW_A2L_Ident_Float 1 100 -3.4E+38 3.4E+38 ECU_ADDRESS 0x00000000 /end MEASUREMENT
/begin MEASUREMENT VAR_Rdc_Cos_s16 "VAR_Rdc_Cos_s16" SWORD BSW_A2L_Ident_Int 1 100 -32768 32767 ECU_ADDRESS 0x00000000 /end MEASUREMENT
/begin CHARACTERISTIC CAL_MCF_flgUseFF_b "CAL_MCF_flgUseFF_b" VALUE 0x00000000 Scalar_BOOLEAN 0 BSW_A2L_Ident_Int 0 1 /end CHARACTERISTIC
/begin MEASUREMENT VAR_PcfDia_flgtMosOv_b "VAR_PcfDia_flgtMosOv_b" UBYTE BSW_A2L_Ident_Int 1 100 0 1 ECU_ADDRESS 0x00000000 /end MEASUREMENT
/begin CHARACTERISTIC CAL_Scf_cntWakeLoss_u16 "CAL_Scf_cntWakeLoss_u16" VALUE 0x00000000 Scalar_UWORD 0 BSW_A2L_Ident_Int 0 65535 /end CHARACTERISTIC
/begin CHARACTERISTIC CAL_MDF_Pwr3PhaFlt_f32 "CAL_MDF_Pwr3PhaFlt_f32" VALUE 0x00000000 Scalar_FLOAT32_IEEE 0 BSW_A2L_Ident_Float -3.4E+38 3.4E+38 /end CHARACTERISTIC
/begin CHARACTERISTIC CAL_TCF_TrqInvalid_s16 "CAL_TCF_TrqInvalid_s16" VALUE 0x00000000 Scalar_SWORD 0 BSW_A2L_Ident_Int -32768 32767 /end CHARACTERISTIC
/begin MEASUREMENT VAR_TLF35584_SelfTestFinish_Flag_b "VAR_TLF35584_SelfTestFinish_Flag_b" UBYTE BSW_A2L_Ident_Int 1 100 0 1 ECU_ADDRESS 0x00000000 /end MEASUREMENT
/begin CHARACTERISTIC CAL_Vcf_tDamping_f32 "CAL_Vcf_tDamping_f32" VALUE 0x00000000 Scalar_FLOAT32_IEEE 0 BSW_A2L_Ident_Float -3.4E+38 3.4E+38 /end CHARACTERISTIC
/begin CHARACTERISTIC CAL_RCF_tUAlfaSet_u32 "CAL_RCF_tUAlfaSet_u32" VALUE 0x00000000 Scalar_ULONG 0 BSW_A2L_Ident_Int 0 4294967295 /end CHARACTERISTIC
/begin CHARACTERISTIC CAL_Vcf_TrqDmpSwt_b "CAL_Vcf_TrqDmpSwt_b" VALUE 0x00000000 Scalar_BOOLEAN 0 BSW_A2L_Ident_Int 0 1 /end CHARACTERISTIC
/begin CHARACTERISTIC CAL_TpcSmp_iDcLnkOvCGenLim_f32 "CAL_TpcSmp_iDcLnkOvCGenLim_f32" VALUE 0x00000000 Scalar_FLOAT32_IEEE 0 BSW_A2L_Ident_Float -3.4E+38 3.4E+38 /end CHARACTERISTIC
/begin MEASUREMENT VAR_MCF_UsUseRateReal_f32 "VAR_MCF_UsUseRateReal_f32" FLOAT32_IEEE BSW_A2L_Ident_Float 1 100 -3.4E+38 3.4E+38 ECU_ADDRESS 0x00000000 /end MEASUREMENT
/begin MEASUREMENT VAR_FS_RDC_Quadrant_u8 "VAR_FS_RDC_Quadrant_u8" UBYTE BSW_A2L_Ident_Int 1 100 0 255 ECU_ADDRESS 0x00000000 /end MEASUREMENT
/begin MEASUREMENT VAR_TpcFuv_GenTrqLimDiag_f32 "VAR_TpcFuv_GenTrqLimDiag_f32" FLOAT32_IEEE BSW_A2L_Ident_Float 1 100 -3.4E+38 3.4E+38 ECU_ADDRESS 0x00000000 /end MEASUREMENT
/begin MEASUREMENT VAR_Hspf_bSwtTempSttr2_b "VAR_Hspf_bSwtTempSttr2_b" UBYTE BSW_A2L_Ident_Int 1 100 0 1 ECU_ADDRESS 0x00000000 /end MEASUREMENT
/begin MEASUREMENT VAR_PWM3phWDuty_ERR_u8 "VAR_PWM3phWDuty_ERR_u8" UBYTE BSW_A2L_Ident_Int 1 100 0 255 ECU_ADDRESS 0x00000000 /end MEASUREMENT
/begin MEASUREMENT VAR_TpcSmp_ElecPwrLinearDertOvrCurt_f32 "VAR_TpcSmp_ElecPwrLinearDertOvrCurt_f32" FLOAT32_IEEE BSW_A2L_Ident_Float 1 100 -3.4E+38 3.4E+38 ECU_ADDRESS 0x00000000 /end MEASUREMENT
/begin MEASUREMENT VAR_TpcSmp_uDcLnkMin_f32 "VAR_TpcSmp_uDcLnkMin_f32" FLOAT32_IEEE BSW_A2L_Ident_Float 1 100 -3.4E+38 3.4E+38 ECU_ADDRESS 0x00000000 /end MEASUREMENT
/begin CHARACTERISTIC CAL_PcfStm_SLActimeLimt_u16 "CAL_PcfStm_SLActimeLimt_u16" VALUE 0x00000000 Scalar_UWORD 0 BSW_A2L_Ident_Int 0 65535 /end CHARACTERISTIC
/begin CHARACTERISTIC CAL_DEM_Disbl_DFC_HSPF_stIphaOffCalFail_u8 "CAL_DEM_Disbl_DFC_HSPF_stIphaOffCalFail_u8" VALUE 0x00000000 Scalar_UBYTE 0 BSW_A2L_Ident_Int 0 255 /end CHARACTERISTIC
/begin CHARACTERISTIC CAL_MCF_isdSet_f32 "CAL_MCF_isdSet_f32" VALUE 0x00000000 Scalar_FLOAT32_IEEE 0 BSW_A2L_Ident_Float -3.4E+38 3.4E+38 /end CHARACTERISTIC
/begin CHARACTERISTIC CAL_IOHWAB_DIO_AN30_IUVW_N_REF_DEM_f32 "CAL_IOHWAB_DIO_AN30_IUVW_N_REF_DEM_f32" VALUE 0x00000000 Scalar_FLOAT32_IEEE 0 BSW_A2L_Ident_Float -3.4E+38 3.4E+38 /end CHARACTERISTIC
/begin MEASUREMENT VAR_MCF_IsSet11ZR_f32 "VAR_MCF_IsSet11ZR_f32" FLOAT32_IEEE BSW_A2L_Ident_Float 1 100 -3.4E+38 3.4E+38 ECU_ADDRESS 0x00000000 /end MEASUREMENT
/begin MEASUREMENT VAR_TpcCod_ElecTrqCalcUdrVolt_f32 "VAR_TpcCod_ElecTrqCalcUdrVolt_f32" FLOAT32_IEEE BSW_A2L_Ident_Float 1 100 -3.4E+38 3.4E+38 ECU_ADDRESS 0x00000000 /end MEASUREMENT
/begin CHARACTERISTIC CAL_DEM_FIM_DFC_IgbtDrv_LwBrgFaultAFail_au8 "CAL_DEM_FIM_DFC_IgbtDrv_LwBrgFaultAFail_au8" VAL_BLK 0x00000000 Scalar_UBYTE 0 FID_Verb 0 255 NUMBER 10 /end CHARACTERISTIC
/begin CHARACTERISTIC CAL_MDF_nAbsThresOpenCirNoPsbl_f32 "CAL_MDF_nAbsThresOpenCirNoPsbl_f32" VALUE 0x00000000 Scalar_FLOAT32_IEEE 0 BSW_A2L_Ident_Float -3.4E+38 3.4E+38 /end CHARACTERISTIC
/begin MEASUREMENT VAR_TpcTmp_ElecTrqLimTdbc_f32 "VAR_TpcTmp_ElecTrqLimTdbc_f32" FLOAT32_IEEE BSW_A2L_Ident_Float 1 100 -3.4E+38 3.4E+38 ECU_ADDRESS 0x00000000 /end MEASUREMENT
/begin CHARACTERISTIC CAL_MDF_nDidMax_f32 "CAL_MDF_nDidMax_f32" VALUE 0x00000000 Scalar_FLOAT32_IEEE 0 BSW_A2L_Ident_Float -3.4E+38 3.4E+38 /end CHARACTERISTIC
/begin CHARACTERISTIC CAL_TpcCod_CoolFlow1LReq_f32 "CAL_TpcCod_CoolFlow1LReq_f32" VALUE 0x00000000 Scalar_FLOAT32_IEEE 0 BSW_A2L_Ident_Float -3.4E+38 3.4E+38 /end CHARACTERISTIC
/begin CHARACTERISTIC CAL_MCF_ActiveHeatNormal_u8 "CAL_MCF_ActiveHeatNormal_u8" VALUE 0x00000000 Scalar_UBYTE 0 BSW_A2L_Ident_Int 0 255 /end CHARACTERISTIC
/begin MEASUREMENT VAR_UdlTjtIGBT_f32 "VAR_UdlTjtIGBT_f32" FLOAT32_IEEE BSW_A2L_Ident_Float 1 100 -3.4E+38 3.4E+38 ECU_ADDRESS 0x00000000 /end MEASUREMENT
/begin MEASUREMENT VAR_RCF_flgBwClbSucdToAcc_b "VAR_RCF_flgBwClbSucdToAcc_b" UBYTE BSW_A2L_Ident_Int 1 100 0 1 ECU_ADDRESS 0x00000000 /end MEASUREMENT
/begin CHARACTERISTIC CAL_Cspf_bDernOvrIdc_u8 "CAL_Cspf_bDernOvrIdc_u8" VALUE 0x00000000 Scalar_UBYTE 0 BSW_A2L_Ident_Int 0 255 /end CHARACTERISTIC
/begin MEASUREMENT VAR_PcfCtl_enMosOutPID_b "VAR_PcfCtl_enMosOutPID_b" UBYTE BSW_A2L_Ident_Int 1 100 0 1 ECU_ADDRESS 0x00000000 /end MEASUREMENT
/begin CHARACTERISTIC CAL_DEM_FIM_DFC_IOHWAB_CrashFail_au8 "CAL_DEM_FIM_DFC_IOHWAB_CrashFail_au8" VAL_BLK 0x00000000 Scalar_UBYTE 0 FID_Verb 0 255 NUMBER 10 /end CHARACTERISTIC
/begin CHARACTERISTIC CAL_TjLv3Act_f32 "CAL_TjLv3Act_f32" VALUE 0x00000000 Scalar_FLOAT32_IEEE 0 BSW_A2L_Ident_Float -3.4E+38 3.4E+38 /end CHARACTERISTIC
/begin CHARACTERISTIC CAL_TpcCod_PosSpdDirStop_f32 "CAL_TpcCod_PosSpdDirStop_f32" VALUE 0x00000000 Scalar_FLOAT32_IEEE 0 BSW_A2L_Ident_Float -3.4E+38 3.4E+38 /end CHARACTERISTIC
/begin CHARACTERISTIC CAL_Scf_nAllwPwrDcha_f32 "CAL_Scf_nAllwPwrDcha_f32" VALUE 0x00000000 Scalar_FLOAT32_IEEE 0 BSW_A2L_Ident_Float -3.4E+38 3.4E+38 /end CHARACTERISTIC
/begin MEASUREMENT VAR_tpcsmp_ElecPwrDert_f32 "VAR_tpcsmp_ElecPwrDert_f32" FLOAT32_IEEE BSW_A2L_Ident_Float 1 100 -3.4E+38 3.4E+38 ECU_ADDRESS 0x00000000 /end MEASUREMENT
/begin CHARACTERISTIC CAL_Hspf_tSwtTempSttrLoLim_f32 "CAL_Hspf_tSwtTempSttrLoLim_f32" VALUE 0x00000000 Scalar_FLOAT32_IEEE 0 BSW_A2L_Ident_Float -3.4E+38 3.4E+38 /end CHARACTERISTIC
/begin MEASUREMENT VAR_TpcMot_GenTrqRef_f32 "VAR_TpcMot_GenTrqRef_f32" FLOAT32_IEEE BSW_A2L_Ident_Float 1 100 -3.4E+38 3.4E+38 ECU_ADDRESS 0x00000000 /end MEASUREMENT
/begin MEASUREMENT VAR_PcfDia_flgStallFault_b "VAR_PcfDia_flgStallFault_b" UBYTE BSW_A2L_Ident_Int 1 100 0 1 ECU_ADDRESS 0x00000000 /end MEASUREMENT
/begin CHARACTERISTIC CAL_MDF_IsErrThres_f32 "CAL_MDF_IsErrThres_f32" VALUE 0x00000000 Scalar_FLOAT32_IEEE 0 BSW_A2L_Ident_Float -3.4E+38 3.4E+38 /end CHARACTERISTIC
/begin MEASUREMENT VAR_Vcf_AsrOvHiLim_b "VAR_Vcf_AsrOvHiLim_b" UBYTE BSW_A2L_Ident_Int 1 100 0 1 ECU_ADDRESS 0x00000000 /end MEASUREMENT
/begin CHARACTERISTIC CAL_MDF_IsErrFlt_f32 "CAL_MDF_IsErrFlt_f32" VALUE 0x00000000 Scalar_FLOAT32_IEEE 0 BSW_A2L_Ident_Float -3.4E+38 3.4E+38 /end CHARACTERISTIC
/begin MEASUREMENT VAR_TDC_trqRmp_f32 "VAR_TDC_trqRmp_f32" FLOAT32_IEEE BSW_A2L_Ident_Float 1 100 -3.4E+38 3.4E+38 ECU_ADDRESS 0x00000000 /end MEASUREMENT
/begin CHARACTERISTIC CAL_POWER_VDD18_Threhold_Max_f32 "CAL_POWER_VDD18_Threhold_Max_f32" VALUE 0x00000000 Scalar_FLOAT32_IEEE 0 BSW_A2L_Ident_Float -3.4E+38 3.4E+38 /end CHARACTERISTIC
/begin MEASUREMENT VAR_TpcTmp_TDbcWHiLimErrState_u8 "VAR_TpcTmp_TDbcWHiLimErrState_u8" UBYTE BSW_A2L_Ident_Int 1 100 0 255 ECU_ADDRESS 0x00000000 /end MEASUREMENT
/begin MEASUREMENT VAR_RCF_flgEnblOfsClbFrwhlBwd_b "VAR_RCF_flgEnblOfsClbFrwhlBwd_b" UBYTE BSW_A2L_Ident_Int 1 100 0 1 ECU_ADDRESS 0x00000000 /end MEASUREMENT
/begin MEASUREMENT VAR_RCF_OfsFlt4400Fwd_f32 "VAR_RCF_OfsFlt4400Fwd_f32" FLOAT32_IEEE BSW_A2L_Ident_Float 1 100 -3.4E+38 3.4E+38 ECU_ADDRESS 0x00000000 /end MEASUREMENT
/begin CHARACTERISTIC CAL_TpcMot_SttrTempRiseDiff_f32 "CAL_TpcMot_SttrTempRiseDiff_f32" VALUE 0x00000000 Scalar_FLOAT32_IEEE 0 BSW_A2L_Ident_Float -3.4E+38 3.4E+38 /end CHARACTERISTIC
/begin CHARACTERISTIC CAL_Cspf_HwVer_u16 "CAL_Cspf_HwVer_u16" VALUE 0x00000000 Scalar_UWORD 0 BSW_A2L_Ident_Int 0 65535 /end CHARACTERISTIC
/begin CHARACTERISTIC CAL_DEM_Disbl_DFC_CANSM_E_BUS_OFF_NETWORK_1_u8 "CAL_DEM_Disbl_DFC_CANSM_E_BUS_OFF_NETWORK_1_u8" VALUE 0x00000000 Scalar_UBYTE 0 BSW_A2L_Ident_Int 0 255 /end CHARACTERISTIC
/begin MEASUREMENT VAR_DEM_Event_SCF_DisChgOvTiFail_Status_u8 "VAR_DEM_Event_SCF_DisChgOvTiFail_Status_u8" UBYTE BSW_A2L_Ident_Int 1 100 0 255 ECU_ADDRESS 0x00000000 /end MEASUREMENT
/begin MEASUREMENT VAR_tpcsmp_AddPwrElecOvrCurt_f32 "VAR_tpcsmp_AddPwrElecOvrCurt_f32" FLOAT32_IEEE BSW_A2L_Ident_Float 1 100 -3.4E+38 3.4E+38 ECU_ADDRESS 0x00000000 /end MEASUREMENT
/begin CHARACTERISTIC CAL_Cspf_FailCode5_u8 "CAL_Cspf_FailCode5_u8" VALUE 0x00000000 Scalar_UBYTE 0 BSW_A2L_Ident_Int 0 255 /end CHARACTERISTIC
/begin MEASUREMENT VAR_DEM_Event_Cpld_ParityChkErr_Status_u8 "VAR_DEM_Event_Cpld_ParityChkErr_Status_u8" UBYTE BSW_A2L_Ident_Int 1 100 0 255 ECU_ADDRESS 0x00000000 /end MEASUREMENT
/begin MEASUREMENT VAR_Scf_nDchaAllw_b "VAR_Scf_nDchaAllw_b" UBYTE BSW_A2L_Ident_Int 1 100 0 1 ECU_ADDRESS 0x00000000 /end MEASUREMENT
/begin CHARACTERISTIC CAL_DEM_Disbl_DFC_HvMcu_UdcOverVolErr_u8 "CAL_DEM_Disbl_DFC_HvMcu_UdcOverVolErr_u8" VALUE 0x00000000 Scalar_UBYTE 0 BSW_A2L_Ident_Int 0 255 /end CHARACTERISTIC
/begin MEASUREMENT VAR_TpcCod_GenTrqCalcDiag_f32 "VAR_TpcCod_GenTrqCalcDiag_f32" FLOAT32_IEEE BSW_A2L_Ident_Float 1 100 -3.4E+38 3.4E+38 ECU_ADDRESS 0x00000000 /end MEASUREMENT
/begin MEASUREMENT VAR_DEM_Event_PCF_StallWarn_Status_u8 "VAR_DEM_Event_PCF_StallWarn_Status_u8" UBYTE BSW_A2L_Ident_Int 1 100 0 255 ECU_ADDRESS 0x00000000 /end MEASUREMENT
/begin CHARACTERISTIC CAL_Scf_iSubSttrisVal_f32 "CAL_Scf_iSubSttrisVal_f32" VALUE 0x00000000 Scalar_FLOAT32_IEEE 0 BSW_A2L_Ident_Float -3.4E+38 3.4E+38 /end CHARACTERISTIC
/begin CHARACTERISTIC CAL_Cspf_tStrrTemp2Flt_f32 "CAL_Cspf_tStrrTemp2Flt_f32" VALUE 0x00000000 Scalar_FLOAT32_IEEE 0 BSW_A2L_Ident_Float -3.4E+38 3.4E+38 /end CHARACTERISTIC
/begin CHARACTERISTIC CAL_TpcMot_tRiseSttrTraSave2ToOverheating_f32 "CAL_TpcMot_tRiseSttrTraSave2ToOverheating_f32" VALUE 0x00000000 Scalar_FLOAT32_IEEE 0 BSW_A2L_Ident_Float -3.4E+38 3.4E+38 /end CHARACTERISTIC
/begin MEASUREMENT VAR_STM0_SWC_100ms_Task_Core0_u32 "VAR_STM0_SWC_100ms_Task_Core0_u32" ULONG BSW_A2L_Ident_Int 1 100 0 4294967295 ECU_ADDRESS 0x00000000 /end MEASUREMENT
/begin CHARACTERISTIC CAL_DEM_FIM_DFC_IgbtDrv_LwBrgFaultBFail_au8 "CAL_DEM_FIM_DFC_IgbtDrv_LwBrgFaultBFail_au8" VAL_BLK 0x00000000 Scalar_UBYTE 0 FID_Verb 0 255 NUMBER 10 /end CHARACTERISTIC
/begin MEASUREMENT VAR_TpcTmp_ElecTrqLimTIGBT_f32 "VAR_TpcTmp_ElecTrqLimTIGBT_f32" FLOAT32_IEEE BSW_A2L_Ident_Float 1 100 -3.4E+38 3.4E+38 ECU_ADDRESS 0x00000000 /end MEASUREMENT
/begin MEASUREMENT VAR_DEM_Event_HSPF_tDBCTempCmpErr_Status_u8 "VAR_DEM_Event_HSPF_tDBCTempCmpErr_Status_u8" UBYTE BSW_A2L_Ident_Int 1 100 0 255 ECU_ADDRESS 0x00000000 /end MEASUREMENT
/begin MEASUREMENT VAR_L2Sampling_18VHS_MON_u16 "VAR_L2Sampling_18VHS_MON_u16" UWORD BSW_A2L_Ident_Int 1 100 0 65535 ECU_ADDRESS 0x00000000 /end MEASUREMENT
/begin CHARACTERISTIC CAL_Vcf_TrqDmpNegMax_f32 "CAL_Vcf_TrqDmpNegMax_f32" VALUE 0x00000000 Scalar_FLOAT32_IEEE 0 BSW_A2L_Ident_Float -3.4E+38 3.4E+38 /end CHARACTERISTIC
/begin MEASUREMENT VAR_WihTjtIGBT_f32 "VAR_WihTjtIGBT_f32" FLOAT32_IEEE BSW_A2L_Ident_Float 1 100 -3.4E+38 3.4E+38 ECU_ADDRESS 0x00000000 /end MEASUREMENT
/begin MEASUREMENT VAR_Cspf_TraTrqAbsMax_f32 "VAR_Cspf_TraTrqAbsMax_f32" FLOAT32_IEEE BSW_A2L_Ident_Float 1 100 -3.4E+38 3.4E+38 ECU_ADDRESS 0x00000000 /end MEASUREMENT
/begin MEASUREMENT VAR_MDF_DiashCirNoPsblState_u8 "VAR_MDF_DiashCirNoPsblState_u8" UBYTE BSW_A2L_Ident_Int 1 100 0 255 ECU_ADDRESS 0x00000000 /end MEASUREMENT
/begin MEASUREMENT VAR_WTjpwr_f32 "VAR_WTjpwr_f32" FLOAT32_IEEE BSW_A2L_Ident_Float 1 100 -3.4E+38 3.4E+38 ECU_ADDRESS 0x00000000 /end MEASUREMENT
/begin CHARACTERISTIC CAL_TpcTmp_IGBTRiseTempDecDiff_f32 "CAL_TpcTmp_IGBTRiseTempDecDiff_f32" VALUE 0x00000000 Scalar_FLOAT32_IEEE 0 BSW_A2L_Ident_Float -3.4E+38 3.4E+38 /end CHARACTERISTIC
/begin CHARACTERISTIC CAL_MCF_isThetaSet_f32 "CAL_MCF_isThetaSet_f32" VALUE 0x00000000 Scalar_FLOAT32_IEEE 0 BSW_A2L_Ident_Float -3.4E+38 3.4E+38 /end CHARACTERISTIC
/begin CHARACTERISTIC CAL_DEM_FIM_DFC_HvMcu_EmerPowerSapErr_au8 "CAL_DEM_FIM_DFC_HvMcu_EmerPowerSapErr_au8" VAL_BLK 0x00000000 Scalar_UBYTE 0 FID_Verb 0 255 NUMBER 10 /end CHARACTERISTIC
/begin MEASUREMENT VAR_PcfSig_nPcfMot_f32 "VAR_PcfSig_nPcfMot_f32" FLOAT32_IEEE BSW_A2L_Ident_Float 1 100 -3.4E+38 3.4E+38 ECU_ADDRESS 0x00000000 /end MEASUREMENT
/begin CHARACTERISTIC CAL_PcfDia_SLInPUp_f32 "CAL_PcfDia_SLInPUp_f32" VALUE 0x00000000 Scalar_FLOAT32_IEEE 0 BSW_A2L_Ident_Float -3.4E+38 3.4E+38 /end CHARACTERISTIC
/begin CHARACTERISTIC CAL_Cspf_flgFailCode3Swt_b "CAL_Cspf_flgFailCode3Swt_b" VALUE 0x00000000 Scalar_BOOLEAN 0 BSW_A2L_Ident_Int 0 1 /end CHARACTERISTIC
/begin CHARACTERISTIC CAL_TpcSmp_iDcLnkMinMax_f32 "CAL_TpcSmp_iDcLnkMinMax_f32" VALUE 0x00000000 Scalar_FLOAT32_IEEE 0 BSW_A2L_Ident_Float -3.4E+38 3.4E+38 /end CHARACTERISTIC
/begin CHARACTERISTIC CAL_TpcTmp_CoolChgTempUpDiff_f32 "CAL_TpcTmp_CoolChgTempUpDiff_f32" VALUE 0x00000000 Scalar_FLOAT32_IEEE 0 BSW_A2L_Ident_Float -3.4E+38 3.4E+38 /end CHARACTERISTIC
/begin CHARACTERISTIC CAL_PcfCtl_flgFnhSwt_b "CAL_PcfCtl_flgFnhSwt_b" VALUE 0x00000000 Scalar_BOOLEAN 0 BSW_A2L_Ident_Int 0 1 /end CHARACTERISTIC
/begin MEASUREMENT VAR_TpcSmp_TrqMaxCanSet_f32 "VAR_TpcSmp_TrqMaxCanSet_f32" FLOAT32_IEEE BSW_A2L_Ident_Float 1 100 -3.4E+38 3.4E+38 ECU_ADDRESS 0x00000000 /end MEASUREMENT
/begin MEASUREMENT VAR_Scf_flgTranFaultToPostDrv_b "VAR_Scf_flgTranFaultToPostDrv_b" UBYTE BSW_A2L_Ident_Int 1 100 0 1 ECU_ADDRESS 0x00000000 /end MEASUREMENT
/begin MEASUREMENT VAR_DEM_Event_Cpld_UnderVol_HS_InFail_Status_u8 "VAR_DEM_Event_Cpld_UnderVol_HS_InFail_Status_u8" UBYTE BSW_A2L_Ident_Int 1 100 0 255 ECU_ADDRESS 0x00000000 /end MEASUREMENT
/begin CHARACTERISTIC CAL_DEM_FIM_DFC_Epark_OverCurFail_au8 "CAL_DEM_FIM_DFC_Epark_OverCurFail_au8" VAL_BLK 0x00000000 Scalar_UBYTE 0 FID_Verb 0 255 NUMBER 10 /end CHARACTERISTIC
/begin CHARACTERISTIC CAL_MCF_CoefuDCLimtEOL_f32 "CAL_MCF_CoefuDCLimtEOL_f32" VALUE 0x00000000 Scalar_FLOAT32_IEEE 0 BSW_A2L_Ident_Float -3.4E+38 3.4E+38 /end CHARACTERISTIC
/begin MEASUREMENT VAR_DEM_Event_IgbtDrv_UpBrgFaultAFail_Status_u8 "VAR_DEM_Event_IgbtDrv_UpBrgFaultAFail_Status_u8" UBYTE BSW_A2L_Ident_Int 1 100 0 255 ECU_ADDRESS 0x00000000 /end MEASUREMENT
/begin MEASUREMENT VAR_IgbtDrv_Level_NFLTA_L_u8 "VAR_IgbtDrv_Level_NFLTA_L_u8" UBYTE BSW_A2L_Ident_Int 1 100 0 255 ECU_ADDRESS 0x00000000 /end MEASUREMENT
/begin CHARACTERISTIC CAL_Cspf_flgstMainReLaySwt_b "CAL_Cspf_flgstMainReLaySwt_b" VALUE 0x00000000 Scalar_BOOLEAN 0 BSW_A2L_Ident_Int 0 1 /end CHARACTERISTIC
/begin CHARACTERISTIC CAL_Vcf_HoldTrqInSwt_b "CAL_Vcf_HoldTrqInSwt_b" VALUE 0x00000000 Scalar_BOOLEAN 0 BSW_A2L_Ident_Int 0 1 /end CHARACTERISTIC
/begin CHARACTERISTIC CAL_ADM_flgCrash_b "CAL_ADM_flgCrash_b" VALUE 0x00000000 Scalar_BOOLEAN 0 BSW_A2L_Ident_Int 0 1 /end CHARACTERISTIC
/begin MEASUREMENT VAR_DEM_Event_ADC_WPhaseBISTFail_Status_u8 "VAR_DEM_Event_ADC_WPhaseBISTFail_Status_u8" UBYTE BSW_A2L_Ident_Int 1 100 0 255 ECU_ADDRESS 0x00000000 /end MEASUREMENT
/begin MEASUREMENT VAR_PcfCtl_PosDif_f32 "VAR_PcfCtl_PosDif_f32" FLOAT32_IEEE BSW_A2L_Ident_Float 1 100 -3.4E+38 3.4E+38 ECU_ADDRESS 0x00000000 /end MEASUREMENT
/begin CHARACTERISTIC CAL_TpcFuv_CofPwrLimLv2_f32 "CAL_TpcFuv_CofPwrLimLv2_f32" VALUE 0x00000000 Scalar_FLOAT32_IEEE 0 BSW_A2L_Ident_Float -3.4E+38 3.4E+38 /end CHARACTERISTIC
/begin CHARACTERISTIC CAL_DEM_Disbl_DFC_RSL_DOSErr_u8 "CAL_DEM_Disbl_DFC_RSL_DOSErr_u8" VALUE 0x00000000 Scalar_UBYTE 0 BSW_A2L_Ident_Int 0 255 /end CHARACTERISTIC
/begin MEASUREMENT VAR_TpcMot_GenPwrRef_f32 "VAR_TpcMot_GenPwrRef_f32" FLOAT32_IEEE BSW_A2L_Ident_Float 1 100 -3.4E+38 3.4E+38 ECU_ADDRESS 0x00000000 /end MEASUREMENT
/begin CHARACTERISTIC CAL_SWD_AgrslvCompCnt_f32 "CAL_SWD_AgrslvCompCnt_f32" VALUE 0x00000000 Scalar_FLOAT32_IEEE 0 BSW_A2L_Ident_Float -3.4E+38 3.4E+38 /end CHARACTERISTIC
/begin CHARACTERISTIC CAL_CddEparkTEST_ManualMosDir_b "CAL_CddEparkTEST_ManualMosDir_b" VALUE 0x00000000 Scalar_BOOLEAN 0 BSW_A2L_Ident_Int 0 1 /end CHARACTERISTIC
/begin CHARACTERISTIC CAL_TpcTmp_CoolTempAdds_f32 "CAL_TpcTmp_CoolTempAdds_f32" VALUE 0x00000000 Scalar_FLOAT32_IEEE 0 BSW_A2L_Ident_Float -3.4E+38 3.4E+38 /end CHARACTERISTIC
/begin CHARACTERISTIC CAL_DEM_FIM_DFC_Cpld_Short_Circuit_HS_InFail_au8 "CAL_DEM_FIM_DFC_Cpld_Short_Circuit_HS_InFail_au8" VAL_BLK 0x00000000 Scalar_UBYTE 0 FID_Verb 0 255 NUMBER 10 /end CHARACTERISTIC
/begin CHARACTERISTIC CAL_MDF_OfsDeltaAgFltFrq_f32 "CAL_MDF_OfsDeltaAgFltFrq_f32" VALUE 0x00000000 Scalar_FLOAT32_IEEE 0 BSW_A2L_Ident_Float -3.4E+38 3.4E+38 /end CHARACTERISTIC
/begin CHARACTERISTIC CAL_TpcBlk_BlkRevTimSet_u16 "CAL_TpcBlk_BlkRevTimSet_u16" VALUE 0x00000000 Scalar_UWORD 0 BSW_A2L_Ident_Int 0 65535 /end CHARACTERISTIC
/begin CHARACTERISTIC CAL_MCF_FlgUseClose_b "CAL_MCF_FlgUseClose_b" VALUE 0x00000000 Scalar_BOOLEAN 0 BSW_A2L_Ident_Int 0 1 /end CHARACTERISTIC
/begin CHARACTERISTIC CAL_TRSP_RslvRngSinPHiLim_u16 "CAL_TRSP_RslvRngSinPHiLim_u16" VALUE 0x00000000 Scalar_UWORD 0 BSW_A2L_Ident_Int 0 65535 /end CHARACTERISTIC
/begin CHARACTERISTIC CAL_DEM_Disbl_DFC_TPC_TDbcUHiLimFail_u8 "CAL_DEM_Disbl_DFC_TPC_TDbcUHiLimFail_u8" VALUE 0x00000000 Scalar_UBYTE 0 BSW_A2L_Ident_Int 0 255 /end CHARACTERISTIC
/begin MEASUREMENT VAR_PcfDia_flgBCLocked_b "VAR_PcfDia_flgBCLocked_b" UBYTE BSW_A2L_Ident_Int 1 100 0 1 ECU_ADDRESS 0x00000000 /end MEASUREMENT
/begin MEASUREMENT VAR_DEM_Event_Cpld_Short_Circuit_HS_InFail_Status_u8 "VAR_DEM_Event_Cpld_Short_Circuit_HS_InFail_Status_u8" UBYTE BSW_A2L_Ident_Int 1 100 0 255 ECU_ADDRESS 0x00000000 /end MEASUREMENT
/begin CHARACTERISTIC CAL_TpcBlk_MtrBlkIsSecondSet_f32 "CAL_TpcBlk_MtrBlkIsSecondSet_f32" VALUE 0x00000000 Scalar_FLOAT32_IEEE 0 BSW_A2L_Ident_Float -3.4E+38 3.4E+38 /end CHARACTERISTIC
/begin MEASUREMENT VAR_TpcFuv_FimPwrLimLv1_b "VAR_TpcFuv_FimPwrLimLv1_b" UBYTE BSW_A2L_Ident_Int 1 100 0 1 ECU_ADDRESS 0x00000000 /end MEASUREMENT
/begin CHARACTERISTIC CAL_Hspf_tDBCtempOffset_u8 "CAL_Hspf_tDBCtempOffset_u8" VALUE 0x00000000 Scalar_UBYTE 0 BSW_A2L_Ident_Int 0 255 /end CHARACTERISTIC
/begin CHARACTERISTIC CAL_Scf_flgDrvToPostWihDisSwt_b "CAL_Scf_flgDrvToPostWihDisSwt_b" VALUE 0x00000000 Scalar_BOOLEAN 0 BSW_A2L_Ident_Int 0 1 /end CHARACTERISTIC
/begin MEASUREMENT VAR_MDF_bAlfOfsNoPlauseFault_b "VAR_MDF_bAlfOfsNoPlauseFault_b" UBYTE BSW_A2L_Ident_Int 1 100 0 1 ECU_ADDRESS 0x00000000 /end MEASUREMENT
/begin MEASUREMENT VAR_SWD_Tan_f32 "VAR_SWD_Tan_f32" FLOAT32_IEEE BSW_A2L_Ident_Float 1 100 -3.4E+38 3.4E+38 ECU_ADDRESS 0x00000000 /end MEASUREMENT
/begin CHARACTERISTIC CAL_PcfStm_SLAccTrqDes_f32 "CAL_PcfStm_SLAccTrqDes_f32" VALUE 0x00000000 Scalar_FLOAT32_IEEE 0 BSW_A2L_Ident_Float -3.4E+38 3.4E+38 /end CHARACTERISTIC
/begin CHARACTERISTIC CAL_DEM_Disbl_DFC_IOHWAB_5VQt2SampFail_u8 "CAL_DEM_Disbl_DFC_IOHWAB_5VQt2SampFail_u8" VALUE 0x00000000 Scalar_UBYTE 0 BSW_A2L_Ident_Int 0 255 /end CHARACTERISTIC
/begin MEASUREMENT VAR_Tpcblk_TrqMin_f32 "VAR_Tpcblk_TrqMin_f32" FLOAT32_IEEE BSW_A2L_Ident_Float 1 100 -3.4E+38 3.4E+38 ECU_ADDRESS 0x00000000 /end MEASUREMENT
/begin CHARACTERISTIC CAL_PcfDia_SLOutPUp_f32 "CAL_PcfDia_SLOutPUp_f32" VALUE 0x00000000 Scalar_FLOAT32_IEEE 0 BSW_A2L_Ident_Float -3.4E+38 3.4E+38 /end CHARACTERISTIC
/begin CHARACTERISTIC CAL_TpcTmp_tIGBTTempLoLim_f32 "CAL_TpcTmp_tIGBTTempLoLim_f32" VALUE 0x00000000 Scalar_FLOAT32_IEEE 0 BSW_A2L_Ident_Float -3.4E+38 3.4E+38 /end CHARACTERISTIC
/begin CHARACTERISTIC CAL_TpcTmp_tDbcTraSave2ToOverheating_f32 "CAL_TpcTmp_tDbcTraSave2ToOverheating_f32" VALUE 0x00000000 Scalar_FLOAT32_IEEE 0 BSW_A2L_Ident_Float -3.4E+38 3.4E+38 /end CHARACTERISTIC
/begin MEASUREMENT VAR_TRSP_RslvExciNRngChkRslt_b "VAR_TRSP_RslvExciNRngChkRslt_b" UBYTE BSW_A2L_Ident_Int 1 100 0 1 ECU_ADDRESS 0x00000000 /end MEASUREMENT
/begin MEASUREMENT VAR_Scf_flgEmgReqInvDcha_b "VAR_Scf_flgEmgReqInvDcha_b" UBYTE BSW_A2L_Ident_Int 1 100 0 1 ECU_ADDRESS 0x00000000 /end MEASUREMENT
/begin CHARACTERISTIC CAL_RCF_nMinSuccessStp_f32 "CAL_RCF_nMinSuccessStp_f32" VALUE 0x00000000 Scalar_FLOAT32_IEEE 0 BSW_A2L_Ident_Float -3.4E+38 3.4E+38 /end CHARACTERISTIC
/begin MEASUREMENT VAR_MCF_IsThetaSet11ZR_f32 "VAR_MCF_IsThetaSet11ZR_f32" FLOAT32_IEEE BSW_A2L_Ident_Float 1 100 -3.4E+38 3.4E+38 ECU_ADDRESS 0x00000000 /end MEASUREMENT
/begin CHARACTERISTIC CAL_MDF_UdcFwMin_f32 "CAL_MDF_UdcFwMin_f32" VALUE 0x00000000 Scalar_FLOAT32_IEEE 0 BSW_A2L_Ident_Float -3.4E+38 3.4E+38 /end CHARACTERISTIC
/begin CHARACTERISTIC CAL_DEM_FIM_DFC_RCF_AccOvTiErr_au8 "CAL_DEM_FIM_DFC_RCF_AccOvTiErr_au8" VAL_BLK 0x00000000 Scalar_UBYTE 0 FID_Verb 0 255 NUMBER 10 /end CHARACTERISTIC
/begin CHARACTERISTIC CAL_TpcCod_PosSpdStart_f32 "CAL_TpcCod_PosSpdStart_f32" VALUE 0x00000000 Scalar_FLOAT32_IEEE 0 BSW_A2L_Ident_Float -3.4E+38 3.4E+38 /end CHARACTERISTIC
/begin MEASUREMENT VAR_TpcBlk_IsSum_f32 "VAR_TpcBlk_IsSum_f32" FLOAT32_IEEE BSW_A2L_Ident_Float 1 100 -3.4E+38 3.4E+38 ECU_ADDRESS 0x00000000 /end MEASUREMENT
/begin CHARACTERISTIC CAL_PcfSig_stBelt_u8 "CAL_PcfSig_stBelt_u8" VALUE 0x00000000 Scalar_UBYTE 0 BSW_A2L_Ident_Int 0 255 /end CHARACTERISTIC
/begin CHARACTERISTIC CAL_DEM_FIM_DFC_Cpld_SZTKT_InFail_au8 "CAL_DEM_FIM_DFC_Cpld_SZTKT_InFail_au8" VAL_BLK 0x00000000 Scalar_UBYTE 0 FID_Verb 0 255 NUMBER 10 /end CHARACTERISTIC
/begin CHARACTERISTIC CAL_TRSP_18VHSVoltCountTrh_s16 "CAL_TRSP_18VHSVoltCountTrh_s16" VALUE 0x00000000 Scalar_SWORD 0 BSW_A2L_Ident_Int -32768 32767 /end CHARACTERISTIC
/begin MEASUREMENT VAR_DEM_Event_RCF_OfsClbFail_Status_u8 "VAR_DEM_Event_RCF_OfsClbFail_Status_u8" UBYTE BSW_A2L_Ident_Int 1 100 0 255 ECU_ADDRESS 0x00000000 /end MEASUREMENT
/begin CHARACTERISTIC CAL_TCF_SpeedCtlMode_u8 "CAL_TCF_SpeedCtlMode_u8" VALUE 0x00000000 Scalar_UBYTE 0 BSW_A2L_Ident_Int 0 255 /end CHARACTERISTIC
/begin CHARACTERISTIC CAL_Cspf_MainReLay_u8 "CAL_Cspf_MainReLay_u8" VALUE 0x00000000 Scalar_UBYTE 0 BSW_A2L_Ident_Int 0 255 /end CHARACTERISTIC
/begin MEASUREMENT VAR_Scf_flgTranPreDrvToPostDrv_b "VAR_Scf_flgTranPreDrvToPostDrv_b" UBYTE BSW_A2L_Ident_Int 1 100 0 1 ECU_ADDRESS 0x00000000 /end MEASUREMENT
/begin MEASUREMENT VAR_PcfSig_IsenPcf_f32 "VAR_PcfSig_IsenPcf_f32" FLOAT32_IEEE BSW_A2L_Ident_Float 1 100 -3.4E+38 3.4E+38 ECU_ADDRESS 0x00000000 /end MEASUREMENT
/begin MEASUREMENT VAR_DEM_Event_IOHWAB_CrashFail_Status_u8 "VAR_DEM_Event_IOHWAB_CrashFail_Status_u8" UBYTE BSW_A2L_Ident_Int 1 100 0 255 ECU_ADDRESS 0x00000000 /end MEASUREMENT
/begin CHARACTERISTIC CAL_Cspf_flgCpldVerSwt_b "CAL_Cspf_flgCpldVerSwt_b" VALUE 0x00000000 Scalar_BOOLEAN 0 BSW_A2L_Ident_Int 0 1 /end CHARACTERISTIC
/begin MEASUREMENT VAR_WdlTjtIGBT_f32 "VAR_WdlTjtIGBT_f32" FLOAT32_IEEE BSW_A2L_Ident_Float 1 100 -3.4E+38 3.4E+38 ECU_ADDRESS 0x00000000 /end MEASUREMENT
/begin CHARACTERISTIC CAL_Hspf_INVOpenChkCntLoLim_s8 "CAL_Hspf_INVOpenChkCntLoLim_s8" VALUE 0x00000000 Scalar_BYTE 0 BSW_A2L_Ident_Int -128 127 /end CHARACTERISTIC
/begin CHARACTERISTIC CAL_MCF_ratLo_f32 "CAL_MCF_ratLo_f32" VALUE 0x00000000 Scalar_FLOAT32_IEEE 0 BSW_A2L_Ident_Float -3.4E+38 3.4E+38 /end CHARACTERISTIC
/begin MEASUREMENT VAR_TpcSmp_cofDertOvrSpdElecQuad1_f32 "VAR_TpcSmp_cofDertOvrSpdElecQuad1_f32" FLOAT32_IEEE BSW_A2L_Ident_Float 1 100 -3.4E+38 3.4E+38 ECU_ADDRESS 0x00000000 /end MEASUREMENT
/begin CHARACTERISTIC CAL_BCC_dycUpLimt_f32 "CAL_BCC_dycUpLimt_f32" VALUE 0x00000000 Scalar_FLOAT32_IEEE 0 BSW_A2L_Ident_Float -3.4E+38 3.4E+38 /end CHARACTERISTIC
/begin CHARACTERISTIC CAL_MCF_nDpwmOffDelay_f32 "CAL_MCF_nDpwmOffDelay_f32" VALUE 0x00000000 Scalar_FLOAT32_IEEE 0 BSW_A2L_Ident_Float -3.4E+38 3.4E+38 /end CHARACTERISTIC
/begin MEASUREMENT VAR_Scf_flgTranStbToIdle_b "VAR_Scf_flgTranStbToIdle_b" UBYTE BSW_A2L_Ident_Int 1 100 0 1 ECU_ADDRESS 0x00000000 /end MEASUREMENT
/begin MEASUREMENT VAR_TRSP_3V3CPLDVoltRngErr_b "VAR_TRSP_3V3CPLDVoltRngErr_b" UBYTE BSW_A2L_Ident_Int 1 100 0 1 ECU_ADDRESS 0x00000000 /end MEASUREMENT
/begin MEASUREMENT VAR_MCF_flgMotHeat_b "VAR_MCF_flgMotHeat_b" UBYTE BSW_A2L_Ident_Int 1 100 0 1 ECU_ADDRESS 0x00000000 /end MEASUREMENT
/begin MEASUREMENT VAR_WdhTjtIGBT_f32 "VAR_WdhTjtIGBT_f32" FLOAT32_IEEE BSW_A2L_Ident_Float 1 100 -3.4E+38 3.4E+38 ECU_ADDRESS 0x00000000 /end MEASUREMENT
/begin MEASUREMENT VAR_PcfSig_DycLim_f32 "VAR_PcfSig_DycLim_f32" FLOAT32_IEEE BSW_A2L_Ident_Float 1 100 -3.4E+38 3.4E+38 ECU_ADDRESS 0x00000000 /end MEASUREMENT
/begin MEASUREMENT VAR_ComRecNmFlag_u8 "VAR_ComRecNmFlag_u8" UBYTE BSW_A2L_Ident_Int 1 100 0 255 ECU_ADDRESS 0x00000000 /end MEASUREMENT
/begin CHARACTERISTIC CAL_PcfSig_flgPSwt_b "CAL_PcfSig_flgPSwt_b" VALUE 0x00000000 Scalar_BOOLEAN 0 BSW_A2L_Ident_Int 0 1 /end CHARACTERISTIC
/begin CHARACTERISTIC CAL_Hspf_uKl30FltFrq_f32 "CAL_Hspf_uKl30FltFrq_f32" VALUE 0x00000000 Scalar_FLOAT32_IEEE 0 BSW_A2L_Ident_Float -3.4E+38 3.4E+38 /end CHARACTERISTIC
/begin MEASUREMENT VAR_VdhTjtIGBT_f32 "VAR_VdhTjtIGBT_f32" FLOAT32_IEEE BSW_A2L_Ident_Float 1 100 -3.4E+38 3.4E+38 ECU_ADDRESS 0x00000000 /end MEASUREMENT
/begin MEASUREMENT VAR_MCF_uAlphaZero_f32 "VAR_MCF_uAlphaZero_f32" FLOAT32_IEEE BSW_A2L_Ident_Float 1 100 -3.4E+38 3.4E+38 ECU_ADDRESS 0x00000000 /end MEASUREMENT
/begin MEASUREMENT VAR_TpcSmp_ElecPwrPIDertUdrVolt_f32 "VAR_TpcSmp_ElecPwrPIDertUdrVolt_f32" FLOAT32_IEEE BSW_A2L_Ident_Float 1 100 -3.4E+38 3.4E+38 ECU_ADDRESS 0x00000000 /end MEASUREMENT
/begin CHARACTERISTIC CAL_PcfCtl_PrePos_f32 "CAL_PcfCtl_PrePos_f32" VALUE 0x00000000 Scalar_FLOAT32_IEEE 0 BSW_A2L_Ident_Float -3.4E+38 3.4E+38 /end CHARACTERISTIC
/begin MEASUREMENT VAR_TpcSmp_cofDertOvrCurtElec_f32 "VAR_TpcSmp_cofDertOvrCurtElec_f32" FLOAT32_IEEE BSW_A2L_Ident_Float 1 100 -3.4E+38 3.4E+38 ECU_ADDRESS 0x00000000 /end MEASUREMENT
/begin MEASUREMENT VAR_tpcsmp_GenPwrDert_f32 "VAR_tpcsmp_GenPwrDert_f32" FLOAT32_IEEE BSW_A2L_Ident_Float 1 100 -3.4E+38 3.4E+38 ECU_ADDRESS 0x00000000 /end MEASUREMENT
/begin CHARACTERISTIC CAL_DEM_Disbl_DFC_Cpld_NEN_InFail_u8 "CAL_DEM_Disbl_DFC_Cpld_NEN_InFail_u8" VALUE 0x00000000 Scalar_UBYTE 0 BSW_A2L_Ident_Int 0 255 /end CHARACTERISTIC
/begin MEASUREMENT VAR_MDF_OperOutdRngState_u8 "VAR_MDF_OperOutdRngState_u8" UBYTE BSW_A2L_Ident_Int 1 100 0 255 ECU_ADDRESS 0x00000000 /end MEASUREMENT
/begin CHARACTERISTIC CAL_MCF_uDDownLimEOL_f32 "CAL_MCF_uDDownLimEOL_f32" VALUE 0x00000000 Scalar_FLOAT32_IEEE 0 BSW_A2L_Ident_Float -3.4E+38 3.4E+38 /end CHARACTERISTIC
/begin MEASUREMENT VAR_PWM3phUDuty_ERR_u8 "VAR_PWM3phUDuty_ERR_u8" UBYTE BSW_A2L_Ident_Int 1 100 0 255 ECU_ADDRESS 0x00000000 /end MEASUREMENT
/begin CHARACTERISTIC CAL_Cspf_flgbDernOvrUdcSwt_b "CAL_Cspf_flgbDernOvrUdcSwt_b" VALUE 0x00000000 Scalar_BOOLEAN 0 BSW_A2L_Ident_Int 0 1 /end CHARACTERISTIC
/begin CHARACTERISTIC CAL_PcfDia_UdcMotLowSet_f32 "CAL_PcfDia_UdcMotLowSet_f32" VALUE 0x00000000 Scalar_FLOAT32_IEEE 0 BSW_A2L_Ident_Float -3.4E+38 3.4E+38 /end CHARACTERISTIC
/begin CHARACTERISTIC CAL_DEM_Disbl_DFC_IgbtDrv_ComErr_u8 "CAL_DEM_Disbl_DFC_IgbtDrv_ComErr_u8" VALUE 0x00000000 Scalar_UBYTE 0 BSW_A2L_Ident_Int 0 255 /end CHARACTERISTIC
/begin CHARACTERISTIC CAL_TpcSmp_iDcLnkMinMin_f32 "CAL_TpcSmp_iDcLnkMinMin_f32" VALUE 0x00000000 Scalar_FLOAT32_IEEE 0 BSW_A2L_Ident_Float -3.4E+38 3.4E+38 /end CHARACTERISTIC
/begin CHARACTERISTIC CAL_Vcf_trqHoldMin_f32 "CAL_Vcf_trqHoldMin_f32" VALUE 0x00000000 Scalar_FLOAT32_IEEE 0 BSW_A2L_Ident_Float -3.4E+38 3.4E+38 /end CHARACTERISTIC
/begin CHARACTERISTIC CAL_Vcf_trqHoldMax_f32 "CAL_Vcf_trqHoldMax_f32" VALUE 0x00000000 Scalar_FLOAT32_IEEE 0 BSW_A2L_Ident_Float -3.4E+38 3.4E+38 /end CHARACTERISTIC
/begin CHARACTERISTIC CAL_Cspf_bDernCoolantTemp_u8 "CAL_Cspf_bDernCoolantTemp_u8" VALUE 0x00000000 Scalar_UBYTE 0 BSW_A2L_Ident_Int 0 255 /end CHARACTERISTIC
/begin CHARACTERISTIC CAL_Vcf_HoldTimeCount_u16 "CAL_Vcf_HoldTimeCount_u16" VALUE 0x00000000 Scalar_UWORD 0 BSW_A2L_Ident_Int 0 65535 /end CHARACTERISTIC
/begin CHARACTERISTIC CAL_TpcSmp_uDcLnkOvVLim_f32 "CAL_TpcSmp_uDcLnkOvVLim_f32" VALUE 0x00000000 Scalar_FLOAT32_IEEE 0 BSW_A2L_Ident_Float -3.4E+38 3.4E+38 /end CHARACTERISTIC
/begin CHARACTERISTIC CAL_MCF_Part_ActiveHeat_u8 "CAL_MCF_Part_ActiveHeat_u8" VALUE 0x00000000 Scalar_UBYTE 0 BSW_A2L_Ident_Int 0 255 /end CHARACTERISTIC
/begin CHARACTERISTIC CAL_Vcf_nSetRamp_f32 "CAL_Vcf_nSetRamp_f32" VALUE 0x00000000 Scalar_FLOAT32_IEEE 0 BSW_A2L_Ident_Float -3.4E+38 3.4E+38 /end CHARACTERISTIC
/begin CHARACTERISTIC CAL_DEM_FIM_DFC_TPC_TIGBTOvHiLimErr_au8 "CAL_DEM_FIM_DFC_TPC_TIGBTOvHiLimErr_au8" VAL_BLK 0x00000000 Scalar_UBYTE 0 FID_Verb 0 255 NUMBER 10 /end CHARACTERISTIC
/begin CHARACTERISTIC CAL_DEM_Disbl_DFC_MDF_PhaseLossFaultErr_u8 "CAL_DEM_Disbl_DFC_MDF_PhaseLossFaultErr_u8" VALUE 0x00000000 Scalar_UBYTE 0 BSW_A2L_Ident_Int 0 255 /end CHARACTERISTIC
/begin CHARACTERISTIC CAL_MCF_flgCalibOffset_b "CAL_MCF_flgCalibOffset_b" VALUE 0x00000000 Scalar_BOOLEAN 0 BSW_A2L_Ident_Int 0 1 /end CHARACTERISTIC
/begin CHARACTERISTIC CAL_PcfDia_SLOutPInit_f32 "CAL_PcfDia_SLOutPInit_f32" VALUE 0x00000000 Scalar_FLOAT32_IEEE 0 BSW_A2L_Ident_Float -3.4E+38 3.4E+38 /end CHARACTERISTIC
/begin CHARACTERISTIC CAL_Cspf_UdcMax_f32 "CAL_Cspf_UdcMax_f32" VALUE 0x00000000 Scalar_FLOAT32_IEEE 0 BSW_A2L_Ident_Float -3.4E+38 3.4E+38 /end CHARACTERISTIC
/begin CHARACTERISTIC CAL_ADM_VoltChgThr_f32 "CAL_ADM_VoltChgThr_f32" VALUE 0x00000000 Scalar_FLOAT32_IEEE 0 BSW_A2L_Ident_Float -3.4E+38 3.4E+38 /end CHARACTERISTIC
/begin MEASUREMENT VAR_RDC_flg_u16 "VAR_RDC_flg_u16" UWORD BSW_A2L_Ident_Int 1 100 0 65535 ECU_ADDRESS 0x00000000 /end MEASUREMENT
/begin MEASUREMENT VAR_PcfSig_flgBelt_b "VAR_PcfSig_flgBelt_b" UBYTE BSW_A2L_Ident_Int 1 100 0 1 ECU_ADDRESS 0x00000000 /end MEASUREMENT
/begin CHARACTERISTIC CAL_TpcMot_tRiseSttrTraNormalToSave1_f32 "CAL_TpcMot_tRiseSttrTraNormalToSave1_f32" VALUE 0x00000000 Scalar_FLOAT32_IEEE 0 BSW_A2L_Ident_Float -3.4E+38 3.4E+38 /end CHARACTERISTIC
/begin CHARACTERISTIC CAL_PcfSig_flgBrake_u8 "CAL_PcfSig_flgBrake_u8" VALUE 0x00000000 Scalar_UBYTE 0 BSW_A2L_Ident_Int 0 255 /end CHARACTERISTIC
/begin CHARACTERISTIC CAL_MCF_flgRpwmFrqRandom_b "CAL_MCF_flgRpwmFrqRandom_b" VALUE 0x00000000 Scalar_BOOLEAN 0 BSW_A2L_Ident_Int 0 1 /end CHARACTERISTIC
/begin MEASUREMENT VAR_TpcCod_GenTrqCalcOvrCurt_f32 "VAR_TpcCod_GenTrqCalcOvrCurt_f32" FLOAT32_IEEE BSW_A2L_Ident_Float 1 100 -3.4E+38 3.4E+38 ECU_ADDRESS 0x00000000 /end MEASUREMENT
/begin MEASUREMENT VAR_DEM_Event_TPC_TDbcWHiLimFail_Status_u8 "VAR_DEM_Event_TPC_TDbcWHiLimFail_Status_u8" UBYTE BSW_A2L_Ident_Int 1 100 0 255 ECU_ADDRESS 0x00000000 /end MEASUREMENT
/begin CHARACTERISTIC CAL_DEM_FIM_DFC_Event_NvM_WriteErr_au8 "CAL_DEM_FIM_DFC_Event_NvM_WriteErr_au8" VAL_BLK 0x00000000 Scalar_UBYTE 0 FID_Verb 0 255 NUMBER 10 /end CHARACTERISTIC
/begin MEASUREMENT VAR_PcfStm_SLPosReg_f32 "VAR_PcfStm_SLPosReg_f32" FLOAT32_IEEE BSW_A2L_Ident_Float 1 100 -3.4E+38 3.4E+38 ECU_ADDRESS 0x00000000 /end MEASUREMENT
/begin MEASUREMENT VAR_PcfDia_VDD5PcfErr_b "VAR_PcfDia_VDD5PcfErr_b" UBYTE BSW_A2L_Ident_Int 1 100 0 1 ECU_ADDRESS 0x00000000 /end MEASUREMENT
/begin CHARACTERISTIC CAL_DEM_FIM_DFC_MDF_OperOutdRngErr_au8 "CAL_DEM_FIM_DFC_MDF_OperOutdRngErr_au8" VAL_BLK 0x00000000 Scalar_UBYTE 0 FID_Verb 0 255 NUMBER 10 /end CHARACTERISTIC
/begin MEASUREMENT VAR_DEM_Event_TPC_SpdOvHiLimFail_Status_u8 "VAR_DEM_Event_TPC_SpdOvHiLimFail_Status_u8" UBYTE BSW_A2L_Ident_Int 1 100 0 255 ECU_ADDRESS 0x00000000 /end MEASUREMENT
/begin CHARACTERISTIC CAL_Cspf_flgTrqDmpMaxSwt_b "CAL_Cspf_flgTrqDmpMaxSwt_b" VALUE 0x00000000 Scalar_BOOLEAN 0 BSW_A2L_Ident_Int 0 1 /end CHARACTERISTIC
/begin MEASUREMENT VAR_Scf_flgTranDchaToNormal_b "VAR_Scf_flgTranDchaToNormal_b" UBYTE BSW_A2L_Ident_Int 1 100 0 1 ECU_ADDRESS 0x00000000 /end MEASUREMENT
/begin MEASUREMENT VAR_Hspf_tDBCTempW_f32 "VAR_Hspf_tDBCTempW_f32" FLOAT32_IEEE BSW_A2L_Ident_Float 1 100 -3.4E+38 3.4E+38 ECU_ADDRESS 0x00000000 /end MEASUREMENT
/begin CHARACTERISTIC CAL_TpcMot_SttrTempDecDiff_f32 "CAL_TpcMot_SttrTempDecDiff_f32" VALUE 0x00000000 Scalar_FLOAT32_IEEE 0 BSW_A2L_Ident_Float -3.4E+38 3.4E+38 /end CHARACTERISTIC
/begin MEASUREMENT VAR_TpcMot_CofDertTRiseSttrSave1_f32 "VAR_TpcMot_CofDertTRiseSttrSave1_f32" FLOAT32_IEEE BSW_A2L_Ident_Float 1 100 -3.4E+38 3.4E+38 ECU_ADDRESS 0x00000000 /end MEASUREMENT
/begin CHARACTERISTIC CAL_ADM_flgDchgReqSwt_b "CAL_ADM_flgDchgReqSwt_b" VALUE 0x00000000 Scalar_BOOLEAN 0 BSW_A2L_Ident_Int 0 1 /end CHARACTERISTIC
/begin MEASUREMENT VAR_DEM_Event_HvMcu_DisChrgFreqErr_Status_u8 "VAR_DEM_Event_HvMcu_DisChrgFreqErr_Status_u8" UBYTE BSW_A2L_Ident_Int 1 100 0 255 ECU_ADDRESS 0x00000000 /end MEASUREMENT
/begin CHARACTERISTIC CAL_MCF_IsThetaSet11ZR_f32 "CAL_MCF_IsThetaSet11ZR_f32" VALUE 0x00000000 Scalar_FLOAT32_IEEE 0 BSW_A2L_Ident_Float -3.4E+38 3.4E+38 /end CHARACTERISTIC
/begin MEASUREMENT VAR_RCF_UsBetaScalSet_f32 "VAR_RCF_UsBetaScalSet_f32" FLOAT32_IEEE BSW_A2L_Ident_Float 1 100 -3.4E+38 3.4E+38 ECU_ADDRESS 0x00000000 /end MEASUREMENT
/begin MEASUREMENT VAR_PcfStm_flgStandbyToNPC_b "VAR_PcfStm_flgStandbyToNPC_b" UBYTE BSW_A2L_Ident_Int 1 100 0 1 ECU_ADDRESS 0x00000000 /end MEASUREMENT
/begin CHARACTERISTIC CAL_TRSP_18VHSVoltLoLim_u16 "CAL_TRSP_18VHSVoltLoLim_u16" VALUE 0x00000000 Scalar_UWORD 0 BSW_A2L_Ident_Int 0 65535 /end CHARACTERISTIC
/begin CHARACTERISTIC CAL_MCF_flgOverModu_b "CAL_MCF_flgOverModu_b" VALUE 0x00000000 Scalar_BOOLEAN 0 BSW_A2L_Ident_Int 0 1 /end CHARACTERISTIC
/begin MEASUREMENT VAR_TpcSmp_GenPwrAlowMax_f32 "VAR_TpcSmp_GenPwrAlowMax_f32" FLOAT32_IEEE BSW_A2L_Ident_Float 1 100 -3.4E+38 3.4E+38 ECU_ADDRESS 0x00000000 /end MEASUREMENT
/begin CHARACTERISTIC CAL_MDF_nThresAlOfsNoPlauseFaultMin_f32 "CAL_MDF_nThresAlOfsNoPlauseFaultMin_f32" VALUE 0x00000000 Scalar_FLOAT32_IEEE 0 BSW_A2L_Ident_Float -3.4E+38 3.4E+38 /end CHARACTERISTIC
/begin MEASUREMENT VAR_IgbtDrv_Level_NRST_RDY_L_u8 "VAR_IgbtDrv_Level_NRST_RDY_L_u8" UBYTE BSW_A2L_Ident_Int 1 100 0 255 ECU_ADDRESS 0x00000000 /end MEASUREMENT
/begin CHARACTERISTIC CAL_Cspf_stDisChg_u8 "CAL_Cspf_stDisChg_u8" VALUE 0x00000000 Scalar_UBYTE 0 BSW_A2L_Ident_Int 0 255 /end CHARACTERISTIC
/begin CHARACTERISTIC CAL_DEM_FIM_DFC_TPC_iDcLnkOvcWarn_au8 "CAL_DEM_FIM_DFC_TPC_iDcLnkOvcWarn_au8" VAL_BLK 0x00000000 Scalar_UBYTE 0 FID_Verb 0 255 NUMBER 10 /end CHARACTERISTIC
/begin MEASUREMENT VAR_TRSP_RslvCosPRngChkRslt_b "VAR_TRSP_RslvCosPRngChkRslt_b" UBYTE BSW_A2L_Ident_Int 1 100 0 1 ECU_ADDRESS 0x00000000 /end MEASUREMENT
/begin CHARACTERISTIC CAL_Cspf_flgbReadyHVSwt_b "CAL_Cspf_flgbReadyHVSwt_b" VALUE 0x00000000 Scalar_BOOLEAN 0 BSW_A2L_Ident_Int 0 1 /end CHARACTERISTIC
/begin MEASUREMENT VAR_DEM_Event_TPC_TDrvBoardOvHiWarn_Status_u8 "VAR_DEM_Event_TPC_TDrvBoardOvHiWarn_Status_u8" UBYTE BSW_A2L_Ident_Int 1 100 0 255 ECU_ADDRESS 0x00000000 /end MEASUREMENT
/begin CHARACTERISTIC CAL_MCF_KpBetaZeroCtl_f32 "CAL_MCF_KpBetaZeroCtl_f32" VALUE 0x00000000 Scalar_FLOAT32_IEEE 0 BSW_A2L_Ident_Float -3.4E+38 3.4E+38 /end CHARACTERISTIC
/begin MEASUREMENT VAR_PcfCtl_DirOutPID_b "VAR_PcfCtl_DirOutPID_b" UBYTE BSW_A2L_Ident_Int 1 100 0 1 ECU_ADDRESS 0x00000000 /end MEASUREMENT
/begin MEASUREMENT VAR_DEM_Event_IOHWAB_18VLwBrgSampFail_Status_u8 "VAR_DEM_Event_IOHWAB_18VLwBrgSampFail_Status_u8" UBYTE BSW_A2L_Ident_Int 1 100 0 255 ECU_ADDRESS 0x00000000 /end MEASUREMENT
/begin CHARACTERISTIC CAL_DEM_Disbl_DFC_HvMcu_ComErr_u8 "CAL_DEM_Disbl_DFC_HvMcu_ComErr_u8" VALUE 0x00000000 Scalar_UBYTE 0 BSW_A2L_Ident_Int 0 255 /end CHARACTERISTIC
/begin MEASUREMENT VAR_TCF_PwrTrq1_f32 "VAR_TCF_PwrTrq1_f32" FLOAT32_IEEE BSW_A2L_Ident_Float 1 100 -3.4E+38 3.4E+38 ECU_ADDRESS 0x00000000 /end MEASUREMENT
/begin MEASUREMENT VAR_Vcf_TranstoHoldOut_b "VAR_Vcf_TranstoHoldOut_b" UBYTE BSW_A2L_Ident_Int 1 100 0 1 ECU_ADDRESS 0x00000000 /end MEASUREMENT
/begin MEASUREMENT VAR_TpcSmp_uDcLnkUnvWarnState_u8 "VAR_TpcSmp_uDcLnkUnvWarnState_u8" UBYTE BSW_A2L_Ident_Int 1 100 0 255 ECU_ADDRESS 0x00000000 /end MEASUREMENT
/begin CHARACTERISTIC CAL_TpcMot_tRiseSttrTraSave1ToNormal_f32 "CAL_TpcMot_tRiseSttrTraSave1ToNormal_f32" VALUE 0x00000000 Scalar_FLOAT32_IEEE 0 BSW_A2L_Ident_Float -3.4E+38 3.4E+38 /end CHARACTERISTIC
/begin CHARACTERISTIC CAL_TpcCod_CntHysteresislop_u16 "CAL_TpcCod_CntHysteresislop_u16" VALUE 0x00000000 Scalar_UWORD 0 BSW_A2L_Ident_Int 0 65535 /end CHARACTERISTIC
/begin MEASUREMENT VAR_RCF_OfsFlt4000Fwd_f32 "VAR_RCF_OfsFlt4000Fwd_f32" FLOAT32_IEEE BSW_A2L_Ident_Float 1 100 -3.4E+38 3.4E+38 ECU_ADDRESS 0x00000000 /end MEASUREMENT
/begin CHARACTERISTIC CAL_PcfDia_PosDebounce_f32 "CAL_PcfDia_PosDebounce_f32" VALUE 0x00000000 Scalar_FLOAT32_IEEE 0 BSW_A2L_Ident_Float -3.4E+38 3.4E+38 /end CHARACTERISTIC
/begin CHARACTERISTIC CAL_TpcBlk_MtrBlkSpdLowSet_f32 "CAL_TpcBlk_MtrBlkSpdLowSet_f32" VALUE 0x00000000 Scalar_FLOAT32_IEEE 0 BSW_A2L_Ident_Float -3.4E+38 3.4E+38 /end CHARACTERISTIC
/begin MEASUREMENT VAR_TpcTmp_ElecTrqLimTcoolant_f32 "VAR_TpcTmp_ElecTrqLimTcoolant_f32" FLOAT32_IEEE BSW_A2L_Ident_Float 1 100 -3.4E+38 3.4E+38 ECU_ADDRESS 0x00000000 /end MEASUREMENT
/begin CHARACTERISTIC CAL_DEM_Disbl_DFC_IgbtDrv_UpBrgFaultBFail_u8 "CAL_DEM_Disbl_DFC_IgbtDrv_UpBrgFaultBFail_u8" VALUE 0x00000000 Scalar_UBYTE 0 BSW_A2L_Ident_Int 0 255 /end CHARACTERISTIC
/begin MEASUREMENT VAR_IoHwAb_Adc_Phy_3V3_MCU_f32 "VAR_IoHwAb_Adc_Phy_3V3_MCU_f32" FLOAT32_IEEE BSW_A2L_Ident_Float 1 100 -3.4E+38 3.4E+38 ECU_ADDRESS 0x00000000 /end MEASUREMENT
/begin MEASUREMENT VAR_MPC_CofRandomPwm_f32 "VAR_MPC_CofRandomPwm_f32" FLOAT32_IEEE BSW_A2L_Ident_Float 1 100 -3.4E+38 3.4E+38 ECU_ADDRESS 0x00000000 /end MEASUREMENT
/begin CHARACTERISTIC CAL_TpcTmp_tIGBTTempHiLim_f32 "CAL_TpcTmp_tIGBTTempHiLim_f32" VALUE 0x00000000 Scalar_FLOAT32_IEEE 0 BSW_A2L_Ident_Float -3.4E+38 3.4E+38 /end CHARACTERISTIC
/begin CHARACTERISTIC CAL_MCF_cofOverModu_f32 "CAL_MCF_cofOverModu_f32" VALUE 0x00000000 Scalar_FLOAT32_IEEE 0 BSW_A2L_Ident_Float -3.4E+38 3.4E+38 /end CHARACTERISTIC
/begin MEASUREMENT VAR_PcfCtl_enMos_b "VAR_PcfCtl_enMos_b" UBYTE BSW_A2L_Ident_Int 1 100 0 1 ECU_ADDRESS 0x00000000 /end MEASUREMENT
/begin MEASUREMENT VAR_tpccod_flgMinDertMtrSpd_b "VAR_tpccod_flgMinDertMtrSpd_b" UBYTE BSW_A2L_Ident_Int 1 100 0 1 ECU_ADDRESS 0x00000000 /end MEASUREMENT
/begin MEASUREMENT VAR_CDD_Rslv_SinMin_f32 "VAR_CDD_Rslv_SinMin_f32" FLOAT32_IEEE BSW_A2L_Ident_Float 1 100 -3.4E+38 3.4E+38 ECU_ADDRESS 0x00000000 /end MEASUREMENT
/begin MEASUREMENT VAR_TpcCod_CoolantFlowFinReq_f32 "VAR_TpcCod_CoolantFlowFinReq_f32" FLOAT32_IEEE BSW_A2L_Ident_Float 1 100 -3.4E+38 3.4E+38 ECU_ADDRESS 0x00000000 /end MEASUREMENT
/begin CHARACTERISTIC CAL_PcfDia_VDD5Highset_f32 "CAL_PcfDia_VDD5Highset_f32" VALUE 0x00000000 Scalar_FLOAT32_IEEE 0 BSW_A2L_Ident_Float -3.4E+38 3.4E+38 /end CHARACTERISTIC
/begin MEASUREMENT VAR_DEM_Event_RSL_LOSErr_Status_u8 "VAR_DEM_Event_RSL_LOSErr_Status_u8" UBYTE BSW_A2L_Ident_Int 1 100 0 255 ECU_ADDRESS 0x00000000 /end MEASUREMENT
/begin MEASUREMENT VAR_TpcTmp_GenTrqLimTcoolant_f32 "VAR_TpcTmp_GenTrqLimTcoolant_f32" FLOAT32_IEEE BSW_A2L_Ident_Float 1 100 -3.4E+38 3.4E+38 ECU_ADDRESS 0x00000000 /end MEASUREMENT
/begin CHARACTERISTIC CAL_MCF_KpAlphaZeroCtl_f32 "CAL_MCF_KpAlphaZeroCtl_f32" VALUE 0x00000000 Scalar_FLOAT32_IEEE 0 BSW_A2L_Ident_Float -3.4E+38 3.4E+38 /end CHARACTERISTIC
/begin CHARACTERISTIC CAL_Vcf_CrawlRspd_f32 "CAL_Vcf_CrawlRspd_f32" VALUE 0x00000000 Scalar_FLOAT32_IEEE 0 BSW_A2L_Ident_Float -3.4E+38 3.4E+38 /end CHARACTERISTIC
/begin CHARACTERISTIC CAL_MDF_tiAgComp_f32 "CAL_MDF_tiAgComp_f32" VALUE 0x00000000 Scalar_FLOAT32_IEEE 0 BSW_A2L_Ident_Float -3.4E+38 3.4E+38 /end CHARACTERISTIC
/begin CHARACTERISTIC CAL_DEM_FIM_DFC_ADC_WPhaseBISTFail_au8 "CAL_DEM_FIM_DFC_ADC_WPhaseBISTFail_au8" VAL_BLK 0x00000000 Scalar_UBYTE 0 FID_Verb 0 255 NUMBER 10 /end CHARACTERISTIC
/begin CHARACTERISTIC CAL_DEM_Disbl_DFC_ADC_VPhaseBISTFail_u8 "CAL_DEM_Disbl_DFC_ADC_VPhaseBISTFail_u8" VALUE 0x00000000 Scalar_UBYTE 0 BSW_A2L_Ident_Int 0 255 /end CHARACTERISTIC
/begin CHARACTERISTIC CAL_Cspf_flgTrqMinNCtlSwt_b "CAL_Cspf_flgTrqMinNCtlSwt_b" VALUE 0x00000000 Scalar_BOOLEAN 0 BSW_A2L_Ident_Int 0 1 /end CHARACTERISTIC
/begin CHARACTERISTIC CAL_MDF_cErrPwrDcEstMax_f32 "CAL_MDF_cErrPwrDcEstMax_f32" VALUE 0x00000000 Scalar_FLOAT32_IEEE 0 BSW_A2L_Ident_Float -3.4E+38 3.4E+38 /end CHARACTERISTIC
/begin CHARACTERISTIC CAL_DEM_Disbl_DFC_Cpld_UnderVol_HS_InFail_u8 "CAL_DEM_Disbl_DFC_Cpld_UnderVol_HS_InFail_u8" VALUE 0x00000000 Scalar_UBYTE 0 BSW_A2L_Ident_Int 0 255 /end CHARACTERISTIC
/begin CHARACTERISTIC CAL_DEM_Disbl_DFC_TPC_iDcLnkOvCLimFail_u8 "CAL_DEM_Disbl_DFC_TPC_iDcLnkOvCLimFail_u8" VALUE 0x00000000 Scalar_UBYTE 0 BSW_A2L_Ident_Int 0 255 /end CHARACTERISTIC
/begin CHARACTERISTIC CAL_TpcMot_SttrChgTempDownDiff_f32 "CAL_TpcMot_SttrChgTempDownDiff_f32" VALUE 0x00000000 Scalar_FLOAT32_IEEE 0 BSW_A2L_Ident_Float -3.4E+38 3.4E+38 /end CHARACTERISTIC
/begin CHARACTERISTIC CAL_RCF_nCalcSec7_f32 "CAL_RCF_nCalcSec7_f32" VALUE 0x00000000 Scalar_FLOAT32_IEEE 0 BSW_A2L_Ident_Float -3.4E+38 3.4E+38 /end CHARACTERISTIC
/begin MEASUREMENT VAR_TpcMot_tSttrOperationMode_u8 "VAR_TpcMot_tSttrOperationMode_u8" UBYTE BSW_A2L_Ident_Int 1 100 0 255 ECU_ADDRESS 0x00000000 /end MEASUREMENT
/begin MEASUREMENT VAR_Scf_flgFimReqFailr_b "VAR_Scf_flgFimReqFailr_b" UBYTE BSW_A2L_Ident_Int 1 100 0 1 ECU_ADDRESS 0x00000000 /end MEASUREMENT
/begin CHARACTERISTIC CAL_Scf_FFActionDisab_u8 "CAL_Scf_FFActionDisab_u8" VALUE 0x00000000 Scalar_UBYTE 0 BSW_A2L_Ident_Int 0 255 /end CHARACTERISTIC
/begin MEASUREMENT VAR_DEM_Event_Cpld_NEN_InFail_Status_u8 "VAR_DEM_Event_Cpld_NEN_InFail_Status_u8" UBYTE BSW_A2L_Ident_Int 1 100 0 255 ECU_ADDRESS 0x00000000 /end MEASUREMENT
/begin CHARACTERISTIC CAL_PcfSig_flgUseISENorIUB_b "CAL_PcfSig_flgUseISENorIUB_b" VALUE 0x00000000 Scalar_BOOLEAN 0 BSW_A2L_Ident_Int 0 1 /end CHARACTERISTIC
/begin MEASUREMENT VAR_tpccod_flgMaxDertTempDBC_b "VAR_tpccod_flgMaxDertTempDBC_b" UBYTE BSW_A2L_Ident_Int 1 100 0 1 ECU_ADDRESS 0x00000000 /end MEASUREMENT
/begin MEASUREMENT VAR_UdhTjtIGBT_f32 "VAR_UdhTjtIGBT_f32" FLOAT32_IEEE BSW_A2L_Ident_Float 1 100 -3.4E+38 3.4E+38 ECU_ADDRESS 0x00000000 /end MEASUREMENT
/begin MEASUREMENT VAR_DEM_Event_RCF_FwlFwdOvTiErr_Status_u8 "VAR_DEM_Event_RCF_FwlFwdOvTiErr_Status_u8" UBYTE BSW_A2L_Ident_Int 1 100 0 255 ECU_ADDRESS 0x00000000 /end MEASUREMENT
/begin MEASUREMENT VAR_PcfDia_stSLActPos_u8 "VAR_PcfDia_stSLActPos_u8" UBYTE BSW_A2L_Ident_Int 1 100 0 255 ECU_ADDRESS 0x00000000 /end MEASUREMENT
/begin MEASUREMENT VAR_Bsw_tDrvBoardTemp_u16 "VAR_Bsw_tDrvBoardTemp_u16" UWORD BSW_A2L_Ident_Int 1 100 0 65535 ECU_ADDRESS 0x00000000 /end MEASUREMENT
/begin CHARACTERISTIC CAL_MCF_flgInternalOffset_b "CAL_MCF_flgInternalOffset_b" VALUE 0x00000000 Scalar_BOOLEAN 0 BSW_A2L_Ident_Int 0 1 /end CHARACTERISTIC
/begin MEASUREMENT VAR_STM_UintndSpdErr_b "VAR_STM_UintndSpdErr_b" UBYTE BSW_A2L_Ident_Int 1 100 0 1 ECU_ADDRESS 0x00000000 /end MEASUREMENT
/begin MEASUREMENT VAR_TpcFuv_FimPwrLimLv3_b "VAR_TpcFuv_FimPwrLimLv3_b" UBYTE BSW_A2L_Ident_Int 1 100 0 1 ECU_ADDRESS 0x00000000 /end MEASUREMENT
/begin MEASUREMENT VAR_DEM_Event_HvMcu_UartLostFrameErr_Status_u8 "VAR_DEM_Event_HvMcu_UartLostFrameErr_Status_u8" UBYTE BSW_A2L_Ident_Int 1 100 0 255 ECU_ADDRESS 0x00000000 /end MEASUREMENT
/begin MEASUREMENT VAR_3phPWMUH_Duty_f32 "VAR_3phPWMUH_Duty_f32" FLOAT32_IEEE BSW_A2L_Ident_Float 1 100 -3.4E+38 3.4E+38 ECU_ADDRESS 0x00000000 /end MEASUREMENT
/begin MEASUREMENT VAR_DEM_Event_Cpld_SPIComFail_Status_u8 "VAR_DEM_Event_Cpld_SPIComFail_Status_u8" UBYTE BSW_A2L_Ident_Int 1 100 0 255 ECU_ADDRESS 0x00000000 /end MEASUREMENT
/begin MEASUREMENT VAR_PcfStm_SLstModeReq_u8 "VAR_PcfStm_SLstModeReq_u8" UBYTE BSW_A2L_Ident_Int 1 100 0 255 ECU_ADDRESS 0x00000000 /end MEASUREMENT
/begin MEASUREMENT VAR_PcfDia_stUdc_u8 "VAR_PcfDia_stUdc_u8" UBYTE BSW_A2L_Ident_Int 1 100 0 255 ECU_ADDRESS 0x00000000 /end MEASUREMENT
/begin CHARACTERISTIC CAL_PWM_Set_DeadTime_us_f32 "CAL_PWM_Set_DeadTime_us_f32" VALUE 0x00000000 Scalar_FLOAT32_IEEE 0 BSW_A2L_Ident_Float -3.4E+38 3.4E+38 /end CHARACTERISTIC
/begin MEASUREMENT VAR_DEM_Event_TPC_uDcLnkUnvWarn_Status_u8 "VAR_DEM_Event_TPC_uDcLnkUnvWarn_Status_u8" UBYTE BSW_A2L_Ident_Int 1 100 0 255 ECU_ADDRESS 0x00000000 /end MEASUREMENT
/begin MEASUREMENT VAR_Scf_flgVCUComErrDelay_b "VAR_Scf_flgVCUComErrDelay_b" UBYTE BSW_A2L_Ident_Int 1 100 0 1 ECU_ADDRESS 0x00000000 /end MEASUREMENT
/begin CHARACTERISTIC CAL_Scf_SenChkErr_u8 "CAL_Scf_SenChkErr_u8" VALUE 0x00000000 Scalar_UBYTE 0 BSW_A2L_Ident_Int 0 255 /end CHARACTERISTIC
/begin CHARACTERISTIC CAL_TpcSmp_ElecOvrCurtypLim_f32 "CAL_TpcSmp_ElecOvrCurtypLim_f32" VALUE 0x00000000 Scalar_FLOAT32_IEEE 0 BSW_A2L_Ident_Float -3.4E+38 3.4E+38 /end CHARACTERISTIC
/begin CHARACTERISTIC CAL_Hspf_TmpWFltFrq_f32 "CAL_Hspf_TmpWFltFrq_f32" VALUE 0x00000000 Scalar_FLOAT32_IEEE 0 BSW_A2L_Ident_Float -3.4E+38 3.4E+38 /end CHARACTERISTIC
/begin CHARACTERISTIC CAL_RCF_nEstAlOfsStop_f32 "CAL_RCF_nEstAlOfsStop_f32" VALUE 0x00000000 Scalar_FLOAT32_IEEE 0 BSW_A2L_Ident_Float -3.4E+38 3.4E+38 /end CHARACTERISTIC
/begin CHARACTERISTIC CAL_TpcTmp_tDbcTempULoLim_f32 "CAL_TpcTmp_tDbcTempULoLim_f32" VALUE 0x00000000 Scalar_FLOAT32_IEEE 0 BSW_A2L_Ident_Float -3.4E+38 3.4E+38 /end CHARACTERISTIC
/begin CHARACTERISTIC CAL_RCF_cTrqSlopAcc_f32 "CAL_RCF_cTrqSlopAcc_f32" VALUE 0x00000000 Scalar_FLOAT32_IEEE 0 BSW_A2L_Ident_Float -3.4E+38 3.4E+38 /end CHARACTERISTIC
/begin MEASUREMENT VAR_DEM_Event_Cpld_DI_ExdClk_InFail_Status_u8 "VAR_DEM_Event_Cpld_DI_ExdClk_InFail_Status_u8" UBYTE BSW_A2L_Ident_Int 1 100 0 255 ECU_ADDRESS 0x00000000 /end MEASUREMENT
/begin CHARACTERISTIC CAL_PcfSig_tDelayTestP_f32 "CAL_PcfSig_tDelayTestP_f32" VALUE 0x00000000 Scalar_FLOAT32_IEEE 0 BSW_A2L_Ident_Float -3.4E+38 3.4E+38 /end CHARACTERISTIC
/begin CHARACTERISTIC CAL_Scf_nSafeTestMinLim_f32 "CAL_Scf_nSafeTestMinLim_f32" VALUE 0x00000000 Scalar_FLOAT32_IEEE 0 BSW_A2L_Ident_Float -3.4E+38 3.4E+38 /end CHARACTERISTIC
/begin MEASUREMENT VAR_MCF_iBetaActFlt_f32 "VAR_MCF_iBetaActFlt_f32" FLOAT32_IEEE BSW_A2L_Ident_Float 1 100 -3.4E+38 3.4E+38 ECU_ADDRESS 0x00000000 /end MEASUREMENT
/begin MEASUREMENT VAR_PcfStm_flgPCInitToInP_b "VAR_PcfStm_flgPCInitToInP_b" UBYTE BSW_A2L_Ident_Int 1 100 0 1 ECU_ADDRESS 0x00000000 /end MEASUREMENT
/begin CHARACTERISTIC CAL_DEM_FIM_DFC_IOHWAB_KL30UnderVolErr_au8 "CAL_DEM_FIM_DFC_IOHWAB_KL30UnderVolErr_au8" VAL_BLK 0x00000000 Scalar_UBYTE 0 FID_Verb 0 255 NUMBER 10 /end CHARACTERISTIC
/begin MEASUREMENT VAR_TpcFuv_ElecTrqLimDiag_f32 "VAR_TpcFuv_ElecTrqLimDiag_f32" FLOAT32_IEEE BSW_A2L_Ident_Float 1 100 -3.4E+38 3.4E+38 ECU_ADDRESS 0x00000000 /end MEASUREMENT
/begin MEASUREMENT VAR_Scf_DisChaDetec_b "VAR_Scf_DisChaDetec_b" UBYTE BSW_A2L_Ident_Int 1 100 0 1 ECU_ADDRESS 0x00000000 /end MEASUREMENT
/begin MEASUREMENT VAR_flgRecVCU01_u8 "VAR_flgRecVCU01_u8" UBYTE BSW_A2L_Ident_Int 1 100 0 255 ECU_ADDRESS 0x00000000 /end MEASUREMENT
/begin MEASUREMENT VAR_WilTjtIGBT_f32 "VAR_WilTjtIGBT_f32" FLOAT32_IEEE BSW_A2L_Ident_Float 1 100 -3.4E+38 3.4E+38 ECU_ADDRESS 0x00000000 /end MEASUREMENT
/begin MEASUREMENT VAR_RCF_flgBwdClbToCalc_b "VAR_RCF_flgBwdClbToCalc_b" UBYTE BSW_A2L_Ident_Int 1 100 0 1 ECU_ADDRESS 0x00000000 /end MEASUREMENT
/begin CHARACTERISTIC CAL_POWER_UBSBC_Threhold_V7_f32 "CAL_POWER_UBSBC_Threhold_V7_f32" VALUE 0x00000000 Scalar_FLOAT32_IEEE 0 BSW_A2L_Ident_Float -3.4E+38 3.4E+38 /end CHARACTERISTIC
/begin MEASUREMENT VAR_CDD_RslvTimeStamp_f32 "VAR_CDD_RslvTimeStamp_f32" FLOAT32_IEEE BSW_A2L_Ident_Float 1 100 -3.4E+38 3.4E+38 ECU_ADDRESS 0x00000000 /end MEASUREMENT
/begin MEASUREMENT VAR_PcfDiag_flgselfCkFnh_b "VAR_PcfDiag_flgselfCkFnh_b" UBYTE BSW_A2L_Ident_Int 1 100 0 1 ECU_ADDRESS 0x00000000 /end MEASUREMENT
/begin MEASUREMENT VAR_DEM_Event_TPC_TDbcOvHiWarn_Status_u8 "VAR_DEM_Event_TPC_TDbcOvHiWarn_Status_u8" UBYTE BSW_A2L_Ident_Int 1 100 0 255 ECU_ADDRESS 0x00000000 /end MEASUREMENT
/begin CHARACTERISTIC CAL_FRP_UintndSpdErrOutCtl_b "CAL_FRP_UintndSpdErrOutCtl_b" VALUE 0x00000000 Scalar_BOOLEAN 0 BSW_A2L_Ident_Int 0 1 /end CHARACTERISTIC
/begin MEASUREMENT VAR_PcfCtl_ActFnh_b "VAR_PcfCtl_ActFnh_b" UBYTE BSW_A2L_Ident_Int 1 100 0 1 ECU_ADDRESS 0x00000000 /end MEASUREMENT
/begin CHARACTERISTIC CAL_TpcSmp_GenOvrCurtKi_f32 "CAL_TpcSmp_GenOvrCurtKi_f32" VALUE 0x00000000 Scalar_FLOAT32_IEEE 0 BSW_A2L_Ident_Float -3.4E+38 3.4E+38 /end CHARACTERISTIC
/begin MEASUREMENT VAR_L2Sampling_3V3CPLD_MON_u16 "VAR_L2Sampling_3V3CPLD_MON_u16" UWORD BSW_A2L_Ident_Int 1 100 0 65535 ECU_ADDRESS 0x00000000 /end MEASUREMENT
/begin CHARACTERISTIC CAL_Scf_nSafeMaxLim_f32 "CAL_Scf_nSafeMaxLim_f32" VALUE 0x00000000 Scalar_FLOAT32_IEEE 0 BSW_A2L_Ident_Float -3.4E+38 3.4E+38 /end CHARACTERISTIC
/begin CHARACTERISTIC CAL_IOHWAB_AN29_IUVW_P_REF_MAX_f32 "CAL_IOHWAB_AN29_IUVW_P_REF_MAX_f32" VALUE 0x00000000 Scalar_FLOAT32_IEEE 0 BSW_A2L_Ident_Float -3.4E+38 3.4E+38 /end CHARACTERISTIC
/begin CHARACTERISTIC CAL_Cspf_TraTrqMin_f32 "CAL_Cspf_TraTrqMin_f32" VALUE 0x00000000 Scalar_FLOAT32_IEEE 0 BSW_A2L_Ident_Float -3.4E+38 3.4E+38 /end CHARACTERISTIC
/begin MEASUREMENT VAR_FS_RDC_Counter_u8 "VAR_FS_RDC_Counter_u8" UBYTE BSW_A2L_Ident_Int 1 100 0 255 ECU_ADDRESS 0x00000000 /end MEASUREMENT
/begin MEASUREMENT VAR_PcfCtl_SoftDycPID_f32 "VAR_PcfCtl_SoftDycPID_f32" FLOAT32_IEEE BSW_A2L_Ident_Float 1 100 -3.4E+38 3.4E+38 ECU_ADDRESS 0x00000000 /end MEASUREMENT
/begin CHARACTERISTIC CAL_MCF_SampleTime_f32 "CAL_MCF_SampleTime_f32" VALUE 0x00000000 Scalar_FLOAT32_IEEE 0 BSW_A2L_Ident_Float -3.4E+38 3.4E+38 /end CHARACTERISTIC
/begin CHARACTERISTIC CAL_PcfDia_posSenHiRngSet_f32 "CAL_PcfDia_posSenHiRngSet_f32" VALUE 0x00000000 Scalar_FLOAT32_IEEE 0 BSW_A2L_Ident_Float -3.4E+38 3.4E+38 /end CHARACTERISTIC
/begin MEASUREMENT VAR_DEM_Event_IOHWAB_KL30SevUnderVolFail_Status_u8 "VAR_DEM_Event_IOHWAB_KL30SevUnderVolFail_Status_u8" UBYTE BSW_A2L_Ident_Int 1 100 0 255 ECU_ADDRESS 0x00000000 /end MEASUREMENT
/begin MEASUREMENT VAR_DEM_Event_MDF_AlOfsNoPlausErr_Status_u8 "VAR_DEM_Event_MDF_AlOfsNoPlausErr_Status_u8" UBYTE BSW_A2L_Ident_Int 1 100 0 255 ECU_ADDRESS 0x00000000 /end MEASUREMENT
/begin MEASUREMENT VAR_Cspf_TrabDernUndrUdc_u8 "VAR_Cspf_TrabDernUndrUdc_u8" UBYTE BSW_A2L_Ident_Int 1 100 0 255 ECU_ADDRESS 0x00000000 /end MEASUREMENT
/begin CHARACTERISTIC CAL_RDC_flgCorrectOrReal_b "CAL_RDC_flgCorrectOrReal_b" VALUE 0x00000000 Scalar_BOOLEAN 0 BSW_A2L_Ident_Int 0 1 /end CHARACTERISTIC
/begin CHARACTERISTIC CAL_POWER_VDD18_Threhold_Min_f32 "CAL_POWER_VDD18_Threhold_Min_f32" VALUE 0x00000000 Scalar_FLOAT32_IEEE 0 BSW_A2L_Ident_Float -3.4E+38 3.4E+38 /end CHARACTERISTIC
/begin MEASUREMENT VAR_MCF_iV_f32 "VAR_MCF_iV_f32" FLOAT32_IEEE BSW_A2L_Ident_Float 1 100 -3.4E+38 3.4E+38 ECU_ADDRESS 0x00000000 /end MEASUREMENT
/begin CHARACTERISTIC CAL_Hspf_iPhaLowSet_u16 "CAL_Hspf_iPhaLowSet_u16" VALUE 0x00000000 Scalar_UWORD 0 BSW_A2L_Ident_Int 0 65535 /end CHARACTERISTIC
/begin MEASUREMENT VAR_Cspf_TraFailCode2_u8 "VAR_Cspf_TraFailCode2_u8" UBYTE BSW_A2L_Ident_Int 1 100 0 255 ECU_ADDRESS 0x00000000 /end MEASUREMENT
/begin MEASUREMENT VAR_L2Sampling_RslvSin_s32 "VAR_L2Sampling_RslvSin_s32" SLONG BSW_A2L_Ident_Int 1 100 -2147483648 2147483647 ECU_ADDRESS 0x00000000 /end MEASUREMENT
/begin CHARACTERISTIC CAL_MCF_isdfwKi_f32 "CAL_MCF_isdfwKi_f32" VALUE 0x00000000 Scalar_FLOAT32_IEEE 0 BSW_A2L_Ident_Float -3.4E+38 3.4E+38 /end CHARACTERISTIC
/begin CHARACTERISTIC CAL_TjrthLv4dldh_f32 "CAL_TjrthLv4dldh_f32" VALUE 0x00000000 Scalar_FLOAT32_IEEE 0 BSW_A2L_Ident_Float -3.4E+38 3.4E+38 /end CHARACTERISTIC
/begin CHARACTERISTIC CAL_TpcSmp_PwrAddMax_f32 "CAL_TpcSmp_PwrAddMax_f32" VALUE 0x00000000 Scalar_FLOAT32_IEEE 0 BSW_A2L_Ident_Float -3.4E+38 3.4E+38 /end CHARACTERISTIC
/begin MEASUREMENT VAR_Cspf_TraTrqCurrWoDmpC_f32 "VAR_Cspf_TraTrqCurrWoDmpC_f32" FLOAT32_IEEE BSW_A2L_Ident_Float 1 100 -3.4E+38 3.4E+38 ECU_ADDRESS 0x00000000 /end MEASUREMENT
/begin CHARACTERISTIC CAL_MCF_DycVSet_f32 "CAL_MCF_DycVSet_f32" VALUE 0x00000000 Scalar_FLOAT32_IEEE 0 BSW_A2L_Ident_Float -3.4E+38 3.4E+38 /end CHARACTERISTIC
/begin MEASUREMENT VAR_DEM_Event_MDF_PrfElDrvErr_Status_u8 "VAR_DEM_Event_MDF_PrfElDrvErr_Status_u8" UBYTE BSW_A2L_Ident_Int 1 100 0 255 ECU_ADDRESS 0x00000000 /end MEASUREMENT
/begin CHARACTERISTIC CAL_Cspf_flgbDernStrTempSwt_b "CAL_Cspf_flgbDernStrTempSwt_b" VALUE 0x00000000 Scalar_BOOLEAN 0 BSW_A2L_Ident_Int 0 1 /end CHARACTERISTIC
/begin CHARACTERISTIC CAL_TjrthLv4dhil_f32 "CAL_TjrthLv4dhil_f32" VALUE 0x00000000 Scalar_FLOAT32_IEEE 0 BSW_A2L_Ident_Float -3.4E+38 3.4E+38 /end CHARACTERISTIC
/begin MEASUREMENT VAR_Bsw_bt15_b "VAR_Bsw_bt15_b" UBYTE BSW_A2L_Ident_Int 1 100 0 1 ECU_ADDRESS 0x00000000 /end MEASUREMENT
/begin CHARACTERISTIC CAL_TpcTmp_CoolTempKp_f32 "CAL_TpcTmp_CoolTempKp_f32" VALUE 0x00000000 Scalar_FLOAT32_IEEE 0 BSW_A2L_Ident_Float -3.4E+38 3.4E+38 /end CHARACTERISTIC
/begin CHARACTERISTIC CAL_Scf_flgJumpRunBy15Swt_b "CAL_Scf_flgJumpRunBy15Swt_b" VALUE 0x00000000 Scalar_BOOLEAN 0 BSW_A2L_Ident_Int 0 1 /end CHARACTERISTIC
/begin CHARACTERISTIC CAL_Cspf_flgDchaReqSwt_b "CAL_Cspf_flgDchaReqSwt_b" VALUE 0x00000000 Scalar_BOOLEAN 0 BSW_A2L_Ident_Int 0 1 /end CHARACTERISTIC
/begin CHARACTERISTIC CAL_Hspf_MotorOpenChkAddCnt_u8 "CAL_Hspf_MotorOpenChkAddCnt_u8" VALUE 0x00000000 Scalar_UBYTE 0 BSW_A2L_Ident_Int 0 255 /end CHARACTERISTIC
/begin CHARACTERISTIC CAL_PcfStm_flgTestPSwt_b "CAL_PcfStm_flgTestPSwt_b" VALUE 0x00000000 Scalar_BOOLEAN 0 BSW_A2L_Ident_Int 0 1 /end CHARACTERISTIC
/begin MEASUREMENT VAR_CDD_Rslv_Sin_f32 "VAR_CDD_Rslv_Sin_f32" FLOAT32_IEEE BSW_A2L_Ident_Float 1 100 -3.4E+38 3.4E+38 ECU_ADDRESS 0x00000000 /end MEASUREMENT
/begin MEASUREMENT VAR_tpccod_flgMaxDertUndrUdc_b "VAR_tpccod_flgMaxDertUndrUdc_b" UBYTE BSW_A2L_Ident_Int 1 100 0 1 ECU_ADDRESS 0x00000000 /end MEASUREMENT
/begin MEASUREMENT VAR_DMA_Cos_Max_u16 "VAR_DMA_Cos_Max_u16" UWORD BSW_A2L_Ident_Int 1 100 0 65535 ECU_ADDRESS 0x00000000 /end MEASUREMENT
/begin CHARACTERISTIC CAL_TpcSmp_TrqAddMaxGen_f32 "CAL_TpcSmp_TrqAddMaxGen_f32" VALUE 0x00000000 Scalar_FLOAT32_IEEE 0 BSW_A2L_Ident_Float -3.4E+38 3.4E+38 /end CHARACTERISTIC
/begin CHARACTERISTIC CAL_DEM_Disbl_DFC_IOHWAB_1V3MCU_SampFail_u8 "CAL_DEM_Disbl_DFC_IOHWAB_1V3MCU_SampFail_u8" VALUE 0x00000000 Scalar_UBYTE 0 BSW_A2L_Ident_Int 0 255 /end CHARACTERISTIC
/begin MEASUREMENT VAR_PcfDia_flgRetry_b "VAR_PcfDia_flgRetry_b" UBYTE BSW_A2L_Ident_Int 1 100 0 1 ECU_ADDRESS 0x00000000 /end MEASUREMENT
/begin MEASUREMENT VAR_Scf_flgTranOfstCalToStb_b "VAR_Scf_flgTranOfstCalToStb_b" UBYTE BSW_A2L_Ident_Int 1 100 0 1 ECU_ADDRESS 0x00000000 /end MEASUREMENT
/begin MEASUREMENT VAR_TRSP_CurrSumErr_b "VAR_TRSP_CurrSumErr_b" UBYTE BSW_A2L_Ident_Int 1 100 0 1 ECU_ADDRESS 0x00000000 /end MEASUREMENT
/begin CHARACTERISTIC CAL_TpcTmp_DBCTempAdds_f32 "CAL_TpcTmp_DBCTempAdds_f32" VALUE 0x00000000 Scalar_FLOAT32_IEEE 0 BSW_A2L_Ident_Float -3.4E+38 3.4E+38 /end CHARACTERISTIC
/begin MEASUREMENT VAR_PcfStm_flgRetryFnh_b "VAR_PcfStm_flgRetryFnh_b" UBYTE BSW_A2L_Ident_Int 1 100 0 1 ECU_ADDRESS 0x00000000 /end MEASUREMENT
/begin CHARACTERISTIC CAL_Cspf_flgDchaReq_b "CAL_Cspf_flgDchaReq_b" VALUE 0x00000000 Scalar_BOOLEAN 0 BSW_A2L_Ident_Int 0 1 /end CHARACTERISTIC
/begin MEASUREMENT VAR_MCF_uBOm_f32 "VAR_MCF_uBOm_f32" FLOAT32_IEEE BSW_A2L_Ident_Float 1 100 -3.4E+38 3.4E+38 ECU_ADDRESS 0x00000000 /end MEASUREMENT
/begin MEASUREMENT VAR_MCF_uBOfsClb_f32 "VAR_MCF_uBOfsClb_f32" FLOAT32_IEEE BSW_A2L_Ident_Float 1 100 -3.4E+38 3.4E+38 ECU_ADDRESS 0x00000000 /end MEASUREMENT
/begin MEASUREMENT VAR_TpcSmp_flgPIDertOvrVoltGen_b "VAR_TpcSmp_flgPIDertOvrVoltGen_b" UBYTE BSW_A2L_Ident_Int 1 100 0 1 ECU_ADDRESS 0x00000000 /end MEASUREMENT
/begin MEASUREMENT VAR_DEM_Event_Can_Timeout_Status_u8 "VAR_DEM_Event_Can_Timeout_Status_u8" UBYTE BSW_A2L_Ident_Int 1 100 0 255 ECU_ADDRESS 0x00000000 /end MEASUREMENT
/begin MEASUREMENT VAR_DEM_Event_CANSM_E_BUS_OFF_NETWORK_1_Status_u8 "VAR_DEM_Event_CANSM_E_BUS_OFF_NETWORK_1_Status_u8" UBYTE BSW_A2L_Ident_Int 1 100 0 255 ECU_ADDRESS 0x00000000 /end MEASUREMENT
/begin MEASUREMENT VAR_PcfSig_flgPowerOn_b "VAR_PcfSig_flgPowerOn_b" UBYTE BSW_A2L_Ident_Int 1 100 0 1 ECU_ADDRESS 0x00000000 /end MEASUREMENT
/begin CHARACTERISTIC CAL_TRSP_UBRVoltErrRst_b "CAL_TRSP_UBRVoltErrRst_b" VALUE 0x00000000 Scalar_BOOLEAN 0 BSW_A2L_Ident_Int 0 1 /end CHARACTERISTIC
/begin MEASUREMENT VAR_MCF_iqDes_f32 "VAR_MCF_iqDes_f32" FLOAT32_IEEE BSW_A2L_Ident_Float 1 100 -3.4E+38 3.4E+38 ECU_ADDRESS 0x00000000 /end MEASUREMENT
/begin CHARACTERISTIC CAL_TpcSmp_uDcLnkMinMin_f32 "CAL_TpcSmp_uDcLnkMinMin_f32" VALUE 0x00000000 Scalar_FLOAT32_IEEE 0 BSW_A2L_Ident_Float -3.4E+38 3.4E+38 /end CHARACTERISTIC
/begin MEASUREMENT VAR_TpcSmp_uDcLnkOvWarnState_u8 "VAR_TpcSmp_uDcLnkOvWarnState_u8" UBYTE BSW_A2L_Ident_Int 1 100 0 255 ECU_ADDRESS 0x00000000 /end MEASUREMENT
/begin MEASUREMENT VAR_Pwm_Freq_u16 "VAR_Pwm_Freq_u16" UWORD BSW_A2L_Ident_Int 1 100 0 65535 ECU_ADDRESS 0x00000000 /end MEASUREMENT
/begin CHARACTERISTIC CAL_DEM_FIM_DFC_CANSM_E_BUS_OFF_NETWORK_0_au8 "CAL_DEM_FIM_DFC_CANSM_E_BUS_OFF_NETWORK_0_au8" VAL_BLK 0x00000000 Scalar_UBYTE 0 FID_Verb 0 255 NUMBER 10 /end CHARACTERISTIC
/begin CHARACTERISTIC CAL_DEM_FIM_DFC_HvMcu_DisChrgDutyErr_au8 "CAL_DEM_FIM_DFC_HvMcu_DisChrgDutyErr_au8" VAL_BLK 0x00000000 Scalar_UBYTE 0 FID_Verb 0 255 NUMBER 10 /end CHARACTERISTIC
/begin MEASUREMENT VAR_L2Sampling_IsU_Mon_f32 "VAR_L2Sampling_IsU_Mon_f32" FLOAT32_IEEE BSW_A2L_Ident_Float 1 100 -3.4E+38 3.4E+38 ECU_ADDRESS 0x00000000 /end MEASUREMENT
/begin MEASUREMENT VAR_STM0_BSW_10ms_Task_Core0_u32 "VAR_STM0_BSW_10ms_Task_Core0_u32" ULONG BSW_A2L_Ident_Int 1 100 0 4294967295 ECU_ADDRESS 0x00000000 /end MEASUREMENT
/begin COMPU_METHOD BSW_A2L_Ident_Float "Q = V" RAT_FUNC "%8.6" "" COEFFS 0 1 0 0 0 1 /end COMPU_METHOD
/begin COMPU_METHOD BSW_A2L_Ident_Int "Q = V" RAT_FUNC "%8.0" "" COEFFS 0 1 0 0 0 1 /end COMPU_METHOD
/begin COMPU_METHOD FID_Verb "" TAB_VERB " % 2.1" " - " COMPU_TAB_REF FID_LIST /end COMPU_METHOD
/begin COMPU_VTAB FID_LIST "" TAB_VERB 162 1 "FIM_ADC_UPhaseBISTFail" 2 "FIM_ADC_VPhaseBISTFail" 3 "FIM_ADC_WPhaseBISTFail" 4 "FIM_CANSM_E_BUS_OFF_NETWORK_0" 5 "FIM_Can_Timeout" 6 "FIM_CpldErr" 7 "FIM_Cpld_AliveChkErr" 8 "FIM_Cpld_DI_ExdClk_InFail" 9 "FIM_Cpld_ExdClkInFail" 10 "FIM_Cpld_IphaOC" 11 "FIM_Cpld_NEN_InFail" 12 "FIM_Cpld_ParityChkErr" 13 "FIM_Cpld_SPIComFail" 14 "FIM_Cpld_SZTKT_InFail" 15 "FIM_Cpld_Short_Circuit_HS_InFail" 16 "FIM_Cpld_Short_Circuit_LS_InFail" 17 "FIM_Cpld_UdcOverVolFail" 18 "FIM_Cpld_UnderVol_HS_InFail" 19 "FIM_Cpld_UnderVol_LS_InFail" 20 "FIM_Epark_OverCurFail" 21 "FIM_Epark_PosMonSampFail" 22 "FIM_Epark_PosSampFail" 23 "FIM_Epark_SampFail" 24 "FIM_Event_NvM_ReadErr" 25 "FIM_Event_NvM_WriteErr" 26 "FIM_FRStoErr" 27 "FIM_FR_StorageErr" 28 "FIM_HSPF_InvOpenErr" 29 "FIM_HSPF_MotorOpenErr" 30 "FIM_HSPF_VerMatchFailureErr" 31 "FIM_HSPF_stIphaOffCalFail" 32 "FIM_HSPF_tDBCTempCmpErr" 33 "FIM_HvMcu_ComErr" 34 "FIM_HvMcu_DisChrgDutyErr" 35 "FIM_HvMcu_DisChrgFail" 36 "FIM_HvMcu_DisChrgFreqErr" 37 "FIM_HvMcu_EmerPowerSapErr" 38 "FIM_HvMcu_UartCheckFailErr" 39 "FIM_HvMcu_UartLostFrameErr" 40 "FIM_HvMcu_UdcCheckErr" 41 "FIM_HvMcu_UdcOverVolErr" 42 "FIM_HvmcuErr" 43 "FIM_IGBTOvTempErr" 44 "FIM_IGBTOvTempWarn" 45 "FIM_IOHWAB_12VNarrSampErr" 46 "FIM_IOHWAB_12VSampErr" 47 "FIM_IOHWAB_12VWideSampErr" 48 "FIM_IOHWAB_18VLwBrgSampFail" 49 "FIM_IOHWAB_18VUpBrgSampFail" 50 "FIM_IOHWAB_1V3MCU_SampFail" 51 "FIM_IOHWAB_3V3MCU_SampFail" 52 "FIM_IOHWAB_5VQcoSampFail" 53 "FIM_IOHWAB_5VQt1SampFail" 54 "FIM_IOHWAB_5VQt2SampFail" 55 "FIM_IOHWAB_Cpld1v8SampFail" 56 "FIM_IOHWAB_Cpld3v3SampFail" 57 "FIM_IOHWAB_CrashFail" 58 "FIM_IOHWAB_DcLnkOverVolFail" 59 "FIM_IOHWAB_IphaOCFail" 60 "FIM_IOHWAB_KL30OverVolErr" 61 "FIM_IOHWAB_KL30SevOverVolFail" 62 "FIM_IOHWAB_KL30SevUnderVolFail" 63 "FIM_IOHWAB_KL30UnderVolErr" 64 "FIM_IOHWAB_Nen33Fail" 65 "FIM_IOHWAB_SttrSenorShrFail" 66 "FIM_IOHWAB_SttrTemp1SampFail" 67 "FIM_IOHWAB_SttrTemp2SampFail" 68 "FIM_IOHWAB_TCoolantSampFail" 69 "FIM_IOHWAB_VDD5_D_SampFail" 70 "FIM_IgbtDrvErr" 71 "FIM_IgbtDrv_ComErr" 72 "FIM_IgbtDrv_LwBrgFaultAFail" 73 "FIM_IgbtDrv_LwBrgFaultBFail" 74 "FIM_IgbtDrv_UpBrgFaultAFail" 75 "FIM_IgbtDrv_UpBrgFaultBFail" 76 "FIM_IohwabSampErr" 77 "FIM_Lamp" 78 "FIM_LowPowerOvVErr" 79 "FIM_LowPowerUnVErr" 80 "FIM_MDF_AlOfsNoPlausErr" 81 "FIM_MDF_DiashCirNoPsblErr" 82 "FIM_MDF_EmacBlkdErr" 83 "FIM_MDF_EmacBlkdWarn" 84 "FIM_MDF_ICtlRatErr" 85 "FIM_MDF_IsOvHiErr" 86 "FIM_MDF_OpenCirNoPsblErr" 87 "FIM_MDF_OperOutdRngErr" 88 "FIM_MDF_PhaseLossFaultErr" 89 "FIM_MDF_PrfElDrvErr" 90 "FIM_MtrOvTempErr" 91 "FIM_MtrOvTempWarn" 92 "FIM_PCF_ActOvTiErr" 93 "FIM_PCF_IdcOvErr" 94 "FIM_PCF_SelfcheckErr" 95 "FIM_PCF_SenClbErr" 96 "FIM_PCF_SenOvErr" 97 "FIM_PCF_StallRetryErr" 98 "FIM_PCF_StallWarn" 99 "FIM_PCF_UnexpPosErr" 100 "FIM_PwrLimLvFour" 101 "FIM_PwrLimLvOne" 102 "FIM_PwrLimLvThree" 103 "FIM_PwrLimLvTwo" 104 "FIM_RCF_AccOvTiErr" 105 "FIM_RCF_EstOfsErr" 106 "FIM_RCF_FwlBwdOvTiErr" 107 "FIM_RCF_FwlFwdOvTiErr" 108 "FIM_RCF_OfsClbFail" 109 "FIM_RCF_PsiOvErr" 110 "FIM_RSL_DOSErr" 111 "FIM_RSL_ExcErr" 112 "FIM_RSL_LOSErr" 113 "FIM_RSL_LOTErr" 114 "FIM_ReqFailrMod" 115 "FIM_RslvOpen" 116 "FIM_SCF_DisChgOvTiFail" 117 "FIM_SCF_LowPwrShtDwnOvTiFail" 118 "FIM_SCF_RunToDischarErr" 119 "FIM_SpdOvHiErr" 120 "FIM_SpdOvHiWarn" 121 "FIM_Sttr1Err" 122 "FIM_Sttr2Err" 123 "FIM_TPC_SpdOvHiLimFail" 124 "FIM_TPC_SpdOvHiWarn" 125 "FIM_TPC_TCoolantOvHiWarn" 126 "FIM_TPC_TDbcOvHiWarn" 127 "FIM_TPC_TDbcOvLoWarn" 128 "FIM_TPC_TDbcUHiLimFail" 129 "FIM_TPC_TDbcULoLimFail" 130 "FIM_TPC_TDbcVHiLimFail" 131 "FIM_TPC_TDbcVLoLimFail" 132 "FIM_TPC_TDbcWHiLimFail" 133 "FIM_TPC_TDbcWLoLimFail" 134 "FIM_TPC_TDrvBoardOvHiWarn" 135 "FIM_TPC_TIGBTOvHiLimErr" 136 "FIM_TPC_TIGBTOvHiWarn" 137 "FIM_TPC_TIGBTOvLoWarn" 138 "FIM_TPC_TSttrOvHiLimFail" 139 "FIM_TPC_TSttrOvHiWarn" 140 "FIM_TPC_TSttrOvLoWarn" 141 "FIM_TPC_iDcLnkOvCLimFail" 142 "FIM_TPC_iDcLnkOvcWarn" 143 "FIM_TPC_uDcLnkOvVLimFail" 144 "FIM_TPC_uDcLnkOvWarn" 145 "FIM_TPC_uDcLnkUnVLimFail" 146 "FIM_TPC_uDcLnkUnvWarn" 147 "FIM_TrqLimLvFour" 148 "FIM_TrqLimLvOne" 149 "FIM_TrqLimLvThree" 150 "FIM_TrqLimLvTwo" 151 "FIM_Unused" 152 "FIM_VCUComTimeOut" 153 "FIM_flgDchaFailr" 154 "FIM_flgFaultLvFive" 155 "FIM_flgFaultLvFour" 156 "FIM_iDcLnkOvcErr" 157 "FIM_iDcLnkOvcWarn" 158 "FIM_uDcLnkOvErr" 159 "FIM_uDcLnkOvWarn" 160 "FIM_uDcLnkUnvErr" 161 "FIM_uDcLnkUnvWarn" 162 "FiM_FlagforFR" DEFAULT_VALUE "---" /end COMPU_VTAB
/end MODULE
/end PROJECT
/* (add any file trailer comments here) */ /* EOF A2LTOOLKIT_A2L.a2l */
