ASAP2_VERSION 1 31
/begin PROJECT ProjectName "A2LTOOLKIT_A2L"
/begin HEADER "A2LTOOLKIT_A2L" /end HEADER
/begin MODULE ModuleName "A2LTOOLKIT_A2L"
/begin MOD_COMMON "A2LTOOLKIT_A2L" BYTE_ORDER MSB_LAST /end MOD_COMMON
/begin RECORD_LAYOUT Scalar_BOOLEAN FNC_VALUES 1 UBYTE COLUMN_DIR DIRECT /end RECORD_LAYOUT
/begin RECORD_LAYOUT Scalar_UBYTE FNC_VALUES 1 UBYTE COLUMN_DIR DIRECT /end RECORD_LAYOUT
/begin RECORD_LAYOUT Scalar_BYTE FNC_VALUES 1 SBYTE COLUMN_DIR DIRECT /end RECORD_LAYOUT
/begin RECORD_LAYOUT Scalar_UWORD FNC_VALUES 1 UWORD COLUMN_DIR DIRECT /end RECORD_LAYOUT
/begin RECORD_LAYOUT Scalar_SWORD FNC_VALUES 1 SWORD COLUMN_DIR DIRECT /end RECORD_LAYOUT
/begin RECORD_LAYOUT Scalar_ULONG FNC_VALUES 1 ULONG COLUMN_DIR DIRECT /end RECORD_LAYOUT
/begin RECORD_LAYOUT Scalar_LONG FNC_VALUES 1 SLONG COLUMN_DIR DIRECT /end RECORD_LAYOUT
/begin RECORD_LAYOUT Scalar_FLOAT32_IEEE FNC_VALUES 1 FLOAT32_IEEE COLUMN_DIR DIRECT /end RECORD_LAYOUT
/begin MEASUREMENT VAR_TRSP_RslvSensVoltRngChkRslt_b "VAR_TRSP_RslvSensVoltRngChkRslt_b" UBYTE BSW_A2L_Ident_Int 1 100 0 1 ECU_ADDRESS 0x00000000 /end MEASUREMENT
/begin CHARACTERISTIC CAL_Cspf_flgbDernCoolantTempSwt_b "CAL_Cspf_flgbDernCoolantTempSwt_b" VALUE 0x00000000 Scalar_BOOLEAN 0 BSW_A2L_Ident_Int 0 1 /end CHARACTERISTIC
/begin MEASUREMENT VAR_TpcTmp_TCoolStableDiff_u16 "VAR_TpcTmp_TCoolStableDiff_u16" UWORD BSW_A2L_Ident_Int 1 100 0 65535 ECU_ADDRESS 0x00000000 /end MEASUREMENT
/begin CHARACTERISTIC CAL_Cspf_flgCrashSwt_b "CAL_Cspf_flgCrashSwt_b" VALUE 0x00000000 Scalar_BOOLEAN 0 BSW_A2L_Ident_Int 0 1 /end CHARACTERISTIC
/begin MEASUREMENT VAR_NvM_EEP_Study_au8 "VAR_NvM_EEP_Study_au8" UBYTE BSW_A2L_Ident_Int 1 100 0 255 ARRAY_SIZE 8 ECU_ADDRESS 0x00000000 /end MEASUREMENT
/begin CHARACTERISTIC CAL_MCF_flgOfsClbTest_b "CAL_MCF_flgOfsClbTest_b" VALUE 0x00000000 Scalar_BOOLEAN 0 BSW_A2L_Ident_Int 0 1 /end CHARACTERISTIC
/begin CHARACTERISTIC CAL_PcfSig_flgPowerOn_b "CAL_PcfSig_flgPowerOn_b" VALUE 0x00000000 Scalar_BOOLEAN 0 BSW_A2L_Ident_Int 0 1 /end CHARACTERISTIC
/begin MEASUREMENT VAR_HSPF_StrrTempFlt_f32 "VAR_HSPF_StrrTempFlt_f32" FLOAT32_IEEE BSW_A2L_Ident_Float 1 100 -3.4E+38 3.4E+38 ECU_ADDRESS 0x00000000 /end MEASUREMENT
/begin CHARACTERISTIC CAL_PcfDia_nMechHiHyst_f32 "CAL_PcfDia_nMechHiHyst_f32" VALUE 0x00000000 Scalar_FLOAT32_IEEE 0 BSW_A2L_Ident_Float -3.4E+38 3.4E+38 /end CHARACTERISTIC
/begin CHARACTERISTIC CAL_Vcf_NegDmpMaxTrq_f32 "CAL_Vcf_NegDmpMaxTrq_f32" VALUE 0x00000000 Scalar_FLOAT32_IEEE 0 BSW_A2L_Ident_Float -3.4E+38 3.4E+38 /end CHARACTERISTIC
/begin MEASUREMENT VAR_Scf_flgNoWakeSou_b "VAR_Scf_flgNoWakeSou_b" UBYTE BSW_A2L_Ident_Int 1 100 0 1 ECU_ADDRESS 0x00000000 /end MEASUREMENT
/begin CHARACTERISTIC CAL_Tpc_TrqRevStep_f32 "CAL_Tpc_TrqRevStep_f32" VALUE 0x00000000 Scalar_FLOAT32_IEEE 0 BSW_A2L_Ident_Float -3.4E+38 3.4E+38 /end CHARACTERISTIC
/begin CHARACTERISTIC CAL_TRSP_ReqTrqDebTrh_s16 "CAL_TRSP_ReqTrqDebTrh_s16" VALUE 0x00000000 Scalar_SWORD 0 BSW_A2L_Ident_Int -32768 32767 /end CHARACTERISTIC
/begin MEASUREMENT VAR_PcfStm_flgNPCToStandby_b "VAR_PcfStm_flgNPCToStandby_b" UBYTE BSW_A2L_Ident_Int 1 100 0 1 ECU_ADDRESS 0x00000000 /end MEASUREMENT
/begin CHARACTERISTIC CAL_MDF_FwWiIs_f32 "CAL_MDF_FwWiIs_f32" VALUE 0x00000000 Scalar_FLOAT32_IEEE 0 BSW_A2L_Ident_Float -3.4E+38 3.4E+38 /end CHARACTERISTIC
/begin MEASUREMENT VAR_TpcTmp_tIgbtRiseTempFlt_u16 "VAR_TpcTmp_tIgbtRiseTempFlt_u16" UWORD BSW_A2L_Ident_Int 1 100 0 65535 ECU_ADDRESS 0x00000000 /end MEASUREMENT
/begin CHARACTERISTIC CAL_PcfDia_VDD5Debounce_f32 "CAL_PcfDia_VDD5Debounce_f32" VALUE 0x00000000 Scalar_FLOAT32_IEEE 0 BSW_A2L_Ident_Float -3.4E+38 3.4E+38 /end CHARACTERISTIC
/begin CHARACTERISTIC CAL_TpcCod_PowIncRatLim_f32 "CAL_TpcCod_PowIncRatLim_f32" VALUE 0x00000000 Scalar_FLOAT32_IEEE 0 BSW_A2L_Ident_Float -3.4E+38 3.4E+38 /end CHARACTERISTIC
/begin MEASUREMENT VAR_ADM_stModeReq_u8 "VAR_ADM_stModeReq_u8" UBYTE BSW_A2L_Ident_Int 1 100 0 255 ECU_ADDRESS 0x00000000 /end MEASUREMENT
/begin MEASUREMENT VAR_IoHwAb_Adc_Phy_18V_HS_f32 "VAR_IoHwAb_Adc_Phy_18V_HS_f32" FLOAT32_IEEE BSW_A2L_Ident_Float 1 100 -3.4E+38 3.4E+38 ECU_ADDRESS 0x00000000 /end MEASUREMENT
/begin CHARACTERISTIC CAL_PcfSig_flgstDoorSwt_b "CAL_PcfSig_flgstDoorSwt_b" VALUE 0x00000000 Scalar_BOOLEAN 0 BSW_A2L_Ident_Int 0 1 /end CHARACTERISTIC
/begin MEASUREMENT VAR_RCF_flgDefaultToClbFreFwd_b "VAR_RCF_flgDefaultToClbFreFwd_b" UBYTE BSW_A2L_Ident_Int 1 100 0 1 ECU_ADDRESS 0x00000000 /end MEASUREMENT
/begin CHARACTERISTIC CAL_TpcBlk_TrqDecRamp_f32 "CAL_TpcBlk_TrqDecRamp_f32" VALUE 0x00000000 Scalar_FLOAT32_IEEE 0 BSW_A2L_Ident_Float -3.4E+38 3.4E+38 /end CHARACTERISTIC
/begin MEASUREMENT VAR_Cspf_TrabDernTempiGBT_u8 "VAR_Cspf_TrabDernTempiGBT_u8" UBYTE BSW_A2L_Ident_Int 1 100 0 255 ECU_ADDRESS 0x00000000 /end MEASUREMENT
/begin CHARACTERISTIC CAL_Vcf_TrqCtlReq_u8 "CAL_Vcf_TrqCtlReq_u8" VALUE 0x00000000 Scalar_UBYTE 0 BSW_A2L_Ident_Int 0 255 /end CHARACTERISTIC
/begin MEASUREMENT VAR_TpcFuv_FimTrqLimLv2_b "VAR_TpcFuv_FimTrqLimLv2_b" UBYTE BSW_A2L_Ident_Int 1 100 0 1 ECU_ADDRESS 0x00000000 /end MEASUREMENT
/begin CHARACTERISTIC CAL_DEM_Disbl_DFC_Epark_PosMonSampFail_u8 "CAL_DEM_Disbl_DFC_Epark_PosMonSampFail_u8" VALUE 0x00000000 Scalar_UBYTE 0 BSW_A2L_Ident_Int 0 255 /end CHARACTERISTIC
/begin CHARACTERISTIC CAL_MDF_nAbsThresblockedElMa_f32 "CAL_MDF_nAbsThresblockedElMa_f32" VALUE 0x00000000 Scalar_FLOAT32_IEEE 0 BSW_A2L_Ident_Float -3.4E+38 3.4E+38 /end CHARACTERISTIC
/begin MEASUREMENT VAR_TRSP_UBRVoltRngChkRslt_b "VAR_TRSP_UBRVoltRngChkRslt_b" UBYTE BSW_A2L_Ident_Int 1 100 0 1 ECU_ADDRESS 0x00000000 /end MEASUREMENT
/begin CHARACTERISTIC CAL_RCF_cntMovAveFilFwd_u16 "CAL_RCF_cntMovAveFilFwd_u16" VALUE 0x00000000 Scalar_UWORD 0 BSW_A2L_Ident_Int 0 65535 /end CHARACTERISTIC
/begin CHARACTERISTIC CAL_Cspf_tDBCTempVFlt_f32 "CAL_Cspf_tDBCTempVFlt_f32" VALUE 0x00000000 Scalar_FLOAT32_IEEE 0 BSW_A2L_Ident_Float -3.4E+38 3.4E+38 /end CHARACTERISTIC
/begin CHARACTERISTIC CAL_DEM_FIM_DFC_Cpld_Rx_SelfTest_Fail_au8 "CAL_DEM_FIM_DFC_Cpld_Rx_SelfTest_Fail_au8" VAL_BLK 0x00000000 Scalar_UBYTE 0 FID_Verb 0 255 NUMBER 10 /end CHARACTERISTIC
/begin CHARACTERISTIC CAL_TpcCod_MotorStallWarn_b "CAL_TpcCod_MotorStallWarn_b" VALUE 0x00000000 Scalar_BOOLEAN 0 BSW_A2L_Ident_Int 0 1 /end CHARACTERISTIC
/begin MEASUREMENT VAR_MCF_TMAhtChsts_f32 "VAR_MCF_TMAhtChsts_f32" FLOAT32_IEEE BSW_A2L_Ident_Float 1 100 -3.4E+38 3.4E+38 ECU_ADDRESS 0x00000000 /end MEASUREMENT
/begin MEASUREMENT VAR_Vcf_SpdChangeRatio_f32 "VAR_Vcf_SpdChangeRatio_f32" FLOAT32_IEEE BSW_A2L_Ident_Float 1 100 -3.4E+38 3.4E+38 ECU_ADDRESS 0x00000000 /end MEASUREMENT
/begin CHARACTERISTIC CAL_BCC_flgEnableIdc_b "CAL_BCC_flgEnableIdc_b" VALUE 0x00000000 Scalar_BOOLEAN 0 BSW_A2L_Ident_Int 0 1 /end CHARACTERISTIC
/begin MEASUREMENT VAR_MDF_bstGateDrvOpenCir_b "VAR_MDF_bstGateDrvOpenCir_b" UBYTE BSW_A2L_Ident_Int 1 100 0 1 ECU_ADDRESS 0x00000000 /end MEASUREMENT
/begin CHARACTERISTIC CAL_DEM_FIM_DFC_Cpld_Short_Circuit_LS_InFail_au8 "CAL_DEM_FIM_DFC_Cpld_Short_Circuit_LS_InFail_au8" VAL_BLK 0x00000000 Scalar_UBYTE 0 FID_Verb 0 255 NUMBER 10 /end CHARACTERISTIC
/begin CHARACTERISTIC CAL_TRSP_CurrSumCountTrh_s16 "CAL_TRSP_CurrSumCountTrh_s16" VALUE 0x00000000 Scalar_SWORD 0 BSW_A2L_Ident_Int -32768 32767 /end CHARACTERISTIC
/begin CHARACTERISTIC CAL_TpcMot_tSttrTraSave1ToSave2_f32 "CAL_TpcMot_tSttrTraSave1ToSave2_f32" VALUE 0x00000000 Scalar_FLOAT32_IEEE 0 BSW_A2L_Ident_Float -3.4E+38 3.4E+38 /end CHARACTERISTIC
/begin CHARACTERISTIC CAL_TpcSmp_uDcLnkMaxMin_f32 "CAL_TpcSmp_uDcLnkMaxMin_f32" VALUE 0x00000000 Scalar_FLOAT32_IEEE 0 BSW_A2L_Ident_Float -3.4E+38 3.4E+38 /end CHARACTERISTIC
/begin MEASUREMENT VAR_TpcTmp_tCoolantTempFlt_f32 "VAR_TpcTmp_tCoolantTempFlt_f32" FLOAT32_IEEE BSW_A2L_Ident_Float 1 100 -3.4E+38 3.4E+38 ECU_ADDRESS 0x00000000 /end MEASUREMENT
/begin CHARACTERISTIC CAL_Scf_cntDisChgEnd_u16 "CAL_Scf_cntDisChgEnd_u16" VALUE 0x00000000 Scalar_UWORD 0 BSW_A2L_Ident_Int 0 65535 /end CHARACTERISTIC
/begin CHARACTERISTIC CAL_Cspf_flgnSlowFltSwt_b "CAL_Cspf_flgnSlowFltSwt_b" VALUE 0x00000000 Scalar_BOOLEAN 0 BSW_A2L_Ident_Int 0 1 /end CHARACTERISTIC
/begin MEASUREMENT VAR_RCF_flgWaitToFail_b "VAR_RCF_flgWaitToFail_b" UBYTE BSW_A2L_Ident_Int 1 100 0 1 ECU_ADDRESS 0x00000000 /end MEASUREMENT
/begin MEASUREMENT VAR_TpcTmp_TDbcOvLoWarnState_u8 "VAR_TpcTmp_TDbcOvLoWarnState_u8" UBYTE BSW_A2L_Ident_Int 1 100 0 255 ECU_ADDRESS 0x00000000 /end MEASUREMENT
/begin CHARACTERISTIC CAL_FRP_CurrRngErrOutCtl_b "CAL_FRP_CurrRngErrOutCtl_b" VALUE 0x00000000 Scalar_BOOLEAN 0 BSW_A2L_Ident_Int 0 1 /end CHARACTERISTIC
/begin MEASUREMENT VAR_IoHwAb_Adc_Phy_5V_Qt2_f32 "VAR_IoHwAb_Adc_Phy_5V_Qt2_f32" FLOAT32_IEEE BSW_A2L_Ident_Float 1 100 -3.4E+38 3.4E+38 ECU_ADDRESS 0x00000000 /end MEASUREMENT
/begin MEASUREMENT VAR_TpcSmp_ElecPwrLimOvrCurt_f32 "VAR_TpcSmp_ElecPwrLimOvrCurt_f32" FLOAT32_IEEE BSW_A2L_Ident_Float 1 100 -3.4E+38 3.4E+38 ECU_ADDRESS 0x00000000 /end MEASUREMENT
/begin MEASUREMENT VAR_PcfStm_flgStandbyToSLC_b "VAR_PcfStm_flgStandbyToSLC_b" UBYTE BSW_A2L_Ident_Int 1 100 0 1 ECU_ADDRESS 0x00000000 /end MEASUREMENT
/begin CHARACTERISTIC CAL_STM_UxptTrqMonCountTrh_s16 "CAL_STM_UxptTrqMonCountTrh_s16" VALUE 0x00000000 Scalar_SWORD 0 BSW_A2L_Ident_Int -32768 32767 /end CHARACTERISTIC
/begin CHARACTERISTIC CAL_Scf_FFActionArea3_u8 "CAL_Scf_FFActionArea3_u8" VALUE 0x00000000 Scalar_UBYTE 0 BSW_A2L_Ident_Int 0 255 /end CHARACTERISTIC
/begin CHARACTERISTIC CAL_DEM_FIM_DFC_Cpld_ParityChkErr_au8 "CAL_DEM_FIM_DFC_Cpld_ParityChkErr_au8" VAL_BLK 0x00000000 Scalar_UBYTE 0 FID_Verb 0 255 NUMBER 10 /end CHARACTERISTIC
/begin CHARACTERISTIC CAL_TpcSmp_iDcLnkMaxMin_f32 "CAL_TpcSmp_iDcLnkMaxMin_f32" VALUE 0x00000000 Scalar_FLOAT32_IEEE 0 BSW_A2L_Ident_Float -3.4E+38 3.4E+38 /end CHARACTERISTIC
/begin CHARACTERISTIC CAL_DEM_FIM_DFC_PCF_SenOvErr_au8 "CAL_DEM_FIM_DFC_PCF_SenOvErr_au8" VAL_BLK 0x00000000 Scalar_UBYTE 0 FID_Verb 0 255 NUMBER 10 /end CHARACTERISTIC
/begin MEASUREMENT VAR_PcfStm_BCMotDir_b "VAR_PcfStm_BCMotDir_b" UBYTE BSW_A2L_Ident_Int 1 100 0 1 ECU_ADDRESS 0x00000000 /end MEASUREMENT
/begin MEASUREMENT VAR_DEM_Event_IOHWAB_12VNarrSampErr_Status_u8 "VAR_DEM_Event_IOHWAB_12VNarrSampErr_Status_u8" UBYTE BSW_A2L_Ident_Int 1 100 0 255 ECU_ADDRESS 0x00000000 /end MEASUREMENT
/begin MEASUREMENT VAR_DEM_Event_TPC_TDbcVHiLimFail_Status_u8 "VAR_DEM_Event_TPC_TDbcVHiLimFail_Status_u8" UBYTE BSW_A2L_Ident_Int 1 100 0 255 ECU_ADDRESS 0x00000000 /end MEASUREMENT
/begin CHARACTERISTIC CAL_TRSP_RslvSqrtLoLim_u16 "CAL_TRSP_RslvSqrtLoLim_u16" VALUE 0x00000000 Scalar_UWORD 0 BSW_A2L_Ident_Int 0 65535 /end CHARACTERISTIC
/begin CHARACTERISTIC CAL_TpcSmp_nCtlIntReq_u8 "CAL_TpcSmp_nCtlIntReq_u8" VALUE 0x00000000 Scalar_UBYTE 0 BSW_A2L_Ident_Int 0 255 /end CHARACTERISTIC
/begin CHARACTERISTIC CAL_DEM_Disbl_DFC_MDF_ICtlRatErr_u8 "CAL_DEM_Disbl_DFC_MDF_ICtlRatErr_u8" VALUE 0x00000000 Scalar_UBYTE 0 BSW_A2L_Ident_Int 0 255 /end CHARACTERISTIC
/begin CHARACTERISTIC CAL_TpcFuv_CofTrqLimLv1_f32 "CAL_TpcFuv_CofTrqLimLv1_f32" VALUE 0x00000000 Scalar_FLOAT32_IEEE 0 BSW_A2L_Ident_Float -3.4E+38 3.4E+38 /end CHARACTERISTIC
/begin MEASUREMENT VAR_L2Sampling_IsV_Mon_f32 "VAR_L2Sampling_IsV_Mon_f32" FLOAT32_IEEE BSW_A2L_Ident_Float 1 100 -3.4E+38 3.4E+38 ECU_ADDRESS 0x00000000 /end MEASUREMENT
/begin MEASUREMENT VAR_TCF_iqAct_f32 "VAR_TCF_iqAct_f32" FLOAT32_IEEE BSW_A2L_Ident_Float 1 100 -3.4E+38 3.4E+38 ECU_ADDRESS 0x00000000 /end MEASUREMENT
/begin CHARACTERISTIC CAL_TRSP_iPhaUOffset_f32 "CAL_TRSP_iPhaUOffset_f32" VALUE 0x00000000 Scalar_FLOAT32_IEEE 0 BSW_A2L_Ident_Float -3.4E+38 3.4E+38 /end CHARACTERISTIC
/begin MEASUREMENT VAR_Cspf_TraTempCurrStr2_f32 "VAR_Cspf_TraTempCurrStr2_f32" FLOAT32_IEEE BSW_A2L_Ident_Float 1 100 -3.4E+38 3.4E+38 ECU_ADDRESS 0x00000000 /end MEASUREMENT
/begin CHARACTERISTIC CAL_DEM_Disbl_DFC_MDF_OperOutdRngErr_u8 "CAL_DEM_Disbl_DFC_MDF_OperOutdRngErr_u8" VALUE 0x00000000 Scalar_UBYTE 0 BSW_A2L_Ident_Int 0 255 /end CHARACTERISTIC
/begin MEASUREMENT VAR_DEM_Event_RCF_AccOvTiErr_Status_u8 "VAR_DEM_Event_RCF_AccOvTiErr_Status_u8" UBYTE BSW_A2L_Ident_Int 1 100 0 255 ECU_ADDRESS 0x00000000 /end MEASUREMENT
/begin CHARACTERISTIC CAL_DEM_FIM_DFC_TPC_TDbcWHiLimFail_au8 "CAL_DEM_FIM_DFC_TPC_TDbcWHiLimFail_au8" VAL_BLK 0x00000000 Scalar_UBYTE 0 FID_Verb 0 255 NUMBER 10 /end CHARACTERISTIC
/begin MEASUREMENT VAR_tpcsmp_KpProductSau_f32 "VAR_tpcsmp_KpProductSau_f32" FLOAT32_IEEE BSW_A2L_Ident_Float 1 100 -3.4E+38 3.4E+38 ECU_ADDRESS 0x00000000 /end MEASUREMENT
/begin MEASUREMENT VAR_STM2_TimeData_Pwm3ph_EdgeISR_u32 "VAR_STM2_TimeData_Pwm3ph_EdgeISR_u32" ULONG BSW_A2L_Ident_Int 1 100 0 4294967295 ECU_ADDRESS 0x00000000 /end MEASUREMENT
/begin CHARACTERISTIC CAL_DEM_FIM_DFC_IOHWAB_12VNarrSampErr_au8 "CAL_DEM_FIM_DFC_IOHWAB_12VNarrSampErr_au8" VAL_BLK 0x00000000 Scalar_UBYTE 0 FID_Verb 0 255 NUMBER 10 /end CHARACTERISTIC
/begin MEASUREMENT VAR_PwmDutyCyclePhaseU_f32 "VAR_PwmDutyCyclePhaseU_f32" FLOAT32_IEEE BSW_A2L_Ident_Float 1 100 -3.4E+38 3.4E+38 ECU_ADDRESS 0x00000000 /end MEASUREMENT
/begin CHARACTERISTIC CAL_RCF_nMinSkipAcc_f32 "CAL_RCF_nMinSkipAcc_f32" VALUE 0x00000000 Scalar_FLOAT32_IEEE 0 BSW_A2L_Ident_Float -3.4E+38 3.4E+38 /end CHARACTERISTIC
/begin CHARACTERISTIC CAL_TRSP_OfstRngLoLim_f32 "CAL_TRSP_OfstRngLoLim_f32" VALUE 0x00000000 Scalar_FLOAT32_IEEE 0 BSW_A2L_Ident_Float -3.4E+38 3.4E+38 /end CHARACTERISTIC
/begin MEASUREMENT VAR_Hspf_uDcLnk_f32 "VAR_Hspf_uDcLnk_f32" FLOAT32_IEEE BSW_A2L_Ident_Float 1 100 -3.4E+38 3.4E+38 ECU_ADDRESS 0x00000000 /end MEASUREMENT
/begin CHARACTERISTIC CAL_STM_UxptSpdMonDebTrh_s16 "CAL_STM_UxptSpdMonDebTrh_s16" VALUE 0x00000000 Scalar_SWORD 0 BSW_A2L_Ident_Int -32768 32767 /end CHARACTERISTIC
/begin CHARACTERISTIC CAL_TjstUVW_u8 "CAL_TjstUVW_u8" VALUE 0x00000000 Scalar_UBYTE 0 BSW_A2L_Ident_Int 0 255 /end CHARACTERISTIC
/begin MEASUREMENT VAR_L2Com_TrqSetP_f32 "VAR_L2Com_TrqSetP_f32" FLOAT32_IEEE BSW_A2L_Ident_Float 1 100 -3.4E+38 3.4E+38 ECU_ADDRESS 0x00000000 /end MEASUREMENT
/begin MEASUREMENT VAR_MCF_iAlphaActFlt_f32 "VAR_MCF_iAlphaActFlt_f32" FLOAT32_IEEE BSW_A2L_Ident_Float 1 100 -3.4E+38 3.4E+38 ECU_ADDRESS 0x00000000 /end MEASUREMENT
/begin CHARACTERISTIC CAL_Cspf_flgCrash_b "CAL_Cspf_flgCrash_b" VALUE 0x00000000 Scalar_BOOLEAN 0 BSW_A2L_Ident_Int 0 1 /end CHARACTERISTIC
/begin MEASUREMENT VAR_IgbtDrv_Level_NFLTB_L_u8 "VAR_IgbtDrv_Level_NFLTB_L_u8" UBYTE BSW_A2L_Ident_Int 1 100 0 255 ECU_ADDRESS 0x00000000 /end MEASUREMENT
/begin CHARACTERISTIC CAL_TpcTmp_IGBTRiseTempRiseDiff_f32 "CAL_TpcTmp_IGBTRiseTempRiseDiff_f32" VALUE 0x00000000 Scalar_FLOAT32_IEEE 0 BSW_A2L_Ident_Float -3.4E+38 3.4E+38 /end CHARACTERISTIC
/begin MEASUREMENT VAR_Hspf_tDBCTempU_f32 "VAR_Hspf_tDBCTempU_f32" FLOAT32_IEEE BSW_A2L_Ident_Float 1 100 -3.4E+38 3.4E+38 ECU_ADDRESS 0x00000000 /end MEASUREMENT
/begin CHARACTERISTIC CAL_MDF_IsPhaseFault_f32 "CAL_MDF_IsPhaseFault_f32" VALUE 0x00000000 Scalar_FLOAT32_IEEE 0 BSW_A2L_Ident_Float -3.4E+38 3.4E+38 /end CHARACTERISTIC
/begin CHARACTERISTIC CAL_Scf_EmgDchabysiglordoubSwt_b "CAL_Scf_EmgDchabysiglordoubSwt_b" VALUE 0x00000000 Scalar_BOOLEAN 0 BSW_A2L_Ident_Int 0 1 /end CHARACTERISTIC
/begin MEASUREMENT VAR_Scf_flgTranFaultToDcha_b "VAR_Scf_flgTranFaultToDcha_b" UBYTE BSW_A2L_Ident_Int 1 100 0 1 ECU_ADDRESS 0x00000000 /end MEASUREMENT
/begin MEASUREMENT VAR_Scf_flgFimFaultLvFive_b "VAR_Scf_flgFimFaultLvFive_b" UBYTE BSW_A2L_Ident_Int 1 100 0 1 ECU_ADDRESS 0x00000000 /end MEASUREMENT
/begin MEASUREMENT VAR_TRSP_RslvSinPRngChkRslt_b "VAR_TRSP_RslvSinPRngChkRslt_b" UBYTE BSW_A2L_Ident_Int 1 100 0 1 ECU_ADDRESS 0x00000000 /end MEASUREMENT
/begin CHARACTERISTIC CAL_PcfCtl_timePrePos_u16 "CAL_PcfCtl_timePrePos_u16" VALUE 0x00000000 Scalar_UWORD 0 BSW_A2L_Ident_Int 0 65535 /end CHARACTERISTIC
/begin CHARACTERISTIC CAL_PcfDia_AimInPRatDown_f32 "CAL_PcfDia_AimInPRatDown_f32" VALUE 0x00000000 Scalar_FLOAT32_IEEE 0 BSW_A2L_Ident_Float -3.4E+38 3.4E+38 /end CHARACTERISTIC
/begin CHARACTERISTIC CAL_Cspf_flgkDmpSwt_b "CAL_Cspf_flgkDmpSwt_b" VALUE 0x00000000 Scalar_BOOLEAN 0 BSW_A2L_Ident_Int 0 1 /end CHARACTERISTIC
/begin CHARACTERISTIC CAL_STM_UxptSpdMonCountTrh_s16 "CAL_STM_UxptSpdMonCountTrh_s16" VALUE 0x00000000 Scalar_SWORD 0 BSW_A2L_Ident_Int -32768 32767 /end CHARACTERISTIC
/begin CHARACTERISTIC CAL_MCF_ActiveHeatInit_u8 "CAL_MCF_ActiveHeatInit_u8" VALUE 0x00000000 Scalar_UBYTE 0 BSW_A2L_Ident_Int 0 255 /end CHARACTERISTIC
/begin CHARACTERISTIC CAL_Vcf_GearR_u8 "CAL_Vcf_GearR_u8" VALUE 0x00000000 Scalar_UBYTE 0 BSW_A2L_Ident_Int 0 255 /end CHARACTERISTIC
/begin MEASUREMENT VAR_RCF_OfsFlt4200Fwd_f32 "VAR_RCF_OfsFlt4200Fwd_f32" FLOAT32_IEEE BSW_A2L_Ident_Float 1 100 -3.4E+38 3.4E+38 ECU_ADDRESS 0x00000000 /end MEASUREMENT
/begin MEASUREMENT VAR_RCF_flgClbReset_b "VAR_RCF_flgClbReset_b" UBYTE BSW_A2L_Ident_Int 1 100 0 1 ECU_ADDRESS 0x00000000 /end MEASUREMENT
/begin MEASUREMENT VAR_TCF_Is_f32 "VAR_TCF_Is_f32" FLOAT32_IEEE BSW_A2L_Ident_Float 1 100 -3.4E+38 3.4E+38 ECU_ADDRESS 0x00000000 /end MEASUREMENT
/begin MEASUREMENT VAR_FS_DycU_f32 "VAR_FS_DycU_f32" FLOAT32_IEEE BSW_A2L_Ident_Float 1 100 -3.4E+38 3.4E+38 ECU_ADDRESS 0x00000000 /end MEASUREMENT
/begin CHARACTERISTIC CAL_TRSP_UCurrRngLoLim_f32 "CAL_TRSP_UCurrRngLoLim_f32" VALUE 0x00000000 Scalar_FLOAT32_IEEE 0 BSW_A2L_Ident_Float -3.4E+38 3.4E+38 /end CHARACTERISTIC
/begin MEASUREMENT VAR_RCF_flgFwdClbToWait_b "VAR_RCF_flgFwdClbToWait_b" UBYTE BSW_A2L_Ident_Int 1 100 0 1 ECU_ADDRESS 0x00000000 /end MEASUREMENT
/begin MEASUREMENT VAR_Vcf_nMotorObsv_f32 "VAR_Vcf_nMotorObsv_f32" FLOAT32_IEEE BSW_A2L_Ident_Float 1 100 -3.4E+38 3.4E+38 ECU_ADDRESS 0x00000000 /end MEASUREMENT
/begin CHARACTERISTIC CAL_Cspf_bDernExcMin_u8 "CAL_Cspf_bDernExcMin_u8" VALUE 0x00000000 Scalar_UBYTE 0 BSW_A2L_Ident_Int 0 255 /end CHARACTERISTIC
/begin CHARACTERISTIC CAL_DEM_FIM_DFC_IgbtDrv_ComErr_au8 "CAL_DEM_FIM_DFC_IgbtDrv_ComErr_au8" VAL_BLK 0x00000000 Scalar_UBYTE 0 FID_Verb 0 255 NUMBER 10 /end CHARACTERISTIC
/begin MEASUREMENT VAR_TpcTmp_CofDertTRiseIGBT_f32 "VAR_TpcTmp_CofDertTRiseIGBT_f32" FLOAT32_IEEE BSW_A2L_Ident_Float 1 100 -3.4E+38 3.4E+38 ECU_ADDRESS 0x00000000 /end MEASUREMENT
/begin MEASUREMENT VAR_PcfStm_Actime_u16 "VAR_PcfStm_Actime_u16" UWORD BSW_A2L_Ident_Int 1 100 0 65535 ECU_ADDRESS 0x00000000 /end MEASUREMENT
/begin CHARACTERISTIC CAL_FRP_3V3CPLDVoltRngErrOutCtl_b "CAL_FRP_3V3CPLDVoltRngErrOutCtl_b" VALUE 0x00000000 Scalar_BOOLEAN 0 BSW_A2L_Ident_Int 0 1 /end CHARACTERISTIC
/begin CHARACTERISTIC CAL_DEM_Disbl_DFC_Cpld_UnderVol_LS_InFail_u8 "CAL_DEM_Disbl_DFC_Cpld_UnderVol_LS_InFail_u8" VALUE 0x00000000 Scalar_UBYTE 0 BSW_A2L_Ident_Int 0 255 /end CHARACTERISTIC
/begin MEASUREMENT VAR_DEM_Event_MDF_IsOvHiErr_Status_u8 "VAR_DEM_Event_MDF_IsOvHiErr_Status_u8" UBYTE BSW_A2L_Ident_Int 1 100 0 255 ECU_ADDRESS 0x00000000 /end MEASUREMENT
/begin CHARACTERISTIC CAL_TRSP_RslvSensVoltLoLim_u16 "CAL_TRSP_RslvSensVoltLoLim_u16" VALUE 0x00000000 Scalar_UWORD 0 BSW_A2L_Ident_Int 0 65535 /end CHARACTERISTIC
/begin CHARACTERISTIC CAL_RCF_EstToDefault_b "CAL_RCF_EstToDefault_b" VALUE 0x00000000 Scalar_BOOLEAN 0 BSW_A2L_Ident_Int 0 1 /end CHARACTERISTIC
/begin CHARACTERISTIC CAL_TRSP_RslvSqrtErrRst_b "CAL_TRSP_RslvSqrtErrRst_b" VALUE 0x00000000 Scalar_BOOLEAN 0 BSW_A2L_Ident_Int 0 1 /end CHARACTERISTIC
/begin CHARACTERISTIC CAL_MDF_tThd_TempDBCInvSens3Pha_f32 "CAL_MDF_tThd_TempDBCInvSens3Pha_f32" VALUE 0x00000000 Scalar_FLOAT32_IEEE 0 BSW_A2L_Ident_Float -3.4E+38 3.4E+38 /end CHARACTERISTIC
/begin MEASUREMENT VAR_Cspf_TraFailCode1_u8 "VAR_Cspf_TraFailCode1_u8" UBYTE BSW_A2L_Ident_Int 1 100 0 255 ECU_ADDRESS 0x00000000 /end MEASUREMENT
/begin CHARACTERISTIC CAL_TRSP_RslvRngErrRst_b "CAL_TRSP_RslvRngErrRst_b" VALUE 0x00000000 Scalar_BOOLEAN 0 BSW_A2L_Ident_Int 0 1 /end CHARACTERISTIC
/begin CHARACTERISTIC CAL_TpcSmp_iDcLnkMaxMax_f32 "CAL_TpcSmp_iDcLnkMaxMax_f32" VALUE 0x00000000 Scalar_FLOAT32_IEEE 0 BSW_A2L_Ident_Float -3.4E+38 3.4E+38 /end CHARACTERISTIC
/begin MEASUREMENT VAR_TpcFuv_FimPwrLimLv2_b "VAR_TpcFuv_FimPwrLimLv2_b" UBYTE BSW_A2L_Ident_Int 1 100 0 1 ECU_ADDRESS 0x00000000 /end MEASUREMENT
/begin CHARACTERISTIC CAL_DEM_FIM_DFC_RCF_EstOfsErr_au8 "CAL_DEM_FIM_DFC_RCF_EstOfsErr_au8" VAL_BLK 0x00000000 Scalar_UBYTE 0 FID_Verb 0 255 NUMBER 10 /end CHARACTERISTIC
/begin CHARACTERISTIC CAL_DEM_FIM_DFC_MDF_EmacBlkdErr_au8 "CAL_DEM_FIM_DFC_MDF_EmacBlkdErr_au8" VAL_BLK 0x00000000 Scalar_UBYTE 0 FID_Verb 0 255 NUMBER 10 /end CHARACTERISTIC
/begin CHARACTERISTIC CAL_MCF_Non_ActiveHeat_u8 "CAL_MCF_Non_ActiveHeat_u8" VALUE 0x00000000 Scalar_UBYTE 0 BSW_A2L_Ident_Int 0 255 /end CHARACTERISTIC
/begin CHARACTERISTIC CAL_Vcf_flgOpenCrawlFcn_b "CAL_Vcf_flgOpenCrawlFcn_b" VALUE 0x00000000 Scalar_BOOLEAN 0 BSW_A2L_Ident_Int 0 1 /end CHARACTERISTIC
/begin CHARACTERISTIC CAL_PcfSig_factMosFlt_f32 "CAL_PcfSig_factMosFlt_f32" VALUE 0x00000000 Scalar_FLOAT32_IEEE 0 BSW_A2L_Ident_Float -3.4E+38 3.4E+38 /end CHARACTERISTIC
/begin CHARACTERISTIC CAL_Tj_cofFltCoolant_f32 "CAL_Tj_cofFltCoolant_f32" VALUE 0x00000000 Scalar_FLOAT32_IEEE 0 BSW_A2L_Ident_Float -3.4E+38 3.4E+38 /end CHARACTERISTIC
/begin CHARACTERISTIC CAL_DEM_Disbl_DFC_IOHWAB_Cpld1v8SampFail_u8 "CAL_DEM_Disbl_DFC_IOHWAB_Cpld1v8SampFail_u8" VALUE 0x00000000 Scalar_UBYTE 0 BSW_A2L_Ident_Int 0 255 /end CHARACTERISTIC
/begin CHARACTERISTIC CAL_DEM_FIM_DFC_RSL_ExcErr_au8 "CAL_DEM_FIM_DFC_RSL_ExcErr_au8" VAL_BLK 0x00000000 Scalar_UBYTE 0 FID_Verb 0 255 NUMBER 10 /end CHARACTERISTIC
/begin CHARACTERISTIC CAL_MCF_UsdScalSet_f32 "CAL_MCF_UsdScalSet_f32" VALUE 0x00000000 Scalar_FLOAT32_IEEE 0 BSW_A2L_Ident_Float -3.4E+38 3.4E+38 /end CHARACTERISTIC
/begin MEASUREMENT VAR_DEM_Event_TPC_TIGBTOvHiLimErr_Status_u8 "VAR_DEM_Event_TPC_TIGBTOvHiLimErr_Status_u8" UBYTE BSW_A2L_Ident_Int 1 100 0 255 ECU_ADDRESS 0x00000000 /end MEASUREMENT
/begin MEASUREMENT VAR_Pwm_Mode_u8 "VAR_Pwm_Mode_u8" UBYTE BSW_A2L_Ident_Int 1 100 0 255 ECU_ADDRESS 0x00000000 /end MEASUREMENT
/begin MEASUREMENT VAR_3phPWMVL_Duty_f32 "VAR_3phPWMVL_Duty_f32" FLOAT32_IEEE BSW_A2L_Ident_Float 1 100 -3.4E+38 3.4E+38 ECU_ADDRESS 0x00000000 /end MEASUREMENT
/begin CHARACTERISTIC CAL_MCF_UpPowerHeat_f32 "CAL_MCF_UpPowerHeat_f32" VALUE 0x00000000 Scalar_FLOAT32_IEEE 0 BSW_A2L_Ident_Float -3.4E+38 3.4E+38 /end CHARACTERISTIC
/begin CHARACTERISTIC CAL_Cspf_iDcLnkEstFlt_f32 "CAL_Cspf_iDcLnkEstFlt_f32" VALUE 0x00000000 Scalar_FLOAT32_IEEE 0 BSW_A2L_Ident_Float -3.4E+38 3.4E+38 /end CHARACTERISTIC
/begin CHARACTERISTIC CAL_SCF_flgUseSLCal_b "CAL_SCF_flgUseSLCal_b" VALUE 0x00000000 Scalar_BOOLEAN 0 BSW_A2L_Ident_Int 0 1 /end CHARACTERISTIC
/begin MEASUREMENT VAR_RCF_flgPsiToFail_b "VAR_RCF_flgPsiToFail_b" UBYTE BSW_A2L_Ident_Int 1 100 0 1 ECU_ADDRESS 0x00000000 /end MEASUREMENT
/begin MEASUREMENT VAR_TpcTmp_tIGBTOperationMode_u8 "VAR_TpcTmp_tIGBTOperationMode_u8" UBYTE BSW_A2L_Ident_Int 1 100 0 255 ECU_ADDRESS 0x00000000 /end MEASUREMENT
/begin CHARACTERISTIC CAL_TpcSmp_GenOvrVoltypLim_f32 "CAL_TpcSmp_GenOvrVoltypLim_f32" VALUE 0x00000000 Scalar_FLOAT32_IEEE 0 BSW_A2L_Ident_Float -3.4E+38 3.4E+38 /end CHARACTERISTIC
/begin CHARACTERISTIC CAL_TRSP_RslvRngExciHiLim_u16 "CAL_TRSP_RslvRngExciHiLim_u16" VALUE 0x00000000 Scalar_UWORD 0 BSW_A2L_Ident_Int 0 65535 /end CHARACTERISTIC
/begin CHARACTERISTIC CAL_MCF_UpLimitPIMotHeat_f32 "CAL_MCF_UpLimitPIMotHeat_f32" VALUE 0x00000000 Scalar_FLOAT32_IEEE 0 BSW_A2L_Ident_Float -3.4E+38 3.4E+38 /end CHARACTERISTIC
/begin CHARACTERISTIC CAL_TRSP_iPhasSensVoltErrRst_b "CAL_TRSP_iPhasSensVoltErrRst_b" VALUE 0x00000000 Scalar_BOOLEAN 0 BSW_A2L_Ident_Int 0 1 /end CHARACTERISTIC
/begin MEASUREMENT VAR_Scf_flgFimforFR_b "VAR_Scf_flgFimforFR_b" UBYTE BSW_A2L_Ident_Int 1 100 0 1 ECU_ADDRESS 0x00000000 /end MEASUREMENT
/begin MEASUREMENT VAR_Scf_DEMRunToDisChaFail_u8 "VAR_Scf_DEMRunToDisChaFail_u8" UBYTE BSW_A2L_Ident_Int 1 100 0 255 ECU_ADDRESS 0x00000000 /end MEASUREMENT
/begin MEASUREMENT VAR_PcfDiag_flgselfCkErr_b "VAR_PcfDiag_flgselfCkErr_b" UBYTE BSW_A2L_Ident_Int 1 100 0 1 ECU_ADDRESS 0x00000000 /end MEASUREMENT
/begin CHARACTERISTIC CAL_MDF_DIffAlOfsMax_f32 "CAL_MDF_DIffAlOfsMax_f32" VALUE 0x00000000 Scalar_FLOAT32_IEEE 0 BSW_A2L_Ident_Float -3.4E+38 3.4E+38 /end CHARACTERISTIC
/begin CHARACTERISTIC CAL_PcfCtl_BCRunDyc_f32 "CAL_PcfCtl_BCRunDyc_f32" VALUE 0x00000000 Scalar_FLOAT32_IEEE 0 BSW_A2L_Ident_Float -3.4E+38 3.4E+38 /end CHARACTERISTIC
/begin MEASUREMENT VAR_TpcMot_tSttrTempFlt_u16 "VAR_TpcMot_tSttrTempFlt_u16" UWORD BSW_A2L_Ident_Int 1 100 0 65535 ECU_ADDRESS 0x00000000 /end MEASUREMENT
/begin MEASUREMENT VAR_3phPWMWL_Duty_f32 "VAR_3phPWMWL_Duty_f32" FLOAT32_IEEE BSW_A2L_Ident_Float 1 100 -3.4E+38 3.4E+38 ECU_ADDRESS 0x00000000 /end MEASUREMENT
/begin CHARACTERISTIC CAL_DEM_Disbl_DFC_FR_StorageErr_u8 "CAL_DEM_Disbl_DFC_FR_StorageErr_u8" VALUE 0x00000000 Scalar_UBYTE 0 BSW_A2L_Ident_Int 0 255 /end CHARACTERISTIC
/begin CHARACTERISTIC CAL_Vcf_TrqSlopAccMax_f32 "CAL_Vcf_TrqSlopAccMax_f32" VALUE 0x00000000 Scalar_FLOAT32_IEEE 0 BSW_A2L_Ident_Float -3.4E+38 3.4E+38 /end CHARACTERISTIC
/begin CHARACTERISTIC CAL_PcfDia_Retrytimes_u8 "CAL_PcfDia_Retrytimes_u8" VALUE 0x00000000 Scalar_UBYTE 0 BSW_A2L_Ident_Int 0 255 /end CHARACTERISTIC
/begin CHARACTERISTIC CAL_TRSP_SpeedCtlMode_u8 "CAL_TRSP_SpeedCtlMode_u8" VALUE 0x00000000 Scalar_UBYTE 0 BSW_A2L_Ident_Int 0 255 /end CHARACTERISTIC
/begin CHARACTERISTIC CAL_TpcTmp_tRiseIGBTTraNormalToSave1_f32 "CAL_TpcTmp_tRiseIGBTTraNormalToSave1_f32" VALUE 0x00000000 Scalar_FLOAT32_IEEE 0 BSW_A2L_Ident_Float -3.4E+38 3.4E+38 /end CHARACTERISTIC
/begin CHARACTERISTIC CAL_MCF_isqSet_f32 "CAL_MCF_isqSet_f32" VALUE 0x00000000 Scalar_FLOAT32_IEEE 0 BSW_A2L_Ident_Float -3.4E+38 3.4E+38 /end CHARACTERISTIC
/begin CHARACTERISTIC CAL_Cspf_flgtDBCTempVFltSwt_b "CAL_Cspf_flgtDBCTempVFltSwt_b" VALUE 0x00000000 Scalar_BOOLEAN 0 BSW_A2L_Ident_Int 0 1 /end CHARACTERISTIC
/begin MEASUREMENT VAR_RCF_flgAccToClbFreBwd_b "VAR_RCF_flgAccToClbFreBwd_b" UBYTE BSW_A2L_Ident_Int 1 100 0 1 ECU_ADDRESS 0x00000000 /end MEASUREMENT
/begin CHARACTERISTIC CAL_Cspf_flgTraTrqMinSwt_b "CAL_Cspf_flgTraTrqMinSwt_b" VALUE 0x00000000 Scalar_BOOLEAN 0 BSW_A2L_Ident_Int 0 1 /end CHARACTERISTIC
/begin CHARACTERISTIC CAL_Pwm3phB_ClosedThreshold_f32 "CAL_Pwm3phB_ClosedThreshold_f32" VALUE 0x00000000 Scalar_FLOAT32_IEEE 0 BSW_A2L_Ident_Float -3.4E+38 3.4E+38 /end CHARACTERISTIC
/begin CHARACTERISTIC CAL_DEM_FIM_DFC_HvMcu_UdcCheckErr_au8 "CAL_DEM_FIM_DFC_HvMcu_UdcCheckErr_au8" VAL_BLK 0x00000000 Scalar_UBYTE 0 FID_Verb 0 255 NUMBER 10 /end CHARACTERISTIC
/begin MEASUREMENT VAR_TpcMot_TrqGenExCOrg_f32 "VAR_TpcMot_TrqGenExCOrg_f32" FLOAT32_IEEE BSW_A2L_Ident_Float 1 100 -3.4E+38 3.4E+38 ECU_ADDRESS 0x00000000 /end MEASUREMENT
/begin MEASUREMENT VAR_RCF_OfsClbAngFwd_f32 "VAR_RCF_OfsClbAngFwd_f32" FLOAT32_IEEE BSW_A2L_Ident_Float 1 100 -3.4E+38 3.4E+38 ECU_ADDRESS 0x00000000 /end MEASUREMENT
/begin MEASUREMENT VAR_TRSP_RslvSqrt_f32 "VAR_TRSP_RslvSqrt_f32" FLOAT32_IEEE BSW_A2L_Ident_Float 1 100 -3.4E+38 3.4E+38 ECU_ADDRESS 0x00000000 /end MEASUREMENT
/begin CHARACTERISTIC CAL_Hspf_VerMatchFailure_u8 "CAL_Hspf_VerMatchFailure_u8" VALUE 0x00000000 Scalar_UBYTE 0 BSW_A2L_Ident_Int 0 255 /end CHARACTERISTIC
/begin MEASUREMENT VAR_TpcTmp_TDbcStableDiff_u16 "VAR_TpcTmp_TDbcStableDiff_u16" UWORD BSW_A2L_Ident_Int 1 100 0 65535 ECU_ADDRESS 0x00000000 /end MEASUREMENT
/begin MEASUREMENT VAR_Cspf_TrastTrqEmMax_u8 "VAR_Cspf_TrastTrqEmMax_u8" UBYTE BSW_A2L_Ident_Int 1 100 0 255 ECU_ADDRESS 0x00000000 /end MEASUREMENT
/begin CHARACTERISTIC CAL_Vcf_CrawlDspd_f32 "CAL_Vcf_CrawlDspd_f32" VALUE 0x00000000 Scalar_FLOAT32_IEEE 0 BSW_A2L_Ident_Float -3.4E+38 3.4E+38 /end CHARACTERISTIC
/begin MEASUREMENT VAR_MCF_UqDes11ZR_f32 "VAR_MCF_UqDes11ZR_f32" FLOAT32_IEEE BSW_A2L_Ident_Float 1 100 -3.4E+38 3.4E+38 ECU_ADDRESS 0x00000000 /end MEASUREMENT
/begin CHARACTERISTIC CAL_TCF_TrqMechCutOffFrq_f32 "CAL_TCF_TrqMechCutOffFrq_f32" VALUE 0x00000000 Scalar_FLOAT32_IEEE 0 BSW_A2L_Ident_Float -3.4E+38 3.4E+38 /end CHARACTERISTIC
/begin CHARACTERISTIC CAL_Cspf_flgFailCode8Swt_b "CAL_Cspf_flgFailCode8Swt_b" VALUE 0x00000000 Scalar_BOOLEAN 0 BSW_A2L_Ident_Int 0 1 /end CHARACTERISTIC
/begin CHARACTERISTIC CAL_Vcf_NegDmpMaxSpeed_f32 "CAL_Vcf_NegDmpMaxSpeed_f32" VALUE 0x00000000 Scalar_FLOAT32_IEEE 0 BSW_A2L_Ident_Float -3.4E+38 3.4E+38 /end CHARACTERISTIC
/begin MEASUREMENT VAR_TCF_LdsubLq_f32 "VAR_TCF_LdsubLq_f32" FLOAT32_IEEE BSW_A2L_Ident_Float 1 100 -3.4E+38 3.4E+38 ECU_ADDRESS 0x00000000 /end MEASUREMENT
/begin CHARACTERISTIC CAL_PcfDia_AimInPRatUp_f32 "CAL_PcfDia_AimInPRatUp_f32" VALUE 0x00000000 Scalar_FLOAT32_IEEE 0 BSW_A2L_Ident_Float -3.4E+38 3.4E+38 /end CHARACTERISTIC
/begin CHARACTERISTIC CAL_TpcFuv_CofTrqLimLv4_f32 "CAL_TpcFuv_CofTrqLimLv4_f32" VALUE 0x00000000 Scalar_FLOAT32_IEEE 0 BSW_A2L_Ident_Float -3.4E+38 3.4E+38 /end CHARACTERISTIC
/begin CHARACTERISTIC CAL_TpcSmp_TrqAddMax_f32 "CAL_TpcSmp_TrqAddMax_f32" VALUE 0x00000000 Scalar_FLOAT32_IEEE 0 BSW_A2L_Ident_Float -3.4E+38 3.4E+38 /end CHARACTERISTIC
/begin CHARACTERISTIC CAL_MDF_stFrwhlPhd_u8 "CAL_MDF_stFrwhlPhd_u8" VALUE 0x00000000 Scalar_UBYTE 0 BSW_A2L_Ident_Int 0 255 /end CHARACTERISTIC
/begin MEASUREMENT VAR_DEM_Event_RSL_LOTErr_Status_u8 "VAR_DEM_Event_RSL_LOTErr_Status_u8" UBYTE BSW_A2L_Ident_Int 1 100 0 255 ECU_ADDRESS 0x00000000 /end MEASUREMENT
/begin CHARACTERISTIC CAL_Tpcmot_uDcHiset_f32 "CAL_Tpcmot_uDcHiset_f32" VALUE 0x00000000 Scalar_FLOAT32_IEEE 0 BSW_A2L_Ident_Float -3.4E+38 3.4E+38 /end CHARACTERISTIC
/begin MEASUREMENT VAR_PcfDia_flgLocked_b "VAR_PcfDia_flgLocked_b" UBYTE BSW_A2L_Ident_Int 1 100 0 1 ECU_ADDRESS 0x00000000 /end MEASUREMENT
/begin CHARACTERISTIC CAL_MCF_FlgUseEOL_b "CAL_MCF_FlgUseEOL_b" VALUE 0x00000000 Scalar_BOOLEAN 0 BSW_A2L_Ident_Int 0 1 /end CHARACTERISTIC
/begin MEASUREMENT VAR_TpcTmp_CofDertTDbcSave2_f32 "VAR_TpcTmp_CofDertTDbcSave2_f32" FLOAT32_IEEE BSW_A2L_Ident_Float 1 100 -3.4E+38 3.4E+38 ECU_ADDRESS 0x00000000 /end MEASUREMENT
/begin CHARACTERISTIC CAL_TRSP_UCurrRngHiLim_f32 "CAL_TRSP_UCurrRngHiLim_f32" VALUE 0x00000000 Scalar_FLOAT32_IEEE 0 BSW_A2L_Ident_Float -3.4E+38 3.4E+38 /end CHARACTERISTIC
/begin CHARACTERISTIC CAL_TRSP_18VHSVoltHiLim_u16 "CAL_TRSP_18VHSVoltHiLim_u16" VALUE 0x00000000 Scalar_UWORD 0 BSW_A2L_Ident_Int 0 65535 /end CHARACTERISTIC
/begin CHARACTERISTIC CAL_RdcRslExcFaultMax_f32 "CAL_RdcRslExcFaultMax_f32" VALUE 0x00000000 Scalar_FLOAT32_IEEE 0 BSW_A2L_Ident_Float -3.4E+38 3.4E+38 /end CHARACTERISTIC
/begin CHARACTERISTIC CAL_Cspf_stMode_u8 "CAL_Cspf_stMode_u8" VALUE 0x00000000 Scalar_UBYTE 0 BSW_A2L_Ident_Int 0 255 /end CHARACTERISTIC
/begin CHARACTERISTIC CAL_DEM_Disbl_DFC_IOHWAB_SttrTemp1SampFail_u8 "CAL_DEM_Disbl_DFC_IOHWAB_SttrTemp1SampFail_u8" VALUE 0x00000000 Scalar_UBYTE 0 BSW_A2L_Ident_Int 0 255 /end CHARACTERISTIC
/begin CHARACTERISTIC CAL_MDF_tThd_TempDBCInvCoolObsvr_f32 "CAL_MDF_tThd_TempDBCInvCoolObsvr_f32" VALUE 0x00000000 Scalar_FLOAT32_IEEE 0 BSW_A2L_Ident_Float -3.4E+38 3.4E+38 /end CHARACTERISTIC
/begin CHARACTERISTIC CAL_PcfSig_flgNVMSLFnh_b "CAL_PcfSig_flgNVMSLFnh_b" VALUE 0x00000000 Scalar_BOOLEAN 0 BSW_A2L_Ident_Int 0 1 /end CHARACTERISTIC
/begin CHARACTERISTIC CAL_DEM_Disbl_DFC_IOHWAB_SttrTemp2SampFail_u8 "CAL_DEM_Disbl_DFC_IOHWAB_SttrTemp2SampFail_u8" VALUE 0x00000000 Scalar_UBYTE 0 BSW_A2L_Ident_Int 0 255 /end CHARACTERISTIC
/begin MEASUREMENT VAR_TpcSmp_flgGenPwrLimCurtActv_b "VAR_TpcSmp_flgGenPwrLimCurtActv_b" UBYTE BSW_A2L_Ident_Int 1 100 0 1 ECU_ADDRESS 0x00000000 /end MEASUREMENT
/begin CHARACTERISTIC CAL_DEM_Disbl_DFC_PCF_UnexpPosErr_u8 "CAL_DEM_Disbl_DFC_PCF_UnexpPosErr_u8" VALUE 0x00000000 Scalar_UBYTE 0 BSW_A2L_Ident_Int 0 255 /end CHARACTERISTIC
/begin MEASUREMENT VAR_DEM_Event_TPC_uDcLnkOvVLimFail_Status_u8 "VAR_DEM_Event_TPC_uDcLnkOvVLimFail_Status_u8" UBYTE BSW_A2L_Ident_Int 1 100 0 255 ECU_ADDRESS 0x00000000 /end MEASUREMENT
/begin MEASUREMENT VAR_PcfSig_PosAimInP_f32 "VAR_PcfSig_PosAimInP_f32" FLOAT32_IEEE BSW_A2L_Ident_Float 1 100 -3.4E+38 3.4E+38 ECU_ADDRESS 0x00000000 /end MEASUREMENT
/begin MEASUREMENT VAR_TpcTmp_TDbcVLoLimErrState_u8 "VAR_TpcTmp_TDbcVLoLimErrState_u8" UBYTE BSW_A2L_Ident_Int 1 100 0 255 ECU_ADDRESS 0x00000000 /end MEASUREMENT
/begin CHARACTERISTIC CAL_TpcMot_tSttrLoLim_f32 "CAL_TpcMot_tSttrLoLim_f32" VALUE 0x00000000 Scalar_FLOAT32_IEEE 0 BSW_A2L_Ident_Float -3.4E+38 3.4E+38 /end CHARACTERISTIC
/begin CHARACTERISTIC CAL_PcfSig_flgPowerOnSwt_b "CAL_PcfSig_flgPowerOnSwt_b" VALUE 0x00000000 Scalar_BOOLEAN 0 BSW_A2L_Ident_Int 0 1 /end CHARACTERISTIC
/begin CHARACTERISTIC CAL_TpcSmp_flgUsePwrLoss_b "CAL_TpcSmp_flgUsePwrLoss_b" VALUE 0x00000000 Scalar_BOOLEAN 0 BSW_A2L_Ident_Int 0 1 /end CHARACTERISTIC
/begin MEASUREMENT VAR_TpcFuv_FimPwrLimLv4_b "VAR_TpcFuv_FimPwrLimLv4_b" UBYTE BSW_A2L_Ident_Int 1 100 0 1 ECU_ADDRESS 0x00000000 /end MEASUREMENT
/begin MEASUREMENT VAR_PcfStm_stParkCtl_u8 "VAR_PcfStm_stParkCtl_u8" UBYTE BSW_A2L_Ident_Int 1 100 0 255 ECU_ADDRESS 0x00000000 /end MEASUREMENT
/begin MEASUREMENT VAR_PcfStm_flgSLAccToWait_b "VAR_PcfStm_flgSLAccToWait_b" UBYTE BSW_A2L_Ident_Int 1 100 0 1 ECU_ADDRESS 0x00000000 /end MEASUREMENT
/begin CHARACTERISTIC CAL_DEM_Disbl_DFC_Cpld_UdcOverVolFail_u8 "CAL_DEM_Disbl_DFC_Cpld_UdcOverVolFail_u8" VALUE 0x00000000 Scalar_UBYTE 0 BSW_A2L_Ident_Int 0 255 /end CHARACTERISTIC
/begin MEASUREMENT VAR_PcfDia_flgCritSpd_b "VAR_PcfDia_flgCritSpd_b" UBYTE BSW_A2L_Ident_Int 1 100 0 1 ECU_ADDRESS 0x00000000 /end MEASUREMENT
/begin MEASUREMENT VAR_Cspf_TraNCurr_f32 "VAR_Cspf_TraNCurr_f32" FLOAT32_IEEE BSW_A2L_Ident_Float 1 100 -3.4E+38 3.4E+38 ECU_ADDRESS 0x00000000 /end MEASUREMENT
/begin CHARACTERISTIC CAL_DEM_Disbl_DFC_TPC_uDcLnkUnvWarn_u8 "CAL_DEM_Disbl_DFC_TPC_uDcLnkUnvWarn_u8" VALUE 0x00000000 Scalar_UBYTE 0 BSW_A2L_Ident_Int 0 255 /end CHARACTERISTIC
/begin MEASUREMENT VAR_RCF_flg360Edge_b "VAR_RCF_flg360Edge_b" UBYTE BSW_A2L_Ident_Int 1 100 0 1 ECU_ADDRESS 0x00000000 /end MEASUREMENT
/begin MEASUREMENT VAR_Vcf_trqDesUnProc_f32 "VAR_Vcf_trqDesUnProc_f32" FLOAT32_IEEE BSW_A2L_Ident_Float 1 100 -3.4E+38 3.4E+38 ECU_ADDRESS 0x00000000 /end MEASUREMENT
/begin CHARACTERISTIC CAL_ADM_GlbDchgThrshTime_f32 "CAL_ADM_GlbDchgThrshTime_f32" VALUE 0x00000000 Scalar_FLOAT32_IEEE 0 BSW_A2L_Ident_Float -3.4E+38 3.4E+38 /end CHARACTERISTIC
/begin MEASUREMENT VAR_CDD_Rslv_Cos_f32 "VAR_CDD_Rslv_Cos_f32" FLOAT32_IEEE BSW_A2L_Ident_Float 1 100 -3.4E+38 3.4E+38 ECU_ADDRESS 0x00000000 /end MEASUREMENT
/begin MEASUREMENT VAR_DEM_Event_IOHWAB_12VWideSampErr_Status_u8 "VAR_DEM_Event_IOHWAB_12VWideSampErr_Status_u8" UBYTE BSW_A2L_Ident_Int 1 100 0 255 ECU_ADDRESS 0x00000000 /end MEASUREMENT
/begin MEASUREMENT VAR_TpcTmp_tDbcTempFlt_f32 "VAR_TpcTmp_tDbcTempFlt_f32" FLOAT32_IEEE BSW_A2L_Ident_Float 1 100 -3.4E+38 3.4E+38 ECU_ADDRESS 0x00000000 /end MEASUREMENT
/begin MEASUREMENT VAR_PWM3phVDuty_ERR_u8 "VAR_PWM3phVDuty_ERR_u8" UBYTE BSW_A2L_Ident_Int 1 100 0 255 ECU_ADDRESS 0x00000000 /end MEASUREMENT
/begin MEASUREMENT VAR_TpcCod_PowerIncreaseRate_f32 "VAR_TpcCod_PowerIncreaseRate_f32" FLOAT32_IEEE BSW_A2L_Ident_Float 1 100 -3.4E+38 3.4E+38 ECU_ADDRESS 0x00000000 /end MEASUREMENT
/begin MEASUREMENT VAR_RCF_flgClbFreFwdToAcc_b "VAR_RCF_flgClbFreFwdToAcc_b" UBYTE BSW_A2L_Ident_Int 1 100 0 1 ECU_ADDRESS 0x00000000 /end MEASUREMENT
/begin CHARACTERISTIC CAL_Hspf_INVOpenChkAddCnt_u8 "CAL_Hspf_INVOpenChkAddCnt_u8" VALUE 0x00000000 Scalar_UBYTE 0 BSW_A2L_Ident_Int 0 255 /end CHARACTERISTIC
/begin MEASUREMENT VAR_PcfCtl_DycOutPID_f32 "VAR_PcfCtl_DycOutPID_f32" FLOAT32_IEEE BSW_A2L_Ident_Float 1 100 -3.4E+38 3.4E+38 ECU_ADDRESS 0x00000000 /end MEASUREMENT
/begin CHARACTERISTIC CAL_DEM_FIM_DFC_RCF_FwlBwdOvTiErr_au8 "CAL_DEM_FIM_DFC_RCF_FwlBwdOvTiErr_au8" VAL_BLK 0x00000000 Scalar_UBYTE 0 FID_Verb 0 255 NUMBER 10 /end CHARACTERISTIC
/begin CHARACTERISTIC CAL_Pwm3ph_DutyMin_f32 "CAL_Pwm3ph_DutyMin_f32" VALUE 0x00000000 Scalar_FLOAT32_IEEE 0 BSW_A2L_Ident_Float -3.4E+38 3.4E+38 /end CHARACTERISTIC
/begin MEASUREMENT VAR_MCF_udRv_f32 "VAR_MCF_udRv_f32" FLOAT32_IEEE BSW_A2L_Ident_Float 1 100 -3.4E+38 3.4E+38 ECU_ADDRESS 0x00000000 /end MEASUREMENT
/begin CHARACTERISTIC CAL_PcfDia_flgFault_b "CAL_PcfDia_flgFault_b" VALUE 0x00000000 Scalar_BOOLEAN 0 BSW_A2L_Ident_Int 0 1 /end CHARACTERISTIC
/begin CHARACTERISTIC CAL_TpcTmp_DBCTempKp_f32 "CAL_TpcTmp_DBCTempKp_f32" VALUE 0x00000000 Scalar_FLOAT32_IEEE 0 BSW_A2L_Ident_Float -3.4E+38 3.4E+38 /end CHARACTERISTIC
/begin CHARACTERISTIC CAL_Cspf_flgOfsClbSuc_u8 "CAL_Cspf_flgOfsClbSuc_u8" VALUE 0x00000000 Scalar_UBYTE 0 BSW_A2L_Ident_Int 0 255 /end CHARACTERISTIC
/begin MEASUREMENT VAR_MCF_cofFrqPwm_f32 "VAR_MCF_cofFrqPwm_f32" FLOAT32_IEEE BSW_A2L_Ident_Float 1 100 -3.4E+38 3.4E+38 ECU_ADDRESS 0x00000000 /end MEASUREMENT
/begin CHARACTERISTIC CAL_tiPwmLim_f32 "CAL_tiPwmLim_f32" VALUE 0x00000000 Scalar_FLOAT32_IEEE 0 BSW_A2L_Ident_Float -3.4E+38 3.4E+38 /end CHARACTERISTIC
/begin CHARACTERISTIC CAL_Scf_flgEpcShutdownSwt_b "CAL_Scf_flgEpcShutdownSwt_b" VALUE 0x00000000 Scalar_BOOLEAN 0 BSW_A2L_Ident_Int 0 1 /end CHARACTERISTIC
/begin MEASUREMENT VAR_DSADC_Rdc_Cos_s16 "VAR_DSADC_Rdc_Cos_s16" SWORD BSW_A2L_Ident_Int 1 100 -32768 32767 ECU_ADDRESS 0x00000000 /end MEASUREMENT
/begin CHARACTERISTIC CAL_TpcSmp_uDcLnkMinMax_f32 "CAL_TpcSmp_uDcLnkMinMax_f32" VALUE 0x00000000 Scalar_FLOAT32_IEEE 0 BSW_A2L_Ident_Float -3.4E+38 3.4E+38 /end CHARACTERISTIC
/begin MEASUREMENT VAR_tpccod_flgMinDertOvrIdc_b "VAR_tpccod_flgMinDertOvrIdc_b" UBYTE BSW_A2L_Ident_Int 1 100 0 1 ECU_ADDRESS 0x00000000 /end MEASUREMENT
/begin MEASUREMENT VAR_Hspf_HWVer_u8 "VAR_Hspf_HWVer_u8" UBYTE BSW_A2L_Ident_Int 1 100 0 255 ECU_ADDRESS 0x00000000 /end MEASUREMENT
/begin MEASUREMENT VAR_TpcSmp_cofDertOvrSpdElecQuad3_f32 "VAR_TpcSmp_cofDertOvrSpdElecQuad3_f32" FLOAT32_IEEE BSW_A2L_Ident_Float 1 100 -3.4E+38 3.4E+38 ECU_ADDRESS 0x00000000 /end MEASUREMENT
/begin CHARACTERISTIC CAL_MPC_flgUseRs_b "CAL_MPC_flgUseRs_b" VALUE 0x00000000 Scalar_BOOLEAN 0 BSW_A2L_Ident_Int 0 1 /end CHARACTERISTIC
/begin CHARACTERISTIC CAL_Cspf_FailCode7_u8 "CAL_Cspf_FailCode7_u8" VALUE 0x00000000 Scalar_UBYTE 0 BSW_A2L_Ident_Int 0 255 /end CHARACTERISTIC
/begin CHARACTERISTIC CAL_DEM_FIM_DFC_Event_NvM_ReadErr_au8 "CAL_DEM_FIM_DFC_Event_NvM_ReadErr_au8" VAL_BLK 0x00000000 Scalar_UBYTE 0 FID_Verb 0 255 NUMBER 10 /end CHARACTERISTIC
/begin CHARACTERISTIC CAL_FRP_RslvSqrtErrOutCtl_b "CAL_FRP_RslvSqrtErrOutCtl_b" VALUE 0x00000000 Scalar_BOOLEAN 0 BSW_A2L_Ident_Int 0 1 /end CHARACTERISTIC
/begin MEASUREMENT VAR_TpcMot_ElecTrqLimTsttrWoRamp_f32 "VAR_TpcMot_ElecTrqLimTsttrWoRamp_f32" FLOAT32_IEEE BSW_A2L_Ident_Float 1 100 -3.4E+38 3.4E+38 ECU_ADDRESS 0x00000000 /end MEASUREMENT
/begin MEASUREMENT VAR_RCF_flgEnblEstAlRtrOfs_b "VAR_RCF_flgEnblEstAlRtrOfs_b" UBYTE BSW_A2L_Ident_Int 1 100 0 1 ECU_ADDRESS 0x00000000 /end MEASUREMENT
/begin MEASUREMENT VAR_FS_React_u8 "VAR_FS_React_u8" UBYTE BSW_A2L_Ident_Int 1 100 0 255 ECU_ADDRESS 0x00000000 /end MEASUREMENT
/begin CHARACTERISTIC CAL_MPC_flgUseLdSubLq_b "CAL_MPC_flgUseLdSubLq_b" VALUE 0x00000000 Scalar_BOOLEAN 0 BSW_A2L_Ident_Int 0 1 /end CHARACTERISTIC
/begin CHARACTERISTIC CAL_RCF_tMaxFwlFwd_u16 "CAL_RCF_tMaxFwlFwd_u16" VALUE 0x00000000 Scalar_UWORD 0 BSW_A2L_Ident_Int 0 65535 /end CHARACTERISTIC
/begin MEASUREMENT VAR_Vcf_trqLoad_f32 "VAR_Vcf_trqLoad_f32" FLOAT32_IEEE BSW_A2L_Ident_Float 1 100 -3.4E+38 3.4E+38 ECU_ADDRESS 0x00000000 /end MEASUREMENT
/begin CHARACTERISTIC CAL_Vcf_TrqDmpPosMax_f32 "CAL_Vcf_TrqDmpPosMax_f32" VALUE 0x00000000 Scalar_FLOAT32_IEEE 0 BSW_A2L_Ident_Float -3.4E+38 3.4E+38 /end CHARACTERISTIC
/begin MEASUREMENT VAR_DEM_Event_IOHWAB_5VQt2SampFail_Status_u8 "VAR_DEM_Event_IOHWAB_5VQt2SampFail_Status_u8" UBYTE BSW_A2L_Ident_Int 1 100 0 255 ECU_ADDRESS 0x00000000 /end MEASUREMENT
/begin CHARACTERISTIC CAL_Hspf_nFltFrq_f32 "CAL_Hspf_nFltFrq_f32" VALUE 0x00000000 Scalar_FLOAT32_IEEE 0 BSW_A2L_Ident_Float -3.4E+38 3.4E+38 /end CHARACTERISTIC
/begin CHARACTERISTIC CAL_DEM_Disbl_DFC_TPC_SpdOvHiLimFail_u8 "CAL_DEM_Disbl_DFC_TPC_SpdOvHiLimFail_u8" VALUE 0x00000000 Scalar_UBYTE 0 BSW_A2L_Ident_Int 0 255 /end CHARACTERISTIC
/begin CHARACTERISTIC CAL_Hspf_tDBCTempROCLim_u8 "CAL_Hspf_tDBCTempROCLim_u8" VALUE 0x00000000 Scalar_UBYTE 0 BSW_A2L_Ident_Int 0 255 /end CHARACTERISTIC
/begin MEASUREMENT VAR_TpcSmp_flgLinearDertOveCurtGen_b "VAR_TpcSmp_flgLinearDertOveCurtGen_b" UBYTE BSW_A2L_Ident_Int 1 100 0 1 ECU_ADDRESS 0x00000000 /end MEASUREMENT
/begin MEASUREMENT VAR_PcfStm_flgNPCToRPC_b "VAR_PcfStm_flgNPCToRPC_b" UBYTE BSW_A2L_Ident_Int 1 100 0 1 ECU_ADDRESS 0x00000000 /end MEASUREMENT
/begin MEASUREMENT VAR_RESET_McuReason_u8 "VAR_RESET_McuReason_u8" UBYTE BSW_A2L_Ident_Int 1 100 0 255 ECU_ADDRESS 0x00000000 /end MEASUREMENT
/begin MEASUREMENT VAR_Rdc_tisamp_f32 "VAR_Rdc_tisamp_f32" FLOAT32_IEEE BSW_A2L_Ident_Float 1 100 -3.4E+38 3.4E+38 ECU_ADDRESS 0x00000000 /end MEASUREMENT
/begin MEASUREMENT VAR_PcfStm_SLtrqDes_f32 "VAR_PcfStm_SLtrqDes_f32" FLOAT32_IEEE BSW_A2L_Ident_Float 1 100 -3.4E+38 3.4E+38 ECU_ADDRESS 0x00000000 /end MEASUREMENT
/begin CHARACTERISTIC CAL_BCC_tiFull_f32 "CAL_BCC_tiFull_f32" VALUE 0x00000000 Scalar_FLOAT32_IEEE 0 BSW_A2L_Ident_Float -3.4E+38 3.4E+38 /end CHARACTERISTIC
/begin MEASUREMENT VAR_MDF_bFaultEMBlkErr_b "VAR_MDF_bFaultEMBlkErr_b" UBYTE BSW_A2L_Ident_Int 1 100 0 1 ECU_ADDRESS 0x00000000 /end MEASUREMENT
/begin CHARACTERISTIC CAL_MDF_EMBlkWarn_f32 "CAL_MDF_EMBlkWarn_f32" VALUE 0x00000000 Scalar_FLOAT32_IEEE 0 BSW_A2L_Ident_Float -3.4E+38 3.4E+38 /end CHARACTERISTIC
/begin MEASUREMENT VAR_TpcTmp_TDbcWLoLimErrState_u8 "VAR_TpcTmp_TDbcWLoLimErrState_u8" UBYTE BSW_A2L_Ident_Int 1 100 0 255 ECU_ADDRESS 0x00000000 /end MEASUREMENT
/begin MEASUREMENT VAR_FS_DMA_Sin_u16 "VAR_FS_DMA_Sin_u16" UWORD BSW_A2L_Ident_Int 1 100 0 65535 ECU_ADDRESS 0x00000000 /end MEASUREMENT
/begin MEASUREMENT VAR_RCF_flgstDefTostEst_b "VAR_RCF_flgstDefTostEst_b" UBYTE BSW_A2L_Ident_Int 1 100 0 1 ECU_ADDRESS 0x00000000 /end MEASUREMENT
/begin CHARACTERISTIC CAL_TRSP_1V8CPLDVoltHiLim_u16 "CAL_TRSP_1V8CPLDVoltHiLim_u16" VALUE 0x00000000 Scalar_UWORD 0 BSW_A2L_Ident_Int 0 65535 /end CHARACTERISTIC
/begin CHARACTERISTIC CAL_Cspf_flgiQActSlowFltSwt_b "CAL_Cspf_flgiQActSlowFltSwt_b" VALUE 0x00000000 Scalar_BOOLEAN 0 BSW_A2L_Ident_Int 0 1 /end CHARACTERISTIC
/begin CHARACTERISTIC CAL_MPC_Psi_f32 "CAL_MPC_Psi_f32" VALUE 0x00000000 Scalar_FLOAT32_IEEE 0 BSW_A2L_Ident_Float -3.4E+38 3.4E+38 /end CHARACTERISTIC
/begin MEASUREMENT VAR_Hspf_tCoolantTemp_f32 "VAR_Hspf_tCoolantTemp_f32" FLOAT32_IEEE BSW_A2L_Ident_Float 1 100 -3.4E+38 3.4E+38 ECU_ADDRESS 0x00000000 /end MEASUREMENT
/begin MEASUREMENT VAR_IoHwAb_Adc_Phy_5V_LEM_f32 "VAR_IoHwAb_Adc_Phy_5V_LEM_f32" FLOAT32_IEEE BSW_A2L_Ident_Float 1 100 -3.4E+38 3.4E+38 ECU_ADDRESS 0x00000000 /end MEASUREMENT
/begin CHARACTERISTIC CAL_PcfStm_BCActimeLimt_u16 "CAL_PcfStm_BCActimeLimt_u16" VALUE 0x00000000 Scalar_UWORD 0 BSW_A2L_Ident_Int 0 65535 /end CHARACTERISTIC
/begin MEASUREMENT VAR_MDF_PrfElDrvState_u8 "VAR_MDF_PrfElDrvState_u8" UBYTE BSW_A2L_Ident_Int 1 100 0 255 ECU_ADDRESS 0x00000000 /end MEASUREMENT
/begin CHARACTERISTIC CAL_DEM_FIM_DFC_IgbtDrv_UpBrgFaultBFail_au8 "CAL_DEM_FIM_DFC_IgbtDrv_UpBrgFaultBFail_au8" VAL_BLK 0x00000000 Scalar_UBYTE 0 FID_Verb 0 255 NUMBER 10 /end CHARACTERISTIC
/begin CHARACTERISTIC CAL_MPC_uqActCutOffFrq_f32 "CAL_MPC_uqActCutOffFrq_f32" VALUE 0x00000000 Scalar_FLOAT32_IEEE 0 BSW_A2L_Ident_Float -3.4E+38 3.4E+38 /end CHARACTERISTIC
/begin CHARACTERISTIC CAL_Cspf_stModeReq_u8 "CAL_Cspf_stModeReq_u8" VALUE 0x00000000 Scalar_UBYTE 0 BSW_A2L_Ident_Int 0 255 /end CHARACTERISTIC
/begin CHARACTERISTIC CAL_TpcTmp_DBCTempDecDiff_f32 "CAL_TpcTmp_DBCTempDecDiff_f32" VALUE 0x00000000 Scalar_FLOAT32_IEEE 0 BSW_A2L_Ident_Float -3.4E+38 3.4E+38 /end CHARACTERISTIC
/begin CHARACTERISTIC CAL_PcfDia_VDD5Lowset_f32 "CAL_PcfDia_VDD5Lowset_f32" VALUE 0x00000000 Scalar_FLOAT32_IEEE 0 BSW_A2L_Ident_Float -3.4E+38 3.4E+38 /end CHARACTERISTIC
/begin CHARACTERISTIC CAL_FRP_VoltCmpChkErrOutCtl_b "CAL_FRP_VoltCmpChkErrOutCtl_b" VALUE 0x00000000 Scalar_BOOLEAN 0 BSW_A2L_Ident_Int 0 1 /end CHARACTERISTIC
/begin CHARACTERISTIC CAL_DEM_Disbl_DFC_TPC_TIGBTOvHiWarn_u8 "CAL_DEM_Disbl_DFC_TPC_TIGBTOvHiWarn_u8" VALUE 0x00000000 Scalar_UBYTE 0 BSW_A2L_Ident_Int 0 255 /end CHARACTERISTIC
/begin MEASUREMENT VAR_RCF_flgEnblOfsClbFrwhlFwd_b "VAR_RCF_flgEnblOfsClbFrwhlFwd_b" UBYTE BSW_A2L_Ident_Int 1 100 0 1 ECU_ADDRESS 0x00000000 /end MEASUREMENT
/begin CHARACTERISTIC CAL_RDC_tiRsvlAngleSample_f32 "CAL_RDC_tiRsvlAngleSample_f32" VALUE 0x00000000 Scalar_FLOAT32_IEEE 0 BSW_A2L_Ident_Float -3.4E+38 3.4E+38 /end CHARACTERISTIC
/begin CHARACTERISTIC CAL_STM_UxptTrqMonErrRst_b "CAL_STM_UxptTrqMonErrRst_b" VALUE 0x00000000 Scalar_BOOLEAN 0 BSW_A2L_Ident_Int 0 1 /end CHARACTERISTIC
/begin CHARACTERISTIC CAL_PcfDia_tMosNum_u16 "CAL_PcfDia_tMosNum_u16" VALUE 0x00000000 Scalar_UWORD 0 BSW_A2L_Ident_Int 0 65535 /end CHARACTERISTIC
/begin MEASUREMENT VAR_NvM_EPC_NVMPosAimUpLimt_au8 "VAR_NvM_EPC_NVMPosAimUpLimt_au8" UBYTE BSW_A2L_Ident_Int 1 100 0 255 ARRAY_SIZE 8 ECU_ADDRESS 0x00000000 /end MEASUREMENT
/begin CHARACTERISTIC CAL_Hspf_bt15ChkAddCnt_u8 "CAL_Hspf_bt15ChkAddCnt_u8" VALUE 0x00000000 Scalar_UBYTE 0 BSW_A2L_Ident_Int 0 255 /end CHARACTERISTIC
/begin MEASUREMENT VAR_L2Sampling_1V8CPLD_MON_u16 "VAR_L2Sampling_1V8CPLD_MON_u16" UWORD BSW_A2L_Ident_Int 1 100 0 65535 ECU_ADDRESS 0x00000000 /end MEASUREMENT
/begin MEASUREMENT VAR_3phPWMWH_Duty_f32 "VAR_3phPWMWH_Duty_f32" FLOAT32_IEEE BSW_A2L_Ident_Float 1 100 -3.4E+38 3.4E+38 ECU_ADDRESS 0x00000000 /end MEASUREMENT
/begin MEASUREMENT VAR_TRSP_AgRtr_f32 "VAR_TRSP_AgRtr_f32" FLOAT32_IEEE BSW_A2L_Ident_Float 1 100 -3.4E+38 3.4E+38 ECU_ADDRESS 0x00000000 /end MEASUREMENT
/begin CHARACTERISTIC CAL_DEM_Disbl_DFC_TPC_TSttrOvHiLimFail_u8 "CAL_DEM_Disbl_DFC_TPC_TSttrOvHiLimFail_u8" VALUE 0x00000000 Scalar_UBYTE 0 BSW_A2L_Ident_Int 0 255 /end CHARACTERISTIC
/begin MEASUREMENT VAR_TpcTmp_flgTrqLimTdbcActv_b "VAR_TpcTmp_flgTrqLimTdbcActv_b" UBYTE BSW_A2L_Ident_Int 1 100 0 1 ECU_ADDRESS 0x00000000 /end MEASUREMENT
/begin MEASUREMENT VAR_Scf_DchaCntAdd_u8 "VAR_Scf_DchaCntAdd_u8" UBYTE BSW_A2L_Ident_Int 1 100 0 255 ECU_ADDRESS 0x00000000 /end MEASUREMENT
/begin CHARACTERISTIC CAL_FRP_ModeReqRngErrOutCtl_b "CAL_FRP_ModeReqRngErrOutCtl_b" VALUE 0x00000000 Scalar_BOOLEAN 0 BSW_A2L_Ident_Int 0 1 /end CHARACTERISTIC
/begin CHARACTERISTIC CAL_DEM_FIM_DFC_Cpld_AliveChkErr_au8 "CAL_DEM_FIM_DFC_Cpld_AliveChkErr_au8" VAL_BLK 0x00000000 Scalar_UBYTE 0 FID_Verb 0 255 NUMBER 10 /end CHARACTERISTIC
/begin CHARACTERISTIC CAL_TpcSmp_CntElecOvrCurt_u8 "CAL_TpcSmp_CntElecOvrCurt_u8" VALUE 0x00000000 Scalar_UBYTE 0 BSW_A2L_Ident_Int 0 255 /end CHARACTERISTIC
/begin CHARACTERISTIC CAL_STM_SpeedCtlMode_u8 "CAL_STM_SpeedCtlMode_u8" VALUE 0x00000000 Scalar_UBYTE 0 BSW_A2L_Ident_Int 0 255 /end CHARACTERISTIC
/begin MEASUREMENT VAR_TpcCod_ElecTrqLim_f32 "VAR_TpcCod_ElecTrqLim_f32" FLOAT32_IEEE BSW_A2L_Ident_Float 1 100 -3.4E+38 3.4E+38 ECU_ADDRESS 0x00000000 /end MEASUREMENT
/begin CHARACTERISTIC CAL_Vcf_OvCrawlRspd_f32 "CAL_Vcf_OvCrawlRspd_f32" VALUE 0x00000000 Scalar_FLOAT32_IEEE 0 BSW_A2L_Ident_Float -3.4E+38 3.4E+38 /end CHARACTERISTIC
/begin MEASUREMENT VAR_TpcTmp_tDbcOperationMode_u8 "VAR_TpcTmp_tDbcOperationMode_u8" UBYTE BSW_A2L_Ident_Int 1 100 0 255 ECU_ADDRESS 0x00000000 /end MEASUREMENT
/begin CHARACTERISTIC CAL_Scf_flgOfsClbSwt_b "CAL_Scf_flgOfsClbSwt_b" VALUE 0x00000000 Scalar_BOOLEAN 0 BSW_A2L_Ident_Int 0 1 /end CHARACTERISTIC
/begin CHARACTERISTIC CAL_TpcTmp_IGBTRiseTempMinus_f32 "CAL_TpcTmp_IGBTRiseTempMinus_f32" VALUE 0x00000000 Scalar_FLOAT32_IEEE 0 BSW_A2L_Ident_Float -3.4E+38 3.4E+38 /end CHARACTERISTIC
/begin CHARACTERISTIC CAL_TRSP_CurrRngDebTrh_s16 "CAL_TRSP_CurrRngDebTrh_s16" VALUE 0x00000000 Scalar_SWORD 0 BSW_A2L_Ident_Int -32768 32767 /end CHARACTERISTIC
/begin CHARACTERISTIC CAL_Vcf_flgUseSLCal_b "CAL_Vcf_flgUseSLCal_b" VALUE 0x00000000 Scalar_BOOLEAN 0 BSW_A2L_Ident_Int 0 1 /end CHARACTERISTIC
/begin CHARACTERISTIC CAL_MCF_cofFltPowerHeat_f32 "CAL_MCF_cofFltPowerHeat_f32" VALUE 0x00000000 Scalar_FLOAT32_IEEE 0 BSW_A2L_Ident_Float -3.4E+38 3.4E+38 /end CHARACTERISTIC
/begin CHARACTERISTIC CAL_DEM_FIM_DFC_IOHWAB_SttrTemp2SampFail_au8 "CAL_DEM_FIM_DFC_IOHWAB_SttrTemp2SampFail_au8" VAL_BLK 0x00000000 Scalar_UBYTE 0 FID_Verb 0 255 NUMBER 10 /end CHARACTERISTIC
/begin CHARACTERISTIC CAL_ADM_VoltCmpChkErrDebThr_s16 "CAL_ADM_VoltCmpChkErrDebThr_s16" VALUE 0x00000000 Scalar_SWORD 0 BSW_A2L_Ident_Int -32768 32767 /end CHARACTERISTIC
/begin MEASUREMENT VAR_DEM_Event_Cpld_UnderVol_LS_InFail_Status_u8 "VAR_DEM_Event_Cpld_UnderVol_LS_InFail_Status_u8" UBYTE BSW_A2L_Ident_Int 1 100 0 255 ECU_ADDRESS 0x00000000 /end MEASUREMENT
/begin CHARACTERISTIC CAL_PcfDia_BCLockedNum_u16 "CAL_PcfDia_BCLockedNum_u16" VALUE 0x00000000 Scalar_UWORD 0 BSW_A2L_Ident_Int 0 65535 /end CHARACTERISTIC
/begin MEASUREMENT VAR_TpcMot_TSttrOvHiLimErrState_u8 "VAR_TpcMot_TSttrOvHiLimErrState_u8" UBYTE BSW_A2L_Ident_Int 1 100 0 255 ECU_ADDRESS 0x00000000 /end MEASUREMENT
/begin MEASUREMENT VAR_DEM_Event_ADC_VPhaseBISTFail_Status_u8 "VAR_DEM_Event_ADC_VPhaseBISTFail_Status_u8" UBYTE BSW_A2L_Ident_Int 1 100 0 255 ECU_ADDRESS 0x00000000 /end MEASUREMENT
/begin CHARACTERISTIC CAL_TpcFuv_CofPwrLimLv4_f32 "CAL_TpcFuv_CofPwrLimLv4_f32" VALUE 0x00000000 Scalar_FLOAT32_IEEE 0 BSW_A2L_Ident_Float -3.4E+38 3.4E+38 /end CHARACTERISTIC
/begin CHARACTERISTIC CAL_Vcf_GenElecSpd_f32 "CAL_Vcf_GenElecSpd_f32" VALUE 0x00000000 Scalar_FLOAT32_IEEE 0 BSW_A2L_Ident_Float -3.4E+38 3.4E+38 /end CHARACTERISTIC
/begin MEASUREMENT VAR_FS_DMA_Cos_u16 "VAR_FS_DMA_Cos_u16" UWORD BSW_A2L_Ident_Int 1 100 0 65535 ECU_ADDRESS 0x00000000 /end MEASUREMENT
/begin CHARACTERISTIC CAL_TpcSmp_OvSpdWarnHiLim_f32 "CAL_TpcSmp_OvSpdWarnHiLim_f32" VALUE 0x00000000 Scalar_FLOAT32_IEEE 0 BSW_A2L_Ident_Float -3.4E+38 3.4E+38 /end CHARACTERISTIC
/begin CHARACTERISTIC CAL_TpcTmp_tRiseIGBTTraSave2ToOverheating_f32 "CAL_TpcTmp_tRiseIGBTTraSave2ToOverheating_f32" VALUE 0x00000000 Scalar_FLOAT32_IEEE 0 BSW_A2L_Ident_Float -3.4E+38 3.4E+38 /end CHARACTERISTIC
/begin MEASUREMENT VAR_Tpcblk_TrqLim_f32 "VAR_Tpcblk_TrqLim_f32" FLOAT32_IEEE BSW_A2L_Ident_Float 1 100 -3.4E+38 3.4E+38 ECU_ADDRESS 0x00000000 /end MEASUREMENT
/begin MEASUREMENT VAR_DEM_Event_PCF_SenClbErr_Status_u8 "VAR_DEM_Event_PCF_SenClbErr_Status_u8" UBYTE BSW_A2L_Ident_Int 1 100 0 255 ECU_ADDRESS 0x00000000 /end MEASUREMENT
/begin CHARACTERISTIC CAL_DMA_buffer_flag_u8 "CAL_DMA_buffer_flag_u8" VALUE 0x00000000 Scalar_UBYTE 0 BSW_A2L_Ident_Int 0 255 /end CHARACTERISTIC
/begin CHARACTERISTIC CAL_TpcTmp_tIGBTTraSave1ToSave2_f32 "CAL_TpcTmp_tIGBTTraSave1ToSave2_f32" VALUE 0x00000000 Scalar_FLOAT32_IEEE 0 BSW_A2L_Ident_Float -3.4E+38 3.4E+38 /end CHARACTERISTIC
/begin CHARACTERISTIC CAL_TRSP_OfstErrRst_b "CAL_TRSP_OfstErrRst_b" VALUE 0x00000000 Scalar_BOOLEAN 0 BSW_A2L_Ident_Int 0 1 /end CHARACTERISTIC
/begin MEASUREMENT VAR_TpcTmp_tIgbtTempFlt_u16 "VAR_TpcTmp_tIgbtTempFlt_u16" UWORD BSW_A2L_Ident_Int 1 100 0 65535 ECU_ADDRESS 0x00000000 /end MEASUREMENT
/begin CHARACTERISTIC CAL_Cspf_bDernExcMax_u8 "CAL_Cspf_bDernExcMax_u8" VALUE 0x00000000 Scalar_UBYTE 0 BSW_A2L_Ident_Int 0 255 /end CHARACTERISTIC
/begin CHARACTERISTIC CAL_RDC_RslRefMin_s32 "CAL_RDC_RslRefMin_s32" VALUE 0x00000000 Scalar_LONG 0 BSW_A2L_Ident_Int -2147483648 2147483647 /end CHARACTERISTIC
/begin CHARACTERISTIC CAL_TpcTmp_tRiseDbcTraSave1ToSave2_f32 "CAL_TpcTmp_tRiseDbcTraSave1ToSave2_f32" VALUE 0x00000000 Scalar_FLOAT32_IEEE 0 BSW_A2L_Ident_Float -3.4E+38 3.4E+38 /end CHARACTERISTIC
/begin MEASUREMENT VAR_STM0_TimeData_DsAdcISR_u32 "VAR_STM0_TimeData_DsAdcISR_u32" ULONG BSW_A2L_Ident_Int 1 100 0 4294967295 ECU_ADDRESS 0x00000000 /end MEASUREMENT
/begin CHARACTERISTIC CAL_MDF_UsErrFlt_f32 "CAL_MDF_UsErrFlt_f32" VALUE 0x00000000 Scalar_FLOAT32_IEEE 0 BSW_A2L_Ident_Float -3.4E+38 3.4E+38 /end CHARACTERISTIC
/begin CHARACTERISTIC CAL_RDC_RslRefMax_s32 "CAL_RDC_RslRefMax_s32" VALUE 0x00000000 Scalar_LONG 0 BSW_A2L_Ident_Int -2147483648 2147483647 /end CHARACTERISTIC
/begin MEASUREMENT VAR_Scf_flgReqInvDcha_b "VAR_Scf_flgReqInvDcha_b" UBYTE BSW_A2L_Ident_Int 1 100 0 1 ECU_ADDRESS 0x00000000 /end MEASUREMENT
/begin CHARACTERISTIC CAL_FRP_18VHSVoltRngErrOutCtl_b "CAL_FRP_18VHSVoltRngErrOutCtl_b" VALUE 0x00000000 Scalar_BOOLEAN 0 BSW_A2L_Ident_Int 0 1 /end CHARACTERISTIC
/begin CHARACTERISTIC CAL_TjrthLv4ihdh_f32 "CAL_TjrthLv4ihdh_f32" VALUE 0x00000000 Scalar_FLOAT32_IEEE 0 BSW_A2L_Ident_Float -3.4E+38 3.4E+38 /end CHARACTERISTIC
/begin CHARACTERISTIC CAL_DEM_FIM_DFC_MDF_OpenCirNoPsblErr_au8 "CAL_DEM_FIM_DFC_MDF_OpenCirNoPsblErr_au8" VAL_BLK 0x00000000 Scalar_UBYTE 0 FID_Verb 0 255 NUMBER 10 /end CHARACTERISTIC
/begin CHARACTERISTIC CAL_FRP_iPhasSensVolRngErrOutCtl_b "CAL_FRP_iPhasSensVolRngErrOutCtl_b" VALUE 0x00000000 Scalar_BOOLEAN 0 BSW_A2L_Ident_Int 0 1 /end CHARACTERISTIC
/begin MEASUREMENT VAR_MCF_PowerMech_f32 "VAR_MCF_PowerMech_f32" FLOAT32_IEEE BSW_A2L_Ident_Float 1 100 -3.4E+38 3.4E+38 ECU_ADDRESS 0x00000000 /end MEASUREMENT
/begin MEASUREMENT VAR_TpcTmp_flgTrqLimTIGBTActv_b "VAR_TpcTmp_flgTrqLimTIGBTActv_b" UBYTE BSW_A2L_Ident_Int 1 100 0 1 ECU_ADDRESS 0x00000000 /end MEASUREMENT
/begin CHARACTERISTIC CAL_DEM_Disbl_DFC_TPC_uDcLnkUnVLimFail_u8 "CAL_DEM_Disbl_DFC_TPC_uDcLnkUnVLimFail_u8" VALUE 0x00000000 Scalar_UBYTE 0 BSW_A2L_Ident_Int 0 255 /end CHARACTERISTIC
/begin CHARACTERISTIC CAL_TRSP_18VHSVoltDebTrh_s16 "CAL_TRSP_18VHSVoltDebTrh_s16" VALUE 0x00000000 Scalar_SWORD 0 BSW_A2L_Ident_Int -32768 32767 /end CHARACTERISTIC
/begin CHARACTERISTIC CAL_TpcSmp_SystemEffiGen_f32 "CAL_TpcSmp_SystemEffiGen_f32" VALUE 0x00000000 Scalar_FLOAT32_IEEE 0 BSW_A2L_Ident_Float -3.4E+38 3.4E+38 /end CHARACTERISTIC
/begin MEASUREMENT VAR_DEM_Event_TPC_TCoolantOvHiWarn_Status_u8 "VAR_DEM_Event_TPC_TCoolantOvHiWarn_Status_u8" UBYTE BSW_A2L_Ident_Int 1 100 0 255 ECU_ADDRESS 0x00000000 /end MEASUREMENT
/begin MEASUREMENT VAR_RCF_UsAlfaScalSet_f32 "VAR_RCF_UsAlfaScalSet_f32" FLOAT32_IEEE BSW_A2L_Ident_Float 1 100 -3.4E+38 3.4E+38 ECU_ADDRESS 0x00000000 /end MEASUREMENT
/begin CHARACTERISTIC CAL_Cspf_tDBCTempWFlt_f32 "CAL_Cspf_tDBCTempWFlt_f32" VALUE 0x00000000 Scalar_FLOAT32_IEEE 0 BSW_A2L_Ident_Float -3.4E+38 3.4E+38 /end CHARACTERISTIC
/begin CHARACTERISTIC CAL_DEM_FIM_DFC_HvMcu_UartLostFrameErr_au8 "CAL_DEM_FIM_DFC_HvMcu_UartLostFrameErr_au8" VAL_BLK 0x00000000 Scalar_UBYTE 0 FID_Verb 0 255 NUMBER 10 /end CHARACTERISTIC
/begin CHARACTERISTIC CAL_TpcCod_IGBTSampErr_b "CAL_TpcCod_IGBTSampErr_b" VALUE 0x00000000 Scalar_BOOLEAN 0 BSW_A2L_Ident_Int 0 1 /end CHARACTERISTIC
/begin CHARACTERISTIC CAL_Vcf_trqSlopeCoffent_f32 "CAL_Vcf_trqSlopeCoffent_f32" VALUE 0x00000000 Scalar_FLOAT32_IEEE 0 BSW_A2L_Ident_Float -3.4E+38 3.4E+38 /end CHARACTERISTIC
/begin CHARACTERISTIC CAL_MDF_tThd_TempStr_f32 "CAL_MDF_tThd_TempStr_f32" VALUE 0x00000000 Scalar_FLOAT32_IEEE 0 BSW_A2L_Ident_Float -3.4E+38 3.4E+38 /end CHARACTERISTIC
/begin MEASUREMENT VAR_TpcMot_CofDertTSttrSave2_f32 "VAR_TpcMot_CofDertTSttrSave2_f32" FLOAT32_IEEE BSW_A2L_Ident_Float 1 100 -3.4E+38 3.4E+38 ECU_ADDRESS 0x00000000 /end MEASUREMENT
/begin CHARACTERISTIC CAL_MCF_DycWSet_f32 "CAL_MCF_DycWSet_f32" VALUE 0x00000000 Scalar_FLOAT32_IEEE 0 BSW_A2L_Ident_Float -3.4E+38 3.4E+38 /end CHARACTERISTIC
/begin MEASUREMENT VAR_TpcSmp_cofDertOvrVoltGen_f32 "VAR_TpcSmp_cofDertOvrVoltGen_f32" FLOAT32_IEEE BSW_A2L_Ident_Float 1 100 -3.4E+38 3.4E+38 ECU_ADDRESS 0x00000000 /end MEASUREMENT
/begin MEASUREMENT VAR_TpcSmp_GenTrqLimOvrSpd_f32 "VAR_TpcSmp_GenTrqLimOvrSpd_f32" FLOAT32_IEEE BSW_A2L_Ident_Float 1 100 -3.4E+38 3.4E+38 ECU_ADDRESS 0x00000000 /end MEASUREMENT
/begin CHARACTERISTIC CAL_PcfCtl_InitOutP_f32 "CAL_PcfCtl_InitOutP_f32" VALUE 0x00000000 Scalar_FLOAT32_IEEE 0 BSW_A2L_Ident_Float -3.4E+38 3.4E+38 /end CHARACTERISTIC
/begin MEASUREMENT VAR_IoHwAb_Adc_Phy_CPLD_3_3V_f32 "VAR_IoHwAb_Adc_Phy_CPLD_3_3V_f32" FLOAT32_IEEE BSW_A2L_Ident_Float 1 100 -3.4E+38 3.4E+38 ECU_ADDRESS 0x00000000 /end MEASUREMENT
/begin MEASUREMENT VAR_TRSP_CurrSumChkRslt_b "VAR_TRSP_CurrSumChkRslt_b" UBYTE BSW_A2L_Ident_Int 1 100 0 1 ECU_ADDRESS 0x00000000 /end MEASUREMENT
/begin CHARACTERISTIC CAL_MPC_iqActCutOffFrq_f32 "CAL_MPC_iqActCutOffFrq_f32" VALUE 0x00000000 Scalar_FLOAT32_IEEE 0 BSW_A2L_Ident_Float -3.4E+38 3.4E+38 /end CHARACTERISTIC
/begin CHARACTERISTIC CAL_IOHWAB_AN30_IUVW_N_REF_MAX_f32 "CAL_IOHWAB_AN30_IUVW_N_REF_MAX_f32" VALUE 0x00000000 Scalar_FLOAT32_IEEE 0 BSW_A2L_Ident_Float -3.4E+38 3.4E+38 /end CHARACTERISTIC
/begin CHARACTERISTIC CAL_PcfStm_flgUseRPC_b "CAL_PcfStm_flgUseRPC_b" VALUE 0x00000000 Scalar_BOOLEAN 0 BSW_A2L_Ident_Int 0 1 /end CHARACTERISTIC
/begin CHARACTERISTIC CAL_DEM_Disbl_DFC_Event_NvM_WriteErr_u8 "CAL_DEM_Disbl_DFC_Event_NvM_WriteErr_u8" VALUE 0x00000000 Scalar_UBYTE 0 BSW_A2L_Ident_Int 0 255 /end CHARACTERISTIC
/begin MEASUREMENT VAR_3phPWMVL_Period_f32 "VAR_3phPWMVL_Period_f32" FLOAT32_IEEE BSW_A2L_Ident_Float 1 100 -3.4E+38 3.4E+38 ECU_ADDRESS 0x00000000 /end MEASUREMENT
/begin CHARACTERISTIC CAL_DEM_Disbl_DFC_HSPF_VerMatchFailureErr_u8 "CAL_DEM_Disbl_DFC_HSPF_VerMatchFailureErr_u8" VALUE 0x00000000 Scalar_UBYTE 0 BSW_A2L_Ident_Int 0 255 /end CHARACTERISTIC
/begin MEASUREMENT VAR_RCF_flgAccToDefault_b "VAR_RCF_flgAccToDefault_b" UBYTE BSW_A2L_Ident_Int 1 100 0 1 ECU_ADDRESS 0x00000000 /end MEASUREMENT
/begin CHARACTERISTIC CAL_PcfStm_flgUseAutoBackP_b "CAL_PcfStm_flgUseAutoBackP_b" VALUE 0x00000000 Scalar_BOOLEAN 0 BSW_A2L_Ident_Int 0 1 /end CHARACTERISTIC
/begin MEASUREMENT VAR_Vcf_flgTrqSetPDecAsr_b "VAR_Vcf_flgTrqSetPDecAsr_b" UBYTE BSW_A2L_Ident_Int 1 100 0 1 ECU_ADDRESS 0x00000000 /end MEASUREMENT
/begin MEASUREMENT VAR_Cspf_TraHwVer_u16 "VAR_Cspf_TraHwVer_u16" UWORD BSW_A2L_Ident_Int 1 100 0 65535 ECU_ADDRESS 0x00000000 /end MEASUREMENT
/begin CHARACTERISTIC CAL_Cspf_flgTraTrqMaxSwt_b "CAL_Cspf_flgTraTrqMaxSwt_b" VALUE 0x00000000 Scalar_BOOLEAN 0 BSW_A2L_Ident_Int 0 1 /end CHARACTERISTIC
/begin MEASUREMENT VAR_TRSP_RslvSin_f32 "VAR_TRSP_RslvSin_f32" FLOAT32_IEEE BSW_A2L_Ident_Float 1 100 -3.4E+38 3.4E+38 ECU_ADDRESS 0x00000000 /end MEASUREMENT
/begin CHARACTERISTIC CAL_DEM_FIM_DFC_IOHWAB_Cpld3v3SampFail_au8 "CAL_DEM_FIM_DFC_IOHWAB_Cpld3v3SampFail_au8" VAL_BLK 0x00000000 Scalar_UBYTE 0 FID_Verb 0 255 NUMBER 10 /end CHARACTERISTIC
/begin MEASUREMENT VAR_TCF_PwrTrqTubeH1_f32 "VAR_TCF_PwrTrqTubeH1_f32" FLOAT32_IEEE BSW_A2L_Ident_Float 1 100 -3.4E+38 3.4E+38 ECU_ADDRESS 0x00000000 /end MEASUREMENT
/begin CHARACTERISTIC CAL_Cspf_flgTrqSetPSwt_b "CAL_Cspf_flgTrqSetPSwt_b" VALUE 0x00000000 Scalar_BOOLEAN 0 BSW_A2L_Ident_Int 0 1 /end CHARACTERISTIC
/begin CHARACTERISTIC CAL_Scf_udcPrechgFish_f32 "CAL_Scf_udcPrechgFish_f32" VALUE 0x00000000 Scalar_FLOAT32_IEEE 0 BSW_A2L_Ident_Float -3.4E+38 3.4E+38 /end CHARACTERISTIC
/begin CHARACTERISTIC CAL_Cspf_bDernMtrSpd_u8 "CAL_Cspf_bDernMtrSpd_u8" VALUE 0x00000000 Scalar_UBYTE 0 BSW_A2L_Ident_Int 0 255 /end CHARACTERISTIC
/begin MEASUREMENT VAR_DEM_Event_Cpld_AliveChkErr_Status_u8 "VAR_DEM_Event_Cpld_AliveChkErr_Status_u8" UBYTE BSW_A2L_Ident_Int 1 100 0 255 ECU_ADDRESS 0x00000000 /end MEASUREMENT
/begin MEASUREMENT VAR_TpcSmp_uDcLnkMax_f32 "VAR_TpcSmp_uDcLnkMax_f32" FLOAT32_IEEE BSW_A2L_Ident_Float 1 100 -3.4E+38 3.4E+38 ECU_ADDRESS 0x00000000 /end MEASUREMENT
/begin CHARACTERISTIC CAL_Cspf_flgbDernExcMinSwt_b "CAL_Cspf_flgbDernExcMinSwt_b" VALUE 0x00000000 Scalar_BOOLEAN 0 BSW_A2L_Ident_Int 0 1 /end CHARACTERISTIC
/begin MEASUREMENT VAR_Scf_flgTranPreDrvRunToFish_b "VAR_Scf_flgTranPreDrvRunToFish_b" UBYTE BSW_A2L_Ident_Int 1 100 0 1 ECU_ADDRESS 0x00000000 /end MEASUREMENT
/begin CHARACTERISTIC CAL_MCF_SpdOffDeadCpn_f32 "CAL_MCF_SpdOffDeadCpn_f32" VALUE 0x00000000 Scalar_FLOAT32_IEEE 0 BSW_A2L_Ident_Float -3.4E+38 3.4E+38 /end CHARACTERISTIC
/begin CHARACTERISTIC CAL_Hspf_INVOpenChkCntHiLim_u8 "CAL_Hspf_INVOpenChkCntHiLim_u8" VALUE 0x00000000 Scalar_UBYTE 0 BSW_A2L_Ident_Int 0 255 /end CHARACTERISTIC
/begin MEASUREMENT VAR_TpcTmp_tCoolTempFlt_u16 "VAR_TpcTmp_tCoolTempFlt_u16" UWORD BSW_A2L_Ident_Int 1 100 0 65535 ECU_ADDRESS 0x00000000 /end MEASUREMENT
/begin MEASUREMENT VAR_MCF_uDcLnk_f32 "VAR_MCF_uDcLnk_f32" FLOAT32_IEEE BSW_A2L_Ident_Float 1 100 -3.4E+38 3.4E+38 ECU_ADDRESS 0x00000000 /end MEASUREMENT
/begin CHARACTERISTIC CAL_DEM_FIM_DFC_TPC_TDbcUHiLimFail_au8 "CAL_DEM_FIM_DFC_TPC_TDbcUHiLimFail_au8" VAL_BLK 0x00000000 Scalar_UBYTE 0 FID_Verb 0 255 NUMBER 10 /end CHARACTERISTIC
/begin CHARACTERISTIC CAL_Vcf_CrawlNsetR_f32 "CAL_Vcf_CrawlNsetR_f32" VALUE 0x00000000 Scalar_FLOAT32_IEEE 0 BSW_A2L_Ident_Float -3.4E+38 3.4E+38 /end CHARACTERISTIC
/begin CHARACTERISTIC CAL_Hspf_tCoolantFltFrq_f32 "CAL_Hspf_tCoolantFltFrq_f32" VALUE 0x00000000 Scalar_FLOAT32_IEEE 0 BSW_A2L_Ident_Float -3.4E+38 3.4E+38 /end CHARACTERISTIC
/begin MEASUREMENT VAR_TRSP_RslvExciPRngChkRslt_b "VAR_TRSP_RslvExciPRngChkRslt_b" UBYTE BSW_A2L_Ident_Int 1 100 0 1 ECU_ADDRESS 0x00000000 /end MEASUREMENT
/begin MEASUREMENT VAR_TCF_PinputDc_f32 "VAR_TCF_PinputDc_f32" FLOAT32_IEEE BSW_A2L_Ident_Float 1 100 -3.4E+38 3.4E+38 ECU_ADDRESS 0x00000000 /end MEASUREMENT
/begin CHARACTERISTIC CAL_TRSP_ReqTrqCountTrh_s16 "CAL_TRSP_ReqTrqCountTrh_s16" VALUE 0x00000000 Scalar_SWORD 0 BSW_A2L_Ident_Int -32768 32767 /end CHARACTERISTIC
/begin MEASUREMENT VAR_TpcSmp_GenPwrLinearDertOvrCurt_f32 "VAR_TpcSmp_GenPwrLinearDertOvrCurt_f32" FLOAT32_IEEE BSW_A2L_Ident_Float 1 100 -3.4E+38 3.4E+38 ECU_ADDRESS 0x00000000 /end MEASUREMENT
/begin CHARACTERISTIC CAL_Scf_flgDisChgReqSwt_b "CAL_Scf_flgDisChgReqSwt_b" VALUE 0x00000000 Scalar_BOOLEAN 0 BSW_A2L_Ident_Int 0 1 /end CHARACTERISTIC
/begin MEASUREMENT VAR_tpcsmp_RefPwrElecOvrCurt_f32 "VAR_tpcsmp_RefPwrElecOvrCurt_f32" FLOAT32_IEEE BSW_A2L_Ident_Float 1 100 -3.4E+38 3.4E+38 ECU_ADDRESS 0x00000000 /end MEASUREMENT
/begin MEASUREMENT VAR_RCF_OfsFlt3600Fwd_f32 "VAR_RCF_OfsFlt3600Fwd_f32" FLOAT32_IEEE BSW_A2L_Ident_Float 1 100 -3.4E+38 3.4E+38 ECU_ADDRESS 0x00000000 /end MEASUREMENT
/begin CHARACTERISTIC CAL_Scf_uTnetHysToDrv_f32 "CAL_Scf_uTnetHysToDrv_f32" VALUE 0x00000000 Scalar_FLOAT32_IEEE 0 BSW_A2L_Ident_Float -3.4E+38 3.4E+38 /end CHARACTERISTIC
/begin CHARACTERISTIC CAL_BCC_flgDelayDyc_b "CAL_BCC_flgDelayDyc_b" VALUE 0x00000000 Scalar_BOOLEAN 0 BSW_A2L_Ident_Int 0 1 /end CHARACTERISTIC
/begin CHARACTERISTIC CAL_Cspf_TrqCurrWoDmpC_f32 "CAL_Cspf_TrqCurrWoDmpC_f32" VALUE 0x00000000 Scalar_FLOAT32_IEEE 0 BSW_A2L_Ident_Float -3.4E+38 3.4E+38 /end CHARACTERISTIC
/begin MEASUREMENT VAR_TpcTmp_CofDertTdrvboard_f32 "VAR_TpcTmp_CofDertTdrvboard_f32" FLOAT32_IEEE BSW_A2L_Ident_Float 1 100 -3.4E+38 3.4E+38 ECU_ADDRESS 0x00000000 /end MEASUREMENT
/begin CHARACTERISTIC CAL_Cpld_State_Fault_Debounce_Max_u8 "CAL_Cpld_State_Fault_Debounce_Max_u8" VALUE 0x00000000 Scalar_UBYTE 0 BSW_A2L_Ident_Int 0 255 /end CHARACTERISTIC
/begin CHARACTERISTIC CAL_TpcFuv_CofPwrLimLv1_f32 "CAL_TpcFuv_CofPwrLimLv1_f32" VALUE 0x00000000 Scalar_FLOAT32_IEEE 0 BSW_A2L_Ident_Float -3.4E+38 3.4E+38 /end CHARACTERISTIC
/begin CHARACTERISTIC CAL_RCF_tUbetaSet_u32 "CAL_RCF_tUbetaSet_u32" VALUE 0x00000000 Scalar_ULONG 0 BSW_A2L_Ident_Int 0 4294967295 /end CHARACTERISTIC
/begin CHARACTERISTIC CAL_DEM_FIM_DFC_HSPF_InvOpenErr_au8 "CAL_DEM_FIM_DFC_HSPF_InvOpenErr_au8" VAL_BLK 0x00000000 Scalar_UBYTE 0 FID_Verb 0 255 NUMBER 10 /end CHARACTERISTIC
/begin CHARACTERISTIC CAL_Scf_flgActvSubUSwt_b "CAL_Scf_flgActvSubUSwt_b" VALUE 0x00000000 Scalar_BOOLEAN 0 BSW_A2L_Ident_Int 0 1 /end CHARACTERISTIC
/begin CHARACTERISTIC CAL_PcfDia_SpdHiHyst_f32 "CAL_PcfDia_SpdHiHyst_f32" VALUE 0x00000000 Scalar_FLOAT32_IEEE 0 BSW_A2L_Ident_Float -3.4E+38 3.4E+38 /end CHARACTERISTIC
/begin CHARACTERISTIC CAL_DEM_Disbl_DFC_TPC_uDcLnkOvWarn_u8 "CAL_DEM_Disbl_DFC_TPC_uDcLnkOvWarn_u8" VALUE 0x00000000 Scalar_UBYTE 0 BSW_A2L_Ident_Int 0 255 /end CHARACTERISTIC
/begin MEASUREMENT VAR_VilTjtIGBT_f32 "VAR_VilTjtIGBT_f32" FLOAT32_IEEE BSW_A2L_Ident_Float 1 100 -3.4E+38 3.4E+38 ECU_ADDRESS 0x00000000 /end MEASUREMENT
/begin CHARACTERISTIC CAL_TRSP_RslvRngCosNLoLim_u16 "CAL_TRSP_RslvRngCosNLoLim_u16" VALUE 0x00000000 Scalar_UWORD 0 BSW_A2L_Ident_Int 0 65535 /end CHARACTERISTIC
/begin CHARACTERISTIC CAL_Cspf_bDernCAN_u8 "CAL_Cspf_bDernCAN_u8" VALUE 0x00000000 Scalar_UBYTE 0 BSW_A2L_Ident_Int 0 255 /end CHARACTERISTIC
/begin CHARACTERISTIC CAL_MDF_tiEMBlk_f32 "CAL_MDF_tiEMBlk_f32" VALUE 0x00000000 Scalar_FLOAT32_IEEE 0 BSW_A2L_Ident_Float -3.4E+38 3.4E+38 /end CHARACTERISTIC
/begin MEASUREMENT VAR_MDF_bFaultICtlChk_b "VAR_MDF_bFaultICtlChk_b" UBYTE BSW_A2L_Ident_Int 1 100 0 1 ECU_ADDRESS 0x00000000 /end MEASUREMENT
/begin MEASUREMENT VAR_TCF_nDir_u8 "VAR_TCF_nDir_u8" UBYTE BSW_A2L_Ident_Int 1 100 0 255 ECU_ADDRESS 0x00000000 /end MEASUREMENT
/begin CHARACTERISTIC CAL_Vcf_TrqHoldOutLim_f32 "CAL_Vcf_TrqHoldOutLim_f32" VALUE 0x00000000 Scalar_FLOAT32_IEEE 0 BSW_A2L_Ident_Float -3.4E+38 3.4E+38 /end CHARACTERISTIC
/begin MEASUREMENT VAR_L2Sampling_DycWMon_f32 "VAR_L2Sampling_DycWMon_f32" FLOAT32_IEEE BSW_A2L_Ident_Float 1 100 -3.4E+38 3.4E+38 ECU_ADDRESS 0x00000000 /end MEASUREMENT
/begin MEASUREMENT VAR_TpcTmp_CofDertTIGBTSave1_f32 "VAR_TpcTmp_CofDertTIGBTSave1_f32" FLOAT32_IEEE BSW_A2L_Ident_Float 1 100 -3.4E+38 3.4E+38 ECU_ADDRESS 0x00000000 /end MEASUREMENT
/begin MEASUREMENT VAR_TpcSmp_flgPIDertOvrCurtGen_b "VAR_TpcSmp_flgPIDertOvrCurtGen_b" UBYTE BSW_A2L_Ident_Int 1 100 0 1 ECU_ADDRESS 0x00000000 /end MEASUREMENT
/begin MEASUREMENT VAR_MCF_UdDes11ZR_f32 "VAR_MCF_UdDes11ZR_f32" FLOAT32_IEEE BSW_A2L_Ident_Float 1 100 -3.4E+38 3.4E+38 ECU_ADDRESS 0x00000000 /end MEASUREMENT
/begin CHARACTERISTIC CAL_DEM_Disbl_DFC_IOHWAB_KL30UnderVolErr_u8 "CAL_DEM_Disbl_DFC_IOHWAB_KL30UnderVolErr_u8" VALUE 0x00000000 Scalar_UBYTE 0 BSW_A2L_Ident_Int 0 255 /end CHARACTERISTIC
/begin CHARACTERISTIC CAL_RCF_nExtClbFrewhlFwd_f32 "CAL_RCF_nExtClbFrewhlFwd_f32" VALUE 0x00000000 Scalar_FLOAT32_IEEE 0 BSW_A2L_Ident_Float -3.4E+38 3.4E+38 /end CHARACTERISTIC
/begin CHARACTERISTIC CAL_DEM_FIM_DFC_IOHWAB_TCoolantSampFail_au8 "CAL_DEM_FIM_DFC_IOHWAB_TCoolantSampFail_au8" VAL_BLK 0x00000000 Scalar_UBYTE 0 FID_Verb 0 255 NUMBER 10 /end CHARACTERISTIC
/begin MEASUREMENT VAR_MDF_OffSetSiteAObs_f32 "VAR_MDF_OffSetSiteAObs_f32" FLOAT32_IEEE BSW_A2L_Ident_Float 1 100 -3.4E+38 3.4E+38 ECU_ADDRESS 0x00000000 /end MEASUREMENT
/begin CHARACTERISTIC CAL_MCF_DisChaisdDes_f32 "CAL_MCF_DisChaisdDes_f32" VALUE 0x00000000 Scalar_FLOAT32_IEEE 0 BSW_A2L_Ident_Float -3.4E+38 3.4E+38 /end CHARACTERISTIC
/begin CHARACTERISTIC CAL_MCF_CoefFltZero_B_f32 "CAL_MCF_CoefFltZero_B_f32" VALUE 0x00000000 Scalar_FLOAT32_IEEE 0 BSW_A2L_Ident_Float -3.4E+38 3.4E+38 /end CHARACTERISTIC
/begin CHARACTERISTIC CAL_Tpc_Powersave1Mode_u8 "CAL_Tpc_Powersave1Mode_u8" VALUE 0x00000000 Scalar_UBYTE 0 BSW_A2L_Ident_Int 0 255 /end CHARACTERISTIC
/begin CHARACTERISTIC CAL_TpcSmp_OvSpdWarnLoLim_f32 "CAL_TpcSmp_OvSpdWarnLoLim_f32" VALUE 0x00000000 Scalar_FLOAT32_IEEE 0 BSW_A2L_Ident_Float -3.4E+38 3.4E+38 /end CHARACTERISTIC
/begin MEASUREMENT VAR_TpcSmp_flgPIDertOvrCurtElec_b "VAR_TpcSmp_flgPIDertOvrCurtElec_b" UBYTE BSW_A2L_Ident_Int 1 100 0 1 ECU_ADDRESS 0x00000000 /end MEASUREMENT
/begin CHARACTERISTIC CAL_DEM_FIM_DFC_IOHWAB_SttrSenorShrFail_au8 "CAL_DEM_FIM_DFC_IOHWAB_SttrSenorShrFail_au8" VAL_BLK 0x00000000 Scalar_UBYTE 0 FID_Verb 0 255 NUMBER 10 /end CHARACTERISTIC
/begin CHARACTERISTIC CAL_Cspf_HvMcuVer_u8 "CAL_Cspf_HvMcuVer_u8" VALUE 0x00000000 Scalar_UBYTE 0 BSW_A2L_Ident_Int 0 255 /end CHARACTERISTIC
/begin CHARACTERISTIC CAL_RCF_nOfValBwdStp_f32 "CAL_RCF_nOfValBwdStp_f32" VALUE 0x00000000 Scalar_FLOAT32_IEEE 0 BSW_A2L_Ident_Float -3.4E+38 3.4E+38 /end CHARACTERISTIC
/begin CHARACTERISTIC CAL_Cspf_stTrqEmMin_u8 "CAL_Cspf_stTrqEmMin_u8" VALUE 0x00000000 Scalar_UBYTE 0 BSW_A2L_Ident_Int 0 255 /end CHARACTERISTIC
/begin CHARACTERISTIC CAL_Cspf_stTrqEmMax_u8 "CAL_Cspf_stTrqEmMax_u8" VALUE 0x00000000 Scalar_UBYTE 0 BSW_A2L_Ident_Int 0 255 /end CHARACTERISTIC
/begin CHARACTERISTIC CAL_TpcTmp_tDbcTempVLoLim_f32 "CAL_TpcTmp_tDbcTempVLoLim_f32" VALUE 0x00000000 Scalar_FLOAT32_IEEE 0 BSW_A2L_Ident_Float -3.4E+38 3.4E+38 /end CHARACTERISTIC
/begin CHARACTERISTIC CAL_PcfCtl_PosKd_f32 "CAL_PcfCtl_PosKd_f32" VALUE 0x00000000 Scalar_FLOAT32_IEEE 0 BSW_A2L_Ident_Float -3.4E+38 3.4E+38 /end CHARACTERISTIC
/begin MEASUREMENT VAR_DEM_Event_PCF_StallRetryErr_Status_u8 "VAR_DEM_Event_PCF_StallRetryErr_Status_u8" UBYTE BSW_A2L_Ident_Int 1 100 0 255 ECU_ADDRESS 0x00000000 /end MEASUREMENT
/begin CHARACTERISTIC CAL_RCF_agReferenceFwd_f32 "CAL_RCF_agReferenceFwd_f32" VALUE 0x00000000 Scalar_FLOAT32_IEEE 0 BSW_A2L_Ident_Float -3.4E+38 3.4E+38 /end CHARACTERISTIC
/begin MEASUREMENT VAR_MDF_bPwrCmpDFCCalc_b "VAR_MDF_bPwrCmpDFCCalc_b" UBYTE BSW_A2L_Ident_Int 1 100 0 1 ECU_ADDRESS 0x00000000 /end MEASUREMENT
/begin CHARACTERISTIC CAL_DEM_FIM_DFC_IOHWAB_3V3MCU_SampFail_au8 "CAL_DEM_FIM_DFC_IOHWAB_3V3MCU_SampFail_au8" VAL_BLK 0x00000000 Scalar_UBYTE 0 FID_Verb 0 255 NUMBER 10 /end CHARACTERISTIC
/begin MEASUREMENT VAR_3phPWMUL_Duty_f32 "VAR_3phPWMUL_Duty_f32" FLOAT32_IEEE BSW_A2L_Ident_Float 1 100 -3.4E+38 3.4E+38 ECU_ADDRESS 0x00000000 /end MEASUREMENT
/begin CHARACTERISTIC CAL_Cspf_TrqSLope_f32 "CAL_Cspf_TrqSLope_f32" VALUE 0x00000000 Scalar_FLOAT32_IEEE 0 BSW_A2L_Ident_Float -3.4E+38 3.4E+38 /end CHARACTERISTIC
/begin CHARACTERISTIC CAL_TRSP_1V8CPLDVoltErrRst_b "CAL_TRSP_1V8CPLDVoltErrRst_b" VALUE 0x00000000 Scalar_BOOLEAN 0 BSW_A2L_Ident_Int 0 1 /end CHARACTERISTIC
/begin MEASUREMENT VAR_tpccod_flgMinDertCAN_b "VAR_tpccod_flgMinDertCAN_b" UBYTE BSW_A2L_Ident_Int 1 100 0 1 ECU_ADDRESS 0x00000000 /end MEASUREMENT
/begin CHARACTERISTIC CAL_Scf_LowPwrSetUpSud_u8 "CAL_Scf_LowPwrSetUpSud_u8" VALUE 0x00000000 Scalar_UBYTE 0 BSW_A2L_Ident_Int 0 255 /end CHARACTERISTIC
/begin MEASUREMENT VAR_TpcTmp_ElecTrqLimTdbcWoRamp_f32 "VAR_TpcTmp_ElecTrqLimTdbcWoRamp_f32" FLOAT32_IEEE BSW_A2L_Ident_Float 1 100 -3.4E+38 3.4E+38 ECU_ADDRESS 0x00000000 /end MEASUREMENT
/begin CHARACTERISTIC CAL_DEM_FIM_DFC_MDF_AlOfsNoPlausErr_au8 "CAL_DEM_FIM_DFC_MDF_AlOfsNoPlausErr_au8" VAL_BLK 0x00000000 Scalar_UBYTE 0 FID_Verb 0 255 NUMBER 10 /end CHARACTERISTIC
/begin MEASUREMENT VAR_PcfDia_stRunTi_u8 "VAR_PcfDia_stRunTi_u8" UBYTE BSW_A2L_Ident_Int 1 100 0 255 ECU_ADDRESS 0x00000000 /end MEASUREMENT
/begin MEASUREMENT VAR_MDF_bICtlRatChk_b "VAR_MDF_bICtlRatChk_b" UBYTE BSW_A2L_Ident_Int 1 100 0 1 ECU_ADDRESS 0x00000000 /end MEASUREMENT
/begin MEASUREMENT VAR_DEM_Event_HvMcu_EmerPowerSapErr_Status_u8 "VAR_DEM_Event_HvMcu_EmerPowerSapErr_Status_u8" UBYTE BSW_A2L_Ident_Int 1 100 0 255 ECU_ADDRESS 0x00000000 /end MEASUREMENT
/begin CHARACTERISTIC CAL_TRSP_3V3CPLDVoltErrRst_b "CAL_TRSP_3V3CPLDVoltErrRst_b" VALUE 0x00000000 Scalar_BOOLEAN 0 BSW_A2L_Ident_Int 0 1 /end CHARACTERISTIC
/begin MEASUREMENT VAR_MCF_uQDesEOL_f32 "VAR_MCF_uQDesEOL_f32" FLOAT32_IEEE BSW_A2L_Ident_Float 1 100 -3.4E+38 3.4E+38 ECU_ADDRESS 0x00000000 /end MEASUREMENT
/begin CHARACTERISTIC CAL_TpcTmp_DBCTempRiseDiff_f32 "CAL_TpcTmp_DBCTempRiseDiff_f32" VALUE 0x00000000 Scalar_FLOAT32_IEEE 0 BSW_A2L_Ident_Float -3.4E+38 3.4E+38 /end CHARACTERISTIC
/begin CHARACTERISTIC CAL_MPC_nTrqMonMin_f32 "CAL_MPC_nTrqMonMin_f32" VALUE 0x00000000 Scalar_FLOAT32_IEEE 0 BSW_A2L_Ident_Float -3.4E+38 3.4E+38 /end CHARACTERISTIC
/begin CHARACTERISTIC CAL_MDF_UsErrThres_f32 "CAL_MDF_UsErrThres_f32" VALUE 0x00000000 Scalar_FLOAT32_IEEE 0 BSW_A2L_Ident_Float -3.4E+38 3.4E+38 /end CHARACTERISTIC
/begin MEASUREMENT VAR_L2Sampling_UBRWIDE_MON_u16 "VAR_L2Sampling_UBRWIDE_MON_u16" UWORD BSW_A2L_Ident_Int 1 100 0 65535 ECU_ADDRESS 0x00000000 /end MEASUREMENT
/begin MEASUREMENT VAR_DEM_Event_IOHWAB_5VQt1SampFail_Status_u8 "VAR_DEM_Event_IOHWAB_5VQt1SampFail_Status_u8" UBYTE BSW_A2L_Ident_Int 1 100 0 255 ECU_ADDRESS 0x00000000 /end MEASUREMENT
/begin CHARACTERISTIC CAL_MCF_UsqScalSet_f32 "CAL_MCF_UsqScalSet_f32" VALUE 0x00000000 Scalar_FLOAT32_IEEE 0 BSW_A2L_Ident_Float -3.4E+38 3.4E+38 /end CHARACTERISTIC
/begin MEASUREMENT VAR_TRSP_iPhasSensVoltRngChkRslt_b "VAR_TRSP_iPhasSensVoltRngChkRslt_b" UBYTE BSW_A2L_Ident_Int 1 100 0 1 ECU_ADDRESS 0x00000000 /end MEASUREMENT
/begin MEASUREMENT VAR_Scf_flgTranSenCalToiMMO_b "VAR_Scf_flgTranSenCalToiMMO_b" UBYTE BSW_A2L_Ident_Int 1 100 0 1 ECU_ADDRESS 0x00000000 /end MEASUREMENT
/begin MEASUREMENT VAR_tpccod_flgMaxDertCAN_b "VAR_tpccod_flgMaxDertCAN_b" UBYTE BSW_A2L_Ident_Int 1 100 0 1 ECU_ADDRESS 0x00000000 /end MEASUREMENT
/begin MEASUREMENT VAR_L2Sampling_RslvCosN_VADC_Min1_u16 "VAR_L2Sampling_RslvCosN_VADC_Min1_u16" UWORD BSW_A2L_Ident_Int 1 100 0 65535 ECU_ADDRESS 0x00000000 /end MEASUREMENT
/begin MEASUREMENT VAR_PcfStm_SLflgPosNvm_b "VAR_PcfStm_SLflgPosNvm_b" UBYTE BSW_A2L_Ident_Int 1 100 0 1 ECU_ADDRESS 0x00000000 /end MEASUREMENT
/begin MEASUREMENT VAR_Hspf_tStrrTemp2_s16 "VAR_Hspf_tStrrTemp2_s16" SWORD BSW_A2L_Ident_Int 1 100 -32768 32767 ECU_ADDRESS 0x00000000 /end MEASUREMENT
/begin CHARACTERISTIC CAL_Cspf_kDmp_f32 "CAL_Cspf_kDmp_f32" VALUE 0x00000000 Scalar_FLOAT32_IEEE 0 BSW_A2L_Ident_Float -3.4E+38 3.4E+38 /end CHARACTERISTIC
/begin MEASUREMENT VAR_DEM_Event_IOHWAB_Cpld3v3SampFail_Status_u8 "VAR_DEM_Event_IOHWAB_Cpld3v3SampFail_Status_u8" UBYTE BSW_A2L_Ident_Int 1 100 0 255 ECU_ADDRESS 0x00000000 /end MEASUREMENT
/begin CHARACTERISTIC CAL_RCF_flgEnOfsClb_b "CAL_RCF_flgEnOfsClb_b" VALUE 0x00000000 Scalar_BOOLEAN 0 BSW_A2L_Ident_Int 0 1 /end CHARACTERISTIC
/begin CHARACTERISTIC CAL_Tpcmot_uDcLoset_f32 "CAL_Tpcmot_uDcLoset_f32" VALUE 0x00000000 Scalar_FLOAT32_IEEE 0 BSW_A2L_Ident_Float -3.4E+38 3.4E+38 /end CHARACTERISTIC
/begin CHARACTERISTIC CAL_Cspf_iQActSlowFlt_f32 "CAL_Cspf_iQActSlowFlt_f32" VALUE 0x00000000 Scalar_FLOAT32_IEEE 0 BSW_A2L_Ident_Float -3.4E+38 3.4E+38 /end CHARACTERISTIC
/begin CHARACTERISTIC CAL_DEM_FIM_DFC_PCF_SenClbErr_au8 "CAL_DEM_FIM_DFC_PCF_SenClbErr_au8" VAL_BLK 0x00000000 Scalar_UBYTE 0 FID_Verb 0 255 NUMBER 10 /end CHARACTERISTIC
/begin CHARACTERISTIC CAL_Cspf_flgbDernUndrUdcSwt_b "CAL_Cspf_flgbDernUndrUdcSwt_b" VALUE 0x00000000 Scalar_BOOLEAN 0 BSW_A2L_Ident_Int 0 1 /end CHARACTERISTIC
/begin MEASUREMENT VAR_DEM_Event_IgbtDrv_LwBrgFaultBFail_Status_u8 "VAR_DEM_Event_IgbtDrv_LwBrgFaultBFail_Status_u8" UBYTE BSW_A2L_Ident_Int 1 100 0 255 ECU_ADDRESS 0x00000000 /end MEASUREMENT
/begin CHARACTERISTIC CAL_RCF_nCalcSec1_f32 "CAL_RCF_nCalcSec1_f32" VALUE 0x00000000 Scalar_FLOAT32_IEEE 0 BSW_A2L_Ident_Float -3.4E+38 3.4E+38 /end CHARACTERISTIC
/begin CHARACTERISTIC CAL_POWER_UBSBC_Threhold_V3_f32 "CAL_POWER_UBSBC_Threhold_V3_f32" VALUE 0x00000000 Scalar_FLOAT32_IEEE 0 BSW_A2L_Ident_Float -3.4E+38 3.4E+38 /end CHARACTERISTIC
/begin MEASUREMENT VAR_DEM_Event_Epark_PosMonSampFail_Status_u8 "VAR_DEM_Event_Epark_PosMonSampFail_Status_u8" UBYTE BSW_A2L_Ident_Int 1 100 0 255 ECU_ADDRESS 0x00000000 /end MEASUREMENT
/begin MEASUREMENT VAR_Scf_uDcLnkDiffUnLo_b "VAR_Scf_uDcLnkDiffUnLo_b" UBYTE BSW_A2L_Ident_Int 1 100 0 1 ECU_ADDRESS 0x00000000 /end MEASUREMENT
/begin CHARACTERISTIC CAL_TpcTmp_IGBTTempDecDiff_f32 "CAL_TpcTmp_IGBTTempDecDiff_f32" VALUE 0x00000000 Scalar_FLOAT32_IEEE 0 BSW_A2L_Ident_Float -3.4E+38 3.4E+38 /end CHARACTERISTIC
/begin MEASUREMENT VAR_Scf_flgTranSLCalToStb_b "VAR_Scf_flgTranSLCalToStb_b" UBYTE BSW_A2L_Ident_Int 1 100 0 1 ECU_ADDRESS 0x00000000 /end MEASUREMENT
/begin MEASUREMENT VAR_TpcTmp_CofDertIGBT_f32 "VAR_TpcTmp_CofDertIGBT_f32" FLOAT32_IEEE BSW_A2L_Ident_Float 1 100 -3.4E+38 3.4E+38 ECU_ADDRESS 0x00000000 /end MEASUREMENT
/begin CHARACTERISTIC CAL_TpcSmp_ThresOverSpd_f32 "CAL_TpcSmp_ThresOverSpd_f32" VALUE 0x00000000 Scalar_FLOAT32_IEEE 0 BSW_A2L_Ident_Float -3.4E+38 3.4E+38 /end CHARACTERISTIC
/begin CHARACTERISTIC CAL_TRSP_RslvRngCosNHiLim_u16 "CAL_TRSP_RslvRngCosNHiLim_u16" VALUE 0x00000000 Scalar_UWORD 0 BSW_A2L_Ident_Int 0 65535 /end CHARACTERISTIC
/begin CHARACTERISTIC CAL_TRSP_RslvSensVoltDebTrh_s16 "CAL_TRSP_RslvSensVoltDebTrh_s16" VALUE 0x00000000 Scalar_SWORD 0 BSW_A2L_Ident_Int -32768 32767 /end CHARACTERISTIC
/begin MEASUREMENT VAR_TRSP_TrqSetPRngErr_b "VAR_TRSP_TrqSetPRngErr_b" UBYTE BSW_A2L_Ident_Int 1 100 0 1 ECU_ADDRESS 0x00000000 /end MEASUREMENT
/begin CHARACTERISTIC CAL_DEM_FIM_DFC_TPC_TCoolantOvHiWarn_au8 "CAL_DEM_FIM_DFC_TPC_TCoolantOvHiWarn_au8" VAL_BLK 0x00000000 Scalar_UBYTE 0 FID_Verb 0 255 NUMBER 10 /end CHARACTERISTIC
/begin CHARACTERISTIC CAL_TjrthLv4ildh_f32 "CAL_TjrthLv4ildh_f32" VALUE 0x00000000 Scalar_FLOAT32_IEEE 0 BSW_A2L_Ident_Float -3.4E+38 3.4E+38 /end CHARACTERISTIC
/begin MEASUREMENT VAR_TpcTmp_tRiseIGBT_f32 "VAR_TpcTmp_tRiseIGBT_f32" FLOAT32_IEEE BSW_A2L_Ident_Float 1 100 -3.4E+38 3.4E+38 ECU_ADDRESS 0x00000000 /end MEASUREMENT
/begin MEASUREMENT VAR_Cspf_TrabDernTempCooL_u8 "VAR_Cspf_TrabDernTempCooL_u8" UBYTE BSW_A2L_Ident_Int 1 100 0 255 ECU_ADDRESS 0x00000000 /end MEASUREMENT
/begin CHARACTERISTIC CAL_RDC_nWofltDelay_u16 "CAL_RDC_nWofltDelay_u16" VALUE 0x00000000 Scalar_UWORD 0 BSW_A2L_Ident_Int 0 65535 /end CHARACTERISTIC
/begin CHARACTERISTIC CAL_Vcf_tSlopAddMax_u16 "CAL_Vcf_tSlopAddMax_u16" VALUE 0x00000000 Scalar_UWORD 0 BSW_A2L_Ident_Int 0 65535 /end CHARACTERISTIC
/begin CHARACTERISTIC CAL_DEM_Disbl_DFC_IOHWAB_3V3MCU_SampFail_u8 "CAL_DEM_Disbl_DFC_IOHWAB_3V3MCU_SampFail_u8" VALUE 0x00000000 Scalar_UBYTE 0 BSW_A2L_Ident_Int 0 255 /end CHARACTERISTIC
/begin MEASUREMENT VAR_L2_Sample_flag_b "VAR_L2_Sample_flag_b" UBYTE BSW_A2L_Ident_Int 1 100 0 1 ECU_ADDRESS 0x00000000 /end MEASUREMENT
/begin MEASUREMENT VAR_Igbt_Normal_State_u16 "VAR_Igbt_Normal_State_u16" UWORD BSW_A2L_Ident_Int 1 100 0 65535 ECU_ADDRESS 0x00000000 /end MEASUREMENT
/begin CHARACTERISTIC CAL_TRSP_RslvSqrtHiLim_u16 "CAL_TRSP_RslvSqrtHiLim_u16" VALUE 0x00000000 Scalar_UWORD 0 BSW_A2L_Ident_Int 0 65535 /end CHARACTERISTIC
/begin CHARACTERISTIC CAL_TpcMot_flgTrqRefSwt_b "CAL_TpcMot_flgTrqRefSwt_b" VALUE 0x00000000 Scalar_BOOLEAN 0 BSW_A2L_Ident_Int 0 1 /end CHARACTERISTIC
/begin CHARACTERISTIC CAL_DEM_Disbl_DFC_Event_NvM_ReadErr_u8 "CAL_DEM_Disbl_DFC_Event_NvM_ReadErr_u8" VALUE 0x00000000 Scalar_UBYTE 0 BSW_A2L_Ident_Int 0 255 /end CHARACTERISTIC
/begin CHARACTERISTIC CAL_TCF_flgUsePlossCompa_b "CAL_TCF_flgUsePlossCompa_b" VALUE 0x00000000 Scalar_BOOLEAN 0 BSW_A2L_Ident_Int 0 1 /end CHARACTERISTIC
/begin CHARACTERISTIC CAL_TRSP_ReqTrqLoLim_f32 "CAL_TRSP_ReqTrqLoLim_f32" VALUE 0x00000000 Scalar_FLOAT32_IEEE 0 BSW_A2L_Ident_Float -3.4E+38 3.4E+38 /end CHARACTERISTIC
/begin CHARACTERISTIC CAL_Cspf_stDmpCtLReq_u8 "CAL_Cspf_stDmpCtLReq_u8" VALUE 0x00000000 Scalar_UBYTE 0 BSW_A2L_Ident_Int 0 255 /end CHARACTERISTIC
/begin MEASUREMENT VAR_TpcTmp_tRiseDbcFlt_f32 "VAR_TpcTmp_tRiseDbcFlt_f32" FLOAT32_IEEE BSW_A2L_Ident_Float 1 100 -3.4E+38 3.4E+38 ECU_ADDRESS 0x00000000 /end MEASUREMENT
/begin CHARACTERISTIC CAL_DEM_Disbl_DFC_HvMcu_DisChrgFail_u8 "CAL_DEM_Disbl_DFC_HvMcu_DisChrgFail_u8" VALUE 0x00000000 Scalar_UBYTE 0 BSW_A2L_Ident_Int 0 255 /end CHARACTERISTIC
/begin CHARACTERISTIC CAL_DEM_FIM_DFC_RCF_FwlFwdOvTiErr_au8 "CAL_DEM_FIM_DFC_RCF_FwlFwdOvTiErr_au8" VAL_BLK 0x00000000 Scalar_UBYTE 0 FID_Verb 0 255 NUMBER 10 /end CHARACTERISTIC
/begin MEASUREMENT VAR_Cspf_TraOfsAL_f32 "VAR_Cspf_TraOfsAL_f32" FLOAT32_IEEE BSW_A2L_Ident_Float 1 100 -3.4E+38 3.4E+38 ECU_ADDRESS 0x00000000 /end MEASUREMENT
/begin CHARACTERISTIC CAL_DEM_Disbl_DFC_Can_Timeout_u8 "CAL_DEM_Disbl_DFC_Can_Timeout_u8" VALUE 0x00000000 Scalar_UBYTE 0 BSW_A2L_Ident_Int 0 255 /end CHARACTERISTIC
/begin MEASUREMENT VAR_MPC_TrqMon_f32 "VAR_MPC_TrqMon_f32" FLOAT32_IEEE BSW_A2L_Ident_Float 1 100 -3.4E+38 3.4E+38 ECU_ADDRESS 0x00000000 /end MEASUREMENT
/begin CHARACTERISTIC CAL_PcfStm_flgUseSLC_b "CAL_PcfStm_flgUseSLC_b" VALUE 0x00000000 Scalar_BOOLEAN 0 BSW_A2L_Ident_Int 0 1 /end CHARACTERISTIC
/begin CHARACTERISTIC CAL_RCF_flgUseClbSucNvm_b "CAL_RCF_flgUseClbSucNvm_b" VALUE 0x00000000 Scalar_BOOLEAN 0 BSW_A2L_Ident_Int 0 1 /end CHARACTERISTIC
/begin CHARACTERISTIC CAL_PcfSig_flgAimInPLimtSwt_b "CAL_PcfSig_flgAimInPLimtSwt_b" VALUE 0x00000000 Scalar_BOOLEAN 0 BSW_A2L_Ident_Int 0 1 /end CHARACTERISTIC
/begin CHARACTERISTIC CAL_TRSP_AgTimecompCtl_u8 "CAL_TRSP_AgTimecompCtl_u8" VALUE 0x00000000 Scalar_UBYTE 0 BSW_A2L_Ident_Int 0 255 /end CHARACTERISTIC
/begin CHARACTERISTIC CAL_PcfDia_SLInPLimt_f32 "CAL_PcfDia_SLInPLimt_f32" VALUE 0x00000000 Scalar_FLOAT32_IEEE 0 BSW_A2L_Ident_Float -3.4E+38 3.4E+38 /end CHARACTERISTIC
/begin MEASUREMENT VAR_CddEpark_Direction_b "VAR_CddEpark_Direction_b" UBYTE BSW_A2L_Ident_Int 1 100 0 1 ECU_ADDRESS 0x00000000 /end MEASUREMENT
/begin CHARACTERISTIC CAL_RCF_tMaxEstAlOfs1_u32 "CAL_RCF_tMaxEstAlOfs1_u32" VALUE 0x00000000 Scalar_ULONG 0 BSW_A2L_Ident_Int 0 4294967295 /end CHARACTERISTIC
/begin CHARACTERISTIC CAL_DEM_Disbl_DFC_HvMcu_UdcOverFlagLimit_u8 "CAL_DEM_Disbl_DFC_HvMcu_UdcOverFlagLimit_u8" VALUE 0x00000000 Scalar_UBYTE 0 BSW_A2L_Ident_Int 0 255 /end CHARACTERISTIC
/begin CHARACTERISTIC CAL_MCF_DownLimitPIMotHeat_f32 "CAL_MCF_DownLimitPIMotHeat_f32" VALUE 0x00000000 Scalar_FLOAT32_IEEE 0 BSW_A2L_Ident_Float -3.4E+38 3.4E+38 /end CHARACTERISTIC
/begin CHARACTERISTIC CAL_IOHWAB_AN29_IUVW_P_REF_MIN_f32 "CAL_IOHWAB_AN29_IUVW_P_REF_MIN_f32" VALUE 0x00000000 Scalar_FLOAT32_IEEE 0 BSW_A2L_Ident_Float -3.4E+38 3.4E+38 /end CHARACTERISTIC
/begin CHARACTERISTIC CAL_DEM_Disbl_DFC_TPC_TCoolantOvHiWarn_u8 "CAL_DEM_Disbl_DFC_TPC_TCoolantOvHiWarn_u8" VALUE 0x00000000 Scalar_UBYTE 0 BSW_A2L_Ident_Int 0 255 /end CHARACTERISTIC
/begin MEASUREMENT VAR_DEM_Event_TPC_TSttrOvHiWarn_Status_u8 "VAR_DEM_Event_TPC_TSttrOvHiWarn_Status_u8" UBYTE BSW_A2L_Ident_Int 1 100 0 255 ECU_ADDRESS 0x00000000 /end MEASUREMENT
/begin MEASUREMENT VAR_Cspf_TrabDernTrqMin_u8 "VAR_Cspf_TrabDernTrqMin_u8" UBYTE BSW_A2L_Ident_Int 1 100 0 255 ECU_ADDRESS 0x00000000 /end MEASUREMENT
/begin CHARACTERISTIC CAL_TpcTmp_IGBTTempAdds_f32 "CAL_TpcTmp_IGBTTempAdds_f32" VALUE 0x00000000 Scalar_FLOAT32_IEEE 0 BSW_A2L_Ident_Float -3.4E+38 3.4E+38 /end CHARACTERISTIC
/begin MEASUREMENT VAR_TpcMot_TsttrStableDiff_u16 "VAR_TpcMot_TsttrStableDiff_u16" UWORD BSW_A2L_Ident_Int 1 100 0 65535 ECU_ADDRESS 0x00000000 /end MEASUREMENT
/begin CHARACTERISTIC CAL_Scf_flgEmgDisChgReqSwt_b "CAL_Scf_flgEmgDisChgReqSwt_b" VALUE 0x00000000 Scalar_BOOLEAN 0 BSW_A2L_Ident_Int 0 1 /end CHARACTERISTIC
/begin CHARACTERISTIC CAL_DEM_FIM_DFC_PCF_UnexpPosErr_au8 "CAL_DEM_FIM_DFC_PCF_UnexpPosErr_au8" VAL_BLK 0x00000000 Scalar_UBYTE 0 FID_Verb 0 255 NUMBER 10 /end CHARACTERISTIC
/begin CHARACTERISTIC CAL_TpcSmp_FacElecOvrCurt_u8 "CAL_TpcSmp_FacElecOvrCurt_u8" VALUE 0x00000000 Scalar_UBYTE 0 BSW_A2L_Ident_Int 0 255 /end CHARACTERISTIC
/begin CHARACTERISTIC CAL_Hspf_tStrrTmp2FltFrq_f32 "CAL_Hspf_tStrrTmp2FltFrq_f32" VALUE 0x00000000 Scalar_FLOAT32_IEEE 0 BSW_A2L_Ident_Float -3.4E+38 3.4E+38 /end CHARACTERISTIC
/begin CHARACTERISTIC CAL_RCF_OffsetAngFiltCoef_f32 "CAL_RCF_OffsetAngFiltCoef_f32" VALUE 0x00000000 Scalar_FLOAT32_IEEE 0 BSW_A2L_Ident_Float -3.4E+38 3.4E+38 /end CHARACTERISTIC
/begin MEASUREMENT VAR_Cspf_TraiGBTTempW_f32 "VAR_Cspf_TraiGBTTempW_f32" FLOAT32_IEEE BSW_A2L_Ident_Float 1 100 -3.4E+38 3.4E+38 ECU_ADDRESS 0x00000000 /end MEASUREMENT
/begin CHARACTERISTIC CAL_MCF_cofFltN_f32 "CAL_MCF_cofFltN_f32" VALUE 0x00000000 Scalar_FLOAT32_IEEE 0 BSW_A2L_Ident_Float -3.4E+38 3.4E+38 /end CHARACTERISTIC
/begin MEASUREMENT VAR_Scf_flgTranIdleToStb_b "VAR_Scf_flgTranIdleToStb_b" UBYTE BSW_A2L_Ident_Int 1 100 0 1 ECU_ADDRESS 0x00000000 /end MEASUREMENT
/begin CHARACTERISTIC CAL_DEM_FIM_DFC_IOHWAB_SttrTemp1SampFail_au8 "CAL_DEM_FIM_DFC_IOHWAB_SttrTemp1SampFail_au8" VAL_BLK 0x00000000 Scalar_UBYTE 0 FID_Verb 0 255 NUMBER 10 /end CHARACTERISTIC
/begin CHARACTERISTIC CAL_MCF_SpdOnDeadCpn_f32 "CAL_MCF_SpdOnDeadCpn_f32" VALUE 0x00000000 Scalar_FLOAT32_IEEE 0 BSW_A2L_Ident_Float -3.4E+38 3.4E+38 /end CHARACTERISTIC
/begin MEASUREMENT VAR_PcfStm_flgPCInPtoRun_b "VAR_PcfStm_flgPCInPtoRun_b" UBYTE BSW_A2L_Ident_Int 1 100 0 1 ECU_ADDRESS 0x00000000 /end MEASUREMENT
/begin CHARACTERISTIC CAL_HardComp_f32 "CAL_HardComp_f32" VALUE 0x00000000 Scalar_FLOAT32_IEEE 0 BSW_A2L_Ident_Float -3.4E+38 3.4E+38 /end CHARACTERISTIC
/begin CHARACTERISTIC CAL_Vcf_StepSlopeFunSwt_b "CAL_Vcf_StepSlopeFunSwt_b" VALUE 0x00000000 Scalar_BOOLEAN 0 BSW_A2L_Ident_Int 0 1 /end CHARACTERISTIC
/begin MEASUREMENT VAR_CddEpark_Con_Duty_f32 "VAR_CddEpark_Con_Duty_f32" FLOAT32_IEEE BSW_A2L_Ident_Float 1 100 -3.4E+38 3.4E+38 ECU_ADDRESS 0x00000000 /end MEASUREMENT
/begin MEASUREMENT VAR_TRSP_CurrRngErr_b "VAR_TRSP_CurrRngErr_b" UBYTE BSW_A2L_Ident_Int 1 100 0 1 ECU_ADDRESS 0x00000000 /end MEASUREMENT
/begin CHARACTERISTIC CAL_TRSP_iPhaWOffset_f32 "CAL_TRSP_iPhaWOffset_f32" VALUE 0x00000000 Scalar_FLOAT32_IEEE 0 BSW_A2L_Ident_Float -3.4E+38 3.4E+38 /end CHARACTERISTIC
/begin CHARACTERISTIC CAL_PcfSig_IUBPcfFltCoe_f32 "CAL_PcfSig_IUBPcfFltCoe_f32" VALUE 0x00000000 Scalar_FLOAT32_IEEE 0 BSW_A2L_Ident_Float -3.4E+38 3.4E+38 /end CHARACTERISTIC
/begin MEASUREMENT VAR_MDF_OffSetSiteBObs_f32 "VAR_MDF_OffSetSiteBObs_f32" FLOAT32_IEEE BSW_A2L_Ident_Float 1 100 -3.4E+38 3.4E+38 ECU_ADDRESS 0x00000000 /end MEASUREMENT
/begin MEASUREMENT VAR_TpcTmp_CofDertDbc_f32 "VAR_TpcTmp_CofDertDbc_f32" FLOAT32_IEEE BSW_A2L_Ident_Float 1 100 -3.4E+38 3.4E+38 ECU_ADDRESS 0x00000000 /end MEASUREMENT
/begin MEASUREMENT VAR_DEM_Event_MDF_PhaseLossFaultErr_Status_u8 "VAR_DEM_Event_MDF_PhaseLossFaultErr_Status_u8" UBYTE BSW_A2L_Ident_Int 1 100 0 255 ECU_ADDRESS 0x00000000 /end MEASUREMENT
/begin MEASUREMENT VAR_DEM_Event_TPC_TSttrOvHiLimFail_Status_u8 "VAR_DEM_Event_TPC_TSttrOvHiLimFail_Status_u8" UBYTE BSW_A2L_Ident_Int 1 100 0 255 ECU_ADDRESS 0x00000000 /end MEASUREMENT
/begin CHARACTERISTIC CAL_Hspf_VerChkTime_u16 "CAL_Hspf_VerChkTime_u16" VALUE 0x00000000 Scalar_UWORD 0 BSW_A2L_Ident_Int 0 65535 /end CHARACTERISTIC
/begin MEASUREMENT VAR_SWD_AgRslvDelta0_f32 "VAR_SWD_AgRslvDelta0_f32" FLOAT32_IEEE BSW_A2L_Ident_Float 1 100 -3.4E+38 3.4E+38 ECU_ADDRESS 0x00000000 /end MEASUREMENT
/begin CHARACTERISTIC CAL_DEM_FIM_DFC_HSPF_VerMatchFailureErr_au8 "CAL_DEM_FIM_DFC_HSPF_VerMatchFailureErr_au8" VAL_BLK 0x00000000 Scalar_UBYTE 0 FID_Verb 0 255 NUMBER 10 /end CHARACTERISTIC
/begin MEASUREMENT VAR_TpcSmp_flgElecTrqLimOvrSpdActv_b "VAR_TpcSmp_flgElecTrqLimOvrSpdActv_b" UBYTE BSW_A2L_Ident_Int 1 100 0 1 ECU_ADDRESS 0x00000000 /end MEASUREMENT
/begin MEASUREMENT VAR_TpcSmp_ElecPwrLimUdrVolt_f32 "VAR_TpcSmp_ElecPwrLimUdrVolt_f32" FLOAT32_IEEE BSW_A2L_Ident_Float 1 100 -3.4E+38 3.4E+38 ECU_ADDRESS 0x00000000 /end MEASUREMENT
/begin CHARACTERISTIC CAL_Hspf_bt15ChkSubCnt_s8 "CAL_Hspf_bt15ChkSubCnt_s8" VALUE 0x00000000 Scalar_BYTE 0 BSW_A2L_Ident_Int -128 127 /end CHARACTERISTIC
/begin MEASUREMENT VAR_tpcsmp_RefPwrGenOvrCurt_f32 "VAR_tpcsmp_RefPwrGenOvrCurt_f32" FLOAT32_IEEE BSW_A2L_Ident_Float 1 100 -3.4E+38 3.4E+38 ECU_ADDRESS 0x00000000 /end MEASUREMENT
/begin CHARACTERISTIC CAL_DEM_Disbl_DFC_Cpld_Short_Circuit_LS_InFail_u8 "CAL_DEM_Disbl_DFC_Cpld_Short_Circuit_LS_InFail_u8" VALUE 0x00000000 Scalar_UBYTE 0 BSW_A2L_Ident_Int 0 255 /end CHARACTERISTIC
/begin MEASUREMENT VAR_TpcMot_CofDertTsttr_f32 "VAR_TpcMot_CofDertTsttr_f32" FLOAT32_IEEE BSW_A2L_Ident_Float 1 100 -3.4E+38 3.4E+38 ECU_ADDRESS 0x00000000 /end MEASUREMENT
/begin CHARACTERISTIC CAL_DEM_Disbl_DFC_IOHWAB_18VLwBrgSampFail_u8 "CAL_DEM_Disbl_DFC_IOHWAB_18VLwBrgSampFail_u8" VALUE 0x00000000 Scalar_UBYTE 0 BSW_A2L_Ident_Int 0 255 /end CHARACTERISTIC
/begin CHARACTERISTIC CAL_TpcFuv_CofTrqLimLv2_f32 "CAL_TpcFuv_CofTrqLimLv2_f32" VALUE 0x00000000 Scalar_FLOAT32_IEEE 0 BSW_A2L_Ident_Float -3.4E+38 3.4E+38 /end CHARACTERISTIC
/begin MEASUREMENT VAR_Bsw_tDBCTempU_u16 "VAR_Bsw_tDBCTempU_u16" UWORD BSW_A2L_Ident_Int 1 100 0 65535 ECU_ADDRESS 0x00000000 /end MEASUREMENT
/begin MEASUREMENT VAR_MDF_bPhaseFault_b "VAR_MDF_bPhaseFault_b" UBYTE BSW_A2L_Ident_Int 1 100 0 1 ECU_ADDRESS 0x00000000 /end MEASUREMENT
/begin CHARACTERISTIC CAL_Cspf_flgiDActSlowFltSwt_b "CAL_Cspf_flgiDActSlowFltSwt_b" VALUE 0x00000000 Scalar_BOOLEAN 0 BSW_A2L_Ident_Int 0 1 /end CHARACTERISTIC
/begin MEASUREMENT VAR_TpcTmp_CofDertTcoolant_f32 "VAR_TpcTmp_CofDertTcoolant_f32" FLOAT32_IEEE BSW_A2L_Ident_Float 1 100 -3.4E+38 3.4E+38 ECU_ADDRESS 0x00000000 /end MEASUREMENT
/begin CHARACTERISTIC CAL_TCF_TrqCalcMonCountTrh_s16 "CAL_TCF_TrqCalcMonCountTrh_s16" VALUE 0x00000000 Scalar_SWORD 0 BSW_A2L_Ident_Int -32768 32767 /end CHARACTERISTIC
/begin MEASUREMENT VAR_DEM_Event_MDF_DiashCirNoPsblErr_Status_u8 "VAR_DEM_Event_MDF_DiashCirNoPsblErr_Status_u8" UBYTE BSW_A2L_Ident_Int 1 100 0 255 ECU_ADDRESS 0x00000000 /end MEASUREMENT
/begin MEASUREMENT VAR_RCF_cTrqSlpOfsClb_f32 "VAR_RCF_cTrqSlpOfsClb_f32" FLOAT32_IEEE BSW_A2L_Ident_Float 1 100 -3.4E+38 3.4E+38 ECU_ADDRESS 0x00000000 /end MEASUREMENT
/begin MEASUREMENT VAR_TRSP_RslvCosPRngErr_b "VAR_TRSP_RslvCosPRngErr_b" UBYTE BSW_A2L_Ident_Int 1 100 0 1 ECU_ADDRESS 0x00000000 /end MEASUREMENT
/begin CHARACTERISTIC CAL_Cspf_flgstGateDrvSwt_b "CAL_Cspf_flgstGateDrvSwt_b" VALUE 0x00000000 Scalar_BOOLEAN 0 BSW_A2L_Ident_Int 0 1 /end CHARACTERISTIC
/begin CHARACTERISTIC CAL_DEM_Disbl_DFC_IgbtDrv_LwBrgFaultBFail_u8 "CAL_DEM_Disbl_DFC_IgbtDrv_LwBrgFaultBFail_u8" VALUE 0x00000000 Scalar_UBYTE 0 BSW_A2L_Ident_Int 0 255 /end CHARACTERISTIC
/begin MEASUREMENT VAR_DEM_Event_Cpld_Short_Circuit_LS_InFail_Status_u8 "VAR_DEM_Event_Cpld_Short_Circuit_LS_InFail_Status_u8" UBYTE BSW_A2L_Ident_Int 1 100 0 255 ECU_ADDRESS 0x00000000 /end MEASUREMENT
/begin MEASUREMENT VAR_DEM_Event_HvMcu_DisChrgFail_Status_u8 "VAR_DEM_Event_HvMcu_DisChrgFail_Status_u8" UBYTE BSW_A2L_Ident_Int 1 100 0 255 ECU_ADDRESS 0x00000000 /end MEASUREMENT
/begin MEASUREMENT VAR_Scf_flgShtDwnByMcu_b "VAR_Scf_flgShtDwnByMcu_b" UBYTE BSW_A2L_Ident_Int 1 100 0 1 ECU_ADDRESS 0x00000000 /end MEASUREMENT
/begin CHARACTERISTIC CAL_PcfCtl_intPIDdownlim_f32 "CAL_PcfCtl_intPIDdownlim_f32" VALUE 0x00000000 Scalar_FLOAT32_IEEE 0 BSW_A2L_Ident_Float -3.4E+38 3.4E+38 /end CHARACTERISTIC
/begin CHARACTERISTIC CAL_Cspf_flgstModeSwt_b "CAL_Cspf_flgstModeSwt_b" VALUE 0x00000000 Scalar_BOOLEAN 0 BSW_A2L_Ident_Int 0 1 /end CHARACTERISTIC
/begin CHARACTERISTIC CAL_TpcTmp_IGBRiseTTempAdds_f32 "CAL_TpcTmp_IGBRiseTTempAdds_f32" VALUE 0x00000000 Scalar_FLOAT32_IEEE 0 BSW_A2L_Ident_Float -3.4E+38 3.4E+38 /end CHARACTERISTIC
/begin MEASUREMENT VAR_TpcBlk_IsValid_f32 "VAR_TpcBlk_IsValid_f32" FLOAT32_IEEE BSW_A2L_Ident_Float 1 100 -3.4E+38 3.4E+38 ECU_ADDRESS 0x00000000 /end MEASUREMENT
/begin MEASUREMENT VAR_TpcSmp_ElecPwrPIDertOvrCurt_f32 "VAR_TpcSmp_ElecPwrPIDertOvrCurt_f32" FLOAT32_IEEE BSW_A2L_Ident_Float 1 100 -3.4E+38 3.4E+38 ECU_ADDRESS 0x00000000 /end MEASUREMENT
/begin CHARACTERISTIC CAL_TpcTmp_DBCRiseTempKp_f32 "CAL_TpcTmp_DBCRiseTempKp_f32" VALUE 0x00000000 Scalar_FLOAT32_IEEE 0 BSW_A2L_Ident_Float -3.4E+38 3.4E+38 /end CHARACTERISTIC
/begin MEASUREMENT VAR_RCF_flgstEstToFail_b "VAR_RCF_flgstEstToFail_b" UBYTE BSW_A2L_Ident_Int 1 100 0 1 ECU_ADDRESS 0x00000000 /end MEASUREMENT
/begin CHARACTERISTIC CAL_TCF_LoTrqDirStop_f32 "CAL_TCF_LoTrqDirStop_f32" VALUE 0x00000000 Scalar_FLOAT32_IEEE 0 BSW_A2L_Ident_Float -3.4E+38 3.4E+38 /end CHARACTERISTIC
/begin MEASUREMENT VAR_PcfDia_flgShtDwnReq_b "VAR_PcfDia_flgShtDwnReq_b" UBYTE BSW_A2L_Ident_Int 1 100 0 1 ECU_ADDRESS 0x00000000 /end MEASUREMENT
/begin CHARACTERISTIC CAL_POWER_UBSBC_Threhold_V1_f32 "CAL_POWER_UBSBC_Threhold_V1_f32" VALUE 0x00000000 Scalar_FLOAT32_IEEE 0 BSW_A2L_Ident_Float -3.4E+38 3.4E+38 /end CHARACTERISTIC
/begin MEASUREMENT VAR_RCF_OfsFlt4800Fwd_f32 "VAR_RCF_OfsFlt4800Fwd_f32" FLOAT32_IEEE BSW_A2L_Ident_Float 1 100 -3.4E+38 3.4E+38 ECU_ADDRESS 0x00000000 /end MEASUREMENT
/begin MEASUREMENT VAR_L2Sampling_LEM5V_MON_u16 "VAR_L2Sampling_LEM5V_MON_u16" UWORD BSW_A2L_Ident_Int 1 100 0 65535 ECU_ADDRESS 0x00000000 /end MEASUREMENT
/begin MEASUREMENT VAR_RCF_OfsFlt4800Bwd_f32 "VAR_RCF_OfsFlt4800Bwd_f32" FLOAT32_IEEE BSW_A2L_Ident_Float 1 100 -3.4E+38 3.4E+38 ECU_ADDRESS 0x00000000 /end MEASUREMENT
/begin CHARACTERISTIC CAL_FRP_UBRVoltRngErrOutCtl_b "CAL_FRP_UBRVoltRngErrOutCtl_b" VALUE 0x00000000 Scalar_BOOLEAN 0 BSW_A2L_Ident_Int 0 1 /end CHARACTERISTIC
/begin CHARACTERISTIC CAL_Cspf_flgKpLowNCtlSwt_b "CAL_Cspf_flgKpLowNCtlSwt_b" VALUE 0x00000000 Scalar_BOOLEAN 0 BSW_A2L_Ident_Int 0 1 /end CHARACTERISTIC
/begin CHARACTERISTIC CAL_Cspf_flgtStrrTemp2FltSwt_b "CAL_Cspf_flgtStrrTemp2FltSwt_b" VALUE 0x00000000 Scalar_BOOLEAN 0 BSW_A2L_Ident_Int 0 1 /end CHARACTERISTIC
/begin MEASUREMENT VAR_Vcf_nVehicleObsv_f32 "VAR_Vcf_nVehicleObsv_f32" FLOAT32_IEEE BSW_A2L_Ident_Float 1 100 -3.4E+38 3.4E+38 ECU_ADDRESS 0x00000000 /end MEASUREMENT
/begin CHARACTERISTIC CAL_TRSP_iPhasSensVoltLoLim_u16 "CAL_TRSP_iPhasSensVoltLoLim_u16" VALUE 0x00000000 Scalar_UWORD 0 BSW_A2L_Ident_Int 0 65535 /end CHARACTERISTIC
/begin MEASUREMENT VAR_VCoolantTj_f32 "VAR_VCoolantTj_f32" FLOAT32_IEEE BSW_A2L_Ident_Float 1 100 -3.4E+38 3.4E+38 ECU_ADDRESS 0x00000000 /end MEASUREMENT
/begin CHARACTERISTIC CAL_TDC_DeltaT_f32 "CAL_TDC_DeltaT_f32" VALUE 0x00000000 Scalar_FLOAT32_IEEE 0 BSW_A2L_Ident_Float -3.4E+38 3.4E+38 /end CHARACTERISTIC
/begin MEASUREMENT VAR_PcfStm_BCstDiag_u8 "VAR_PcfStm_BCstDiag_u8" UBYTE BSW_A2L_Ident_Int 1 100 0 255 ECU_ADDRESS 0x00000000 /end MEASUREMENT
/begin CHARACTERISTIC CAL_Cspf_CpldVer_u8 "CAL_Cspf_CpldVer_u8" VALUE 0x00000000 Scalar_UBYTE 0 BSW_A2L_Ident_Int 0 255 /end CHARACTERISTIC
/begin MEASUREMENT VAR_TpcMot_GenTrqLimTsttr_f32 "VAR_TpcMot_GenTrqLimTsttr_f32" FLOAT32_IEEE BSW_A2L_Ident_Float 1 100 -3.4E+38 3.4E+38 ECU_ADDRESS 0x00000000 /end MEASUREMENT
/begin CHARACTERISTIC CAL_MCF_iUCnvFac_f32 "CAL_MCF_iUCnvFac_f32" VALUE 0x00000000 Scalar_FLOAT32_IEEE 0 BSW_A2L_Ident_Float -3.4E+38 3.4E+38 /end CHARACTERISTIC
/begin MEASUREMENT VAR_PwmDutyCyclePhaseW_f32 "VAR_PwmDutyCyclePhaseW_f32" FLOAT32_IEEE BSW_A2L_Ident_Float 1 100 -3.4E+38 3.4E+38 ECU_ADDRESS 0x00000000 /end MEASUREMENT
/begin CHARACTERISTIC CAL_ADM_BMSVoltRngErrCntThr_s16 "CAL_ADM_BMSVoltRngErrCntThr_s16" VALUE 0x00000000 Scalar_SWORD 0 BSW_A2L_Ident_Int -32768 32767 /end CHARACTERISTIC
/begin CHARACTERISTIC CAL_TpcSmp_ElecUdrVoltKp_f32 "CAL_TpcSmp_ElecUdrVoltKp_f32" VALUE 0x00000000 Scalar_FLOAT32_IEEE 0 BSW_A2L_Ident_Float -3.4E+38 3.4E+38 /end CHARACTERISTIC
/begin CHARACTERISTIC CAL_PcfDia_SLOutPDown_f32 "CAL_PcfDia_SLOutPDown_f32" VALUE 0x00000000 Scalar_FLOAT32_IEEE 0 BSW_A2L_Ident_Float -3.4E+38 3.4E+38 /end CHARACTERISTIC
/begin MEASUREMENT VAR_TpcTmp_tIGBTTempFlt_f32 "VAR_TpcTmp_tIGBTTempFlt_f32" FLOAT32_IEEE BSW_A2L_Ident_Float 1 100 -3.4E+38 3.4E+38 ECU_ADDRESS 0x00000000 /end MEASUREMENT
/begin CHARACTERISTIC CAL_TpcMot_tSttrHiLim_f32 "CAL_TpcMot_tSttrHiLim_f32" VALUE 0x00000000 Scalar_FLOAT32_IEEE 0 BSW_A2L_Ident_Float -3.4E+38 3.4E+38 /end CHARACTERISTIC
/begin CHARACTERISTIC CAL_TpcFuv_CofPwrLimLv3_f32 "CAL_TpcFuv_CofPwrLimLv3_f32" VALUE 0x00000000 Scalar_FLOAT32_IEEE 0 BSW_A2L_Ident_Float -3.4E+38 3.4E+38 /end CHARACTERISTIC
/begin CHARACTERISTIC CAL_TpcTmp_IGBTTempKp_f32 "CAL_TpcTmp_IGBTTempKp_f32" VALUE 0x00000000 Scalar_FLOAT32_IEEE 0 BSW_A2L_Ident_Float -3.4E+38 3.4E+38 /end CHARACTERISTIC
/begin MEASUREMENT VAR_Scf_flgDchaVcuReq_b "VAR_Scf_flgDchaVcuReq_b" UBYTE BSW_A2L_Ident_Int 1 100 0 1 ECU_ADDRESS 0x00000000 /end MEASUREMENT
/begin CHARACTERISTIC CAL_Hspf_CrashChkAddCnt_u8 "CAL_Hspf_CrashChkAddCnt_u8" VALUE 0x00000000 Scalar_UBYTE 0 BSW_A2L_Ident_Int 0 255 /end CHARACTERISTIC
/begin CHARACTERISTIC CAL_Scf_cntVCUComErrLim_u16 "CAL_Scf_cntVCUComErrLim_u16" VALUE 0x00000000 Scalar_UWORD 0 BSW_A2L_Ident_Int 0 65535 /end CHARACTERISTIC
/begin CHARACTERISTIC CAL_DEM_FIM_DFC_FR_StorageErr_au8 "CAL_DEM_FIM_DFC_FR_StorageErr_au8" VAL_BLK 0x00000000 Scalar_UBYTE 0 FID_Verb 0 255 NUMBER 10 /end CHARACTERISTIC
/begin CHARACTERISTIC CAL_TRSP_TorqueCtlMode_u8 "CAL_TRSP_TorqueCtlMode_u8" VALUE 0x00000000 Scalar_UBYTE 0 BSW_A2L_Ident_Int 0 255 /end CHARACTERISTIC
/begin CHARACTERISTIC CAL_MPC_CofUdc_f32 "CAL_MPC_CofUdc_f32" VALUE 0x00000000 Scalar_FLOAT32_IEEE 0 BSW_A2L_Ident_Float -3.4E+38 3.4E+38 /end CHARACTERISTIC
/begin MEASUREMENT VAR_L2Com_ModeReq_u16 "VAR_L2Com_ModeReq_u16" UWORD BSW_A2L_Ident_Int 1 100 0 65535 ECU_ADDRESS 0x00000000 /end MEASUREMENT
/begin MEASUREMENT VAR_TRSP_RslvSinNRngChkRslt_b "VAR_TRSP_RslvSinNRngChkRslt_b" UBYTE BSW_A2L_Ident_Int 1 100 0 1 ECU_ADDRESS 0x00000000 /end MEASUREMENT
/begin MEASUREMENT VAR_Scf_cntSigFit_b "VAR_Scf_cntSigFit_b" UBYTE BSW_A2L_Ident_Int 1 100 0 1 ECU_ADDRESS 0x00000000 /end MEASUREMENT
/begin CHARACTERISTIC CAL_PcfStm_SLAccSpdUp_f32 "CAL_PcfStm_SLAccSpdUp_f32" VALUE 0x00000000 Scalar_FLOAT32_IEEE 0 BSW_A2L_Ident_Float -3.4E+38 3.4E+38 /end CHARACTERISTIC
/begin CHARACTERISTIC CAL_ADM_GlbDchgThrshVolt_f32 "CAL_ADM_GlbDchgThrshVolt_f32" VALUE 0x00000000 Scalar_FLOAT32_IEEE 0 BSW_A2L_Ident_Float -3.4E+38 3.4E+38 /end CHARACTERISTIC
/begin CHARACTERISTIC CAL_DEM_FIM_DFC_HvMcu_DisChrgFreqErr_au8 "CAL_DEM_FIM_DFC_HvMcu_DisChrgFreqErr_au8" VAL_BLK 0x00000000 Scalar_UBYTE 0 FID_Verb 0 255 NUMBER 10 /end CHARACTERISTIC
/begin CHARACTERISTIC CAL_MCF_bUseduDclnkSet_b "CAL_MCF_bUseduDclnkSet_b" VALUE 0x00000000 Scalar_BOOLEAN 0 BSW_A2L_Ident_Int 0 1 /end CHARACTERISTIC
/begin MEASUREMENT VAR_FS_ISR_10ms_Cntr_u32 "VAR_FS_ISR_10ms_Cntr_u32" ULONG BSW_A2L_Ident_Int 1 100 0 4294967295 ECU_ADDRESS 0x00000000 /end MEASUREMENT
/begin CHARACTERISTIC CAL_CddEparkTEST_ManualSwitch_b "CAL_CddEparkTEST_ManualSwitch_b" VALUE 0x00000000 Scalar_BOOLEAN 0 BSW_A2L_Ident_Int 0 1 /end CHARACTERISTIC
/begin CHARACTERISTIC CAL_Vcf_NormalTrqSlope_u8 "CAL_Vcf_NormalTrqSlope_u8" VALUE 0x00000000 Scalar_UBYTE 0 BSW_A2L_Ident_Int 0 255 /end CHARACTERISTIC
/begin MEASUREMENT VAR_PcfDia_flgSenOv_b "VAR_PcfDia_flgSenOv_b" UBYTE BSW_A2L_Ident_Int 1 100 0 1 ECU_ADDRESS 0x00000000 /end MEASUREMENT
/begin CHARACTERISTIC CAL_MCF_AgDiffCurrSec_f32 "CAL_MCF_AgDiffCurrSec_f32" VALUE 0x00000000 Scalar_FLOAT32_IEEE 0 BSW_A2L_Ident_Float -3.4E+38 3.4E+38 /end CHARACTERISTIC
/begin MEASUREMENT VAR_PcfStm_flgAutoP_b "VAR_PcfStm_flgAutoP_b" UBYTE BSW_A2L_Ident_Int 1 100 0 1 ECU_ADDRESS 0x00000000 /end MEASUREMENT
/begin CHARACTERISTIC CAL_TpcSmp_ElecOvrCurtKi_f32 "CAL_TpcSmp_ElecOvrCurtKi_f32" VALUE 0x00000000 Scalar_FLOAT32_IEEE 0 BSW_A2L_Ident_Float -3.4E+38 3.4E+38 /end CHARACTERISTIC
/begin CHARACTERISTIC CAL_Cspf_flgTrqMaxSwt_b "CAL_Cspf_flgTrqMaxSwt_b" VALUE 0x00000000 Scalar_BOOLEAN 0 BSW_A2L_Ident_Int 0 1 /end CHARACTERISTIC
/begin MEASUREMENT VAR_CDD_Rslv_CosMax_f32 "VAR_CDD_Rslv_CosMax_f32" FLOAT32_IEEE BSW_A2L_Ident_Float 1 100 -3.4E+38 3.4E+38 ECU_ADDRESS 0x00000000 /end MEASUREMENT
/begin CHARACTERISTIC CAL_DEM_FIM_DFC_HSPF_stIphaOffCalFail_au8 "CAL_DEM_FIM_DFC_HSPF_stIphaOffCalFail_au8" VAL_BLK 0x00000000 Scalar_UBYTE 0 FID_Verb 0 255 NUMBER 10 /end CHARACTERISTIC
/begin MEASUREMENT VAR_tpccod_flgMinDertTCoolant_b "VAR_tpccod_flgMinDertTCoolant_b" UBYTE BSW_A2L_Ident_Int 1 100 0 1 ECU_ADDRESS 0x00000000 /end MEASUREMENT
/begin MEASUREMENT VAR_TpcCod_PowerAdd_f32 "VAR_TpcCod_PowerAdd_f32" FLOAT32_IEEE BSW_A2L_Ident_Float 1 100 -3.4E+38 3.4E+38 ECU_ADDRESS 0x00000000 /end MEASUREMENT
/begin CHARACTERISTIC CAL_Cspf_flgTrqMinSwt_b "CAL_Cspf_flgTrqMinSwt_b" VALUE 0x00000000 Scalar_BOOLEAN 0 BSW_A2L_Ident_Int 0 1 /end CHARACTERISTIC
/begin MEASUREMENT VAR_L2Sampling_RslvCos_s32 "VAR_L2Sampling_RslvCos_s32" SLONG BSW_A2L_Ident_Int 1 100 -2147483648 2147483647 ECU_ADDRESS 0x00000000 /end MEASUREMENT
/begin CHARACTERISTIC CAL_Scf_uDisChgEnd_f32 "CAL_Scf_uDisChgEnd_f32" VALUE 0x00000000 Scalar_FLOAT32_IEEE 0 BSW_A2L_Ident_Float -3.4E+38 3.4E+38 /end CHARACTERISTIC
/begin CHARACTERISTIC CAL_MCF_UpLimitIMotHeat_f32 "CAL_MCF_UpLimitIMotHeat_f32" VALUE 0x00000000 Scalar_FLOAT32_IEEE 0 BSW_A2L_Ident_Float -3.4E+38 3.4E+38 /end CHARACTERISTIC
/begin CHARACTERISTIC CAL_DEM_Disbl_DFC_ADC_WPhaseBISTFail_u8 "CAL_DEM_Disbl_DFC_ADC_WPhaseBISTFail_u8" VALUE 0x00000000 Scalar_UBYTE 0 BSW_A2L_Ident_Int 0 255 /end CHARACTERISTIC
/begin CHARACTERISTIC CAL_DEM_FIM_DFC_Can_Timeout_au8 "CAL_DEM_FIM_DFC_Can_Timeout_au8" VAL_BLK 0x00000000 Scalar_UBYTE 0 FID_Verb 0 255 NUMBER 10 /end CHARACTERISTIC
/begin CHARACTERISTIC CAL_TpcTmp_tDbcTraNormalToSave1_f32 "CAL_TpcTmp_tDbcTraNormalToSave1_f32" VALUE 0x00000000 Scalar_FLOAT32_IEEE 0 BSW_A2L_Ident_Float -3.4E+38 3.4E+38 /end CHARACTERISTIC
/begin CHARACTERISTIC CAL_TjrthLv4dhntc_f32 "CAL_TjrthLv4dhntc_f32" VALUE 0x00000000 Scalar_FLOAT32_IEEE 0 BSW_A2L_Ident_Float -3.4E+38 3.4E+38 /end CHARACTERISTIC
/begin MEASUREMENT VAR_TpcTmp_GenTrqLimTdrvboard_f32 "VAR_TpcTmp_GenTrqLimTdrvboard_f32" FLOAT32_IEEE BSW_A2L_Ident_Float 1 100 -3.4E+38 3.4E+38 ECU_ADDRESS 0x00000000 /end MEASUREMENT
/begin CHARACTERISTIC CAL_Cspf_flguKl30FltSwt_b "CAL_Cspf_flguKl30FltSwt_b" VALUE 0x00000000 Scalar_BOOLEAN 0 BSW_A2L_Ident_Int 0 1 /end CHARACTERISTIC
/begin CHARACTERISTIC CAL_TjDycMax_f32 "CAL_TjDycMax_f32" VALUE 0x00000000 Scalar_FLOAT32_IEEE 0 BSW_A2L_Ident_Float -3.4E+38 3.4E+38 /end CHARACTERISTIC
/begin CHARACTERISTIC CAL_DEM_Disbl_DFC_SCF_LowPwrShtDwnOvTiFail_u8 "CAL_DEM_Disbl_DFC_SCF_LowPwrShtDwnOvTiFail_u8" VALUE 0x00000000 Scalar_UBYTE 0 BSW_A2L_Ident_Int 0 255 /end CHARACTERISTIC
/begin CHARACTERISTIC CAL_Cspf_flgtStrrTemp1FltSwt_b "CAL_Cspf_flgtStrrTemp1FltSwt_b" VALUE 0x00000000 Scalar_BOOLEAN 0 BSW_A2L_Ident_Int 0 1 /end CHARACTERISTIC
/begin MEASUREMENT VAR_RCF_AutoClbOffset_f32 "VAR_RCF_AutoClbOffset_f32" FLOAT32_IEEE BSW_A2L_Ident_Float 1 100 -3.4E+38 3.4E+38 ECU_ADDRESS 0x00000000 /end MEASUREMENT
/begin MEASUREMENT VAR_RollCntRx_MCU_430_u8 "VAR_RollCntRx_MCU_430_u8" UBYTE BSW_A2L_Ident_Int 1 100 0 255 ECU_ADDRESS 0x00000000 /end MEASUREMENT
/begin MEASUREMENT VAR_RCF_stOfsFrwhlFwd_u8 "VAR_RCF_stOfsFrwhlFwd_u8" UBYTE BSW_A2L_Ident_Int 1 100 0 255 ECU_ADDRESS 0x00000000 /end MEASUREMENT
/begin CHARACTERISTIC CAL_MCF_IsSet11ZR_f32 "CAL_MCF_IsSet11ZR_f32" VALUE 0x00000000 Scalar_FLOAT32_IEEE 0 BSW_A2L_Ident_Float -3.4E+38 3.4E+38 /end CHARACTERISTIC
/begin CHARACTERISTIC CAL_TRSP_RslvExciCountTrh_s16 "CAL_TRSP_RslvExciCountTrh_s16" VALUE 0x00000000 Scalar_SWORD 0 BSW_A2L_Ident_Int -32768 32767 /end CHARACTERISTIC
/begin MEASUREMENT VAR_MCF_PowerMotHeat_f32 "VAR_MCF_PowerMotHeat_f32" FLOAT32_IEEE BSW_A2L_Ident_Float 1 100 -3.4E+38 3.4E+38 ECU_ADDRESS 0x00000000 /end MEASUREMENT
/begin CHARACTERISTIC CAL_PcfCtl_SLRunDir_b "CAL_PcfCtl_SLRunDir_b" VALUE 0x00000000 Scalar_BOOLEAN 0 BSW_A2L_Ident_Int 0 1 /end CHARACTERISTIC
/begin CHARACTERISTIC CAL_Cspf_TrqMechFlt_f32 "CAL_Cspf_TrqMechFlt_f32" VALUE 0x00000000 Scalar_FLOAT32_IEEE 0 BSW_A2L_Ident_Float -3.4E+38 3.4E+38 /end CHARACTERISTIC
/begin MEASUREMENT VAR_TpcSmp_flgLinearDertOvrVoltGen_b "VAR_TpcSmp_flgLinearDertOvrVoltGen_b" UBYTE BSW_A2L_Ident_Int 1 100 0 1 ECU_ADDRESS 0x00000000 /end MEASUREMENT
/begin MEASUREMENT VAR_Scf_flgPostDrvReqWoDcha_b "VAR_Scf_flgPostDrvReqWoDcha_b" UBYTE BSW_A2L_Ident_Int 1 100 0 1 ECU_ADDRESS 0x00000000 /end MEASUREMENT
/begin CHARACTERISTIC CAL_DEM_Disbl_DFC_HSPF_InvOpenErr_u8 "CAL_DEM_Disbl_DFC_HSPF_InvOpenErr_u8" VALUE 0x00000000 Scalar_UBYTE 0 BSW_A2L_Ident_Int 0 255 /end CHARACTERISTIC
/begin MEASUREMENT VAR_DEM_Event_HvMcu_UdcCheckErr_Status_u8 "VAR_DEM_Event_HvMcu_UdcCheckErr_Status_u8" UBYTE BSW_A2L_Ident_Int 1 100 0 255 ECU_ADDRESS 0x00000000 /end MEASUREMENT
/begin MEASUREMENT VAR_Scf_flgTranSLInitToSLAcc_b "VAR_Scf_flgTranSLInitToSLAcc_b" UBYTE BSW_A2L_Ident_Int 1 100 0 1 ECU_ADDRESS 0x00000000 /end MEASUREMENT
/begin MEASUREMENT VAR_3phPWMUH_Period_f32 "VAR_3phPWMUH_Period_f32" FLOAT32_IEEE BSW_A2L_Ident_Float 1 100 -3.4E+38 3.4E+38 ECU_ADDRESS 0x00000000 /end MEASUREMENT
/begin CHARACTERISTIC CAL_Cspf_flgTrqDmpMinSwt_b "CAL_Cspf_flgTrqDmpMinSwt_b" VALUE 0x00000000 Scalar_BOOLEAN 0 BSW_A2L_Ident_Int 0 1 /end CHARACTERISTIC
/begin MEASUREMENT VAR_DEM_Event_IOHWAB_KL30SevOverVolFail_Status_u8 "VAR_DEM_Event_IOHWAB_KL30SevOverVolFail_Status_u8" UBYTE BSW_A2L_Ident_Int 1 100 0 255 ECU_ADDRESS 0x00000000 /end MEASUREMENT
/begin MEASUREMENT VAR_Hspf_flgSttr1NoErr_b "VAR_Hspf_flgSttr1NoErr_b" UBYTE BSW_A2L_Ident_Int 1 100 0 1 ECU_ADDRESS 0x00000000 /end MEASUREMENT
/begin CHARACTERISTIC CAL_PcfSig_AimInPLimt_f32 "CAL_PcfSig_AimInPLimt_f32" VALUE 0x00000000 Scalar_FLOAT32_IEEE 0 BSW_A2L_Ident_Float -3.4E+38 3.4E+38 /end CHARACTERISTIC
/begin MEASUREMENT VAR_Tpcblk_TrqMax_f32 "VAR_Tpcblk_TrqMax_f32" FLOAT32_IEEE BSW_A2L_Ident_Float 1 100 -3.4E+38 3.4E+38 ECU_ADDRESS 0x00000000 /end MEASUREMENT
/begin CHARACTERISTIC CAL_Scf_cntPostDrvDone_u16 "CAL_Scf_cntPostDrvDone_u16" VALUE 0x00000000 Scalar_UWORD 0 BSW_A2L_Ident_Int 0 65535 /end CHARACTERISTIC
/begin MEASUREMENT VAR_MCF_idDes_f32 "VAR_MCF_idDes_f32" FLOAT32_IEEE BSW_A2L_Ident_Float 1 100 -3.4E+38 3.4E+38 ECU_ADDRESS 0x00000000 /end MEASUREMENT
/begin CHARACTERISTIC CAL_Cspf_KpLowNCtl_f32 "CAL_Cspf_KpLowNCtl_f32" VALUE 0x00000000 Scalar_FLOAT32_IEEE 0 BSW_A2L_Ident_Float -3.4E+38 3.4E+38 /end CHARACTERISTIC
/begin CHARACTERISTIC CAL_STM_UxptSpdMonErrRst_b "CAL_STM_UxptSpdMonErrRst_b" VALUE 0x00000000 Scalar_BOOLEAN 0 BSW_A2L_Ident_Int 0 1 /end CHARACTERISTIC
/begin MEASUREMENT VAR_TpcSmp_ElecPwrLinearDertUdrVolt_f32 "VAR_TpcSmp_ElecPwrLinearDertUdrVolt_f32" FLOAT32_IEEE BSW_A2L_Ident_Float 1 100 -3.4E+38 3.4E+38 ECU_ADDRESS 0x00000000 /end MEASUREMENT
/begin MEASUREMENT VAR_TCF_CurrAgTrq1_f32 "VAR_TCF_CurrAgTrq1_f32" FLOAT32_IEEE BSW_A2L_Ident_Float 1 100 -3.4E+38 3.4E+38 ECU_ADDRESS 0x00000000 /end MEASUREMENT
/begin MEASUREMENT VAR_Bsw_INV_Open_b "VAR_Bsw_INV_Open_b" UBYTE BSW_A2L_Ident_Int 1 100 0 1 ECU_ADDRESS 0x00000000 /end MEASUREMENT
/begin CHARACTERISTIC CAL_Cspf_flgstModeReqSwt_b "CAL_Cspf_flgstModeReqSwt_b" VALUE 0x00000000 Scalar_BOOLEAN 0 BSW_A2L_Ident_Int 0 1 /end CHARACTERISTIC
/begin CHARACTERISTIC CAL_MCF_IsrmsDesEOL_f32 "CAL_MCF_IsrmsDesEOL_f32" VALUE 0x00000000 Scalar_FLOAT32_IEEE 0 BSW_A2L_Ident_Float -3.4E+38 3.4E+38 /end CHARACTERISTIC
/begin CHARACTERISTIC CAL_PcfSig_flgIUBSwt_b "CAL_PcfSig_flgIUBSwt_b" VALUE 0x00000000 Scalar_BOOLEAN 0 BSW_A2L_Ident_Int 0 1 /end CHARACTERISTIC
/begin CHARACTERISTIC CAL_MPC_nSetTrqMonMin_f32 "CAL_MPC_nSetTrqMonMin_f32" VALUE 0x00000000 Scalar_FLOAT32_IEEE 0 BSW_A2L_Ident_Float -3.4E+38 3.4E+38 /end CHARACTERISTIC
/begin MEASUREMENT VAR_L2Sampling_RslvSinN_VADC_u16 "VAR_L2Sampling_RslvSinN_VADC_u16" UWORD BSW_A2L_Ident_Int 1 100 0 65535 ECU_ADDRESS 0x00000000 /end MEASUREMENT
/begin CHARACTERISTIC CAL_ADM_BMSVoltRngErrRst_b "CAL_ADM_BMSVoltRngErrRst_b" VALUE 0x00000000 Scalar_BOOLEAN 0 BSW_A2L_Ident_Int 0 1 /end CHARACTERISTIC
/begin MEASUREMENT VAR_TpcSmp_cofDertOvrCurtGen_f32 "VAR_TpcSmp_cofDertOvrCurtGen_f32" FLOAT32_IEEE BSW_A2L_Ident_Float 1 100 -3.4E+38 3.4E+38 ECU_ADDRESS 0x00000000 /end MEASUREMENT
/begin CHARACTERISTIC CAL_Scf_nSafeLoSpdMinLim_f32 "CAL_Scf_nSafeLoSpdMinLim_f32" VALUE 0x00000000 Scalar_FLOAT32_IEEE 0 BSW_A2L_Ident_Float -3.4E+38 3.4E+38 /end CHARACTERISTIC
/begin MEASUREMENT VAR_Hspf_VerMatchFailureErr_u8 "VAR_Hspf_VerMatchFailureErr_u8" UBYTE BSW_A2L_Ident_Int 1 100 0 255 ECU_ADDRESS 0x00000000 /end MEASUREMENT
/begin CHARACTERISTIC CAL_Vcf_CrawltrqLo_f32 "CAL_Vcf_CrawltrqLo_f32" VALUE 0x00000000 Scalar_FLOAT32_IEEE 0 BSW_A2L_Ident_Float -3.4E+38 3.4E+38 /end CHARACTERISTIC
/begin CHARACTERISTIC CAL_PcfDia_flgRetry_b "CAL_PcfDia_flgRetry_b" VALUE 0x00000000 Scalar_BOOLEAN 0 BSW_A2L_Ident_Int 0 1 /end CHARACTERISTIC
/begin MEASUREMENT VAR_TpcCod_GenTrqCalcOvrVolt_f32 "VAR_TpcCod_GenTrqCalcOvrVolt_f32" FLOAT32_IEEE BSW_A2L_Ident_Float 1 100 -3.4E+38 3.4E+38 ECU_ADDRESS 0x00000000 /end MEASUREMENT
/begin CHARACTERISTIC CAL_MDF_UsFrwhlMax_f32 "CAL_MDF_UsFrwhlMax_f32" VALUE 0x00000000 Scalar_FLOAT32_IEEE 0 BSW_A2L_Ident_Float -3.4E+38 3.4E+38 /end CHARACTERISTIC
/begin CHARACTERISTIC CAL_ADM_BMSUpperThr_f32 "CAL_ADM_BMSUpperThr_f32" VALUE 0x00000000 Scalar_FLOAT32_IEEE 0 BSW_A2L_Ident_Float -3.4E+38 3.4E+38 /end CHARACTERISTIC
/begin CHARACTERISTIC CAL_Vcf_PosDmpMaxSpeed_f32 "CAL_Vcf_PosDmpMaxSpeed_f32" VALUE 0x00000000 Scalar_FLOAT32_IEEE 0 BSW_A2L_Ident_Float -3.4E+38 3.4E+38 /end CHARACTERISTIC
/begin MEASUREMENT VAR_Cspf_TraFailCode8_u8 "VAR_Cspf_TraFailCode8_u8" UBYTE BSW_A2L_Ident_Int 1 100 0 255 ECU_ADDRESS 0x00000000 /end MEASUREMENT
/begin CHARACTERISTIC CAL_Scf_SenChkSud_u8 "CAL_Scf_SenChkSud_u8" VALUE 0x00000000 Scalar_UBYTE 0 BSW_A2L_Ident_Int 0 255 /end CHARACTERISTIC
/begin MEASUREMENT VAR_MCF_uDDesEOL_f32 "VAR_MCF_uDDesEOL_f32" FLOAT32_IEEE BSW_A2L_Ident_Float 1 100 -3.4E+38 3.4E+38 ECU_ADDRESS 0x00000000 /end MEASUREMENT
/begin MEASUREMENT VAR_MDF_bAlOfsChk_b "VAR_MDF_bAlOfsChk_b" UBYTE BSW_A2L_Ident_Int 1 100 0 1 ECU_ADDRESS 0x00000000 /end MEASUREMENT
/begin CHARACTERISTIC CAL_Scf_flgCanNmSwt_b "CAL_Scf_flgCanNmSwt_b" VALUE 0x00000000 Scalar_BOOLEAN 0 BSW_A2L_Ident_Int 0 1 /end CHARACTERISTIC
/begin CHARACTERISTIC CAL_SnapshotRam_TriggerFault_u8 "CAL_SnapshotRam_TriggerFault_u8" VALUE 0x00000000 Scalar_UBYTE 0 BSW_A2L_Ident_Int 0 255 /end CHARACTERISTIC
/begin MEASUREMENT VAR_TpcTmp_CofDertTCoolantSave2_f32 "VAR_TpcTmp_CofDertTCoolantSave2_f32" FLOAT32_IEEE BSW_A2L_Ident_Float 1 100 -3.4E+38 3.4E+38 ECU_ADDRESS 0x00000000 /end MEASUREMENT
/begin MEASUREMENT VAR_DEM_Event_IOHWAB_SttrTemp1SampFail_Status_u8 "VAR_DEM_Event_IOHWAB_SttrTemp1SampFail_Status_u8" UBYTE BSW_A2L_Ident_Int 1 100 0 255 ECU_ADDRESS 0x00000000 /end MEASUREMENT
/begin MEASUREMENT VAR_TCF_TrqCalcErr_b "VAR_TCF_TrqCalcErr_b" UBYTE BSW_A2L_Ident_Int 1 100 0 1 ECU_ADDRESS 0x00000000 /end MEASUREMENT
/begin MEASUREMENT VAR_MCF_flgFw_b "VAR_MCF_flgFw_b" UBYTE BSW_A2L_Ident_Int 1 100 0 1 ECU_ADDRESS 0x00000000 /end MEASUREMENT
/begin MEASUREMENT VAR_DEM_Event_IOHWAB_IphaOCFail_Status_u8 "VAR_DEM_Event_IOHWAB_IphaOCFail_Status_u8" UBYTE BSW_A2L_Ident_Int 1 100 0 255 ECU_ADDRESS 0x00000000 /end MEASUREMENT
/begin MEASUREMENT VAR_L2Sampling_IsW_Mon_f32 "VAR_L2Sampling_IsW_Mon_f32" FLOAT32_IEEE BSW_A2L_Ident_Float 1 100 -3.4E+38 3.4E+38 ECU_ADDRESS 0x00000000 /end MEASUREMENT
/begin MEASUREMENT VAR_PcfSig_VehSpd_f32 "VAR_PcfSig_VehSpd_f32" FLOAT32_IEEE BSW_A2L_Ident_Float 1 100 -3.4E+38 3.4E+38 ECU_ADDRESS 0x00000000 /end MEASUREMENT
/begin CHARACTERISTIC CAL_RCF_nCalcSec5_f32 "CAL_RCF_nCalcSec5_f32" VALUE 0x00000000 Scalar_FLOAT32_IEEE 0 BSW_A2L_Ident_Float -3.4E+38 3.4E+38 /end CHARACTERISTIC
/begin MEASUREMENT VAR_PcfStm_stPark_u8 "VAR_PcfStm_stPark_u8" UBYTE BSW_A2L_Ident_Int 1 100 0 255 ECU_ADDRESS 0x00000000 /end MEASUREMENT
/begin CHARACTERISTIC CAL_DEM_Disbl_DFC_Epark_SampFail_u8 "CAL_DEM_Disbl_DFC_Epark_SampFail_u8" VALUE 0x00000000 Scalar_UBYTE 0 BSW_A2L_Ident_Int 0 255 /end CHARACTERISTIC
/begin CHARACTERISTIC CAL_Scf_cntDchaSigFit_u8 "CAL_Scf_cntDchaSigFit_u8" VALUE 0x00000000 Scalar_UBYTE 0 BSW_A2L_Ident_Int 0 255 /end CHARACTERISTIC
/begin MEASUREMENT VAR_TpcMot_TrqElecExC_f32 "VAR_TpcMot_TrqElecExC_f32" FLOAT32_IEEE BSW_A2L_Ident_Float 1 100 -3.4E+38 3.4E+38 ECU_ADDRESS 0x00000000 /end MEASUREMENT
/begin MEASUREMENT VAR_RESET_AllReason_u8 "VAR_RESET_AllReason_u8" UBYTE BSW_A2L_Ident_Int 1 100 0 255 ECU_ADDRESS 0x00000000 /end MEASUREMENT
/begin MEASUREMENT VAR_RCF_OfsFlt4200Bwd_f32 "VAR_RCF_OfsFlt4200Bwd_f32" FLOAT32_IEEE BSW_A2L_Ident_Float 1 100 -3.4E+38 3.4E+38 ECU_ADDRESS 0x00000000 /end MEASUREMENT
/begin CHARACTERISTIC CAL_TpcTmp_tIGBTTrqLimRamp_f32 "CAL_TpcTmp_tIGBTTrqLimRamp_f32" VALUE 0x00000000 Scalar_FLOAT32_IEEE 0 BSW_A2L_Ident_Float -3.4E+38 3.4E+38 /end CHARACTERISTIC
/begin MEASUREMENT VAR_TCF_Ploss_f32 "VAR_TCF_Ploss_f32" FLOAT32_IEEE BSW_A2L_Ident_Float 1 100 -3.4E+38 3.4E+38 ECU_ADDRESS 0x00000000 /end MEASUREMENT
/begin CHARACTERISTIC CAL_DEM_FIM_DFC_IOHWAB_5VQt1SampFail_au8 "CAL_DEM_FIM_DFC_IOHWAB_5VQt1SampFail_au8" VAL_BLK 0x00000000 Scalar_UBYTE 0 FID_Verb 0 255 NUMBER 10 /end CHARACTERISTIC
/begin MEASUREMENT VAR_LvPower_PowerUpFnh_u8 "VAR_LvPower_PowerUpFnh_u8" UBYTE BSW_A2L_Ident_Int 1 100 0 255 ECU_ADDRESS 0x00000000 /end MEASUREMENT
/begin MEASUREMENT VAR_DEM_Event_TPC_TDbcUHiLimFail_Status_u8 "VAR_DEM_Event_TPC_TDbcUHiLimFail_Status_u8" UBYTE BSW_A2L_Ident_Int 1 100 0 255 ECU_ADDRESS 0x00000000 /end MEASUREMENT
/begin CHARACTERISTIC CAL_Scf_udcPrechgFail_f32 "CAL_Scf_udcPrechgFail_f32" VALUE 0x00000000 Scalar_FLOAT32_IEEE 0 BSW_A2L_Ident_Float -3.4E+38 3.4E+38 /end CHARACTERISTIC
/begin MEASUREMENT VAR_Vcf_trqRmp_f32 "VAR_Vcf_trqRmp_f32" FLOAT32_IEEE BSW_A2L_Ident_Float 1 100 -3.4E+38 3.4E+38 ECU_ADDRESS 0x00000000 /end MEASUREMENT
/begin MEASUREMENT VAR_TpcSmp_ErrElecOvrCurt_f32 "VAR_TpcSmp_ErrElecOvrCurt_f32" FLOAT32_IEEE BSW_A2L_Ident_Float 1 100 -3.4E+38 3.4E+38 ECU_ADDRESS 0x00000000 /end MEASUREMENT
/begin MEASUREMENT VAR_PcfCtl_enMosPID_b "VAR_PcfCtl_enMosPID_b" UBYTE BSW_A2L_Ident_Int 1 100 0 1 ECU_ADDRESS 0x00000000 /end MEASUREMENT
/begin CHARACTERISTIC CAL_DEM_Disbl_DFC_RCF_AccOvTiErr_u8 "CAL_DEM_Disbl_DFC_RCF_AccOvTiErr_u8" VALUE 0x00000000 Scalar_UBYTE 0 BSW_A2L_Ident_Int 0 255 /end CHARACTERISTIC
/begin MEASUREMENT VAR_TpcTmp_tRiseDbcOperationMode_u8 "VAR_TpcTmp_tRiseDbcOperationMode_u8" UBYTE BSW_A2L_Ident_Int 1 100 0 255 ECU_ADDRESS 0x00000000 /end MEASUREMENT
/begin MEASUREMENT VAR_Scf_flgTranSLInitToSLFw_b "VAR_Scf_flgTranSLInitToSLFw_b" UBYTE BSW_A2L_Ident_Int 1 100 0 1 ECU_ADDRESS 0x00000000 /end MEASUREMENT
/begin MEASUREMENT VAR_Scf_flgTranDrvToFault_b "VAR_Scf_flgTranDrvToFault_b" UBYTE BSW_A2L_Ident_Int 1 100 0 1 ECU_ADDRESS 0x00000000 /end MEASUREMENT
/begin CHARACTERISTIC CAL_TpcCod_PosTrqDirStop_f32 "CAL_TpcCod_PosTrqDirStop_f32" VALUE 0x00000000 Scalar_FLOAT32_IEEE 0 BSW_A2L_Ident_Float -3.4E+38 3.4E+38 /end CHARACTERISTIC
/begin CHARACTERISTIC CAL_PcfDia_UdcMotUVSet_f32 "CAL_PcfDia_UdcMotUVSet_f32" VALUE 0x00000000 Scalar_FLOAT32_IEEE 0 BSW_A2L_Ident_Float -3.4E+38 3.4E+38 /end CHARACTERISTIC
/begin MEASUREMENT VAR_tpccod_flgMaxDertTIGBT_b "VAR_tpccod_flgMaxDertTIGBT_b" UBYTE BSW_A2L_Ident_Int 1 100 0 1 ECU_ADDRESS 0x00000000 /end MEASUREMENT
/begin CHARACTERISTIC CAL_TpcTmp_DBCRiseTempAdds_f32 "CAL_TpcTmp_DBCRiseTempAdds_f32" VALUE 0x00000000 Scalar_FLOAT32_IEEE 0 BSW_A2L_Ident_Float -3.4E+38 3.4E+38 /end CHARACTERISTIC
/begin MEASUREMENT VAR_TpcTmp_GenTrqLimTIGBTWoRamp_f32 "VAR_TpcTmp_GenTrqLimTIGBTWoRamp_f32" FLOAT32_IEEE BSW_A2L_Ident_Float 1 100 -3.4E+38 3.4E+38 ECU_ADDRESS 0x00000000 /end MEASUREMENT
/begin CHARACTERISTIC CAL_TRSP_iWCnvFac_f32 "CAL_TRSP_iWCnvFac_f32" VALUE 0x00000000 Scalar_FLOAT32_IEEE 0 BSW_A2L_Ident_Float -3.4E+38 3.4E+38 /end CHARACTERISTIC
/begin CHARACTERISTIC CAL_Cspf_flgIdcMaxSwt_b "CAL_Cspf_flgIdcMaxSwt_b" VALUE 0x00000000 Scalar_BOOLEAN 0 BSW_A2L_Ident_Int 0 1 /end CHARACTERISTIC
/begin CHARACTERISTIC CAL_MPC_Ld_f32 "CAL_MPC_Ld_f32" VALUE 0x00000000 Scalar_FLOAT32_IEEE 0 BSW_A2L_Ident_Float -3.4E+38 3.4E+38 /end CHARACTERISTIC
/begin MEASUREMENT VAR_UCoolantTj_f32 "VAR_UCoolantTj_f32" FLOAT32_IEEE BSW_A2L_Ident_Float 1 100 -3.4E+38 3.4E+38 ECU_ADDRESS 0x00000000 /end MEASUREMENT
/begin CHARACTERISTIC CAL_Vcf_ActiveCnt_u8 "CAL_Vcf_ActiveCnt_u8" VALUE 0x00000000 Scalar_UBYTE 0 BSW_A2L_Ident_Int 0 255 /end CHARACTERISTIC
/begin CHARACTERISTIC CAL_DEM_Disbl_DFC_PCF_IdcOvErr_u8 "CAL_DEM_Disbl_DFC_PCF_IdcOvErr_u8" VALUE 0x00000000 Scalar_UBYTE 0 BSW_A2L_Ident_Int 0 255 /end CHARACTERISTIC
/begin MEASUREMENT VAR_IoHwAb_Adc_Phy_KL30_f32 "VAR_IoHwAb_Adc_Phy_KL30_f32" FLOAT32_IEEE BSW_A2L_Ident_Float 1 100 -3.4E+38 3.4E+38 ECU_ADDRESS 0x00000000 /end MEASUREMENT
/begin MEASUREMENT VAR_Scf_flgTranLoPowSetToDia_b "VAR_Scf_flgTranLoPowSetToDia_b" UBYTE BSW_A2L_Ident_Int 1 100 0 1 ECU_ADDRESS 0x00000000 /end MEASUREMENT
/begin CHARACTERISTIC CAL_TpcBlk_flgEnBlkFun_b "CAL_TpcBlk_flgEnBlkFun_b" VALUE 0x00000000 Scalar_BOOLEAN 0 BSW_A2L_Ident_Int 0 1 /end CHARACTERISTIC
/begin CHARACTERISTIC CAL_Hspf_cntIPhCalOffValCnt_u16 "CAL_Hspf_cntIPhCalOffValCnt_u16" VALUE 0x00000000 Scalar_UWORD 0 BSW_A2L_Ident_Int 0 65535 /end CHARACTERISTIC
/begin CHARACTERISTIC CAL_TCF_HiSpdDirStop_f32 "CAL_TCF_HiSpdDirStop_f32" VALUE 0x00000000 Scalar_FLOAT32_IEEE 0 BSW_A2L_Ident_Float -3.4E+38 3.4E+38 /end CHARACTERISTIC
/begin CHARACTERISTIC CAL_Cspf_TrqMinNCtl_f32 "CAL_Cspf_TrqMinNCtl_f32" VALUE 0x00000000 Scalar_FLOAT32_IEEE 0 BSW_A2L_Ident_Float -3.4E+38 3.4E+38 /end CHARACTERISTIC
/begin CHARACTERISTIC CAL_Cspf_flgagRtrEeSwt_b "CAL_Cspf_flgagRtrEeSwt_b" VALUE 0x00000000 Scalar_BOOLEAN 0 BSW_A2L_Ident_Int 0 1 /end CHARACTERISTIC
/begin CHARACTERISTIC CAL_ADM_VoltAbsDiffThrPerc_f32 "CAL_ADM_VoltAbsDiffThrPerc_f32" VALUE 0x00000000 Scalar_FLOAT32_IEEE 0 BSW_A2L_Ident_Float -3.4E+38 3.4E+38 /end CHARACTERISTIC
/begin MEASUREMENT VAR_MCF_uBetaZero_f32 "VAR_MCF_uBetaZero_f32" FLOAT32_IEEE BSW_A2L_Ident_Float 1 100 -3.4E+38 3.4E+38 ECU_ADDRESS 0x00000000 /end MEASUREMENT
/begin MEASUREMENT VAR_IoHwAb_Adc_Phy_CPLD_1_8V_f32 "VAR_IoHwAb_Adc_Phy_CPLD_1_8V_f32" FLOAT32_IEEE BSW_A2L_Ident_Float 1 100 -3.4E+38 3.4E+38 ECU_ADDRESS 0x00000000 /end MEASUREMENT
/begin CHARACTERISTIC CAL_MCF_uqOverGain_f32 "CAL_MCF_uqOverGain_f32" VALUE 0x00000000 Scalar_FLOAT32_IEEE 0 BSW_A2L_Ident_Float -3.4E+38 3.4E+38 /end CHARACTERISTIC
/begin CHARACTERISTIC CAL_ADM_VoltCmpChkErrRst_b "CAL_ADM_VoltCmpChkErrRst_b" VALUE 0x00000000 Scalar_BOOLEAN 0 BSW_A2L_Ident_Int 0 1 /end CHARACTERISTIC
/begin CHARACTERISTIC CAL_RCF_tMaxFwlBwd_u16 "CAL_RCF_tMaxFwlBwd_u16" VALUE 0x00000000 Scalar_UWORD 0 BSW_A2L_Ident_Int 0 65535 /end CHARACTERISTIC
/begin CHARACTERISTIC CAL_DEM_FIM_DFC_PCF_StallWarn_au8 "CAL_DEM_FIM_DFC_PCF_StallWarn_au8" VAL_BLK 0x00000000 Scalar_UBYTE 0 FID_Verb 0 255 NUMBER 10 /end CHARACTERISTIC
/begin CHARACTERISTIC CAL_DEM_Disbl_DFC_MDF_PrfElDrvErr_u8 "CAL_DEM_Disbl_DFC_MDF_PrfElDrvErr_u8" VALUE 0x00000000 Scalar_UBYTE 0 BSW_A2L_Ident_Int 0 255 /end CHARACTERISTIC
/begin MEASUREMENT VAR_MCF_idAct_f32 "VAR_MCF_idAct_f32" FLOAT32_IEEE BSW_A2L_Ident_Float 1 100 -3.4E+38 3.4E+38 ECU_ADDRESS 0x00000000 /end MEASUREMENT
/begin CHARACTERISTIC CAL_MCF_flgUseUsOver_b "CAL_MCF_flgUseUsOver_b" VALUE 0x00000000 Scalar_BOOLEAN 0 BSW_A2L_Ident_Int 0 1 /end CHARACTERISTIC
/begin CHARACTERISTIC CAL_MCF_udki_f32 "CAL_MCF_udki_f32" VALUE 0x00000000 Scalar_FLOAT32_IEEE 0 BSW_A2L_Ident_Float -3.4E+38 3.4E+38 /end CHARACTERISTIC
/begin CHARACTERISTIC CAL_MPC_idActCutOffFrq_f32 "CAL_MPC_idActCutOffFrq_f32" VALUE 0x00000000 Scalar_FLOAT32_IEEE 0 BSW_A2L_Ident_Float -3.4E+38 3.4E+38 /end CHARACTERISTIC
/begin CHARACTERISTIC CAL_ADM_L2Com_BMSVolt_b "CAL_ADM_L2Com_BMSVolt_b" VALUE 0x00000000 Scalar_BOOLEAN 0 BSW_A2L_Ident_Int 0 1 /end CHARACTERISTIC
/begin MEASUREMENT VAR_TpcTmp_TIgbtRiseStableDiff_u16 "VAR_TpcTmp_TIgbtRiseStableDiff_u16" UWORD BSW_A2L_Ident_Int 1 100 0 65535 ECU_ADDRESS 0x00000000 /end MEASUREMENT
/begin MEASUREMENT VAR_Cpld_Normal_Work_u8 "VAR_Cpld_Normal_Work_u8" UBYTE BSW_A2L_Ident_Int 1 100 0 255 ECU_ADDRESS 0x00000000 /end MEASUREMENT
/begin MEASUREMENT VAR_TpcSmp_GenPwrPIDertOvrCurt_f32 "VAR_TpcSmp_GenPwrPIDertOvrCurt_f32" FLOAT32_IEEE BSW_A2L_Ident_Float 1 100 -3.4E+38 3.4E+38 ECU_ADDRESS 0x00000000 /end MEASUREMENT
/begin MEASUREMENT VAR_FS_ISR_1ms_Cntr_u32 "VAR_FS_ISR_1ms_Cntr_u32" ULONG BSW_A2L_Ident_Int 1 100 0 4294967295 ECU_ADDRESS 0x00000000 /end MEASUREMENT
/begin CHARACTERISTIC CAL_Vcf_ActiveCntAver_f32 "CAL_Vcf_ActiveCntAver_f32" VALUE 0x00000000 Scalar_FLOAT32_IEEE 0 BSW_A2L_Ident_Float -3.4E+38 3.4E+38 /end CHARACTERISTIC
/begin MEASUREMENT VAR_tpccod_flgMinDertTIGBT_b "VAR_tpccod_flgMinDertTIGBT_b" UBYTE BSW_A2L_Ident_Int 1 100 0 1 ECU_ADDRESS 0x00000000 /end MEASUREMENT
/begin CHARACTERISTIC CAL_DEM_FIM_DFC_ADC_VPhaseBISTFail_au8 "CAL_DEM_FIM_DFC_ADC_VPhaseBISTFail_au8" VAL_BLK 0x00000000 Scalar_UBYTE 0 FID_Verb 0 255 NUMBER 10 /end CHARACTERISTIC
/begin CHARACTERISTIC CAL_CoolantFlowReq_u8 "CAL_CoolantFlowReq_u8" VALUE 0x00000000 Scalar_UBYTE 0 BSW_A2L_Ident_Int 0 255 /end CHARACTERISTIC
/begin MEASUREMENT VAR_TpcTmp_TDbcUHiLimErrState_u8 "VAR_TpcTmp_TDbcUHiLimErrState_u8" UBYTE BSW_A2L_Ident_Int 1 100 0 255 ECU_ADDRESS 0x00000000 /end MEASUREMENT
/begin MEASUREMENT VAR_L2Sampling_RslvCosP_VADC_Max1_u16 "VAR_L2Sampling_RslvCosP_VADC_Max1_u16" UWORD BSW_A2L_Ident_Int 1 100 0 65535 ECU_ADDRESS 0x00000000 /end MEASUREMENT
/begin MEASUREMENT VAR_Scf_VCUComErr_b "VAR_Scf_VCUComErr_b" UBYTE BSW_A2L_Ident_Int 1 100 0 1 ECU_ADDRESS 0x00000000 /end MEASUREMENT
/begin MEASUREMENT VAR_DEM_Event_Epark_OverCurFail_Status_u8 "VAR_DEM_Event_Epark_OverCurFail_Status_u8" UBYTE BSW_A2L_Ident_Int 1 100 0 255 ECU_ADDRESS 0x00000000 /end MEASUREMENT
/begin CHARACTERISTIC CAL_PcfCtl_ManualDir_b "CAL_PcfCtl_ManualDir_b" VALUE 0x00000000 Scalar_BOOLEAN 0 BSW_A2L_Ident_Int 0 1 /end CHARACTERISTIC
/begin MEASUREMENT VAR_tpccod_flgMaxDertStrTemp_b "VAR_tpccod_flgMaxDertStrTemp_b" UBYTE BSW_A2L_Ident_Int 1 100 0 1 ECU_ADDRESS 0x00000000 /end MEASUREMENT
/begin CHARACTERISTIC CAL_TpcBlk_TrqIncRamp_f32 "CAL_TpcBlk_TrqIncRamp_f32" VALUE 0x00000000 Scalar_FLOAT32_IEEE 0 BSW_A2L_Ident_Float -3.4E+38 3.4E+38 /end CHARACTERISTIC
/begin MEASUREMENT VAR_TRSP_RslvExciRngErr_b "VAR_TRSP_RslvExciRngErr_b" UBYTE BSW_A2L_Ident_Int 1 100 0 1 ECU_ADDRESS 0x00000000 /end MEASUREMENT
/begin CHARACTERISTIC CAL_MCF_CoefFltZero_A_f32 "CAL_MCF_CoefFltZero_A_f32" VALUE 0x00000000 Scalar_FLOAT32_IEEE 0 BSW_A2L_Ident_Float -3.4E+38 3.4E+38 /end CHARACTERISTIC
/begin MEASUREMENT VAR_STM_UintndTrqErr_b "VAR_STM_UintndTrqErr_b" UBYTE BSW_A2L_Ident_Int 1 100 0 1 ECU_ADDRESS 0x00000000 /end MEASUREMENT
/begin MEASUREMENT VAR_TRSP_iW_f32 "VAR_TRSP_iW_f32" FLOAT32_IEEE BSW_A2L_Ident_Float 1 100 -3.4E+38 3.4E+38 ECU_ADDRESS 0x00000000 /end MEASUREMENT
/begin MEASUREMENT VAR_PcfCtl_PosKd_f32 "VAR_PcfCtl_PosKd_f32" FLOAT32_IEEE BSW_A2L_Ident_Float 1 100 -3.4E+38 3.4E+38 ECU_ADDRESS 0x00000000 /end MEASUREMENT
/begin CHARACTERISTIC CAL_PcfDia_tRetry_u16 "CAL_PcfDia_tRetry_u16" VALUE 0x00000000 Scalar_UWORD 0 BSW_A2L_Ident_Int 0 65535 /end CHARACTERISTIC
/begin MEASUREMENT VAR_Cspf_TrabDernTrqMax_u8 "VAR_Cspf_TrabDernTrqMax_u8" UBYTE BSW_A2L_Ident_Int 1 100 0 255 ECU_ADDRESS 0x00000000 /end MEASUREMENT
/begin MEASUREMENT VAR_Pwm_DeadTime_In_f32 "VAR_Pwm_DeadTime_In_f32" FLOAT32_IEEE BSW_A2L_Ident_Float 1 100 -3.4E+38 3.4E+38 ECU_ADDRESS 0x00000000 /end MEASUREMENT
/begin CHARACTERISTIC CAL_TRSP_UB_SBCCnvFac_f32 "CAL_TRSP_UB_SBCCnvFac_f32" VALUE 0x00000000 Scalar_FLOAT32_IEEE 0 BSW_A2L_Ident_Float -3.4E+38 3.4E+38 /end CHARACTERISTIC
/begin CHARACTERISTIC CAL_TpcSmp_FacElecUdrVolt_u8 "CAL_TpcSmp_FacElecUdrVolt_u8" VALUE 0x00000000 Scalar_UBYTE 0 BSW_A2L_Ident_Int 0 255 /end CHARACTERISTIC
/begin MEASUREMENT VAR_Cspf_TrastGateDrv_u8 "VAR_Cspf_TrastGateDrv_u8" UBYTE BSW_A2L_Ident_Int 1 100 0 255 ECU_ADDRESS 0x00000000 /end MEASUREMENT
/begin MEASUREMENT VAR_RCF_flgClbToInact_b "VAR_RCF_flgClbToInact_b" UBYTE BSW_A2L_Ident_Int 1 100 0 1 ECU_ADDRESS 0x00000000 /end MEASUREMENT
/begin MEASUREMENT VAR_tpccod_flgMinDertTempDBC_b "VAR_tpccod_flgMinDertTempDBC_b" UBYTE BSW_A2L_Ident_Int 1 100 0 1 ECU_ADDRESS 0x00000000 /end MEASUREMENT
/begin CHARACTERISTIC CAL_Scf_flgActvSubNSwt_b "CAL_Scf_flgActvSubNSwt_b" VALUE 0x00000000 Scalar_BOOLEAN 0 BSW_A2L_Ident_Int 0 1 /end CHARACTERISTIC
/begin CHARACTERISTIC CAL_TpcTmp_tDbcThrPhLoLim_f32 "CAL_TpcTmp_tDbcThrPhLoLim_f32" VALUE 0x00000000 Scalar_FLOAT32_IEEE 0 BSW_A2L_Ident_Float -3.4E+38 3.4E+38 /end CHARACTERISTIC
/begin MEASUREMENT VAR_Scf_flgTranDiagToSenCal_b "VAR_Scf_flgTranDiagToSenCal_b" UBYTE BSW_A2L_Ident_Int 1 100 0 1 ECU_ADDRESS 0x00000000 /end MEASUREMENT
/begin CHARACTERISTIC CAL_Hspf_tDBCCmpTime_u16 "CAL_Hspf_tDBCCmpTime_u16" VALUE 0x00000000 Scalar_UWORD 0 BSW_A2L_Ident_Int 0 65535 /end CHARACTERISTIC
/begin MEASUREMENT VAR_MCF_periodCalc_f32 "VAR_MCF_periodCalc_f32" FLOAT32_IEEE BSW_A2L_Ident_Float 1 100 -3.4E+38 3.4E+38 ECU_ADDRESS 0x00000000 /end MEASUREMENT
/begin CHARACTERISTIC CAL_MDF_pwrDcDiaMin_f32 "CAL_MDF_pwrDcDiaMin_f32" VALUE 0x00000000 Scalar_FLOAT32_IEEE 0 BSW_A2L_Ident_Float -3.4E+38 3.4E+38 /end CHARACTERISTIC
/begin CHARACTERISTIC CAL_RCF_nCalcSec6_f32 "CAL_RCF_nCalcSec6_f32" VALUE 0x00000000 Scalar_FLOAT32_IEEE 0 BSW_A2L_Ident_Float -3.4E+38 3.4E+38 /end CHARACTERISTIC
/begin MEASUREMENT VAR_TRSP_Diff_UBR_SBC_f32 "VAR_TRSP_Diff_UBR_SBC_f32" FLOAT32_IEEE BSW_A2L_Ident_Float 1 100 -3.4E+38 3.4E+38 ECU_ADDRESS 0x00000000 /end MEASUREMENT
/begin CHARACTERISTIC CAL_DEM_FIM_DFC_TPC_TSttrOvLoWarn_au8 "CAL_DEM_FIM_DFC_TPC_TSttrOvLoWarn_au8" VAL_BLK 0x00000000 Scalar_UBYTE 0 FID_Verb 0 255 NUMBER 10 /end CHARACTERISTIC
/begin CHARACTERISTIC CAL_Cspf_flgagOffsetSwt_b "CAL_Cspf_flgagOffsetSwt_b" VALUE 0x00000000 Scalar_BOOLEAN 0 BSW_A2L_Ident_Int 0 1 /end CHARACTERISTIC
/begin MEASUREMENT VAR_Bsw_Hwver_f32 "VAR_Bsw_Hwver_f32" FLOAT32_IEEE BSW_A2L_Ident_Float 1 100 -3.4E+38 3.4E+38 ECU_ADDRESS 0x00000000 /end MEASUREMENT
/begin MEASUREMENT VAR_PcfDia_flgAimInPRat_b "VAR_PcfDia_flgAimInPRat_b" UBYTE BSW_A2L_Ident_Int 1 100 0 1 ECU_ADDRESS 0x00000000 /end MEASUREMENT
/begin CHARACTERISTIC CAL_ADM_GlbDchgErrRst_b "CAL_ADM_GlbDchgErrRst_b" VALUE 0x00000000 Scalar_BOOLEAN 0 BSW_A2L_Ident_Int 0 1 /end CHARACTERISTIC
/begin CHARACTERISTIC CAL_TpcBlk_TrqBlkStab_f32 "CAL_TpcBlk_TrqBlkStab_f32" VALUE 0x00000000 Scalar_FLOAT32_IEEE 0 BSW_A2L_Ident_Float -3.4E+38 3.4E+38 /end CHARACTERISTIC
/begin CHARACTERISTIC CAL_Hspf_CrashChkCntLoLim_s8 "CAL_Hspf_CrashChkCntLoLim_s8" VALUE 0x00000000 Scalar_BYTE 0 BSW_A2L_Ident_Int -128 127 /end CHARACTERISTIC
/begin CHARACTERISTIC CAL_Tpcmot_TrqDiffGen_f32 "CAL_Tpcmot_TrqDiffGen_f32" VALUE 0x00000000 Scalar_FLOAT32_IEEE 0 BSW_A2L_Ident_Float -3.4E+38 3.4E+38 /end CHARACTERISTIC
/begin MEASUREMENT VAR_Hspf_bSwtTempSttr1_b "VAR_Hspf_bSwtTempSttr1_b" UBYTE BSW_A2L_Ident_Int 1 100 0 1 ECU_ADDRESS 0x00000000 /end MEASUREMENT
/begin MEASUREMENT VAR_PcfSig_IsentMosPcf_f32 "VAR_PcfSig_IsentMosPcf_f32" FLOAT32_IEEE BSW_A2L_Ident_Float 1 100 -3.4E+38 3.4E+38 ECU_ADDRESS 0x00000000 /end MEASUREMENT
/begin MEASUREMENT VAR_TpcSmp_flgLinearDertUdrVoltElec_b "VAR_TpcSmp_flgLinearDertUdrVoltElec_b" UBYTE BSW_A2L_Ident_Int 1 100 0 1 ECU_ADDRESS 0x00000000 /end MEASUREMENT
/begin MEASUREMENT VAR_DEM_Event_IgbtDrv_LwBrgFaultAFail_Status_u8 "VAR_DEM_Event_IgbtDrv_LwBrgFaultAFail_Status_u8" UBYTE BSW_A2L_Ident_Int 1 100 0 255 ECU_ADDRESS 0x00000000 /end MEASUREMENT
/begin CHARACTERISTIC CAL_MCF_flgMotHeat_b "CAL_MCF_flgMotHeat_b" VALUE 0x00000000 Scalar_BOOLEAN 0 BSW_A2L_Ident_Int 0 1 /end CHARACTERISTIC
/begin CHARACTERISTIC CAL_Cspf_flgbDernMtrSpdSwt_b "CAL_Cspf_flgbDernMtrSpdSwt_b" VALUE 0x00000000 Scalar_BOOLEAN 0 BSW_A2L_Ident_Int 0 1 /end CHARACTERISTIC
/begin CHARACTERISTIC CAL_TpcMot_tSttrTrqLimRamp_f32 "CAL_TpcMot_tSttrTrqLimRamp_f32" VALUE 0x00000000 Scalar_FLOAT32_IEEE 0 BSW_A2L_Ident_Float -3.4E+38 3.4E+38 /end CHARACTERISTIC
/begin MEASUREMENT VAR_TpcMot_CofDertTSttrSave1_f32 "VAR_TpcMot_CofDertTSttrSave1_f32" FLOAT32_IEEE BSW_A2L_Ident_Float 1 100 -3.4E+38 3.4E+38 ECU_ADDRESS 0x00000000 /end MEASUREMENT
/begin CHARACTERISTIC CAL_TjrthLv4ihdl_f32 "CAL_TjrthLv4ihdl_f32" VALUE 0x00000000 Scalar_FLOAT32_IEEE 0 BSW_A2L_Ident_Float -3.4E+38 3.4E+38 /end CHARACTERISTIC
/begin MEASUREMENT VAR_3phPWMVH_Period_f32 "VAR_3phPWMVH_Period_f32" FLOAT32_IEEE BSW_A2L_Ident_Float 1 100 -3.4E+38 3.4E+38 ECU_ADDRESS 0x00000000 /end MEASUREMENT
/begin CHARACTERISTIC CAL_Cspf_flgNDiffMaxSwt_b "CAL_Cspf_flgNDiffMaxSwt_b" VALUE 0x00000000 Scalar_BOOLEAN 0 BSW_A2L_Ident_Int 0 1 /end CHARACTERISTIC
/begin CHARACTERISTIC CAL_DEM_Disbl_DFC_PCF_StallRetryErr_u8 "CAL_DEM_Disbl_DFC_PCF_StallRetryErr_u8" VALUE 0x00000000 Scalar_UBYTE 0 BSW_A2L_Ident_Int 0 255 /end CHARACTERISTIC
/begin MEASUREMENT VAR_Scf_flgFimFaultLvFour_b "VAR_Scf_flgFimFaultLvFour_b" UBYTE BSW_A2L_Ident_Int 1 100 0 1 ECU_ADDRESS 0x00000000 /end MEASUREMENT
/begin CHARACTERISTIC CAL_TpcTmp_DbcChgTempUpDiff_f32 "CAL_TpcTmp_DbcChgTempUpDiff_f32" VALUE 0x00000000 Scalar_FLOAT32_IEEE 0 BSW_A2L_Ident_Float -3.4E+38 3.4E+38 /end CHARACTERISTIC
/begin CHARACTERISTIC CAL_PcfCtl_flgFnh_b "CAL_PcfCtl_flgFnh_b" VALUE 0x00000000 Scalar_BOOLEAN 0 BSW_A2L_Ident_Int 0 1 /end CHARACTERISTIC
/begin CHARACTERISTIC CAL_PcfDia_SLInPDown_f32 "CAL_PcfDia_SLInPDown_f32" VALUE 0x00000000 Scalar_FLOAT32_IEEE 0 BSW_A2L_Ident_Float -3.4E+38 3.4E+38 /end CHARACTERISTIC
/begin CHARACTERISTIC CAL_TRSP_3V3CPLDVoltLoLim_u16 "CAL_TRSP_3V3CPLDVoltLoLim_u16" VALUE 0x00000000 Scalar_UWORD 0 BSW_A2L_Ident_Int 0 65535 /end CHARACTERISTIC
/begin MEASUREMENT VAR_MCF_uAOm_f32 "VAR_MCF_uAOm_f32" FLOAT32_IEEE BSW_A2L_Ident_Float 1 100 -3.4E+38 3.4E+38 ECU_ADDRESS 0x00000000 /end MEASUREMENT
/begin CHARACTERISTIC CAL_TRSP_3V3CPLDVoltHiLim_u16 "CAL_TRSP_3V3CPLDVoltHiLim_u16" VALUE 0x00000000 Scalar_UWORD 0 BSW_A2L_Ident_Int 0 65535 /end CHARACTERISTIC
/begin MEASUREMENT VAR_SWD_AgRslv45_f32 "VAR_SWD_AgRslv45_f32" FLOAT32_IEEE BSW_A2L_Ident_Float 1 100 -3.4E+38 3.4E+38 ECU_ADDRESS 0x00000000 /end MEASUREMENT
/begin CHARACTERISTIC CAL_MCF_ratUp_f32 "CAL_MCF_ratUp_f32" VALUE 0x00000000 Scalar_FLOAT32_IEEE 0 BSW_A2L_Ident_Float -3.4E+38 3.4E+38 /end CHARACTERISTIC
/begin MEASUREMENT VAR_MCF_udDes_f32 "VAR_MCF_udDes_f32" FLOAT32_IEEE BSW_A2L_Ident_Float 1 100 -3.4E+38 3.4E+38 ECU_ADDRESS 0x00000000 /end MEASUREMENT
/begin CHARACTERISTIC CAL_MCF_AplhaRefZeroCtl_f32 "CAL_MCF_AplhaRefZeroCtl_f32" VALUE 0x00000000 Scalar_FLOAT32_IEEE 0 BSW_A2L_Ident_Float -3.4E+38 3.4E+38 /end CHARACTERISTIC
/begin CHARACTERISTIC CAL_TpcTmp_tIGBTTraSave1ToNormal_f32 "CAL_TpcTmp_tIGBTTraSave1ToNormal_f32" VALUE 0x00000000 Scalar_FLOAT32_IEEE 0 BSW_A2L_Ident_Float -3.4E+38 3.4E+38 /end CHARACTERISTIC
/begin CHARACTERISTIC CAL_TRSP_1V8CPLDVoltLoLim_u16 "CAL_TRSP_1V8CPLDVoltLoLim_u16" VALUE 0x00000000 Scalar_UWORD 0 BSW_A2L_Ident_Int 0 65535 /end CHARACTERISTIC
/begin CHARACTERISTIC CAL_DEM_Disbl_DFC_TPC_TIGBTOvHiLimErr_u8 "CAL_DEM_Disbl_DFC_TPC_TIGBTOvHiLimErr_u8" VALUE 0x00000000 Scalar_UBYTE 0 BSW_A2L_Ident_Int 0 255 /end CHARACTERISTIC
/begin MEASUREMENT VAR_TRSP_18VHSVoltRngChkRslt_b "VAR_TRSP_18VHSVoltRngChkRslt_b" UBYTE BSW_A2L_Ident_Int 1 100 0 1 ECU_ADDRESS 0x00000000 /end MEASUREMENT
/begin CHARACTERISTIC CAL_MCF_FlgUpdateDyc_b "CAL_MCF_FlgUpdateDyc_b" VALUE 0x00000000 Scalar_BOOLEAN 0 BSW_A2L_Ident_Int 0 1 /end CHARACTERISTIC
/begin MEASUREMENT VAR_Scf_flgFimVCUComErr_b "VAR_Scf_flgFimVCUComErr_b" UBYTE BSW_A2L_Ident_Int 1 100 0 1 ECU_ADDRESS 0x00000000 /end MEASUREMENT
/begin CHARACTERISTIC CAL_Hvmcu_DClink_Gain_f32 "CAL_Hvmcu_DClink_Gain_f32" VALUE 0x00000000 Scalar_FLOAT32_IEEE 0 BSW_A2L_Ident_Float -3.4E+38 3.4E+38 /end CHARACTERISTIC
/begin MEASUREMENT VAR_TpcTmp_tDbcRiseTempFlt_u16 "VAR_TpcTmp_tDbcRiseTempFlt_u16" UWORD BSW_A2L_Ident_Int 1 100 0 65535 ECU_ADDRESS 0x00000000 /end MEASUREMENT
/begin MEASUREMENT VAR_STM0_BSW_1ms_Task_Core0_u32 "VAR_STM0_BSW_1ms_Task_Core0_u32" ULONG BSW_A2L_Ident_Int 1 100 0 4294967295 ECU_ADDRESS 0x00000000 /end MEASUREMENT
/begin CHARACTERISTIC CAL_TjDycMin_f32 "CAL_TjDycMin_f32" VALUE 0x00000000 Scalar_FLOAT32_IEEE 0 BSW_A2L_Ident_Float -3.4E+38 3.4E+38 /end CHARACTERISTIC
/begin CHARACTERISTIC CAL_TRSP_CurrRngCountTrh_s16 "CAL_TRSP_CurrRngCountTrh_s16" VALUE 0x00000000 Scalar_SWORD 0 BSW_A2L_Ident_Int -32768 32767 /end CHARACTERISTIC
/begin CHARACTERISTIC CAL_Vcf_TrqFbkLMinNeg_f32 "CAL_Vcf_TrqFbkLMinNeg_f32" VALUE 0x00000000 Scalar_FLOAT32_IEEE 0 BSW_A2L_Ident_Float -3.4E+38 3.4E+38 /end CHARACTERISTIC
/begin CHARACTERISTIC CAL_DEM_Disbl_DFC_Cpld_Short_Circuit_HS_InFail_u8 "CAL_DEM_Disbl_DFC_Cpld_Short_Circuit_HS_InFail_u8" VALUE 0x00000000 Scalar_UBYTE 0 BSW_A2L_Ident_Int 0 255 /end CHARACTERISTIC
/begin MEASUREMENT VAR_MCF_FlgDeadCpn_b "VAR_MCF_FlgDeadCpn_b" UBYTE BSW_A2L_Ident_Int 1 100 0 1 ECU_ADDRESS 0x00000000 /end MEASUREMENT
/begin MEASUREMENT VAR_Hspf_tDBCCmpErrDelay_b "VAR_Hspf_tDBCCmpErrDelay_b" UBYTE BSW_A2L_Ident_Int 1 100 0 1 ECU_ADDRESS 0x00000000 /end MEASUREMENT
/begin COMPU_METHOD RTE_A2L_Ident_Int "Q = V" RAT_FUNC "%8.0" "" COEFFS 0 1 0 0 0 1 /end COMPU_METHOD
/begin COMPU_METHOD BSW_A2L_Ident_Float "Q = V" RAT_FUNC "%8.6" "" COEFFS 0 1 0 0 0 1 /end COMPU_METHOD
/begin COMPU_METHOD BSW_A2L_Ident_Int "Q = V" RAT_FUNC "%8.0" "" COEFFS 0 1 0 0 0 1 /end COMPU_METHOD
/begin COMPU_METHOD FID_Verb "" TAB_VERB " % 2.1" " - " COMPU_TAB_REF FID_LIST /end COMPU_METHOD
/begin COMPU_VTAB FID_LIST "" TAB_VERB 162 1 "FIM_ADC_UPhaseBISTFail" 2 "FIM_ADC_VPhaseBISTFail" 3 "FIM_ADC_WPhaseBISTFail" 4 "FIM_CANSM_E_BUS_OFF_NETWORK_0" 5 "FIM_Can_Timeout" 6 "FIM_CpldErr" 7 "FIM_Cpld_AliveChkErr" 8 "FIM_Cpld_DI_ExdClk_InFail" 9 "FIM_Cpld_ExdClkInFail" 10 "FIM_Cpld_IphaOC" 11 "FIM_Cpld_NEN_InFail" 12 "FIM_Cpld_ParityChkErr" 13 "FIM_Cpld_SPIComFail" 14 "FIM_Cpld_SZTKT_InFail" 15 "FIM_Cpld_Short_Circuit_HS_InFail" 16 "FIM_Cpld_Short_Circuit_LS_InFail" 17 "FIM_Cpld_UdcOverVolFail" 18 "FIM_Cpld_UnderVol_HS_InFail" 19 "FIM_Cpld_UnderVol_LS_InFail" 20 "FIM_Epark_OverCurFail" 21 "FIM_Epark_PosMonSampFail" 22 "FIM_Epark_PosSampFail" 23 "FIM_Epark_SampFail" 24 "FIM_Event_NvM_ReadErr" 25 "FIM_Event_NvM_WriteErr" 26 "FIM_FRStoErr" 27 "FIM_FR_StorageErr" 28 "FIM_HSPF_InvOpenErr" 29 "FIM_HSPF_MotorOpenErr" 30 "FIM_HSPF_VerMatchFailureErr" 31 "FIM_HSPF_stIphaOffCalFail" 32 "FIM_HSPF_tDBCTempCmpErr" 33 "FIM_HvMcu_ComErr" 34 "FIM_HvMcu_DisChrgDutyErr" 35 "FIM_HvMcu_DisChrgFail" 36 "FIM_HvMcu_DisChrgFreqErr" 37 "FIM_HvMcu_EmerPowerSapErr" 38 "FIM_HvMcu_UartCheckFailErr" 39 "FIM_HvMcu_UartLostFrameErr" 40 "FIM_HvMcu_UdcCheckErr" 41 "FIM_HvMcu_UdcOverVolErr" 42 "FIM_HvmcuErr" 43 "FIM_IGBTOvTempErr" 44 "FIM_IGBTOvTempWarn" 45 "FIM_IOHWAB_12VNarrSampErr" 46 "FIM_IOHWAB_12VSampErr" 47 "FIM_IOHWAB_12VWideSampErr" 48 "FIM_IOHWAB_18VLwBrgSampFail" 49 "FIM_IOHWAB_18VUpBrgSampFail" 50 "FIM_IOHWAB_1V3MCU_SampFail" 51 "FIM_IOHWAB_3V3MCU_SampFail" 52 "FIM_IOHWAB_5VQcoSampFail" 53 "FIM_IOHWAB_5VQt1SampFail" 54 "FIM_IOHWAB_5VQt2SampFail" 55 "FIM_IOHWAB_Cpld1v8SampFail" 56 "FIM_IOHWAB_Cpld3v3SampFail" 57 "FIM_IOHWAB_CrashFail" 58 "FIM_IOHWAB_DcLnkOverVolFail" 59 "FIM_IOHWAB_IphaOCFail" 60 "FIM_IOHWAB_KL30OverVolErr" 61 "FIM_IOHWAB_KL30SevOverVolFail" 62 "FIM_IOHWAB_KL30SevUnderVolFail" 63 "FIM_IOHWAB_KL30UnderVolErr" 64 "FIM_IOHWAB_Nen33Fail" 65 "FIM_IOHWAB_SttrSenorShrFail" 66 "FIM_IOHWAB_SttrTemp1SampFail" 67 "FIM_IOHWAB_SttrTemp2SampFail" 68 "FIM_IOHWAB_TCoolantSampFail" 69 "FIM_IOHWAB_VDD5_D_SampFail" 70 "FIM_IgbtDrvErr" 71 "FIM_IgbtDrv_ComErr" 72 "FIM_IgbtDrv_LwBrgFaultAFail" 73 "FIM_IgbtDrv_LwBrgFaultBFail" 74 "FIM_IgbtDrv_UpBrgFaultAFail" 75 "FIM_IgbtDrv_UpBrgFaultBFail" 76 "FIM_IohwabSampErr" 77 "FIM_Lamp" 78 "FIM_LowPowerOvVErr" 79 "FIM_LowPowerUnVErr" 80 "FIM_MDF_AlOfsNoPlausErr" 81 "FIM_MDF_DiashCirNoPsblErr" 82 "FIM_MDF_EmacBlkdErr" 83 "FIM_MDF_EmacBlkdWarn" 84 "FIM_MDF_ICtlRatErr" 85 "FIM_MDF_IsOvHiErr" 86 "FIM_MDF_OpenCirNoPsblErr" 87 "FIM_MDF_OperOutdRngErr" 88 "FIM_MDF_PhaseLossFaultErr" 89 "FIM_MDF_PrfElDrvErr" 90 "FIM_MtrOvTempErr" 91 "FIM_MtrOvTempWarn" 92 "FIM_PCF_ActOvTiErr" 93 "FIM_PCF_IdcOvErr" 94 "FIM_PCF_SelfcheckErr" 95 "FIM_PCF_SenClbErr" 96 "FIM_PCF_SenOvErr" 97 "FIM_PCF_StallRetryErr" 98 "FIM_PCF_StallWarn" 99 "FIM_PCF_UnexpPosErr" 100 "FIM_PwrLimLvFour" 101 "FIM_PwrLimLvOne" 102 "FIM_PwrLimLvThree" 103 "FIM_PwrLimLvTwo" 104 "FIM_RCF_AccOvTiErr" 105 "FIM_RCF_EstOfsErr" 106 "FIM_RCF_FwlBwdOvTiErr" 107 "FIM_RCF_FwlFwdOvTiErr" 108 "FIM_RCF_OfsClbFail" 109 "FIM_RCF_PsiOvErr" 110 "FIM_RSL_DOSErr" 111 "FIM_RSL_ExcErr" 112 "FIM_RSL_LOSErr" 113 "FIM_RSL_LOTErr" 114 "FIM_ReqFailrMod" 115 "FIM_RslvOpen" 116 "FIM_SCF_DisChgOvTiFail" 117 "FIM_SCF_LowPwrShtDwnOvTiFail" 118 "FIM_SCF_RunToDischarErr" 119 "FIM_SpdOvHiErr" 120 "FIM_SpdOvHiWarn" 121 "FIM_Sttr1Err" 122 "FIM_Sttr2Err" 123 "FIM_TPC_SpdOvHiLimFail" 124 "FIM_TPC_SpdOvHiWarn" 125 "FIM_TPC_TCoolantOvHiWarn" 126 "FIM_TPC_TDbcOvHiWarn" 127 "FIM_TPC_TDbcOvLoWarn" 128 "FIM_TPC_TDbcUHiLimFail" 129 "FIM_TPC_TDbcULoLimFail" 130 "FIM_TPC_TDbcVHiLimFail" 131 "FIM_TPC_TDbcVLoLimFail" 132 "FIM_TPC_TDbcWHiLimFail" 133 "FIM_TPC_TDbcWLoLimFail" 134 "FIM_TPC_TDrvBoardOvHiWarn" 135 "FIM_TPC_TIGBTOvHiLimErr" 136 "FIM_TPC_TIGBTOvHiWarn" 137 "FIM_TPC_TIGBTOvLoWarn" 138 "FIM_TPC_TSttrOvHiLimFail" 139 "FIM_TPC_TSttrOvHiWarn" 140 "FIM_TPC_TSttrOvLoWarn" 141 "FIM_TPC_iDcLnkOvCLimFail" 142 "FIM_TPC_iDcLnkOvcWarn" 143 "FIM_TPC_uDcLnkOvVLimFail" 144 "FIM_TPC_uDcLnkOvWarn" 145 "FIM_TPC_uDcLnkUnVLimFail" 146 "FIM_TPC_uDcLnkUnvWarn" 147 "FIM_TrqLimLvFour" 148 "FIM_TrqLimLvOne" 149 "FIM_TrqLimLvThree" 150 "FIM_TrqLimLvTwo" 151 "FIM_Unused" 152 "FIM_VCUComTimeOut" 153 "FIM_flgDchaFailr" 154 "FIM_flgFaultLvFive" 155 "FIM_flgFaultLvFour" 156 "FIM_iDcLnkOvcErr" 157 "FIM_iDcLnkOvcWarn" 158 "FIM_uDcLnkOvErr" 159 "FIM_uDcLnkOvWarn" 160 "FIM_uDcLnkUnvErr" 161 "FIM_uDcLnkUnvWarn" 162 "FiM_FlagforFR" DEFAULT_VALUE "---" /end COMPU_VTAB
/end MODULE
/end PROJECT
