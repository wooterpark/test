/******************************************************************************
* ASAP2 file: SWC_CSPF.a2l
* Code generation for model "SWC_CSPF".
* Model version : 1.8
* Simulink Coder version : 9.3 (R2020a) 18-Nov-2019
* C source code generated on : Wed Nov 11 13:42:07 2020
* Target selection: autosar.tlc
* Embedded hardware selection: Intel->x86-64 (Windows64)
* Code generation objectives: Unspecified
* Validation result: Not run
* (add additional file header information here)
******************************************************************************/ ASAP2_VERSION 1 31
/* Version 1.31 */
/begin PROJECT ProjectName "Project Comment Goes Here"
/begin HEADER "Header Comments go here" /end HEADER
/begin MODULE ModuleName "Module Comment Goes Here"
/begin MOD_PAR "MOD PAR Comment Goes Here" /end MOD_PAR
/begin MOD_COMMON "Mod Common Comment Here" BYTE_ORDER MSB_LAST /end MOD_COMMON
/begin RECORD_LAYOUT Scalar_BOOLEAN FNC_VALUES 1 UBYTE COLUMN_DIR DIRECT /end RECORD_LAYOUT
/begin RECORD_LAYOUT Scalar_UBYTE FNC_VALUES 1 UBYTE COLUMN_DIR DIRECT /end RECORD_LAYOUT
/begin RECORD_LAYOUT Scalar_BYTE FNC_VALUES 1 SBYTE COLUMN_DIR DIRECT /end RECORD_LAYOUT
/begin RECORD_LAYOUT Scalar_UWORD FNC_VALUES 1 UWORD COLUMN_DIR DIRECT /end RECORD_LAYOUT
/begin RECORD_LAYOUT Scalar_SWORD FNC_VALUES 1 SWORD COLUMN_DIR DIRECT /end RECORD_LAYOUT
/begin RECORD_LAYOUT Scalar_ULONG FNC_VALUES 1 ULONG COLUMN_DIR DIRECT /end RECORD_LAYOUT
/begin RECORD_LAYOUT Scalar_LONG FNC_VALUES 1 SLONG COLUMN_DIR DIRECT /end RECORD_LAYOUT
/begin RECORD_LAYOUT Scalar_FLOAT32_IEEE FNC_VALUES 1 FLOAT32_IEEE COLUMN_DIR DIRECT /end RECORD_LAYOUT
/begin RECORD_LAYOUT Scalar_FLOAT64_IEEE FNC_VALUES 1 FLOAT64_IEEE COLUMN_DIR DIRECT /end RECORD_LAYOUT
/begin RECORD_LAYOUT Lookup1D_BOOLEAN FNC_VALUES 1 UBYTE COLUMN_DIR DIRECT /end RECORD_LAYOUT
/begin RECORD_LAYOUT Lookup1D_X_BOOLEAN AXIS_PTS_X 1 UBYTE INDEX_INCR DIRECT /end RECORD_LAYOUT
/begin RECORD_LAYOUT Lookup1D_BYTE FNC_VALUES 1 SBYTE COLUMN_DIR DIRECT /end RECORD_LAYOUT
/begin RECORD_LAYOUT Lookup1D_X_BYTE AXIS_PTS_X 1 SBYTE INDEX_INCR DIRECT /end RECORD_LAYOUT
/begin RECORD_LAYOUT Lookup1D_UBYTE FNC_VALUES 1 UBYTE COLUMN_DIR DIRECT /end RECORD_LAYOUT
/begin RECORD_LAYOUT Lookup1D_X_UBYTE AXIS_PTS_X 1 UBYTE INDEX_INCR DIRECT /end RECORD_LAYOUT
/begin RECORD_LAYOUT Lookup1D_UWORD FNC_VALUES 1 UWORD COLUMN_DIR DIRECT /end RECORD_LAYOUT
/begin RECORD_LAYOUT Lookup1D_X_UWORD AXIS_PTS_X 1 UWORD INDEX_INCR DIRECT /end RECORD_LAYOUT
/begin RECORD_LAYOUT Lookup1D_WORD FNC_VALUES 1 SWORD COLUMN_DIR DIRECT /end RECORD_LAYOUT
/begin RECORD_LAYOUT Lookup1D_X_WORD AXIS_PTS_X 1 SWORD INDEX_INCR DIRECT /end RECORD_LAYOUT
/begin RECORD_LAYOUT Lookup1D_ULONG FNC_VALUES 1 ULONG COLUMN_DIR DIRECT /end RECORD_LAYOUT
/begin RECORD_LAYOUT Lookup1D_X_ULONG AXIS_PTS_X 1 ULONG INDEX_INCR DIRECT /end RECORD_LAYOUT
/begin RECORD_LAYOUT Lookup1D_SLONG FNC_VALUES 1 SLONG COLUMN_DIR DIRECT /end RECORD_LAYOUT
/begin RECORD_LAYOUT Lookup1D_X_LONG AXIS_PTS_X 1 SLONG INDEX_INCR DIRECT /end RECORD_LAYOUT
/begin RECORD_LAYOUT Lookup1D_FLOAT32_IEEE FNC_VALUES 1 FLOAT32_IEEE COLUMN_DIR DIRECT /end RECORD_LAYOUT
/begin RECORD_LAYOUT Lookup1D_X_FLOAT32_IEEE AXIS_PTS_X 1 FLOAT32_IEEE INDEX_INCR DIRECT /end RECORD_LAYOUT
/begin RECORD_LAYOUT Lookup1D_FLOAT64_IEEE FNC_VALUES 1 FLOAT64_IEEE COLUMN_DIR DIRECT /end RECORD_LAYOUT
/begin RECORD_LAYOUT Lookup1D_X_FLOAT64_IEEE AXIS_PTS_X 1 FLOAT64_IEEE INDEX_INCR DIRECT /end RECORD_LAYOUT
/begin RECORD_LAYOUT Lookup2D_BOOLEAN FNC_VALUES 1 UBYTE COLUMN_DIR DIRECT /end RECORD_LAYOUT
/begin RECORD_LAYOUT Lookup2D_X_BOOLEAN AXIS_PTS_X 1 UBYTE INDEX_INCR DIRECT /end RECORD_LAYOUT
/begin RECORD_LAYOUT Lookup2D_UBYTE FNC_VALUES 1 UBYTE COLUMN_DIR DIRECT /end RECORD_LAYOUT
/begin RECORD_LAYOUT Lookup2D_X_UBYTE AXIS_PTS_X 1 UBYTE INDEX_INCR DIRECT /end RECORD_LAYOUT
/begin RECORD_LAYOUT Lookup2D_BYTE FNC_VALUES 1 SBYTE COLUMN_DIR DIRECT /end RECORD_LAYOUT
/begin RECORD_LAYOUT Lookup2D_X_BYTE AXIS_PTS_X 1 SBYTE INDEX_INCR DIRECT /end RECORD_LAYOUT
/begin RECORD_LAYOUT Lookup2D_UWORD FNC_VALUES 1 UWORD COLUMN_DIR DIRECT /end RECORD_LAYOUT
/begin RECORD_LAYOUT Lookup2D_X_UWORD AXIS_PTS_X 1 UWORD INDEX_INCR DIRECT /end RECORD_LAYOUT
/begin RECORD_LAYOUT Lookup2D_WORD FNC_VALUES 1 SWORD COLUMN_DIR DIRECT /end RECORD_LAYOUT
/begin RECORD_LAYOUT Lookup2D_X_WORD AXIS_PTS_X 1 SWORD INDEX_INCR DIRECT /end RECORD_LAYOUT
/begin RECORD_LAYOUT Lookup2D_ULONG FNC_VALUES 1 ULONG COLUMN_DIR DIRECT /end RECORD_LAYOUT
/begin RECORD_LAYOUT Lookup2D_X_ULONG AXIS_PTS_X 1 ULONG INDEX_INCR DIRECT /end RECORD_LAYOUT
/begin RECORD_LAYOUT Lookup2D_LONG FNC_VALUES 1 SLONG COLUMN_DIR DIRECT /end RECORD_LAYOUT
/begin RECORD_LAYOUT Lookup2D_X_LONG AXIS_PTS_X 1 SLONG INDEX_INCR DIRECT /end RECORD_LAYOUT
/begin RECORD_LAYOUT Lookup2D_FLOAT32_IEEE FNC_VALUES 1 FLOAT32_IEEE COLUMN_DIR DIRECT /end RECORD_LAYOUT
/begin RECORD_LAYOUT Lookup2D_X_FLOAT32_IEEE AXIS_PTS_X 1 FLOAT32_IEEE INDEX_INCR DIRECT /end RECORD_LAYOUT
/begin RECORD_LAYOUT Lookup2D_FLOAT64_IEEE FNC_VALUES 1 FLOAT64_IEEE COLUMN_DIR DIRECT /end RECORD_LAYOUT
/begin RECORD_LAYOUT Lookup2D_X_FLOAT64_IEEE AXIS_PTS_X 1 FLOAT64_IEEE INDEX_INCR DIRECT /end RECORD_LAYOUT
/begin CHARACTERISTIC CAL_Cspf_IdcMax_f32 "" VALUE 0x0000 /* @ECU_Address@CAL_Cspf_IdcMax_f32@ */ Scalar_FLOAT32_IEEE 0 SWC_CSPF_CM_single -3.4E+38 3.4E+38 /end CHARACTERISTIC
/begin CHARACTERISTIC CAL_Cspf_IdcMin_f32 "" VALUE 0x0000 /* @ECU_Address@CAL_Cspf_IdcMin_f32@ */ Scalar_FLOAT32_IEEE 0 SWC_CSPF_CM_single -3.4E+38 3.4E+38 /end CHARACTERISTIC
/begin CHARACTERISTIC CAL_Cspf_IsFlt_f32 "" VALUE 0x0000 /* @ECU_Address@CAL_Cspf_IsFlt_f32@ */ Scalar_FLOAT32_IEEE 0 SWC_CSPF_CM_single -3.4E+38 3.4E+38 /end CHARACTERISTIC
/begin CHARACTERISTIC CAL_Cspf_KpHighNCtL_f32 "" VALUE 0x0000 /* @ECU_Address@CAL_Cspf_KpHighNCtL_f32@ */ Scalar_FLOAT32_IEEE 0 SWC_CSPF_CM_single -3.4E+38 3.4E+38 /end CHARACTERISTIC
/begin CHARACTERISTIC CAL_Cspf_KpLowNCtl_f32 "" VALUE 0x0000 /* @ECU_Address@CAL_Cspf_KpLowNCtl_f32@ */ Scalar_FLOAT32_IEEE 0 SWC_CSPF_CM_single -3.4E+38 3.4E+38 /end CHARACTERISTIC
/begin CHARACTERISTIC CAL_Cspf_NDiffMax_f32 "" VALUE 0x0000 /* @ECU_Address@CAL_Cspf_NDiffMax_f32@ */ Scalar_FLOAT32_IEEE 0 SWC_CSPF_CM_single -3.4E+38 3.4E+38 /end CHARACTERISTIC
/begin CHARACTERISTIC CAL_Cspf_NSetP_f32 "" VALUE 0x0000 /* @ECU_Address@CAL_Cspf_NSetP_f32@ */ Scalar_FLOAT32_IEEE 0 SWC_CSPF_CM_single -3.4E+38 3.4E+38 /end CHARACTERISTIC
/begin CHARACTERISTIC CAL_Cspf_TraTrqMax_f32 "" VALUE 0x0000 /* @ECU_Address@CAL_Cspf_TraTrqMax_f32@ */ Scalar_FLOAT32_IEEE 0 SWC_CSPF_CM_single -3.4E+38 3.4E+38 /end CHARACTERISTIC
/begin CHARACTERISTIC CAL_Cspf_TraTrqMin_f32 "" VALUE 0x0000 /* @ECU_Address@CAL_Cspf_TraTrqMin_f32@ */ Scalar_FLOAT32_IEEE 0 SWC_CSPF_CM_single -3.4E+38 3.4E+38 /end CHARACTERISTIC
/begin CHARACTERISTIC CAL_Cspf_TrqCurrWoDmpC_f32 "" VALUE 0x0000 /* @ECU_Address@CAL_Cspf_TrqCurrWoDmpC_f32@ */ Scalar_FLOAT32_IEEE 0 SWC_CSPF_CM_single -3.4E+38 3.4E+38 /end CHARACTERISTIC
/begin CHARACTERISTIC CAL_Cspf_TrqDmpLim_f32 "" VALUE 0x0000 /* @ECU_Address@CAL_Cspf_TrqDmpLim_f32@ */ Scalar_FLOAT32_IEEE 0 SWC_CSPF_CM_single -3.4E+38 3.4E+38 /end CHARACTERISTIC
/begin CHARACTERISTIC CAL_Cspf_TrqDmpMax_f32 "" VALUE 0x0000 /* @ECU_Address@CAL_Cspf_TrqDmpMax_f32@ */ Scalar_FLOAT32_IEEE 0 SWC_CSPF_CM_single -3.4E+38 3.4E+38 /end CHARACTERISTIC
/begin CHARACTERISTIC CAL_Cspf_TrqMaxNCtL_f32 "" VALUE 0x0000 /* @ECU_Address@CAL_Cspf_TrqMaxNCtL_f32@ */ Scalar_FLOAT32_IEEE 0 SWC_CSPF_CM_single -3.4E+38 3.4E+38 /end CHARACTERISTIC
/begin CHARACTERISTIC CAL_Cspf_TrqMax_f32 "" VALUE 0x0000 /* @ECU_Address@CAL_Cspf_TrqMax_f32@ */ Scalar_FLOAT32_IEEE 0 SWC_CSPF_CM_single -3.4E+38 3.4E+38 /end CHARACTERISTIC
/begin CHARACTERISTIC CAL_Cspf_TrqMechFlt_f32 "" VALUE 0x0000 /* @ECU_Address@CAL_Cspf_TrqMechFlt_f32@ */ Scalar_FLOAT32_IEEE 0 SWC_CSPF_CM_single -3.4E+38 3.4E+38 /end CHARACTERISTIC
/begin CHARACTERISTIC CAL_Cspf_TrqMinNCtl_f32 "" VALUE 0x0000 /* @ECU_Address@CAL_Cspf_TrqMinNCtl_f32@ */ Scalar_FLOAT32_IEEE 0 SWC_CSPF_CM_single -3.4E+38 3.4E+38 /end CHARACTERISTIC
/begin CHARACTERISTIC CAL_Cspf_TrqMin_f32 "" VALUE 0x0000 /* @ECU_Address@CAL_Cspf_TrqMin_f32@ */ Scalar_FLOAT32_IEEE 0 SWC_CSPF_CM_single -3.4E+38 3.4E+38 /end CHARACTERISTIC
/begin CHARACTERISTIC CAL_Cspf_TrqSLope_f32 "" VALUE 0x0000 /* @ECU_Address@CAL_Cspf_TrqSLope_f32@ */ Scalar_FLOAT32_IEEE 0 SWC_CSPF_CM_single -3.4E+38 3.4E+38 /end CHARACTERISTIC
/begin CHARACTERISTIC CAL_Cspf_TrqSetP_f32 "" VALUE 0x0000 /* @ECU_Address@CAL_Cspf_TrqSetP_f32@ */ Scalar_FLOAT32_IEEE 0 SWC_CSPF_CM_single -3.4E+38 3.4E+38 /end CHARACTERISTIC
/begin CHARACTERISTIC CAL_Cspf_UdcMax_f32 "" VALUE 0x0000 /* @ECU_Address@CAL_Cspf_UdcMax_f32@ */ Scalar_FLOAT32_IEEE 0 SWC_CSPF_CM_single -3.4E+38 3.4E+38 /end CHARACTERISTIC
/begin CHARACTERISTIC CAL_Cspf_UdcMin_f32 "" VALUE 0x0000 /* @ECU_Address@CAL_Cspf_UdcMin_f32@ */ Scalar_FLOAT32_IEEE 0 SWC_CSPF_CM_single -3.4E+38 3.4E+38 /end CHARACTERISTIC
/begin CHARACTERISTIC CAL_Cspf_agOffset_f32 "" VALUE 0x0000 /* @ECU_Address@CAL_Cspf_agOffset_f32@ */ Scalar_FLOAT32_IEEE 0 SWC_CSPF_CM_single -3.4E+38 3.4E+38 /end CHARACTERISTIC
/begin CHARACTERISTIC CAL_Cspf_agRtrEe_f32 "" VALUE 0x0000 /* @ECU_Address@CAL_Cspf_agRtrEe_f32@ */ Scalar_FLOAT32_IEEE 0 SWC_CSPF_CM_single -3.4E+38 3.4E+38 /end CHARACTERISTIC
/begin CHARACTERISTIC CAL_Cspf_iDActSlowFlt_f32 "" VALUE 0x0000 /* @ECU_Address@CAL_Cspf_iDActSlowFlt_f32@ */ Scalar_FLOAT32_IEEE 0 SWC_CSPF_CM_single -3.4E+38 3.4E+38 /end CHARACTERISTIC
/begin CHARACTERISTIC CAL_Cspf_iDcLnkEstFlt_f32 "" VALUE 0x0000 /* @ECU_Address@CAL_Cspf_iDcLnkEstFlt_f32@ */ Scalar_FLOAT32_IEEE 0 SWC_CSPF_CM_single -3.4E+38 3.4E+38 /end CHARACTERISTIC
/begin CHARACTERISTIC CAL_Cspf_iQActSlowFlt_f32 "" VALUE 0x0000 /* @ECU_Address@CAL_Cspf_iQActSlowFlt_f32@ */ Scalar_FLOAT32_IEEE 0 SWC_CSPF_CM_single -3.4E+38 3.4E+38 /end CHARACTERISTIC
/begin CHARACTERISTIC CAL_Cspf_kDmp_f32 "" VALUE 0x0000 /* @ECU_Address@CAL_Cspf_kDmp_f32@ */ Scalar_FLOAT32_IEEE 0 SWC_CSPF_CM_single -3.4E+38 3.4E+38 /end CHARACTERISTIC
/begin CHARACTERISTIC CAL_Cspf_nSlowFlt_f32 "" VALUE 0x0000 /* @ECU_Address@CAL_Cspf_nSlowFlt_f32@ */ Scalar_FLOAT32_IEEE 0 SWC_CSPF_CM_single -3.4E+38 3.4E+38 /end CHARACTERISTIC
/begin CHARACTERISTIC CAL_Cspf_tCoolantTempFlt_f32 "" VALUE 0x0000 /* @ECU_Address@CAL_Cspf_tCoolantTempFlt_f32@ */ Scalar_FLOAT32_IEEE 0 SWC_CSPF_CM_single -3.4E+38 3.4E+38 /end CHARACTERISTIC
/begin CHARACTERISTIC CAL_Cspf_tDBCTempUFlt_f32 "" VALUE 0x0000 /* @ECU_Address@CAL_Cspf_tDBCTempUFlt_f32@ */ Scalar_FLOAT32_IEEE 0 SWC_CSPF_CM_single -3.4E+38 3.4E+38 /end CHARACTERISTIC
/begin CHARACTERISTIC CAL_Cspf_tDBCTempVFlt_f32 "" VALUE 0x0000 /* @ECU_Address@CAL_Cspf_tDBCTempVFlt_f32@ */ Scalar_FLOAT32_IEEE 0 SWC_CSPF_CM_single -3.4E+38 3.4E+38 /end CHARACTERISTIC
/begin CHARACTERISTIC CAL_Cspf_tDBCTempWFlt_f32 "" VALUE 0x0000 /* @ECU_Address@CAL_Cspf_tDBCTempWFlt_f32@ */ Scalar_FLOAT32_IEEE 0 SWC_CSPF_CM_single -3.4E+38 3.4E+38 /end CHARACTERISTIC
/begin CHARACTERISTIC CAL_Cspf_tStrrTemp1Flt_f32 "" VALUE 0x0000 /* @ECU_Address@CAL_Cspf_tStrrTemp1Flt_f32@ */ Scalar_FLOAT32_IEEE 0 SWC_CSPF_CM_single -3.4E+38 3.4E+38 /end CHARACTERISTIC
/begin CHARACTERISTIC CAL_Cspf_tStrrTemp2Flt_f32 "" VALUE 0x0000 /* @ECU_Address@CAL_Cspf_tStrrTemp2Flt_f32@ */ Scalar_FLOAT32_IEEE 0 SWC_CSPF_CM_single -3.4E+38 3.4E+38 /end CHARACTERISTIC
/begin CHARACTERISTIC CAL_Cspf_uDcLnkSlowFlt_f32 "" VALUE 0x0000 /* @ECU_Address@CAL_Cspf_uDcLnkSlowFlt_f32@ */ Scalar_FLOAT32_IEEE 0 SWC_CSPF_CM_single -3.4E+38 3.4E+38 /end CHARACTERISTIC
/begin CHARACTERISTIC CAL_Cspf_uKl30Flt_f32 "" VALUE 0x0000 /* @ECU_Address@CAL_Cspf_uKl30Flt_f32@ */ Scalar_FLOAT32_IEEE 0 SWC_CSPF_CM_single -3.4E+38 3.4E+38 /end CHARACTERISTIC
/begin CHARACTERISTIC CAL_Cspf_CodeVer_u16 "" VALUE 0x0000 /* @ECU_Address@CAL_Cspf_CodeVer_u16@ */ Scalar_UWORD 0 SWC_CSPF_CM_uint16 0 65535 /end CHARACTERISTIC
/begin CHARACTERISTIC CAL_Cspf_DataVer_u16 "" VALUE 0x0000 /* @ECU_Address@CAL_Cspf_DataVer_u16@ */ Scalar_UWORD 0 SWC_CSPF_CM_uint16 0 65535 /end CHARACTERISTIC
/begin CHARACTERISTIC CAL_Cspf_HwVer_u16 "" VALUE 0x0000 /* @ECU_Address@CAL_Cspf_HwVer_u16@ */ Scalar_UWORD 0 SWC_CSPF_CM_uint16 0 65535 /end CHARACTERISTIC
/begin CHARACTERISTIC CAL_Cspf_bDernDrvBoardTemp_u16 "" VALUE 0x0000 /* @ECU_Address@CAL_Cspf_bDernDrvBoardTemp_u16@ */ Scalar_UWORD 0 SWC_CSPF_CM_uint16 0 65535 /end CHARACTERISTIC
/begin CHARACTERISTIC CAL_Cspf_flgCpldVerSwt_b "" VALUE 0x0000 /* @ECU_Address@CAL_Cspf_flgCpldVerSwt_b@ */ Scalar_BOOLEAN 0 SWC_CSPF_CM_boolean 0 1 /end CHARACTERISTIC
/begin CHARACTERISTIC CAL_Cspf_flgCrashSwt_b "" VALUE 0x0000 /* @ECU_Address@CAL_Cspf_flgCrashSwt_b@ */ Scalar_BOOLEAN 0 SWC_CSPF_CM_boolean 0 1 /end CHARACTERISTIC
/begin CHARACTERISTIC CAL_Cspf_flgCrash_b "" VALUE 0x0000 /* @ECU_Address@CAL_Cspf_flgCrash_b@ */ Scalar_BOOLEAN 0 SWC_CSPF_CM_boolean 0 1 /end CHARACTERISTIC
/begin CHARACTERISTIC CAL_Cspf_flgDchaReqSwt_b "" VALUE 0x0000 /* @ECU_Address@CAL_Cspf_flgDchaReqSwt_b@ */ Scalar_BOOLEAN 0 SWC_CSPF_CM_boolean 0 1 /end CHARACTERISTIC
/begin CHARACTERISTIC CAL_Cspf_flgDchaReq_b "" VALUE 0x0000 /* @ECU_Address@CAL_Cspf_flgDchaReq_b@ */ Scalar_BOOLEAN 0 SWC_CSPF_CM_boolean 0 1 /end CHARACTERISTIC
/begin CHARACTERISTIC CAL_Cspf_flgFailCode1Swt_b "" VALUE 0x0000 /* @ECU_Address@CAL_Cspf_flgFailCode1Swt_b@ */ Scalar_BOOLEAN 0 SWC_CSPF_CM_boolean 0 1 /end CHARACTERISTIC
/begin CHARACTERISTIC CAL_Cspf_flgFailCode2Swt_b "" VALUE 0x0000 /* @ECU_Address@CAL_Cspf_flgFailCode2Swt_b@ */ Scalar_BOOLEAN 0 SWC_CSPF_CM_boolean 0 1 /end CHARACTERISTIC
/begin CHARACTERISTIC CAL_Cspf_flgFailCode3Swt_b "" VALUE 0x0000 /* @ECU_Address@CAL_Cspf_flgFailCode3Swt_b@ */ Scalar_BOOLEAN 0 SWC_CSPF_CM_boolean 0 1 /end CHARACTERISTIC
/begin CHARACTERISTIC CAL_Cspf_flgFailCode4Swt_b "" VALUE 0x0000 /* @ECU_Address@CAL_Cspf_flgFailCode4Swt_b@ */ Scalar_BOOLEAN 0 SWC_CSPF_CM_boolean 0 1 /end CHARACTERISTIC
/begin CHARACTERISTIC CAL_Cspf_flgFailCode5Swt_b "" VALUE 0x0000 /* @ECU_Address@CAL_Cspf_flgFailCode5Swt_b@ */ Scalar_BOOLEAN 0 SWC_CSPF_CM_boolean 0 1 /end CHARACTERISTIC
/begin CHARACTERISTIC CAL_Cspf_flgFailCode6Swt_b "" VALUE 0x0000 /* @ECU_Address@CAL_Cspf_flgFailCode6Swt_b@ */ Scalar_BOOLEAN 0 SWC_CSPF_CM_boolean 0 1 /end CHARACTERISTIC
/begin CHARACTERISTIC CAL_Cspf_flgFailCode7Swt_b "" VALUE 0x0000 /* @ECU_Address@CAL_Cspf_flgFailCode7Swt_b@ */ Scalar_BOOLEAN 0 SWC_CSPF_CM_boolean 0 1 /end CHARACTERISTIC
/begin CHARACTERISTIC CAL_Cspf_flgFailCode8Swt_b "" VALUE 0x0000 /* @ECU_Address@CAL_Cspf_flgFailCode8Swt_b@ */ Scalar_BOOLEAN 0 SWC_CSPF_CM_boolean 0 1 /end CHARACTERISTIC
/begin CHARACTERISTIC CAL_Cspf_flgHvMcuVerSwt_b "" VALUE 0x0000 /* @ECU_Address@CAL_Cspf_flgHvMcuVerSwt_b@ */ Scalar_BOOLEAN 0 SWC_CSPF_CM_boolean 0 1 /end CHARACTERISTIC
/begin CHARACTERISTIC CAL_Cspf_flgHwVerSwt_b "" VALUE 0x0000 /* @ECU_Address@CAL_Cspf_flgHwVerSwt_b@ */ Scalar_BOOLEAN 0 SWC_CSPF_CM_boolean 0 1 /end CHARACTERISTIC
/begin CHARACTERISTIC CAL_Cspf_flgIdcMaxSwt_b "" VALUE 0x0000 /* @ECU_Address@CAL_Cspf_flgIdcMaxSwt_b@ */ Scalar_BOOLEAN 0 SWC_CSPF_CM_boolean 0 1 /end CHARACTERISTIC
/begin CHARACTERISTIC CAL_Cspf_flgIdcMinSwt_b "" VALUE 0x0000 /* @ECU_Address@CAL_Cspf_flgIdcMinSwt_b@ */ Scalar_BOOLEAN 0 SWC_CSPF_CM_boolean 0 1 /end CHARACTERISTIC
/begin CHARACTERISTIC CAL_Cspf_flgIsFltSwt_b "" VALUE 0x0000 /* @ECU_Address@CAL_Cspf_flgIsFltSwt_b@ */ Scalar_BOOLEAN 0 SWC_CSPF_CM_boolean 0 1 /end CHARACTERISTIC
/begin CHARACTERISTIC CAL_Cspf_flgKpHighNCtLSwt_b "" VALUE 0x0000 /* @ECU_Address@CAL_Cspf_flgKpHighNCtLSwt_b@ */ Scalar_BOOLEAN 0 SWC_CSPF_CM_boolean 0 1 /end CHARACTERISTIC
/begin CHARACTERISTIC CAL_Cspf_flgKpLowNCtlSwt_b "" VALUE 0x0000 /* @ECU_Address@CAL_Cspf_flgKpLowNCtlSwt_b@ */ Scalar_BOOLEAN 0 SWC_CSPF_CM_boolean 0 1 /end CHARACTERISTIC
/begin CHARACTERISTIC CAL_Cspf_flgNDiffMaxSwt_b "" VALUE 0x0000 /* @ECU_Address@CAL_Cspf_flgNDiffMaxSwt_b@ */ Scalar_BOOLEAN 0 SWC_CSPF_CM_boolean 0 1 /end CHARACTERISTIC
/begin CHARACTERISTIC CAL_Cspf_flgNSetPSwt_b "" VALUE 0x0000 /* @ECU_Address@CAL_Cspf_flgNSetPSwt_b@ */ Scalar_BOOLEAN 0 SWC_CSPF_CM_boolean 0 1 /end CHARACTERISTIC
/begin CHARACTERISTIC CAL_Cspf_flgOfsClbSucSwt_b "" VALUE 0x0000 /* @ECU_Address@CAL_Cspf_flgOfsClbSucSwt_b@ */ Scalar_BOOLEAN 0 SWC_CSPF_CM_boolean 0 1 /end CHARACTERISTIC
/begin CHARACTERISTIC CAL_Cspf_flgTraTrqMaxSwt_b "" VALUE 0x0000 /* @ECU_Address@CAL_Cspf_flgTraTrqMaxSwt_b@ */ Scalar_BOOLEAN 0 SWC_CSPF_CM_boolean 0 1 /end CHARACTERISTIC
/begin CHARACTERISTIC CAL_Cspf_flgTraTrqMinSwt_b "" VALUE 0x0000 /* @ECU_Address@CAL_Cspf_flgTraTrqMinSwt_b@ */ Scalar_BOOLEAN 0 SWC_CSPF_CM_boolean 0 1 /end CHARACTERISTIC
/begin CHARACTERISTIC CAL_Cspf_flgTrqCurrWoDmpCSwt_b "" VALUE 0x0000 /* @ECU_Address@CAL_Cspf_flgTrqCurrWoDmpCSwt_b@ */ Scalar_BOOLEAN 0 SWC_CSPF_CM_boolean 0 1 /end CHARACTERISTIC
/begin CHARACTERISTIC CAL_Cspf_flgTrqDmpMaxSwt_b "" VALUE 0x0000 /* @ECU_Address@CAL_Cspf_flgTrqDmpMaxSwt_b@ */ Scalar_BOOLEAN 0 SWC_CSPF_CM_boolean 0 1 /end CHARACTERISTIC
/begin CHARACTERISTIC CAL_Cspf_flgTrqDmpMinSwt_b "" VALUE 0x0000 /* @ECU_Address@CAL_Cspf_flgTrqDmpMinSwt_b@ */ Scalar_BOOLEAN 0 SWC_CSPF_CM_boolean 0 1 /end CHARACTERISTIC
/begin CHARACTERISTIC CAL_Cspf_flgTrqMaxNCtLSwt_b "" VALUE 0x0000 /* @ECU_Address@CAL_Cspf_flgTrqMaxNCtLSwt_b@ */ Scalar_BOOLEAN 0 SWC_CSPF_CM_boolean 0 1 /end CHARACTERISTIC
/begin CHARACTERISTIC CAL_Cspf_flgTrqMaxSwt_b "" VALUE 0x0000 /* @ECU_Address@CAL_Cspf_flgTrqMaxSwt_b@ */ Scalar_BOOLEAN 0 SWC_CSPF_CM_boolean 0 1 /end CHARACTERISTIC
/begin CHARACTERISTIC CAL_Cspf_flgTrqMechFltSwt_b "" VALUE 0x0000 /* @ECU_Address@CAL_Cspf_flgTrqMechFltSwt_b@ */ Scalar_BOOLEAN 0 SWC_CSPF_CM_boolean 0 1 /end CHARACTERISTIC
/begin CHARACTERISTIC CAL_Cspf_flgTrqMinNCtlSwt_b "" VALUE 0x0000 /* @ECU_Address@CAL_Cspf_flgTrqMinNCtlSwt_b@ */ Scalar_BOOLEAN 0 SWC_CSPF_CM_boolean 0 1 /end CHARACTERISTIC
/begin CHARACTERISTIC CAL_Cspf_flgTrqMinSwt_b "" VALUE 0x0000 /* @ECU_Address@CAL_Cspf_flgTrqMinSwt_b@ */ Scalar_BOOLEAN 0 SWC_CSPF_CM_boolean 0 1 /end CHARACTERISTIC
/begin CHARACTERISTIC CAL_Cspf_flgTrqSetPSwt_b "" VALUE 0x0000 /* @ECU_Address@CAL_Cspf_flgTrqSetPSwt_b@ */ Scalar_BOOLEAN 0 SWC_CSPF_CM_boolean 0 1 /end CHARACTERISTIC
/begin CHARACTERISTIC CAL_Cspf_flgUdcMaxSwt_b "" VALUE 0x0000 /* @ECU_Address@CAL_Cspf_flgUdcMaxSwt_b@ */ Scalar_BOOLEAN 0 SWC_CSPF_CM_boolean 0 1 /end CHARACTERISTIC
/begin CHARACTERISTIC CAL_Cspf_flgUdcMinSwt_b "" VALUE 0x0000 /* @ECU_Address@CAL_Cspf_flgUdcMinSwt_b@ */ Scalar_BOOLEAN 0 SWC_CSPF_CM_boolean 0 1 /end CHARACTERISTIC
/begin CHARACTERISTIC CAL_Cspf_flgagOffsetSwt_b "" VALUE 0x0000 /* @ECU_Address@CAL_Cspf_flgagOffsetSwt_b@ */ Scalar_BOOLEAN 0 SWC_CSPF_CM_boolean 0 1 /end CHARACTERISTIC
/begin CHARACTERISTIC CAL_Cspf_flgagRtrEeSwt_b "" VALUE 0x0000 /* @ECU_Address@CAL_Cspf_flgagRtrEeSwt_b@ */ Scalar_BOOLEAN 0 SWC_CSPF_CM_boolean 0 1 /end CHARACTERISTIC
/begin CHARACTERISTIC CAL_Cspf_flgbDernCANSwt_b "" VALUE 0x0000 /* @ECU_Address@CAL_Cspf_flgbDernCANSwt_b@ */ Scalar_BOOLEAN 0 SWC_CSPF_CM_boolean 0 1 /end CHARACTERISTIC
/begin CHARACTERISTIC CAL_Cspf_flgbDernCoolantTempSwt_b "" VALUE 0x0000 /* @ECU_Address@CAL_Cspf_flgbDernCoolantTempSwt_b@ */ Scalar_BOOLEAN 0 SWC_CSPF_CM_boolean 0 1 /end CHARACTERISTIC
/begin CHARACTERISTIC CAL_Cspf_flgbDernDbcTempSwt_b "" VALUE 0x0000 /* @ECU_Address@CAL_Cspf_flgbDernDbcTempSwt_b@ */ Scalar_BOOLEAN 0 SWC_CSPF_CM_boolean 0 1 /end CHARACTERISTIC
/begin CHARACTERISTIC CAL_Cspf_flgbDernDrvBoardTempSwt_b "" VALUE 0x0000 /* @ECU_Address@CAL_Cspf_flgbDernDrvBoardTempSwt_b@ */ Scalar_BOOLEAN 0 SWC_CSPF_CM_boolean 0 1 /end CHARACTERISTIC
/begin CHARACTERISTIC CAL_Cspf_flgbDernExcMaxSwt_b "" VALUE 0x0000 /* @ECU_Address@CAL_Cspf_flgbDernExcMaxSwt_b@ */ Scalar_BOOLEAN 0 SWC_CSPF_CM_boolean 0 1 /end CHARACTERISTIC
/begin CHARACTERISTIC CAL_Cspf_flgbDernExcMinSwt_b "" VALUE 0x0000 /* @ECU_Address@CAL_Cspf_flgbDernExcMinSwt_b@ */ Scalar_BOOLEAN 0 SWC_CSPF_CM_boolean 0 1 /end CHARACTERISTIC
/begin CHARACTERISTIC CAL_Cspf_flgbDernMtrSpdSwt_b "" VALUE 0x0000 /* @ECU_Address@CAL_Cspf_flgbDernMtrSpdSwt_b@ */ Scalar_BOOLEAN 0 SWC_CSPF_CM_boolean 0 1 /end CHARACTERISTIC
/begin CHARACTERISTIC CAL_Cspf_flgbDernOvrIdcSwt_b "" VALUE 0x0000 /* @ECU_Address@CAL_Cspf_flgbDernOvrIdcSwt_b@ */ Scalar_BOOLEAN 0 SWC_CSPF_CM_boolean 0 1 /end CHARACTERISTIC
/begin CHARACTERISTIC CAL_Cspf_flgbDernOvrUdcSwt_b "" VALUE 0x0000 /* @ECU_Address@CAL_Cspf_flgbDernOvrUdcSwt_b@ */ Scalar_BOOLEAN 0 SWC_CSPF_CM_boolean 0 1 /end CHARACTERISTIC
/begin CHARACTERISTIC CAL_Cspf_flgbDernStrTempSwt_b "" VALUE 0x0000 /* @ECU_Address@CAL_Cspf_flgbDernStrTempSwt_b@ */ Scalar_BOOLEAN 0 SWC_CSPF_CM_boolean 0 1 /end CHARACTERISTIC
/begin CHARACTERISTIC CAL_Cspf_flgbDernUndrUdcSwt_b "" VALUE 0x0000 /* @ECU_Address@CAL_Cspf_flgbDernUndrUdcSwt_b@ */ Scalar_BOOLEAN 0 SWC_CSPF_CM_boolean 0 1 /end CHARACTERISTIC
/begin CHARACTERISTIC CAL_Cspf_flgbReadyHVSwt_b "" VALUE 0x0000 /* @ECU_Address@CAL_Cspf_flgbReadyHVSwt_b@ */ Scalar_BOOLEAN 0 SWC_CSPF_CM_boolean 0 1 /end CHARACTERISTIC
/begin CHARACTERISTIC CAL_Cspf_flgcTrqSLopeSwt_b "" VALUE 0x0000 /* @ECU_Address@CAL_Cspf_flgcTrqSLopeSwt_b@ */ Scalar_BOOLEAN 0 SWC_CSPF_CM_boolean 0 1 /end CHARACTERISTIC
/begin CHARACTERISTIC CAL_Cspf_flgiDActSlowFltSwt_b "" VALUE 0x0000 /* @ECU_Address@CAL_Cspf_flgiDActSlowFltSwt_b@ */ Scalar_BOOLEAN 0 SWC_CSPF_CM_boolean 0 1 /end CHARACTERISTIC
/begin CHARACTERISTIC CAL_Cspf_flgiDcLnkEstFltSwt_b "" VALUE 0x0000 /* @ECU_Address@CAL_Cspf_flgiDcLnkEstFltSwt_b@ */ Scalar_BOOLEAN 0 SWC_CSPF_CM_boolean 0 1 /end CHARACTERISTIC
/begin CHARACTERISTIC CAL_Cspf_flgiQActSlowFltSwt_b "" VALUE 0x0000 /* @ECU_Address@CAL_Cspf_flgiQActSlowFltSwt_b@ */ Scalar_BOOLEAN 0 SWC_CSPF_CM_boolean 0 1 /end CHARACTERISTIC
/begin CHARACTERISTIC CAL_Cspf_flgkDmpSwt_b "" VALUE 0x0000 /* @ECU_Address@CAL_Cspf_flgkDmpSwt_b@ */ Scalar_BOOLEAN 0 SWC_CSPF_CM_boolean 0 1 /end CHARACTERISTIC
/begin CHARACTERISTIC CAL_Cspf_flgnSlowFltSwt_b "" VALUE 0x0000 /* @ECU_Address@CAL_Cspf_flgnSlowFltSwt_b@ */ Scalar_BOOLEAN 0 SWC_CSPF_CM_boolean 0 1 /end CHARACTERISTIC
/begin CHARACTERISTIC CAL_Cspf_flgstDisChgSwt_b "" VALUE 0x0000 /* @ECU_Address@CAL_Cspf_flgstDisChgSwt_b@ */ Scalar_BOOLEAN 0 SWC_CSPF_CM_boolean 0 1 /end CHARACTERISTIC
/begin CHARACTERISTIC CAL_Cspf_flgstDmpCtLReqSwt_b "" VALUE 0x0000 /* @ECU_Address@CAL_Cspf_flgstDmpCtLReqSwt_b@ */ Scalar_BOOLEAN 0 SWC_CSPF_CM_boolean 0 1 /end CHARACTERISTIC
/begin CHARACTERISTIC CAL_Cspf_flgstGateDrvSwt_b "" VALUE 0x0000 /* @ECU_Address@CAL_Cspf_flgstGateDrvSwt_b@ */ Scalar_BOOLEAN 0 SWC_CSPF_CM_boolean 0 1 /end CHARACTERISTIC
/begin CHARACTERISTIC CAL_Cspf_flgstMainReLaySwt_b "" VALUE 0x0000 /* @ECU_Address@CAL_Cspf_flgstMainReLaySwt_b@ */ Scalar_BOOLEAN 0 SWC_CSPF_CM_boolean 0 1 /end CHARACTERISTIC
/begin CHARACTERISTIC CAL_Cspf_flgstModeReqSwt_b "" VALUE 0x0000 /* @ECU_Address@CAL_Cspf_flgstModeReqSwt_b@ */ Scalar_BOOLEAN 0 SWC_CSPF_CM_boolean 0 1 /end CHARACTERISTIC
/begin CHARACTERISTIC CAL_Cspf_flgstModeSwt_b "" VALUE 0x0000 /* @ECU_Address@CAL_Cspf_flgstModeSwt_b@ */ Scalar_BOOLEAN 0 SWC_CSPF_CM_boolean 0 1 /end CHARACTERISTIC
/begin CHARACTERISTIC CAL_Cspf_flgstTrqEmMaxSwt_b "" VALUE 0x0000 /* @ECU_Address@CAL_Cspf_flgstTrqEmMaxSwt_b@ */ Scalar_BOOLEAN 0 SWC_CSPF_CM_boolean 0 1 /end CHARACTERISTIC
/begin CHARACTERISTIC CAL_Cspf_flgstTrqEmMinSwt_b "" VALUE 0x0000 /* @ECU_Address@CAL_Cspf_flgstTrqEmMinSwt_b@ */ Scalar_BOOLEAN 0 SWC_CSPF_CM_boolean 0 1 /end CHARACTERISTIC
/begin CHARACTERISTIC CAL_Cspf_flgtCoolantTempFltSwt_b "" VALUE 0x0000 /* @ECU_Address@CAL_Cspf_flgtCoolantTempFltSwt_b@ */ Scalar_BOOLEAN 0 SWC_CSPF_CM_boolean 0 1 /end CHARACTERISTIC
/begin CHARACTERISTIC CAL_Cspf_flgtDBCTempUFltSwt_b "" VALUE 0x0000 /* @ECU_Address@CAL_Cspf_flgtDBCTempUFltSwt_b@ */ Scalar_BOOLEAN 0 SWC_CSPF_CM_boolean 0 1 /end CHARACTERISTIC
/begin CHARACTERISTIC CAL_Cspf_flgtDBCTempVFltSwt_b "" VALUE 0x0000 /* @ECU_Address@CAL_Cspf_flgtDBCTempVFltSwt_b@ */ Scalar_BOOLEAN 0 SWC_CSPF_CM_boolean 0 1 /end CHARACTERISTIC
/begin CHARACTERISTIC CAL_Cspf_flgtDBCTempWFltSwt_b "" VALUE 0x0000 /* @ECU_Address@CAL_Cspf_flgtDBCTempWFltSwt_b@ */ Scalar_BOOLEAN 0 SWC_CSPF_CM_boolean 0 1 /end CHARACTERISTIC
/begin CHARACTERISTIC CAL_Cspf_flgtStrrTemp1FltSwt_b "" VALUE 0x0000 /* @ECU_Address@CAL_Cspf_flgtStrrTemp1FltSwt_b@ */ Scalar_BOOLEAN 0 SWC_CSPF_CM_boolean 0 1 /end CHARACTERISTIC
/begin CHARACTERISTIC CAL_Cspf_flgtStrrTemp2FltSwt_b "" VALUE 0x0000 /* @ECU_Address@CAL_Cspf_flgtStrrTemp2FltSwt_b@ */ Scalar_BOOLEAN 0 SWC_CSPF_CM_boolean 0 1 /end CHARACTERISTIC
/begin CHARACTERISTIC CAL_Cspf_flguDcLnkSlowFltSwt_b "" VALUE 0x0000 /* @ECU_Address@CAL_Cspf_flguDcLnkSlowFltSwt_b@ */ Scalar_BOOLEAN 0 SWC_CSPF_CM_boolean 0 1 /end CHARACTERISTIC
/begin CHARACTERISTIC CAL_Cspf_flguKl30FltSwt_b "" VALUE 0x0000 /* @ECU_Address@CAL_Cspf_flguKl30FltSwt_b@ */ Scalar_BOOLEAN 0 SWC_CSPF_CM_boolean 0 1 /end CHARACTERISTIC
/begin CHARACTERISTIC CAL_Cspf_CpldVer_u8 "" VALUE 0x0000 /* @ECU_Address@CAL_Cspf_CpldVer_u8@ */ Scalar_UBYTE 0 SWC_CSPF_CM_uint8 0 255 /end CHARACTERISTIC
/begin CHARACTERISTIC CAL_Cspf_FailCode1_u8 "" VALUE 0x0000 /* @ECU_Address@CAL_Cspf_FailCode1_u8@ */ Scalar_UBYTE 0 SWC_CSPF_CM_uint8 0 255 /end CHARACTERISTIC
/begin CHARACTERISTIC CAL_Cspf_FailCode2_u8 "" VALUE 0x0000 /* @ECU_Address@CAL_Cspf_FailCode2_u8@ */ Scalar_UBYTE 0 SWC_CSPF_CM_uint8 0 255 /end CHARACTERISTIC
/begin CHARACTERISTIC CAL_Cspf_FailCode3_u8 "" VALUE 0x0000 /* @ECU_Address@CAL_Cspf_FailCode3_u8@ */ Scalar_UBYTE 0 SWC_CSPF_CM_uint8 0 255 /end CHARACTERISTIC
/begin CHARACTERISTIC CAL_Cspf_FailCode4_u8 "" VALUE 0x0000 /* @ECU_Address@CAL_Cspf_FailCode4_u8@ */ Scalar_UBYTE 0 SWC_CSPF_CM_uint8 0 255 /end CHARACTERISTIC
/begin CHARACTERISTIC CAL_Cspf_FailCode5_u8 "" VALUE 0x0000 /* @ECU_Address@CAL_Cspf_FailCode5_u8@ */ Scalar_UBYTE 0 SWC_CSPF_CM_uint8 0 255 /end CHARACTERISTIC
/begin CHARACTERISTIC CAL_Cspf_FailCode6_u8 "" VALUE 0x0000 /* @ECU_Address@CAL_Cspf_FailCode6_u8@ */ Scalar_UBYTE 0 SWC_CSPF_CM_uint8 0 255 /end CHARACTERISTIC
/begin CHARACTERISTIC CAL_Cspf_FailCode7_u8 "" VALUE 0x0000 /* @ECU_Address@CAL_Cspf_FailCode7_u8@ */ Scalar_UBYTE 0 SWC_CSPF_CM_uint8 0 255 /end CHARACTERISTIC
/begin CHARACTERISTIC CAL_Cspf_FailCode8_u8 "" VALUE 0x0000 /* @ECU_Address@CAL_Cspf_FailCode8_u8@ */ Scalar_UBYTE 0 SWC_CSPF_CM_uint8 0 255 /end CHARACTERISTIC
/begin CHARACTERISTIC CAL_Cspf_HvMcuVer_u8 "" VALUE 0x0000 /* @ECU_Address@CAL_Cspf_HvMcuVer_u8@ */ Scalar_UBYTE 0 SWC_CSPF_CM_uint8 0 255 /end CHARACTERISTIC
/begin CHARACTERISTIC CAL_Cspf_MainReLay_u8 "" VALUE 0x0000 /* @ECU_Address@CAL_Cspf_MainReLay_u8@ */ Scalar_UBYTE 0 SWC_CSPF_CM_uint8 0 255 /end CHARACTERISTIC
/begin CHARACTERISTIC CAL_Cspf_bDernCAN_u8 "" VALUE 0x0000 /* @ECU_Address@CAL_Cspf_bDernCAN_u8@ */ Scalar_UBYTE 0 SWC_CSPF_CM_uint8 0 255 /end CHARACTERISTIC
/begin CHARACTERISTIC CAL_Cspf_bDernCoolantTemp_u8 "" VALUE 0x0000 /* @ECU_Address@CAL_Cspf_bDernCoolantTemp_u8@ */ Scalar_UBYTE 0 SWC_CSPF_CM_uint8 0 255 /end CHARACTERISTIC
/begin CHARACTERISTIC CAL_Cspf_bDernDbcTemp_u8 "" VALUE 0x0000 /* @ECU_Address@CAL_Cspf_bDernDbcTemp_u8@ */ Scalar_UBYTE 0 SWC_CSPF_CM_uint8 0 255 /end CHARACTERISTIC
/begin CHARACTERISTIC CAL_Cspf_bDernExcMax_u8 "" VALUE 0x0000 /* @ECU_Address@CAL_Cspf_bDernExcMax_u8@ */ Scalar_UBYTE 0 SWC_CSPF_CM_uint8 0 255 /end CHARACTERISTIC
/begin CHARACTERISTIC CAL_Cspf_bDernExcMin_u8 "" VALUE 0x0000 /* @ECU_Address@CAL_Cspf_bDernExcMin_u8@ */ Scalar_UBYTE 0 SWC_CSPF_CM_uint8 0 255 /end CHARACTERISTIC
/begin CHARACTERISTIC CAL_Cspf_bDernMtrSpd_u8 "" VALUE 0x0000 /* @ECU_Address@CAL_Cspf_bDernMtrSpd_u8@ */ Scalar_UBYTE 0 SWC_CSPF_CM_uint8 0 255 /end CHARACTERISTIC
/begin CHARACTERISTIC CAL_Cspf_bDernOvrIdc_u8 "" VALUE 0x0000 /* @ECU_Address@CAL_Cspf_bDernOvrIdc_u8@ */ Scalar_UBYTE 0 SWC_CSPF_CM_uint8 0 255 /end CHARACTERISTIC
/begin CHARACTERISTIC CAL_Cspf_bDernOvrUdc_u8 "" VALUE 0x0000 /* @ECU_Address@CAL_Cspf_bDernOvrUdc_u8@ */ Scalar_UBYTE 0 SWC_CSPF_CM_uint8 0 255 /end CHARACTERISTIC
/begin CHARACTERISTIC CAL_Cspf_bDernStrTemp_u8 "" VALUE 0x0000 /* @ECU_Address@CAL_Cspf_bDernStrTemp_u8@ */ Scalar_UBYTE 0 SWC_CSPF_CM_uint8 0 255 /end CHARACTERISTIC
/begin CHARACTERISTIC CAL_Cspf_bDernUndrUdc_u8 "" VALUE 0x0000 /* @ECU_Address@CAL_Cspf_bDernUndrUdc_u8@ */ Scalar_UBYTE 0 SWC_CSPF_CM_uint8 0 255 /end CHARACTERISTIC
/begin CHARACTERISTIC CAL_Cspf_bReadyHV_u8 "" VALUE 0x0000 /* @ECU_Address@CAL_Cspf_bReadyHV_u8@ */ Scalar_UBYTE 0 SWC_CSPF_CM_uint8 0 255 /end CHARACTERISTIC
/begin CHARACTERISTIC CAL_Cspf_flgOfsClbSuc_u8 "" VALUE 0x0000 /* @ECU_Address@CAL_Cspf_flgOfsClbSuc_u8@ */ Scalar_UBYTE 0 SWC_CSPF_CM_uint8 0 255 /end CHARACTERISTIC
/begin CHARACTERISTIC CAL_Cspf_stDisChg_u8 "" VALUE 0x0000 /* @ECU_Address@CAL_Cspf_stDisChg_u8@ */ Scalar_UBYTE 0 SWC_CSPF_CM_uint8 0 255 /end CHARACTERISTIC
/begin CHARACTERISTIC CAL_Cspf_stDmpCtLReq_u8 "" VALUE 0x0000 /* @ECU_Address@CAL_Cspf_stDmpCtLReq_u8@ */ Scalar_UBYTE 0 SWC_CSPF_CM_uint8 0 255 /end CHARACTERISTIC
/begin CHARACTERISTIC CAL_Cspf_stGateDrv_u8 "" VALUE 0x0000 /* @ECU_Address@CAL_Cspf_stGateDrv_u8@ */ Scalar_UBYTE 0 SWC_CSPF_CM_uint8 0 255 /end CHARACTERISTIC
/begin CHARACTERISTIC CAL_Cspf_stModeReq_u8 "" VALUE 0x0000 /* @ECU_Address@CAL_Cspf_stModeReq_u8@ */ Scalar_UBYTE 0 SWC_CSPF_CM_uint8 0 255 /end CHARACTERISTIC
/begin CHARACTERISTIC CAL_Cspf_stMode_u8 "" VALUE 0x0000 /* @ECU_Address@CAL_Cspf_stMode_u8@ */ Scalar_UBYTE 0 SWC_CSPF_CM_uint8 0 255 /end CHARACTERISTIC
/begin CHARACTERISTIC CAL_Cspf_stTrqEmMax_u8 "" VALUE 0x0000 /* @ECU_Address@CAL_Cspf_stTrqEmMax_u8@ */ Scalar_UBYTE 0 SWC_CSPF_CM_uint8 0 255 /end CHARACTERISTIC
/begin CHARACTERISTIC CAL_Cspf_stTrqEmMin_u8 "" VALUE 0x0000 /* @ECU_Address@CAL_Cspf_stTrqEmMin_u8@ */ Scalar_UBYTE 0 SWC_CSPF_CM_uint8 0 255 /end CHARACTERISTIC
/begin MEASUREMENT VAR_Cspf_TraTrqCurr_f32 "" FLOAT32_IEEE SWC_CSPF_CM_single 0 0 -3.4E+38 3.4E+38 ECU_ADDRESS 0x0000 /* @ECU_Address@VAR_Cspf_TraTrqCurr_f32@ */ /end MEASUREMENT
/begin MEASUREMENT VAR_Cspf_TraUdcCurr_f32 "" FLOAT32_IEEE SWC_CSPF_CM_single 0 0 -3.4E+38 3.4E+38 ECU_ADDRESS 0x0000 /* @ECU_Address@VAR_Cspf_TraUdcCurr_f32@ */ /end MEASUREMENT
/begin MEASUREMENT VAR_Cspf_TraNCurr_f32 "" FLOAT32_IEEE SWC_CSPF_CM_single 0 0 -3.4E+38 3.4E+38 ECU_ADDRESS 0x0000 /* @ECU_Address@VAR_Cspf_TraNCurr_f32@ */ /end MEASUREMENT
/begin MEASUREMENT VAR_Cspf_TraisCurr_f32 "" FLOAT32_IEEE SWC_CSPF_CM_single 0 0 -3.4E+38 3.4E+38 ECU_ADDRESS 0x0000 /* @ECU_Address@VAR_Cspf_TraisCurr_f32@ */ /end MEASUREMENT
/begin MEASUREMENT VAR_Cspf_TraagRtrELecSnsr_f32 "" FLOAT32_IEEE SWC_CSPF_CM_single 0 0 -3.4E+38 3.4E+38 ECU_ADDRESS 0x0000 /* @ECU_Address@VAR_Cspf_TraagRtrELecSnsr_f32@ */ /end MEASUREMENT
/begin MEASUREMENT VAR_Cspf_Traisd_f32 "" FLOAT32_IEEE SWC_CSPF_CM_single 0 0 -3.4E+38 3.4E+38 ECU_ADDRESS 0x0000 /* @ECU_Address@VAR_Cspf_Traisd_f32@ */ /end MEASUREMENT
/begin MEASUREMENT VAR_Cspf_Traisq_f32 "" FLOAT32_IEEE SWC_CSPF_CM_single 0 0 -3.4E+38 3.4E+38 ECU_ADDRESS 0x0000 /* @ECU_Address@VAR_Cspf_Traisq_f32@ */ /end MEASUREMENT
/begin MEASUREMENT VAR_Cspf_TraTrqCurrWoDmpC_f32 "" FLOAT32_IEEE SWC_CSPF_CM_single 0 0 -3.4E+38 3.4E+38 ECU_ADDRESS 0x0000 /* @ECU_Address@VAR_Cspf_TraTrqCurrWoDmpC_f32@ */ /end MEASUREMENT
/begin MEASUREMENT VAR_Cspf_TraOfsAL_f32 "" FLOAT32_IEEE SWC_CSPF_CM_single 0 0 -3.4E+38 3.4E+38 ECU_ADDRESS 0x0000 /* @ECU_Address@VAR_Cspf_TraOfsAL_f32@ */ /end MEASUREMENT
/begin MEASUREMENT VAR_Cspf_TraiGBTTempU_f32 "" FLOAT32_IEEE SWC_CSPF_CM_single 0 0 -3.4E+38 3.4E+38 ECU_ADDRESS 0x0000 /* @ECU_Address@VAR_Cspf_TraiGBTTempU_f32@ */ /end MEASUREMENT
/begin MEASUREMENT VAR_Cspf_TraiGBTTempV_f32 "" FLOAT32_IEEE SWC_CSPF_CM_single 0 0 -3.4E+38 3.4E+38 ECU_ADDRESS 0x0000 /* @ECU_Address@VAR_Cspf_TraiGBTTempV_f32@ */ /end MEASUREMENT
/begin MEASUREMENT VAR_Cspf_TraiGBTTempW_f32 "" FLOAT32_IEEE SWC_CSPF_CM_single 0 0 -3.4E+38 3.4E+38 ECU_ADDRESS 0x0000 /* @ECU_Address@VAR_Cspf_TraiGBTTempW_f32@ */ /end MEASUREMENT
/begin MEASUREMENT VAR_Cspf_TraTempCurrStr1_f32 "" FLOAT32_IEEE SWC_CSPF_CM_single 0 0 -3.4E+38 3.4E+38 ECU_ADDRESS 0x0000 /* @ECU_Address@VAR_Cspf_TraTempCurrStr1_f32@ */ /end MEASUREMENT
/begin MEASUREMENT VAR_Cspf_TraTempCurrStr2_f32 "" FLOAT32_IEEE SWC_CSPF_CM_single 0 0 -3.4E+38 3.4E+38 ECU_ADDRESS 0x0000 /* @ECU_Address@VAR_Cspf_TraTempCurrStr2_f32@ */ /end MEASUREMENT
/begin MEASUREMENT VAR_Cspf_TraTempCurrCooL_f32 "" FLOAT32_IEEE SWC_CSPF_CM_single 0 0 -3.4E+38 3.4E+38 ECU_ADDRESS 0x0000 /* @ECU_Address@VAR_Cspf_TraTempCurrCooL_f32@ */ /end MEASUREMENT
/begin MEASUREMENT VAR_Cspf_TraidcCurr_f32 "" FLOAT32_IEEE SWC_CSPF_CM_single 0 0 -3.4E+38 3.4E+38 ECU_ADDRESS 0x0000 /* @ECU_Address@VAR_Cspf_TraidcCurr_f32@ */ /end MEASUREMENT
/begin MEASUREMENT VAR_Cspf_TraTrqAbsMax_f32 "" FLOAT32_IEEE SWC_CSPF_CM_single 0 0 -3.4E+38 3.4E+38 ECU_ADDRESS 0x0000 /* @ECU_Address@VAR_Cspf_TraTrqAbsMax_f32@ */ /end MEASUREMENT
/begin MEASUREMENT VAR_Cspf_TraTrqAbsMin_f32 "" FLOAT32_IEEE SWC_CSPF_CM_single 0 0 -3.4E+38 3.4E+38 ECU_ADDRESS 0x0000 /* @ECU_Address@VAR_Cspf_TraTrqAbsMin_f32@ */ /end MEASUREMENT
/begin MEASUREMENT VAR_Cspf_TraUT30Curr_f32 "" FLOAT32_IEEE SWC_CSPF_CM_single 0 0 -3.4E+38 3.4E+38 ECU_ADDRESS 0x0000 /* @ECU_Address@VAR_Cspf_TraUT30Curr_f32@ */ /end MEASUREMENT
/begin MEASUREMENT VAR_Cspf_TraHwVer_u16 "" UWORD SWC_CSPF_CM_uint16 0 0 0 65535 ECU_ADDRESS 0x0000 /* @ECU_Address@VAR_Cspf_TraHwVer_u16@ */ /end MEASUREMENT
/begin MEASUREMENT VAR_Cspf_TrabDernDrvBoardTemp_u16 "" UWORD SWC_CSPF_CM_uint16 0 0 0 65535 ECU_ADDRESS 0x0000 /* @ECU_Address@VAR_Cspf_TrabDernDrvBoardTemp_u16@ */ /end MEASUREMENT
/begin MEASUREMENT VAR_Cspf_TraCpldVer_u16 "" UWORD SWC_CSPF_CM_uint16 0 0 0 65535 ECU_ADDRESS 0x0000 /* @ECU_Address@VAR_Cspf_TraCpldVer_u16@ */ /end MEASUREMENT
/begin MEASUREMENT VAR_Cspf_TraHvMcuVer_u16 "" UWORD SWC_CSPF_CM_uint16 0 0 0 65535 ECU_ADDRESS 0x0000 /* @ECU_Address@VAR_Cspf_TraHvMcuVer_u16@ */ /end MEASUREMENT
/begin MEASUREMENT VAR_Cspf_TrastMode_u8 "" UBYTE SWC_CSPF_CM_uint8 0 0 0 255 ECU_ADDRESS 0x0000 /* @ECU_Address@VAR_Cspf_TrastMode_u8@ */ /end MEASUREMENT
/begin MEASUREMENT VAR_Cspf_TraflgOfsClbSuc_u8 "" UBYTE SWC_CSPF_CM_uint8 0 0 0 255 ECU_ADDRESS 0x0000 /* @ECU_Address@VAR_Cspf_TraflgOfsClbSuc_u8@ */ /end MEASUREMENT
/begin MEASUREMENT VAR_Cspf_TrastGateDrv_u8 "" UBYTE SWC_CSPF_CM_uint8 0 0 0 255 ECU_ADDRESS 0x0000 /* @ECU_Address@VAR_Cspf_TrastGateDrv_u8@ */ /end MEASUREMENT
/begin MEASUREMENT VAR_Cspf_TrastDischg_u8 "" UBYTE SWC_CSPF_CM_uint8 0 0 0 255 ECU_ADDRESS 0x0000 /* @ECU_Address@VAR_Cspf_TrastDischg_u8@ */ /end MEASUREMENT
/begin MEASUREMENT VAR_Cspf_TrabDernCAN_u8 "" UBYTE SWC_CSPF_CM_uint8 0 0 0 255 ECU_ADDRESS 0x0000 /* @ECU_Address@VAR_Cspf_TrabDernCAN_u8@ */ /end MEASUREMENT
/begin MEASUREMENT VAR_Cspf_TrabDernN_u8 "" UBYTE SWC_CSPF_CM_uint8 0 0 0 255 ECU_ADDRESS 0x0000 /* @ECU_Address@VAR_Cspf_TrabDernN_u8@ */ /end MEASUREMENT
/begin MEASUREMENT VAR_Cspf_TrabDernOvridc_u8 "" UBYTE SWC_CSPF_CM_uint8 0 0 0 255 ECU_ADDRESS 0x0000 /* @ECU_Address@VAR_Cspf_TrabDernOvridc_u8@ */ /end MEASUREMENT
/begin MEASUREMENT VAR_Cspf_TrabDernOvrUdc_u8 "" UBYTE SWC_CSPF_CM_uint8 0 0 0 255 ECU_ADDRESS 0x0000 /* @ECU_Address@VAR_Cspf_TrabDernOvrUdc_u8@ */ /end MEASUREMENT
/begin MEASUREMENT VAR_Cspf_TrabDernStrTemp_u8 "" UBYTE SWC_CSPF_CM_uint8 0 0 0 255 ECU_ADDRESS 0x0000 /* @ECU_Address@VAR_Cspf_TrabDernStrTemp_u8@ */ /end MEASUREMENT
/begin MEASUREMENT VAR_Cspf_TrabDernTempCooL_u8 "" UBYTE SWC_CSPF_CM_uint8 0 0 0 255 ECU_ADDRESS 0x0000 /* @ECU_Address@VAR_Cspf_TrabDernTempCooL_u8@ */ /end MEASUREMENT
/begin MEASUREMENT VAR_Cspf_TrabDernTempiGBT_u8 "" UBYTE SWC_CSPF_CM_uint8 0 0 0 255 ECU_ADDRESS 0x0000 /* @ECU_Address@VAR_Cspf_TrabDernTempiGBT_u8@ */ /end MEASUREMENT
/begin MEASUREMENT VAR_Cspf_TrabDernUndrUdc_u8 "" UBYTE SWC_CSPF_CM_uint8 0 0 0 255 ECU_ADDRESS 0x0000 /* @ECU_Address@VAR_Cspf_TrabDernUndrUdc_u8@ */ /end MEASUREMENT
/begin MEASUREMENT VAR_Cspf_TrastTrqEmMax_u8 "" UBYTE SWC_CSPF_CM_uint8 0 0 0 255 ECU_ADDRESS 0x0000 /* @ECU_Address@VAR_Cspf_TrastTrqEmMax_u8@ */ /end MEASUREMENT
/begin MEASUREMENT VAR_Cspf_TrastTrqEmMin_u8 "" UBYTE SWC_CSPF_CM_uint8 0 0 0 255 ECU_ADDRESS 0x0000 /* @ECU_Address@VAR_Cspf_TrastTrqEmMin_u8@ */ /end MEASUREMENT
/begin MEASUREMENT VAR_Cspf_TrabDernTrqMax_u8 "" UBYTE SWC_CSPF_CM_uint8 0 0 0 255 ECU_ADDRESS 0x0000 /* @ECU_Address@VAR_Cspf_TrabDernTrqMax_u8@ */ /end MEASUREMENT
/begin MEASUREMENT VAR_Cspf_TrabDernTrqMin_u8 "" UBYTE SWC_CSPF_CM_uint8 0 0 0 255 ECU_ADDRESS 0x0000 /* @ECU_Address@VAR_Cspf_TrabDernTrqMin_u8@ */ /end MEASUREMENT
/begin MEASUREMENT VAR_Cspf_TrabReadyHV_u8 "" UBYTE SWC_CSPF_CM_uint8 0 0 0 255 ECU_ADDRESS 0x0000 /* @ECU_Address@VAR_Cspf_TrabReadyHV_u8@ */ /end MEASUREMENT
/begin MEASUREMENT VAR_Cspf_TraFailCode1_u8 "" UBYTE SWC_CSPF_CM_uint8 0 0 0 255 ECU_ADDRESS 0x0000 /* @ECU_Address@VAR_Cspf_TraFailCode1_u8@ */ /end MEASUREMENT
/begin MEASUREMENT VAR_Cspf_TraFailCode2_u8 "" UBYTE SWC_CSPF_CM_uint8 0 0 0 255 ECU_ADDRESS 0x0000 /* @ECU_Address@VAR_Cspf_TraFailCode2_u8@ */ /end MEASUREMENT
/begin MEASUREMENT VAR_Cspf_TraFailCode3_u8 "" UBYTE SWC_CSPF_CM_uint8 0 0 0 255 ECU_ADDRESS 0x0000 /* @ECU_Address@VAR_Cspf_TraFailCode3_u8@ */ /end MEASUREMENT
/begin MEASUREMENT VAR_Cspf_TraFailCode4_u8 "" UBYTE SWC_CSPF_CM_uint8 0 0 0 255 ECU_ADDRESS 0x0000 /* @ECU_Address@VAR_Cspf_TraFailCode4_u8@ */ /end MEASUREMENT
/begin MEASUREMENT VAR_Cspf_TraFailCode5_u8 "" UBYTE SWC_CSPF_CM_uint8 0 0 0 255 ECU_ADDRESS 0x0000 /* @ECU_Address@VAR_Cspf_TraFailCode5_u8@ */ /end MEASUREMENT
/begin MEASUREMENT VAR_Cspf_TraFailCode6_u8 "" UBYTE SWC_CSPF_CM_uint8 0 0 0 255 ECU_ADDRESS 0x0000 /* @ECU_Address@VAR_Cspf_TraFailCode6_u8@ */ /end MEASUREMENT
/begin MEASUREMENT VAR_Cspf_TraFailCode7_u8 "" UBYTE SWC_CSPF_CM_uint8 0 0 0 255 ECU_ADDRESS 0x0000 /* @ECU_Address@VAR_Cspf_TraFailCode7_u8@ */ /end MEASUREMENT
/begin MEASUREMENT VAR_Cspf_TraFailCode8_u8 "" UBYTE SWC_CSPF_CM_uint8 0 0 0 255 ECU_ADDRESS 0x0000 /* @ECU_Address@VAR_Cspf_TraFailCode8_u8@ */ /end MEASUREMENT
/begin COMPU_METHOD SWC_CSPF_CM_single "Q = V" RAT_FUNC "%8.6" "" COEFFS 0 1 0 0 0 1 /end COMPU_METHOD
/begin COMPU_METHOD SWC_CSPF_CM_uint16 "Q = V" RAT_FUNC "%5.0" "" COEFFS 0 1 0 0 0 1 /end COMPU_METHOD
/begin COMPU_METHOD SWC_CSPF_CM_boolean "Q = V" RAT_FUNC "%1.0" "" COEFFS 0 1 0 0 0 1 /end COMPU_METHOD
/begin COMPU_METHOD SWC_CSPF_CM_uint8 "Q = V" RAT_FUNC "%3.0" "" COEFFS 0 1 0 0 0 1 /end COMPU_METHOD
/begin GROUP SWC_CSPF "SWC_CSPF" /* Root */ ROOT /begin SUB_GROUP Root_RE_SWC_CSPF_100ms_sys Root_RE_SWC_CSPF_10ms_sys /end SUB_GROUP /end GROUP
/begin GROUP Root_RE_SWC_CSPF_100ms_sys "SWC_CSPF/RE_SWC_CSPF_100ms_sys" /begin SUB_GROUP S1_CSPF_Rec_100ms S1_CSPF_Tra_100ms /end SUB_GROUP /end GROUP
/begin GROUP Root_RE_SWC_CSPF_10ms_sys "SWC_CSPF/RE_SWC_CSPF_10ms_sys" /begin SUB_GROUP S2_CSPF_Rec_10ms S2_CSPF_Tra_10ms /end SUB_GROUP /end GROUP
/begin GROUP S1_CSPF_Rec_100ms "SWC_CSPF/RE_SWC_CSPF_100ms_sys/CSPF_Rec_100ms" /begin SUB_GROUP S4_VCU01 /end SUB_GROUP /end GROUP
/begin GROUP S1_CSPF_Tra_100ms "SWC_CSPF/RE_SWC_CSPF_100ms_sys/CSPF_Tra_100ms" /begin SUB_GROUP S5_CSDTra_100ms S5_CSDTra_100ms_sub2 /end SUB_GROUP /end GROUP
/begin GROUP S2_CSPF_Rec_10ms "SWC_CSPF/RE_SWC_CSPF_10ms_sys/CSPF_Rec_10ms" /begin SUB_GROUP S45_CanSig_Select /end SUB_GROUP /end GROUP
/begin GROUP S2_CSPF_Tra_10ms "SWC_CSPF/RE_SWC_CSPF_10ms_sys/CSPF_Tra_10ms" /begin SUB_GROUP S46_CSPFTra_10ms /end SUB_GROUP /end GROUP
/begin GROUP S4_VCU01 "SWC_CSPF/RE_SWC_CSPF_100ms_sys/CSPF_Rec_100ms/VCU01" /begin SUB_GROUP S6_Subsystem1 S6_Subsystem2 S6_Subsystem3 S6_Subsystem4 /end SUB_GROUP /end GROUP
/begin GROUP S5_CSDTra_100ms "SWC_CSPF/RE_SWC_CSPF_100ms_sys/CSPF_Tra_100ms/CSDTra_100ms" /begin SUB_GROUP S12_PEB02 /end SUB_GROUP /end GROUP
/begin GROUP S5_CSDTra_100ms_sub2 "SWC_CSPF/RE_SWC_CSPF_100ms_sys/CSPF_Tra_100ms/CSDTra_100ms_sub2" /begin SUB_GROUP S13_PEB05 S13_PEB06 S13_Subsystem11 /end SUB_GROUP /end GROUP
/begin GROUP S45_CanSig_Select "SWC_CSPF/RE_SWC_CSPF_10ms_sys/CSPF_Rec_10ms/CanSig_Select"
 /begin SUB_GROUP S47_BMS01 S47_Subsystem1 S47_Subsystem22 S47_VCU02 S47_VCU03 S47_VCU04 S47_VCU05 /end SUB_GROUP
/end GROUP
/begin GROUP S46_CSPFTra_10ms "SWC_CSPF/RE_SWC_CSPF_10ms_sys/CSPF_Tra_10ms/CSPFTra_10ms" /begin SUB_GROUP S77_PEB01 S77_PEB03 S77_PEB04 S77_PEB08 S77_Subsystem8 /end SUB_GROUP /end GROUP
/begin GROUP S6_Subsystem1 "SWC_CSPF/RE_SWC_CSPF_100ms_sys/CSPF_Rec_100ms/VCU01/Subsystem1" /begin REF_CHARACTERISTIC CAL_Cspf_UdcMin_f32 CAL_Cspf_flgUdcMinSwt_b /end REF_CHARACTERISTIC /end GROUP
/begin GROUP S6_Subsystem2 "SWC_CSPF/RE_SWC_CSPF_100ms_sys/CSPF_Rec_100ms/VCU01/Subsystem2" /begin REF_CHARACTERISTIC CAL_Cspf_UdcMax_f32 CAL_Cspf_flgUdcMaxSwt_b /end REF_CHARACTERISTIC /end GROUP
/begin GROUP S6_Subsystem3 "SWC_CSPF/RE_SWC_CSPF_100ms_sys/CSPF_Rec_100ms/VCU01/Subsystem3" /begin REF_CHARACTERISTIC CAL_Cspf_IdcMin_f32 CAL_Cspf_flgIdcMinSwt_b /end REF_CHARACTERISTIC /end GROUP
/begin GROUP S6_Subsystem4 "SWC_CSPF/RE_SWC_CSPF_100ms_sys/CSPF_Rec_100ms/VCU01/Subsystem4" /begin REF_CHARACTERISTIC CAL_Cspf_IdcMax_f32 CAL_Cspf_flgIdcMaxSwt_b /end REF_CHARACTERISTIC /end GROUP
/begin GROUP S12_PEB02 "SWC_CSPF/RE_SWC_CSPF_100ms_sys/CSPF_Tra_100ms/CSDTra_100ms/PEB02"
 /begin SUB_GROUP S14_Subsystem1 S14_Subsystem10 S14_Subsystem11 S14_Subsystem12 S14_Subsystem13 S14_Subsystem14 S14_Subsystem15 S14_Subsystem16 S14_Subsystem17 S14_Subsystem2 S14_Subsystem3 S14_Subsystem4 S14_Subsystem5 S14_Subsystem6 S14_Subsystem7 S14_Subsystem8 S14_Subsystem9 /end SUB_GROUP
/end GROUP
/begin GROUP S13_PEB05 "SWC_CSPF/RE_SWC_CSPF_100ms_sys/CSPF_Tra_100ms/CSDTra_100ms_sub2/PEB05"
 /begin SUB_GROUP S32_Subsystem18 S32_Subsystem19 S32_Subsystem20 S32_Subsystem21 S32_Subsystem22 S32_Subsystem23 S32_Subsystem24 S32_Subsystem25 /end SUB_GROUP
/end GROUP
/begin GROUP S13_PEB06 "SWC_CSPF/RE_SWC_CSPF_100ms_sys/CSPF_Tra_100ms/CSDTra_100ms_sub2/PEB06" /begin SUB_GROUP S33_Subsystem26 S33_Subsystem27 /end SUB_GROUP /begin REF_CHARACTERISTIC CAL_Cspf_CodeVer_u16 CAL_Cspf_DataVer_u16 /end REF_CHARACTERISTIC /end GROUP
/begin GROUP S13_Subsystem11 "SWC_CSPF/RE_SWC_CSPF_100ms_sys/CSPF_Tra_100ms/CSDTra_100ms_sub2/Subsystem11"
 /begin REF_CHARACTERISTIC CAL_Cspf_bDernDrvBoardTemp_u16 CAL_Cspf_flgbDernDrvBoardTempSwt_b /end REF_CHARACTERISTIC
 /begin REF_MEASUREMENT VAR_Cspf_TrabDernDrvBoardTemp_u16 /end REF_MEASUREMENT
/end GROUP
/begin GROUP S47_BMS01 "SWC_CSPF/RE_SWC_CSPF_10ms_sys/CSPF_Rec_10ms/CanSig_Select/BMS01" /begin SUB_GROUP S48_Subsystem26 /end SUB_GROUP /end GROUP
/begin GROUP S47_Subsystem1 "SWC_CSPF/RE_SWC_CSPF_10ms_sys/CSPF_Rec_10ms/CanSig_Select/Subsystem1" /begin REF_CHARACTERISTIC CAL_Cspf_flgCrashSwt_b CAL_Cspf_flgCrash_b /end REF_CHARACTERISTIC /end GROUP
/begin GROUP S47_Subsystem22 "SWC_CSPF/RE_SWC_CSPF_10ms_sys/CSPF_Rec_10ms/CanSig_Select/Subsystem22" /begin REF_CHARACTERISTIC CAL_Cspf_flgDchaReqSwt_b CAL_Cspf_flgDchaReq_b /end REF_CHARACTERISTIC /end GROUP
/begin GROUP S47_VCU02 "SWC_CSPF/RE_SWC_CSPF_10ms_sys/CSPF_Rec_10ms/CanSig_Select/VCU02"
 /begin SUB_GROUP S51_Subsystem S51_Subsystem1 S51_Subsystem2 S51_Subsystem24 S51_Subsystem3 /end SUB_GROUP
/end GROUP
/begin GROUP S47_VCU03 "SWC_CSPF/RE_SWC_CSPF_10ms_sys/CSPF_Rec_10ms/CanSig_Select/VCU03" /begin SUB_GROUP S52_Subsystem4 S52_Subsystem5 S52_Subsystem6 /end SUB_GROUP /end GROUP
/begin GROUP S47_VCU04 "SWC_CSPF/RE_SWC_CSPF_10ms_sys/CSPF_Rec_10ms/CanSig_Select/VCU04" /begin SUB_GROUP S53_Subsystem10 S53_Subsystem11 S53_Subsystem9 /end SUB_GROUP /end GROUP
/begin GROUP S47_VCU05 "SWC_CSPF/RE_SWC_CSPF_10ms_sys/CSPF_Rec_10ms/CanSig_Select/VCU05"
 /begin SUB_GROUP S54_Subsystem13 S54_Subsystem15 S54_Subsystem16 S54_Subsystem17 /end SUB_GROUP
/end GROUP
/begin GROUP S77_PEB01 "SWC_CSPF/RE_SWC_CSPF_10ms_sys/CSPF_Tra_10ms/CSPFTra_10ms/PEB01"
 /begin SUB_GROUP S78_Subsystem1 S78_Subsystem2 S78_Subsystem3 S78_Subsystem4 S78_stMode /end SUB_GROUP
/end GROUP
/begin GROUP S77_PEB03 "SWC_CSPF/RE_SWC_CSPF_10ms_sys/CSPF_Tra_10ms/CSPFTra_10ms/PEB03"
 /begin SUB_GROUP S79_Subsystem10 S79_Subsystem5 S79_Subsystem6 S79_Subsystem7 S79_Subsystem9 /end SUB_GROUP
/end GROUP
/begin GROUP S77_PEB04 "SWC_CSPF/RE_SWC_CSPF_10ms_sys/CSPF_Tra_10ms/CSPFTra_10ms/PEB04"
 /begin SUB_GROUP S80_Subsystem11 S80_Subsystem12 S80_Subsystem13 S80_Subsystem14 S80_Subsystem15 S80_Subsystem16 S80_stGateDrv /end SUB_GROUP
/end GROUP
/begin GROUP S77_PEB08 "SWC_CSPF/RE_SWC_CSPF_10ms_sys/CSPF_Tra_10ms/CSPFTra_10ms/PEB08" /begin SUB_GROUP S81_Subsystem17 S81_Subsystem18 /end SUB_GROUP /end GROUP
/begin GROUP S77_Subsystem8 "SWC_CSPF/RE_SWC_CSPF_10ms_sys/CSPF_Tra_10ms/CSPFTra_10ms/Subsystem8"
 /begin REF_CHARACTERISTIC CAL_Cspf_flgtCoolantTempFltSwt_b CAL_Cspf_tCoolantTempFlt_f32 /end REF_CHARACTERISTIC
 /begin REF_MEASUREMENT VAR_Cspf_TraTempCurrCooL_f32 /end REF_MEASUREMENT
/end GROUP
/begin GROUP S14_Subsystem1 "SWC_CSPF/RE_SWC_CSPF_100ms_sys/CSPF_Tra_100ms/CSDTra_100ms/PEB02/Subsystem1" /begin REF_CHARACTERISTIC CAL_Cspf_bDernMtrSpd_u8 CAL_Cspf_flgbDernMtrSpdSwt_b /end REF_CHARACTERISTIC /begin REF_MEASUREMENT VAR_Cspf_TrabDernN_u8 /end REF_MEASUREMENT /end GROUP
/begin GROUP S14_Subsystem10 "SWC_CSPF/RE_SWC_CSPF_100ms_sys/CSPF_Tra_100ms/CSDTra_100ms/PEB02/Subsystem10" /begin REF_CHARACTERISTIC CAL_Cspf_bDernCAN_u8 CAL_Cspf_flgbDernCANSwt_b /end REF_CHARACTERISTIC /begin REF_MEASUREMENT VAR_Cspf_TrabDernCAN_u8 /end REF_MEASUREMENT /end GROUP
/begin GROUP S14_Subsystem11 "SWC_CSPF/RE_SWC_CSPF_100ms_sys/CSPF_Tra_100ms/CSDTra_100ms/PEB02/Subsystem11" /begin REF_CHARACTERISTIC CAL_Cspf_bReadyHV_u8 CAL_Cspf_flgbReadyHVSwt_b /end REF_CHARACTERISTIC /begin REF_MEASUREMENT VAR_Cspf_TrabReadyHV_u8 /end REF_MEASUREMENT /end GROUP
/begin GROUP S14_Subsystem12 "SWC_CSPF/RE_SWC_CSPF_100ms_sys/CSPF_Tra_100ms/CSDTra_100ms/PEB02/Subsystem12" /begin REF_CHARACTERISTIC CAL_Cspf_flgiDcLnkEstFltSwt_b CAL_Cspf_iDcLnkEstFlt_f32 /end REF_CHARACTERISTIC /begin REF_MEASUREMENT VAR_Cspf_TraidcCurr_f32 /end REF_MEASUREMENT /end GROUP
/begin GROUP S14_Subsystem13 "SWC_CSPF/RE_SWC_CSPF_100ms_sys/CSPF_Tra_100ms/CSDTra_100ms/PEB02/Subsystem13" /begin REF_CHARACTERISTIC CAL_Cspf_flgstTrqEmMaxSwt_b CAL_Cspf_stTrqEmMax_u8 /end REF_CHARACTERISTIC /begin REF_MEASUREMENT VAR_Cspf_TrastTrqEmMax_u8 /end REF_MEASUREMENT /end GROUP
/begin GROUP S14_Subsystem14 "SWC_CSPF/RE_SWC_CSPF_100ms_sys/CSPF_Tra_100ms/CSDTra_100ms/PEB02/Subsystem14" /begin REF_CHARACTERISTIC CAL_Cspf_flgstTrqEmMinSwt_b CAL_Cspf_stTrqEmMin_u8 /end REF_CHARACTERISTIC /begin REF_MEASUREMENT VAR_Cspf_TrastTrqEmMin_u8 /end REF_MEASUREMENT /end GROUP
/begin GROUP S14_Subsystem15 "SWC_CSPF/RE_SWC_CSPF_100ms_sys/CSPF_Tra_100ms/CSDTra_100ms/PEB02/Subsystem15" /begin REF_CHARACTERISTIC CAL_Cspf_TraTrqMax_f32 CAL_Cspf_flgTraTrqMaxSwt_b /end REF_CHARACTERISTIC /begin REF_MEASUREMENT VAR_Cspf_TraTrqAbsMax_f32 /end REF_MEASUREMENT /end GROUP
/begin GROUP S14_Subsystem16 "SWC_CSPF/RE_SWC_CSPF_100ms_sys/CSPF_Tra_100ms/CSDTra_100ms/PEB02/Subsystem16" /begin REF_CHARACTERISTIC CAL_Cspf_TraTrqMin_f32 CAL_Cspf_flgTraTrqMinSwt_b /end REF_CHARACTERISTIC /begin REF_MEASUREMENT VAR_Cspf_TraTrqAbsMin_f32 /end REF_MEASUREMENT /end GROUP
/begin GROUP S14_Subsystem17 "SWC_CSPF/RE_SWC_CSPF_100ms_sys/CSPF_Tra_100ms/CSDTra_100ms/PEB02/Subsystem17" /begin REF_CHARACTERISTIC CAL_Cspf_flguKl30FltSwt_b CAL_Cspf_uKl30Flt_f32 /end REF_CHARACTERISTIC /begin REF_MEASUREMENT VAR_Cspf_TraUT30Curr_f32 /end REF_MEASUREMENT /end GROUP
/begin GROUP S14_Subsystem2 "SWC_CSPF/RE_SWC_CSPF_100ms_sys/CSPF_Tra_100ms/CSDTra_100ms/PEB02/Subsystem2" /begin REF_CHARACTERISTIC CAL_Cspf_bDernOvrIdc_u8 CAL_Cspf_flgbDernOvrIdcSwt_b /end REF_CHARACTERISTIC /begin REF_MEASUREMENT VAR_Cspf_TrabDernOvridc_u8 /end REF_MEASUREMENT /end GROUP
/begin GROUP S14_Subsystem3 "SWC_CSPF/RE_SWC_CSPF_100ms_sys/CSPF_Tra_100ms/CSDTra_100ms/PEB02/Subsystem3" /begin REF_CHARACTERISTIC CAL_Cspf_bDernOvrUdc_u8 CAL_Cspf_flgbDernOvrUdcSwt_b /end REF_CHARACTERISTIC /begin REF_MEASUREMENT VAR_Cspf_TrabDernOvrUdc_u8 /end REF_MEASUREMENT /end GROUP
/begin GROUP S14_Subsystem4 "SWC_CSPF/RE_SWC_CSPF_100ms_sys/CSPF_Tra_100ms/CSDTra_100ms/PEB02/Subsystem4" /begin REF_CHARACTERISTIC CAL_Cspf_bDernStrTemp_u8 CAL_Cspf_flgbDernStrTempSwt_b /end REF_CHARACTERISTIC /begin REF_MEASUREMENT VAR_Cspf_TrabDernStrTemp_u8 /end REF_MEASUREMENT /end GROUP
/begin GROUP S14_Subsystem5 "SWC_CSPF/RE_SWC_CSPF_100ms_sys/CSPF_Tra_100ms/CSDTra_100ms/PEB02/Subsystem5"
 /begin REF_CHARACTERISTIC CAL_Cspf_bDernCoolantTemp_u8 CAL_Cspf_flgbDernCoolantTempSwt_b /end REF_CHARACTERISTIC
 /begin REF_MEASUREMENT VAR_Cspf_TrabDernTempCooL_u8 /end REF_MEASUREMENT
/end GROUP
/begin GROUP S14_Subsystem6 "SWC_CSPF/RE_SWC_CSPF_100ms_sys/CSPF_Tra_100ms/CSDTra_100ms/PEB02/Subsystem6" /begin REF_CHARACTERISTIC CAL_Cspf_bDernDbcTemp_u8 CAL_Cspf_flgbDernDbcTempSwt_b /end REF_CHARACTERISTIC /begin REF_MEASUREMENT VAR_Cspf_TrabDernTempiGBT_u8 /end REF_MEASUREMENT /end GROUP
/begin GROUP S14_Subsystem7 "SWC_CSPF/RE_SWC_CSPF_100ms_sys/CSPF_Tra_100ms/CSDTra_100ms/PEB02/Subsystem7" /begin REF_CHARACTERISTIC CAL_Cspf_bDernExcMax_u8 CAL_Cspf_flgbDernExcMaxSwt_b /end REF_CHARACTERISTIC /begin REF_MEASUREMENT VAR_Cspf_TrabDernTrqMax_u8 /end REF_MEASUREMENT /end GROUP
/begin GROUP S14_Subsystem8 "SWC_CSPF/RE_SWC_CSPF_100ms_sys/CSPF_Tra_100ms/CSDTra_100ms/PEB02/Subsystem8" /begin REF_CHARACTERISTIC CAL_Cspf_bDernExcMin_u8 CAL_Cspf_flgbDernExcMinSwt_b /end REF_CHARACTERISTIC /begin REF_MEASUREMENT VAR_Cspf_TrabDernTrqMin_u8 /end REF_MEASUREMENT /end GROUP
/begin GROUP S14_Subsystem9 "SWC_CSPF/RE_SWC_CSPF_100ms_sys/CSPF_Tra_100ms/CSDTra_100ms/PEB02/Subsystem9" /begin REF_CHARACTERISTIC CAL_Cspf_bDernUndrUdc_u8 CAL_Cspf_flgbDernUndrUdcSwt_b /end REF_CHARACTERISTIC /begin REF_MEASUREMENT VAR_Cspf_TrabDernUndrUdc_u8 /end REF_MEASUREMENT /end GROUP
/begin GROUP S32_Subsystem18 "SWC_CSPF/RE_SWC_CSPF_100ms_sys/CSPF_Tra_100ms/CSDTra_100ms_sub2/PEB05/Subsystem18" /begin REF_CHARACTERISTIC CAL_Cspf_FailCode1_u8 CAL_Cspf_flgFailCode1Swt_b /end REF_CHARACTERISTIC /begin REF_MEASUREMENT VAR_Cspf_TraFailCode1_u8 /end REF_MEASUREMENT /end GROUP
/begin GROUP S32_Subsystem19 "SWC_CSPF/RE_SWC_CSPF_100ms_sys/CSPF_Tra_100ms/CSDTra_100ms_sub2/PEB05/Subsystem19" /begin REF_CHARACTERISTIC CAL_Cspf_FailCode2_u8 CAL_Cspf_flgFailCode2Swt_b /end REF_CHARACTERISTIC /begin REF_MEASUREMENT VAR_Cspf_TraFailCode2_u8 /end REF_MEASUREMENT /end GROUP
/begin GROUP S32_Subsystem20 "SWC_CSPF/RE_SWC_CSPF_100ms_sys/CSPF_Tra_100ms/CSDTra_100ms_sub2/PEB05/Subsystem20" /begin REF_CHARACTERISTIC CAL_Cspf_FailCode3_u8 CAL_Cspf_flgFailCode3Swt_b /end REF_CHARACTERISTIC /begin REF_MEASUREMENT VAR_Cspf_TraFailCode3_u8 /end REF_MEASUREMENT /end GROUP
/begin GROUP S32_Subsystem21 "SWC_CSPF/RE_SWC_CSPF_100ms_sys/CSPF_Tra_100ms/CSDTra_100ms_sub2/PEB05/Subsystem21" /begin REF_CHARACTERISTIC CAL_Cspf_FailCode4_u8 CAL_Cspf_flgFailCode4Swt_b /end REF_CHARACTERISTIC /begin REF_MEASUREMENT VAR_Cspf_TraFailCode4_u8 /end REF_MEASUREMENT /end GROUP
/begin GROUP S32_Subsystem22 "SWC_CSPF/RE_SWC_CSPF_100ms_sys/CSPF_Tra_100ms/CSDTra_100ms_sub2/PEB05/Subsystem22" /begin REF_CHARACTERISTIC CAL_Cspf_FailCode5_u8 CAL_Cspf_flgFailCode5Swt_b /end REF_CHARACTERISTIC /begin REF_MEASUREMENT VAR_Cspf_TraFailCode5_u8 /end REF_MEASUREMENT /end GROUP
/begin GROUP S32_Subsystem23 "SWC_CSPF/RE_SWC_CSPF_100ms_sys/CSPF_Tra_100ms/CSDTra_100ms_sub2/PEB05/Subsystem23" /begin REF_CHARACTERISTIC CAL_Cspf_FailCode6_u8 CAL_Cspf_flgFailCode6Swt_b /end REF_CHARACTERISTIC /begin REF_MEASUREMENT VAR_Cspf_TraFailCode6_u8 /end REF_MEASUREMENT /end GROUP
/begin GROUP S32_Subsystem24 "SWC_CSPF/RE_SWC_CSPF_100ms_sys/CSPF_Tra_100ms/CSDTra_100ms_sub2/PEB05/Subsystem24" /begin REF_CHARACTERISTIC CAL_Cspf_FailCode7_u8 CAL_Cspf_flgFailCode7Swt_b /end REF_CHARACTERISTIC /begin REF_MEASUREMENT VAR_Cspf_TraFailCode7_u8 /end REF_MEASUREMENT /end GROUP
/begin GROUP S32_Subsystem25 "SWC_CSPF/RE_SWC_CSPF_100ms_sys/CSPF_Tra_100ms/CSDTra_100ms_sub2/PEB05/Subsystem25" /begin REF_CHARACTERISTIC CAL_Cspf_FailCode8_u8 CAL_Cspf_flgFailCode8Swt_b /end REF_CHARACTERISTIC /begin REF_MEASUREMENT VAR_Cspf_TraFailCode8_u8 /end REF_MEASUREMENT /end GROUP
/begin GROUP S33_Subsystem26 "SWC_CSPF/RE_SWC_CSPF_100ms_sys/CSPF_Tra_100ms/CSDTra_100ms_sub2/PEB06/Subsystem26" /begin REF_CHARACTERISTIC CAL_Cspf_CpldVer_u8 CAL_Cspf_flgCpldVerSwt_b /end REF_CHARACTERISTIC /begin REF_MEASUREMENT VAR_Cspf_TraCpldVer_u16 /end REF_MEASUREMENT /end GROUP
/begin GROUP S33_Subsystem27 "SWC_CSPF/RE_SWC_CSPF_100ms_sys/CSPF_Tra_100ms/CSDTra_100ms_sub2/PEB06/Subsystem27" /begin REF_CHARACTERISTIC CAL_Cspf_HvMcuVer_u8 CAL_Cspf_flgHvMcuVerSwt_b /end REF_CHARACTERISTIC /begin REF_MEASUREMENT VAR_Cspf_TraHvMcuVer_u16 /end REF_MEASUREMENT /end GROUP
/begin GROUP S48_Subsystem26 "SWC_CSPF/RE_SWC_CSPF_10ms_sys/CSPF_Rec_10ms/CanSig_Select/BMS01/Subsystem26" /begin REF_CHARACTERISTIC CAL_Cspf_MainReLay_u8 CAL_Cspf_flgstMainReLaySwt_b /end REF_CHARACTERISTIC /end GROUP
/begin GROUP S51_Subsystem "SWC_CSPF/RE_SWC_CSPF_10ms_sys/CSPF_Rec_10ms/CanSig_Select/VCU02/Subsystem" /begin REF_CHARACTERISTIC CAL_Cspf_KpHighNCtL_f32 CAL_Cspf_flgKpHighNCtLSwt_b /end REF_CHARACTERISTIC /end GROUP
/begin GROUP S51_Subsystem1 "SWC_CSPF/RE_SWC_CSPF_10ms_sys/CSPF_Rec_10ms/CanSig_Select/VCU02/Subsystem1" /begin REF_CHARACTERISTIC CAL_Cspf_NDiffMax_f32 CAL_Cspf_flgNDiffMaxSwt_b /end REF_CHARACTERISTIC /end GROUP
/begin GROUP S51_Subsystem2 "SWC_CSPF/RE_SWC_CSPF_10ms_sys/CSPF_Rec_10ms/CanSig_Select/VCU02/Subsystem2" /begin REF_CHARACTERISTIC CAL_Cspf_TrqMaxNCtL_f32 CAL_Cspf_flgTrqMaxNCtLSwt_b /end REF_CHARACTERISTIC /end GROUP
/begin GROUP S51_Subsystem24 "SWC_CSPF/RE_SWC_CSPF_10ms_sys/CSPF_Rec_10ms/CanSig_Select/VCU02/Subsystem24" /begin REF_CHARACTERISTIC CAL_Cspf_KpLowNCtl_f32 CAL_Cspf_flgKpLowNCtlSwt_b /end REF_CHARACTERISTIC /end GROUP
/begin GROUP S51_Subsystem3 "SWC_CSPF/RE_SWC_CSPF_10ms_sys/CSPF_Rec_10ms/CanSig_Select/VCU02/Subsystem3" /begin REF_CHARACTERISTIC CAL_Cspf_TrqMinNCtl_f32 CAL_Cspf_flgTrqMinNCtlSwt_b /end REF_CHARACTERISTIC /end GROUP
/begin GROUP S52_Subsystem4 "SWC_CSPF/RE_SWC_CSPF_10ms_sys/CSPF_Rec_10ms/CanSig_Select/VCU03/Subsystem4" /begin REF_CHARACTERISTIC CAL_Cspf_TrqSLope_f32 CAL_Cspf_flgcTrqSLopeSwt_b /end REF_CHARACTERISTIC /end GROUP
/begin GROUP S52_Subsystem5 "SWC_CSPF/RE_SWC_CSPF_10ms_sys/CSPF_Rec_10ms/CanSig_Select/VCU03/Subsystem5" /begin REF_CHARACTERISTIC CAL_Cspf_TrqMax_f32 CAL_Cspf_flgTrqMaxSwt_b /end REF_CHARACTERISTIC /end GROUP
/begin GROUP S52_Subsystem6 "SWC_CSPF/RE_SWC_CSPF_10ms_sys/CSPF_Rec_10ms/CanSig_Select/VCU03/Subsystem6" /begin REF_CHARACTERISTIC CAL_Cspf_TrqMin_f32 CAL_Cspf_flgTrqMinSwt_b /end REF_CHARACTERISTIC /end GROUP
/begin GROUP S53_Subsystem10 "SWC_CSPF/RE_SWC_CSPF_10ms_sys/CSPF_Rec_10ms/CanSig_Select/VCU04/Subsystem10" /begin REF_CHARACTERISTIC CAL_Cspf_flgstModeReqSwt_b CAL_Cspf_stModeReq_u8 /end REF_CHARACTERISTIC /end GROUP
/begin GROUP S53_Subsystem11 "SWC_CSPF/RE_SWC_CSPF_10ms_sys/CSPF_Rec_10ms/CanSig_Select/VCU04/Subsystem11" /begin REF_CHARACTERISTIC CAL_Cspf_TrqSetP_f32 CAL_Cspf_flgTrqSetPSwt_b /end REF_CHARACTERISTIC /end GROUP
/begin GROUP S53_Subsystem9 "SWC_CSPF/RE_SWC_CSPF_10ms_sys/CSPF_Rec_10ms/CanSig_Select/VCU04/Subsystem9" /begin REF_CHARACTERISTIC CAL_Cspf_NSetP_f32 CAL_Cspf_flgNSetPSwt_b /end REF_CHARACTERISTIC /end GROUP
/begin GROUP S54_Subsystem13 "SWC_CSPF/RE_SWC_CSPF_10ms_sys/CSPF_Rec_10ms/CanSig_Select/VCU05/Subsystem13" /begin REF_CHARACTERISTIC CAL_Cspf_flgkDmpSwt_b CAL_Cspf_kDmp_f32 /end REF_CHARACTERISTIC /end GROUP
/begin GROUP S54_Subsystem15 "SWC_CSPF/RE_SWC_CSPF_10ms_sys/CSPF_Rec_10ms/CanSig_Select/VCU05/Subsystem15" /begin REF_CHARACTERISTIC CAL_Cspf_flgstDmpCtLReqSwt_b CAL_Cspf_stDmpCtLReq_u8 /end REF_CHARACTERISTIC /end GROUP
/begin GROUP S54_Subsystem16 "SWC_CSPF/RE_SWC_CSPF_10ms_sys/CSPF_Rec_10ms/CanSig_Select/VCU05/Subsystem16" /begin REF_CHARACTERISTIC CAL_Cspf_TrqDmpLim_f32 CAL_Cspf_flgTrqDmpMinSwt_b /end REF_CHARACTERISTIC /end GROUP
/begin GROUP S54_Subsystem17 "SWC_CSPF/RE_SWC_CSPF_10ms_sys/CSPF_Rec_10ms/CanSig_Select/VCU05/Subsystem17" /begin REF_CHARACTERISTIC CAL_Cspf_TrqDmpMax_f32 CAL_Cspf_flgTrqDmpMaxSwt_b /end REF_CHARACTERISTIC /end GROUP
/begin GROUP S78_Subsystem1 "SWC_CSPF/RE_SWC_CSPF_10ms_sys/CSPF_Tra_10ms/CSPFTra_10ms/PEB01/Subsystem1" /begin REF_CHARACTERISTIC CAL_Cspf_flgnSlowFltSwt_b CAL_Cspf_nSlowFlt_f32 /end REF_CHARACTERISTIC /begin REF_MEASUREMENT VAR_Cspf_TraNCurr_f32 /end REF_MEASUREMENT /end GROUP
/begin GROUP S78_Subsystem2 "SWC_CSPF/RE_SWC_CSPF_10ms_sys/CSPF_Tra_10ms/CSPFTra_10ms/PEB01/Subsystem2" /begin REF_CHARACTERISTIC CAL_Cspf_TrqMechFlt_f32 CAL_Cspf_flgTrqMechFltSwt_b /end REF_CHARACTERISTIC /begin REF_MEASUREMENT VAR_Cspf_TraTrqCurr_f32 /end REF_MEASUREMENT /end GROUP
/begin GROUP S78_Subsystem3 "SWC_CSPF/RE_SWC_CSPF_10ms_sys/CSPF_Tra_10ms/CSPFTra_10ms/PEB01/Subsystem3" /begin REF_CHARACTERISTIC CAL_Cspf_flguDcLnkSlowFltSwt_b CAL_Cspf_uDcLnkSlowFlt_f32 /end REF_CHARACTERISTIC /begin REF_MEASUREMENT VAR_Cspf_TraUdcCurr_f32 /end REF_MEASUREMENT /end GROUP
/begin GROUP S78_Subsystem4 "SWC_CSPF/RE_SWC_CSPF_10ms_sys/CSPF_Tra_10ms/CSPFTra_10ms/PEB01/Subsystem4" /begin REF_CHARACTERISTIC CAL_Cspf_IsFlt_f32 CAL_Cspf_flgIsFltSwt_b /end REF_CHARACTERISTIC /begin REF_MEASUREMENT VAR_Cspf_TraisCurr_f32 /end REF_MEASUREMENT /end GROUP
/begin GROUP S78_stMode "SWC_CSPF/RE_SWC_CSPF_10ms_sys/CSPF_Tra_10ms/CSPFTra_10ms/PEB01/stMode" /begin SUB_GROUP S87_Subsystem10 /end SUB_GROUP /end GROUP
/begin GROUP S79_Subsystem10 "SWC_CSPF/RE_SWC_CSPF_10ms_sys/CSPF_Tra_10ms/CSPFTra_10ms/PEB03/Subsystem10" /begin REF_CHARACTERISTIC CAL_Cspf_flgtStrrTemp2FltSwt_b CAL_Cspf_tStrrTemp2Flt_f32 /end REF_CHARACTERISTIC /begin REF_MEASUREMENT VAR_Cspf_TraTempCurrStr2_f32 /end REF_MEASUREMENT /end GROUP
/begin GROUP S79_Subsystem5 "SWC_CSPF/RE_SWC_CSPF_10ms_sys/CSPF_Tra_10ms/CSPFTra_10ms/PEB03/Subsystem5" /begin REF_CHARACTERISTIC CAL_Cspf_flgtDBCTempUFltSwt_b CAL_Cspf_tDBCTempUFlt_f32 /end REF_CHARACTERISTIC /begin REF_MEASUREMENT VAR_Cspf_TraiGBTTempU_f32 /end REF_MEASUREMENT /end GROUP
/begin GROUP S79_Subsystem6 "SWC_CSPF/RE_SWC_CSPF_10ms_sys/CSPF_Tra_10ms/CSPFTra_10ms/PEB03/Subsystem6" /begin REF_CHARACTERISTIC CAL_Cspf_flgtDBCTempVFltSwt_b CAL_Cspf_tDBCTempVFlt_f32 /end REF_CHARACTERISTIC /begin REF_MEASUREMENT VAR_Cspf_TraiGBTTempV_f32 /end REF_MEASUREMENT /end GROUP
/begin GROUP S79_Subsystem7 "SWC_CSPF/RE_SWC_CSPF_10ms_sys/CSPF_Tra_10ms/CSPFTra_10ms/PEB03/Subsystem7" /begin REF_CHARACTERISTIC CAL_Cspf_flgtDBCTempWFltSwt_b CAL_Cspf_tDBCTempWFlt_f32 /end REF_CHARACTERISTIC /begin REF_MEASUREMENT VAR_Cspf_TraiGBTTempW_f32 /end REF_MEASUREMENT /end GROUP
/begin GROUP S79_Subsystem9 "SWC_CSPF/RE_SWC_CSPF_10ms_sys/CSPF_Tra_10ms/CSPFTra_10ms/PEB03/Subsystem9" /begin REF_CHARACTERISTIC CAL_Cspf_flgtStrrTemp1FltSwt_b CAL_Cspf_tStrrTemp1Flt_f32 /end REF_CHARACTERISTIC /begin REF_MEASUREMENT VAR_Cspf_TraTempCurrStr1_f32 /end REF_MEASUREMENT /end GROUP
/begin GROUP S80_Subsystem11 "SWC_CSPF/RE_SWC_CSPF_10ms_sys/CSPF_Tra_10ms/CSPFTra_10ms/PEB04/Subsystem11" /begin REF_CHARACTERISTIC CAL_Cspf_agRtrEe_f32 CAL_Cspf_flgagRtrEeSwt_b /end REF_CHARACTERISTIC /begin REF_MEASUREMENT VAR_Cspf_TraagRtrELecSnsr_f32 /end REF_MEASUREMENT /end GROUP
/begin GROUP S80_Subsystem12 "SWC_CSPF/RE_SWC_CSPF_10ms_sys/CSPF_Tra_10ms/CSPFTra_10ms/PEB04/Subsystem12" /begin REF_CHARACTERISTIC CAL_Cspf_flgOfsClbSucSwt_b CAL_Cspf_flgOfsClbSuc_u8 /end REF_CHARACTERISTIC /begin REF_MEASUREMENT VAR_Cspf_TraflgOfsClbSuc_u8 /end REF_MEASUREMENT /end GROUP
/begin GROUP S80_Subsystem13 "SWC_CSPF/RE_SWC_CSPF_10ms_sys/CSPF_Tra_10ms/CSPFTra_10ms/PEB04/Subsystem13" /begin REF_CHARACTERISTIC CAL_Cspf_flgiDActSlowFltSwt_b CAL_Cspf_iDActSlowFlt_f32 /end REF_CHARACTERISTIC /begin REF_MEASUREMENT VAR_Cspf_Traisd_f32 /end REF_MEASUREMENT /end GROUP
/begin GROUP S80_Subsystem14 "SWC_CSPF/RE_SWC_CSPF_10ms_sys/CSPF_Tra_10ms/CSPFTra_10ms/PEB04/Subsystem14" /begin REF_CHARACTERISTIC CAL_Cspf_flgiQActSlowFltSwt_b CAL_Cspf_iQActSlowFlt_f32 /end REF_CHARACTERISTIC /begin REF_MEASUREMENT VAR_Cspf_Traisq_f32 /end REF_MEASUREMENT /end GROUP
/begin GROUP S80_Subsystem15 "SWC_CSPF/RE_SWC_CSPF_10ms_sys/CSPF_Tra_10ms/CSPFTra_10ms/PEB04/Subsystem15" /begin REF_CHARACTERISTIC CAL_Cspf_agOffset_f32 CAL_Cspf_flgagOffsetSwt_b /end REF_CHARACTERISTIC /begin REF_MEASUREMENT VAR_Cspf_TraOfsAL_f32 /end REF_MEASUREMENT /end GROUP
/begin GROUP S80_Subsystem16 "SWC_CSPF/RE_SWC_CSPF_10ms_sys/CSPF_Tra_10ms/CSPFTra_10ms/PEB04/Subsystem16" /begin REF_CHARACTERISTIC CAL_Cspf_TrqCurrWoDmpC_f32 CAL_Cspf_flgTrqCurrWoDmpCSwt_b /end REF_CHARACTERISTIC /begin REF_MEASUREMENT VAR_Cspf_TraTrqCurrWoDmpC_f32 /end REF_MEASUREMENT /end GROUP
/begin GROUP S80_stGateDrv "SWC_CSPF/RE_SWC_CSPF_10ms_sys/CSPF_Tra_10ms/CSPFTra_10ms/PEB04/stGateDrv" /begin SUB_GROUP S100_Subsystem10 /end SUB_GROUP /end GROUP
/begin GROUP S81_Subsystem17 "SWC_CSPF/RE_SWC_CSPF_10ms_sys/CSPF_Tra_10ms/CSPFTra_10ms/PEB08/Subsystem17" /begin REF_CHARACTERISTIC CAL_Cspf_flgstDisChgSwt_b CAL_Cspf_stDisChg_u8 /end REF_CHARACTERISTIC /begin REF_MEASUREMENT VAR_Cspf_TrastDischg_u8 /end REF_MEASUREMENT /end GROUP
/begin GROUP S81_Subsystem18 "SWC_CSPF/RE_SWC_CSPF_10ms_sys/CSPF_Tra_10ms/CSPFTra_10ms/PEB08/Subsystem18" /begin REF_CHARACTERISTIC CAL_Cspf_HwVer_u16 CAL_Cspf_flgHwVerSwt_b /end REF_CHARACTERISTIC /begin REF_MEASUREMENT VAR_Cspf_TraHwVer_u16 /end REF_MEASUREMENT /end GROUP
/begin GROUP S87_Subsystem10 "SWC_CSPF/RE_SWC_CSPF_10ms_sys/CSPF_Tra_10ms/CSPFTra_10ms/PEB01/stMode/Subsystem10" /begin REF_CHARACTERISTIC CAL_Cspf_flgstModeSwt_b CAL_Cspf_stMode_u8 /end REF_CHARACTERISTIC /begin REF_MEASUREMENT VAR_Cspf_TrastMode_u8 /end REF_MEASUREMENT /end GROUP
/begin GROUP S100_Subsystem10 "SWC_CSPF/RE_SWC_CSPF_10ms_sys/CSPF_Tra_10ms/CSPFTra_10ms/PEB04/stGateDrv/Subsystem10" /begin REF_CHARACTERISTIC CAL_Cspf_flgstGateDrvSwt_b CAL_Cspf_stGateDrv_u8 /end REF_CHARACTERISTIC /begin REF_MEASUREMENT VAR_Cspf_TrastGateDrv_u8 /end REF_MEASUREMENT /end GROUP
/end MODULE
/end PROJECT
/* (add any file trailer comments here) */
/* EOF SWC_CSPF.a2l */
