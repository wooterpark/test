/******************************************************************************
* ASAP2 file: SWC_STM.a2l
* Code generation for model "SWC_STM".
* Model version : 1.499
* Simulink Coder version : 9.3 (R2020a) 18-Nov-2019
* C source code generated on : Wed Sep 1 08:21:32 2021
* Target selection: ert.tlc
* Embedded hardware selection: Intel->x86-64 (Windows64)
* Code generation objectives: Unspecified
* Validation result: Not run
* (add additional file header information here)
******************************************************************************/ ASAP2_VERSION 1 31
/* Version 1.31 */
/begin PROJECT ProjectName "Project Comment Goes Here"
/begin HEADER "Header Comments go here" /end HEADER
/begin MODULE ModuleName "Module Comment Goes Here"
/begin MOD_PAR "MOD PAR Comment Goes Here" /end MOD_PAR
/begin MOD_COMMON "Mod Common Comment Here" BYTE_ORDER MSB_LAST /end MOD_COMMON
/begin RECORD_LAYOUT Scalar_BOOLEAN FNC_VALUES 1 UBYTE COLUMN_DIR DIRECT /end RECORD_LAYOUT
/begin RECORD_LAYOUT Scalar_UBYTE FNC_VALUES 1 UBYTE COLUMN_DIR DIRECT /end RECORD_LAYOUT
/begin RECORD_LAYOUT Scalar_BYTE FNC_VALUES 1 SBYTE COLUMN_DIR DIRECT /end RECORD_LAYOUT
/begin RECORD_LAYOUT Scalar_UWORD FNC_VALUES 1 UWORD COLUMN_DIR DIRECT /end RECORD_LAYOUT
/begin RECORD_LAYOUT Scalar_SWORD FNC_VALUES 1 SWORD COLUMN_DIR DIRECT /end RECORD_LAYOUT
/begin RECORD_LAYOUT Scalar_ULONG FNC_VALUES 1 ULONG COLUMN_DIR DIRECT /end RECORD_LAYOUT
/begin RECORD_LAYOUT Scalar_LONG FNC_VALUES 1 SLONG COLUMN_DIR DIRECT /end RECORD_LAYOUT
/begin RECORD_LAYOUT Scalar_FLOAT32_IEEE FNC_VALUES 1 FLOAT32_IEEE COLUMN_DIR DIRECT /end RECORD_LAYOUT
/begin RECORD_LAYOUT Scalar_FLOAT64_IEEE FNC_VALUES 1 FLOAT64_IEEE COLUMN_DIR DIRECT /end RECORD_LAYOUT
/begin RECORD_LAYOUT Lookup1D_BOOLEAN FNC_VALUES 1 UBYTE COLUMN_DIR DIRECT /end RECORD_LAYOUT
/begin RECORD_LAYOUT Lookup1D_X_BOOLEAN AXIS_PTS_X 1 UBYTE INDEX_INCR DIRECT /end RECORD_LAYOUT
/begin RECORD_LAYOUT Lookup1D_BYTE FNC_VALUES 1 SBYTE COLUMN_DIR DIRECT /end RECORD_LAYOUT
/begin RECORD_LAYOUT Lookup1D_X_BYTE AXIS_PTS_X 1 SBYTE INDEX_INCR DIRECT /end RECORD_LAYOUT
/begin RECORD_LAYOUT Lookup1D_UBYTE FNC_VALUES 1 UBYTE COLUMN_DIR DIRECT /end RECORD_LAYOUT
/begin RECORD_LAYOUT Lookup1D_X_UBYTE AXIS_PTS_X 1 UBYTE INDEX_INCR DIRECT /end RECORD_LAYOUT
/begin RECORD_LAYOUT Lookup1D_UWORD FNC_VALUES 1 UWORD COLUMN_DIR DIRECT /end RECORD_LAYOUT
/begin RECORD_LAYOUT Lookup1D_X_UWORD AXIS_PTS_X 1 UWORD INDEX_INCR DIRECT /end RECORD_LAYOUT
/begin RECORD_LAYOUT Lookup1D_WORD FNC_VALUES 1 SWORD COLUMN_DIR DIRECT /end RECORD_LAYOUT
/begin RECORD_LAYOUT Lookup1D_X_WORD AXIS_PTS_X 1 SWORD INDEX_INCR DIRECT /end RECORD_LAYOUT
/begin RECORD_LAYOUT Lookup1D_ULONG FNC_VALUES 1 ULONG COLUMN_DIR DIRECT /end RECORD_LAYOUT
/begin RECORD_LAYOUT Lookup1D_X_ULONG AXIS_PTS_X 1 ULONG INDEX_INCR DIRECT /end RECORD_LAYOUT
/begin RECORD_LAYOUT Lookup1D_SLONG FNC_VALUES 1 SLONG COLUMN_DIR DIRECT /end RECORD_LAYOUT
/begin RECORD_LAYOUT Lookup1D_X_LONG AXIS_PTS_X 1 SLONG INDEX_INCR DIRECT /end RECORD_LAYOUT
/begin RECORD_LAYOUT Lookup1D_FLOAT32_IEEE FNC_VALUES 1 FLOAT32_IEEE COLUMN_DIR DIRECT /end RECORD_LAYOUT
/begin RECORD_LAYOUT Lookup1D_X_FLOAT32_IEEE AXIS_PTS_X 1 FLOAT32_IEEE INDEX_INCR DIRECT /end RECORD_LAYOUT
/begin RECORD_LAYOUT Lookup1D_FLOAT64_IEEE FNC_VALUES 1 FLOAT64_IEEE COLUMN_DIR DIRECT /end RECORD_LAYOUT
/begin RECORD_LAYOUT Lookup1D_X_FLOAT64_IEEE AXIS_PTS_X 1 FLOAT64_IEEE INDEX_INCR DIRECT /end RECORD_LAYOUT
/begin RECORD_LAYOUT Lookup2D_BOOLEAN FNC_VALUES 1 UBYTE COLUMN_DIR DIRECT /end RECORD_LAYOUT
/begin RECORD_LAYOUT Lookup2D_X_BOOLEAN AXIS_PTS_X 1 UBYTE INDEX_INCR DIRECT /end RECORD_LAYOUT
/begin RECORD_LAYOUT Lookup2D_UBYTE FNC_VALUES 1 UBYTE COLUMN_DIR DIRECT /end RECORD_LAYOUT
/begin RECORD_LAYOUT Lookup2D_X_UBYTE AXIS_PTS_X 1 UBYTE INDEX_INCR DIRECT /end RECORD_LAYOUT
/begin RECORD_LAYOUT Lookup2D_BYTE FNC_VALUES 1 SBYTE COLUMN_DIR DIRECT /end RECORD_LAYOUT
/begin RECORD_LAYOUT Lookup2D_X_BYTE AXIS_PTS_X 1 SBYTE INDEX_INCR DIRECT /end RECORD_LAYOUT
/begin RECORD_LAYOUT Lookup2D_UWORD FNC_VALUES 1 UWORD COLUMN_DIR DIRECT /end RECORD_LAYOUT
/begin RECORD_LAYOUT Lookup2D_X_UWORD AXIS_PTS_X 1 UWORD INDEX_INCR DIRECT /end RECORD_LAYOUT
/begin RECORD_LAYOUT Lookup2D_WORD FNC_VALUES 1 SWORD COLUMN_DIR DIRECT /end RECORD_LAYOUT
/begin RECORD_LAYOUT Lookup2D_X_WORD AXIS_PTS_X 1 SWORD INDEX_INCR DIRECT /end RECORD_LAYOUT
/begin RECORD_LAYOUT Lookup2D_ULONG FNC_VALUES 1 ULONG COLUMN_DIR DIRECT /end RECORD_LAYOUT
/begin RECORD_LAYOUT Lookup2D_X_ULONG AXIS_PTS_X 1 ULONG INDEX_INCR DIRECT /end RECORD_LAYOUT
/begin RECORD_LAYOUT Lookup2D_LONG FNC_VALUES 1 SLONG COLUMN_DIR DIRECT /end RECORD_LAYOUT
/begin RECORD_LAYOUT Lookup2D_X_LONG AXIS_PTS_X 1 SLONG INDEX_INCR DIRECT /end RECORD_LAYOUT
/begin RECORD_LAYOUT Lookup2D_FLOAT32_IEEE FNC_VALUES 1 FLOAT32_IEEE COLUMN_DIR DIRECT /end RECORD_LAYOUT
/begin RECORD_LAYOUT Lookup2D_X_FLOAT32_IEEE AXIS_PTS_X 1 FLOAT32_IEEE INDEX_INCR DIRECT /end RECORD_LAYOUT
/begin RECORD_LAYOUT Lookup2D_FLOAT64_IEEE FNC_VALUES 1 FLOAT64_IEEE COLUMN_DIR DIRECT /end RECORD_LAYOUT
/begin RECORD_LAYOUT Lookup2D_X_FLOAT64_IEEE AXIS_PTS_X 1 FLOAT64_IEEE INDEX_INCR DIRECT /end RECORD_LAYOUT
/begin CHARACTERISTIC CAL_STM_UxptNLim_f32 "" VALUE 0x0000 /* @ECU_Address@CAL_STM_UxptNLim_f32@ */ Scalar_FLOAT32_IEEE 0 SWC_STM_CM_single -24000.0 24000.0 /end CHARACTERISTIC
/begin CHARACTERISTIC CAL_STM_UxptTrqLim_f32 "" VALUE 0x0000 /* @ECU_Address@CAL_STM_UxptTrqLim_f32@ */ Scalar_FLOAT32_IEEE 0 SWC_STM_CM_single -500.0 500.0 /end CHARACTERISTIC
/begin CHARACTERISTIC CAL_STM_UxptSpdMonCountTrh_s16 "" VALUE 0x0000 /* @ECU_Address@CAL_STM_UxptSpdMonCountTrh_s16@ */ Scalar_SWORD 0 SWC_STM_CM_int16 -30000.0 30000.0 /end CHARACTERISTIC
/begin CHARACTERISTIC CAL_STM_UxptSpdMonDebTrh_s16 "" VALUE 0x0000 /* @ECU_Address@CAL_STM_UxptSpdMonDebTrh_s16@ */ Scalar_SWORD 0 SWC_STM_CM_int16 -30000.0 30000.0 /end CHARACTERISTIC
/begin CHARACTERISTIC CAL_STM_UxptTrqMonCountTrh_s16 "" VALUE 0x0000 /* @ECU_Address@CAL_STM_UxptTrqMonCountTrh_s16@ */ Scalar_SWORD 0 SWC_STM_CM_int16 -30000.0 30000.0 /end CHARACTERISTIC
/begin CHARACTERISTIC CAL_STM_UxptTrqMonDebTrh_s16 "" VALUE 0x0000 /* @ECU_Address@CAL_STM_UxptTrqMonDebTrh_s16@ */ Scalar_SWORD 0 SWC_STM_CM_int16 -30000.0 30000.0 /end CHARACTERISTIC
/begin CHARACTERISTIC CAL_STM_UxptSpdMonErrRst_b "" VALUE 0x0000 /* @ECU_Address@CAL_STM_UxptSpdMonErrRst_b@ */ Scalar_BOOLEAN 0 SWC_STM_CM_boolean 0.0 1.0 /end CHARACTERISTIC
/begin CHARACTERISTIC CAL_STM_UxptTrqMonErrRst_b "" VALUE 0x0000 /* @ECU_Address@CAL_STM_UxptTrqMonErrRst_b@ */ Scalar_BOOLEAN 0 SWC_STM_CM_boolean 0.0 1.0 /end CHARACTERISTIC
/begin CHARACTERISTIC CAL_STM_SpeedCtlMode_u8 "" VALUE 0x0000 /* @ECU_Address@CAL_STM_SpeedCtlMode_u8@ */ Scalar_UBYTE 0 SWC_STM_CM_uint8 0.0 255.0 /end CHARACTERISTIC
/begin MEASUREMENT VAR_STM_UintndTrqMonRslt_b "" UBYTE SWC_STM_CM_boolean 0 0 0.0 1.0 ECU_ADDRESS 0x0000 /* @ECU_Address@VAR_STM_UintndTrqMonRslt_b@ */ /end MEASUREMENT
/begin MEASUREMENT VAR_STM_UintndTrqErr_b "" UBYTE SWC_STM_CM_boolean 0 0 0.0 1.0 ECU_ADDRESS 0x0000 /* @ECU_Address@VAR_STM_UintndTrqErr_b@ */ /end MEASUREMENT
/begin MEASUREMENT VAR_STM_UintndSpdMonRslt_b "" UBYTE SWC_STM_CM_boolean 0 0 0.0 1.0 ECU_ADDRESS 0x0000 /* @ECU_Address@VAR_STM_UintndSpdMonRslt_b@ */ /end MEASUREMENT
/begin MEASUREMENT VAR_STM_UintndSpdErr_b "" UBYTE SWC_STM_CM_boolean 0 0 0.0 1.0 ECU_ADDRESS 0x0000 /* @ECU_Address@VAR_STM_UintndSpdErr_b@ */ /end MEASUREMENT
/begin COMPU_METHOD SWC_STM_CM_single "Q = V" RAT_FUNC "%8.6" "" COEFFS 0 1 0 0 0 1 /end COMPU_METHOD
/begin COMPU_METHOD SWC_STM_CM_int16 "Q = V" RAT_FUNC "%5.0" "" COEFFS 0 1 0 0 0 1 /end COMPU_METHOD
/begin COMPU_METHOD SWC_STM_CM_boolean "Q = V" RAT_FUNC "%1.0" "" COEFFS 0 1 0 0 0 1 /end COMPU_METHOD
/begin COMPU_METHOD SWC_STM_CM_uint8 "Q = V" RAT_FUNC "%3.0" "" COEFFS 0 1 0 0 0 1 /end COMPU_METHOD
/begin GROUP SWC_STM "SWC_STM" /* Root */ ROOT /begin SUB_GROUP Root_SWC_STM_1ms_sys /end SUB_GROUP /end GROUP
/begin GROUP Root_SWC_STM_1ms_sys "SWC_STM/SWC_STM_1ms_sys" /begin SUB_GROUP S1_SpdMonProc S1_TrqMonProc /end SUB_GROUP /end GROUP
/begin GROUP S1_SpdMonProc "SWC_STM/SWC_STM_1ms_sys/SpdMonProc" /begin SUB_GROUP S4_SpdMon S4_SpdMonEnable /end SUB_GROUP /end GROUP
/begin GROUP S1_TrqMonProc "SWC_STM/SWC_STM_1ms_sys/TrqMonProc" /begin SUB_GROUP S5_TrqMon S5_TrqMonEnable /end SUB_GROUP /end GROUP
/begin GROUP S4_SpdMon "SWC_STM/SWC_STM_1ms_sys/SpdMonProc/SpdMon" /begin SUB_GROUP S8_Debouncer S8_UintndSpdMon /end SUB_GROUP
 /begin REF_CHARACTERISTIC CAL_STM_UxptSpdMonCountTrh_s16 CAL_STM_UxptSpdMonDebTrh_s16 CAL_STM_UxptSpdMonErrRst_b /end REF_CHARACTERISTIC
/end GROUP
/begin GROUP S4_SpdMonEnable "SWC_STM/SWC_STM_1ms_sys/SpdMonProc/SpdMonEnable" /begin REF_CHARACTERISTIC CAL_STM_SpeedCtlMode_u8 /end REF_CHARACTERISTIC /end GROUP
/begin GROUP S5_TrqMon "SWC_STM/SWC_STM_1ms_sys/TrqMonProc/TrqMon" /begin SUB_GROUP S15_Debouncer S15_UintndTrqMon /end SUB_GROUP
 /begin REF_CHARACTERISTIC CAL_STM_UxptTrqMonCountTrh_s16 CAL_STM_UxptTrqMonDebTrh_s16 CAL_STM_UxptTrqMonErrRst_b /end REF_CHARACTERISTIC
/end GROUP
/begin GROUP S5_TrqMonEnable "SWC_STM/SWC_STM_1ms_sys/TrqMonProc/TrqMonEnable" /begin REF_CHARACTERISTIC CAL_STM_SpeedCtlMode_u8 /end REF_CHARACTERISTIC /end GROUP
/begin GROUP S8_Debouncer "SWC_STM/SWC_STM_1ms_sys/SpdMonProc/SpdMon/Debouncer" /begin REF_MEASUREMENT VAR_STM_UintndSpdErr_b /end REF_MEASUREMENT /end GROUP
/begin GROUP S8_UintndSpdMon "SWC_STM/SWC_STM_1ms_sys/SpdMonProc/SpdMon/UintndSpdMon" /begin REF_CHARACTERISTIC CAL_STM_UxptNLim_f32 /end REF_CHARACTERISTIC /begin REF_MEASUREMENT VAR_STM_UintndSpdMonRslt_b /end REF_MEASUREMENT /end GROUP
/begin GROUP S15_Debouncer "SWC_STM/SWC_STM_1ms_sys/TrqMonProc/TrqMon/Debouncer" /begin REF_MEASUREMENT VAR_STM_UintndTrqErr_b /end REF_MEASUREMENT /end GROUP
/begin GROUP S15_UintndTrqMon "SWC_STM/SWC_STM_1ms_sys/TrqMonProc/TrqMon/UintndTrqMon" /begin REF_CHARACTERISTIC CAL_STM_UxptTrqLim_f32 /end REF_CHARACTERISTIC /begin REF_MEASUREMENT VAR_STM_UintndTrqMonRslt_b /end REF_MEASUREMENT /end GROUP
/end MODULE
/end PROJECT
/* (add any file trailer comments here) */
/* EOF SWC_STM.a2l */
