/******************************************************************************
* ASAP2 file: SWC_TRSP.a2l
* Code generation for model "SWC_TRSP".
* Model version : 1.875
* Simulink Coder version : 9.3 (R2020a) 18-Nov-2019
* C source code generated on : Thu Jan 13 11:26:53 2022
* Target selection: ert.tlc
* Embedded hardware selection: Intel->x86-64 (Windows64)
* Code generation objectives: Unspecified
* Validation result: Not run
* (add additional file header information here)
******************************************************************************/ ASAP2_VERSION 1 31
/* Version 1.31 */
/begin PROJECT ProjectName "Project Comment Goes Here"
/begin HEADER "Header Comments go here" /end HEADER
/begin MODULE ModuleName "Module Comment Goes Here"
/begin MOD_PAR "MOD PAR Comment Goes Here" /end MOD_PAR
/begin MOD_COMMON "Mod Common Comment Here" BYTE_ORDER MSB_LAST /end MOD_COMMON
/begin RECORD_LAYOUT Scalar_BOOLEAN FNC_VALUES 1 UBYTE COLUMN_DIR DIRECT /end RECORD_LAYOUT
/begin RECORD_LAYOUT Scalar_UBYTE FNC_VALUES 1 UBYTE COLUMN_DIR DIRECT /end RECORD_LAYOUT
/begin RECORD_LAYOUT Scalar_BYTE FNC_VALUES 1 SBYTE COLUMN_DIR DIRECT /end RECORD_LAYOUT
/begin RECORD_LAYOUT Scalar_UWORD FNC_VALUES 1 UWORD COLUMN_DIR DIRECT /end RECORD_LAYOUT
/begin RECORD_LAYOUT Scalar_SWORD FNC_VALUES 1 SWORD COLUMN_DIR DIRECT /end RECORD_LAYOUT
/begin RECORD_LAYOUT Scalar_ULONG FNC_VALUES 1 ULONG COLUMN_DIR DIRECT /end RECORD_LAYOUT
/begin RECORD_LAYOUT Scalar_LONG FNC_VALUES 1 SLONG COLUMN_DIR DIRECT /end RECORD_LAYOUT
/begin RECORD_LAYOUT Scalar_FLOAT32_IEEE FNC_VALUES 1 FLOAT32_IEEE COLUMN_DIR DIRECT /end RECORD_LAYOUT
/begin RECORD_LAYOUT Scalar_FLOAT64_IEEE FNC_VALUES 1 FLOAT64_IEEE COLUMN_DIR DIRECT /end RECORD_LAYOUT
/begin RECORD_LAYOUT Lookup1D_BOOLEAN FNC_VALUES 1 UBYTE COLUMN_DIR DIRECT /end RECORD_LAYOUT
/begin RECORD_LAYOUT Lookup1D_X_BOOLEAN AXIS_PTS_X 1 UBYTE INDEX_INCR DIRECT /end RECORD_LAYOUT
/begin RECORD_LAYOUT Lookup1D_BYTE FNC_VALUES 1 SBYTE COLUMN_DIR DIRECT /end RECORD_LAYOUT
/begin RECORD_LAYOUT Lookup1D_X_BYTE AXIS_PTS_X 1 SBYTE INDEX_INCR DIRECT /end RECORD_LAYOUT
/begin RECORD_LAYOUT Lookup1D_UBYTE FNC_VALUES 1 UBYTE COLUMN_DIR DIRECT /end RECORD_LAYOUT
/begin RECORD_LAYOUT Lookup1D_X_UBYTE AXIS_PTS_X 1 UBYTE INDEX_INCR DIRECT /end RECORD_LAYOUT
/begin RECORD_LAYOUT Lookup1D_UWORD FNC_VALUES 1 UWORD COLUMN_DIR DIRECT /end RECORD_LAYOUT
/begin RECORD_LAYOUT Lookup1D_X_UWORD AXIS_PTS_X 1 UWORD INDEX_INCR DIRECT /end RECORD_LAYOUT
/begin RECORD_LAYOUT Lookup1D_WORD FNC_VALUES 1 SWORD COLUMN_DIR DIRECT /end RECORD_LAYOUT
/begin RECORD_LAYOUT Lookup1D_X_WORD AXIS_PTS_X 1 SWORD INDEX_INCR DIRECT /end RECORD_LAYOUT
/begin RECORD_LAYOUT Lookup1D_ULONG FNC_VALUES 1 ULONG COLUMN_DIR DIRECT /end RECORD_LAYOUT
/begin RECORD_LAYOUT Lookup1D_X_ULONG AXIS_PTS_X 1 ULONG INDEX_INCR DIRECT /end RECORD_LAYOUT
/begin RECORD_LAYOUT Lookup1D_SLONG FNC_VALUES 1 SLONG COLUMN_DIR DIRECT /end RECORD_LAYOUT
/begin RECORD_LAYOUT Lookup1D_X_LONG AXIS_PTS_X 1 SLONG INDEX_INCR DIRECT /end RECORD_LAYOUT
/begin RECORD_LAYOUT Lookup1D_FLOAT32_IEEE FNC_VALUES 1 FLOAT32_IEEE COLUMN_DIR DIRECT /end RECORD_LAYOUT
/begin RECORD_LAYOUT Lookup1D_X_FLOAT32_IEEE AXIS_PTS_X 1 FLOAT32_IEEE INDEX_INCR DIRECT /end RECORD_LAYOUT
/begin RECORD_LAYOUT Lookup1D_FLOAT64_IEEE FNC_VALUES 1 FLOAT64_IEEE COLUMN_DIR DIRECT /end RECORD_LAYOUT
/begin RECORD_LAYOUT Lookup1D_X_FLOAT64_IEEE AXIS_PTS_X 1 FLOAT64_IEEE INDEX_INCR DIRECT /end RECORD_LAYOUT
/begin RECORD_LAYOUT Lookup2D_BOOLEAN FNC_VALUES 1 UBYTE COLUMN_DIR DIRECT /end RECORD_LAYOUT
/begin RECORD_LAYOUT Lookup2D_X_BOOLEAN AXIS_PTS_X 1 UBYTE INDEX_INCR DIRECT /end RECORD_LAYOUT
/begin RECORD_LAYOUT Lookup2D_UBYTE FNC_VALUES 1 UBYTE COLUMN_DIR DIRECT /end RECORD_LAYOUT
/begin RECORD_LAYOUT Lookup2D_X_UBYTE AXIS_PTS_X 1 UBYTE INDEX_INCR DIRECT /end RECORD_LAYOUT
/begin RECORD_LAYOUT Lookup2D_BYTE FNC_VALUES 1 SBYTE COLUMN_DIR DIRECT /end RECORD_LAYOUT
/begin RECORD_LAYOUT Lookup2D_X_BYTE AXIS_PTS_X 1 SBYTE INDEX_INCR DIRECT /end RECORD_LAYOUT
/begin RECORD_LAYOUT Lookup2D_UWORD FNC_VALUES 1 UWORD COLUMN_DIR DIRECT /end RECORD_LAYOUT
/begin RECORD_LAYOUT Lookup2D_X_UWORD AXIS_PTS_X 1 UWORD INDEX_INCR DIRECT /end RECORD_LAYOUT
/begin RECORD_LAYOUT Lookup2D_WORD FNC_VALUES 1 SWORD COLUMN_DIR DIRECT /end RECORD_LAYOUT
/begin RECORD_LAYOUT Lookup2D_X_WORD AXIS_PTS_X 1 SWORD INDEX_INCR DIRECT /end RECORD_LAYOUT
/begin RECORD_LAYOUT Lookup2D_ULONG FNC_VALUES 1 ULONG COLUMN_DIR DIRECT /end RECORD_LAYOUT
/begin RECORD_LAYOUT Lookup2D_X_ULONG AXIS_PTS_X 1 ULONG INDEX_INCR DIRECT /end RECORD_LAYOUT
/begin RECORD_LAYOUT Lookup2D_LONG FNC_VALUES 1 SLONG COLUMN_DIR DIRECT /end RECORD_LAYOUT
/begin RECORD_LAYOUT Lookup2D_X_LONG AXIS_PTS_X 1 SLONG INDEX_INCR DIRECT /end RECORD_LAYOUT
/begin RECORD_LAYOUT Lookup2D_FLOAT32_IEEE FNC_VALUES 1 FLOAT32_IEEE COLUMN_DIR DIRECT /end RECORD_LAYOUT
/begin RECORD_LAYOUT Lookup2D_X_FLOAT32_IEEE AXIS_PTS_X 1 FLOAT32_IEEE INDEX_INCR DIRECT /end RECORD_LAYOUT
/begin RECORD_LAYOUT Lookup2D_FLOAT64_IEEE FNC_VALUES 1 FLOAT64_IEEE COLUMN_DIR DIRECT /end RECORD_LAYOUT
/begin RECORD_LAYOUT Lookup2D_X_FLOAT64_IEEE AXIS_PTS_X 1 FLOAT64_IEEE INDEX_INCR DIRECT /end RECORD_LAYOUT
/begin CHARACTERISTIC CAL_TRSP_CurrSumLim_f32 "" VALUE 0x0000 /* @ECU_Address@CAL_TRSP_CurrSumLim_f32@ */ Scalar_FLOAT32_IEEE 0 SWC_TRSP_CM_single 0.0 1000.0 /end CHARACTERISTIC
/begin CHARACTERISTIC CAL_TRSP_Diff_UBR_SBCLim_f32 "" VALUE 0x0000 /* @ECU_Address@CAL_TRSP_Diff_UBR_SBCLim_f32@ */ Scalar_FLOAT32_IEEE 0 SWC_TRSP_CM_single 0.0 20.0 /end CHARACTERISTIC
/begin CHARACTERISTIC CAL_TRSP_OfstRngHiLim_f32 "" VALUE 0x0000 /* @ECU_Address@CAL_TRSP_OfstRngHiLim_f32@ */ Scalar_FLOAT32_IEEE 0 SWC_TRSP_CM_single -1.0 361.0 /end CHARACTERISTIC
/begin CHARACTERISTIC CAL_TRSP_OfstRngLoLim_f32 "" VALUE 0x0000 /* @ECU_Address@CAL_TRSP_OfstRngLoLim_f32@ */ Scalar_FLOAT32_IEEE 0 SWC_TRSP_CM_single -1.0 361.0 /end CHARACTERISTIC
/begin CHARACTERISTIC CAL_TRSP_ReqTrqHiLim_f32 "" VALUE 0x0000 /* @ECU_Address@CAL_TRSP_ReqTrqHiLim_f32@ */ Scalar_FLOAT32_IEEE 0 SWC_TRSP_CM_single -500.0 500.0 /end CHARACTERISTIC
/begin CHARACTERISTIC CAL_TRSP_ReqTrqLoLim_f32 "" VALUE 0x0000 /* @ECU_Address@CAL_TRSP_ReqTrqLoLim_f32@ */ Scalar_FLOAT32_IEEE 0 SWC_TRSP_CM_single -500.0 500.0 /end CHARACTERISTIC
/begin CHARACTERISTIC CAL_TRSP_UBRWIDECnvFac_f32 "" VALUE 0x0000 /* @ECU_Address@CAL_TRSP_UBRWIDECnvFac_f32@ */ Scalar_FLOAT32_IEEE 0 SWC_TRSP_CM_single -1.0 1.0 /end CHARACTERISTIC
/begin CHARACTERISTIC CAL_TRSP_UB_SBCCnvFac_f32 "" VALUE 0x0000 /* @ECU_Address@CAL_TRSP_UB_SBCCnvFac_f32@ */ Scalar_FLOAT32_IEEE 0 SWC_TRSP_CM_single -1.0 1.0 /end CHARACTERISTIC
/begin CHARACTERISTIC CAL_TRSP_UCurrRngHiLim_f32 "" VALUE 0x0000 /* @ECU_Address@CAL_TRSP_UCurrRngHiLim_f32@ */ Scalar_FLOAT32_IEEE 0 SWC_TRSP_CM_single -30000.0 0.0 /end CHARACTERISTIC
/begin CHARACTERISTIC CAL_TRSP_UCurrRngLoLim_f32 "" VALUE 0x0000 /* @ECU_Address@CAL_TRSP_UCurrRngLoLim_f32@ */ Scalar_FLOAT32_IEEE 0 SWC_TRSP_CM_single -30000.0 0.0 /end CHARACTERISTIC
/begin CHARACTERISTIC CAL_TRSP_VCurrRngHiLim_f32 "" VALUE 0x0000 /* @ECU_Address@CAL_TRSP_VCurrRngHiLim_f32@ */ Scalar_FLOAT32_IEEE 0 SWC_TRSP_CM_single 0.0 30000.0 /end CHARACTERISTIC
/begin CHARACTERISTIC CAL_TRSP_VCurrRngLoLim_f32 "" VALUE 0x0000 /* @ECU_Address@CAL_TRSP_VCurrRngLoLim_f32@ */ Scalar_FLOAT32_IEEE 0 SWC_TRSP_CM_single 0.0 30000.0 /end CHARACTERISTIC
/begin CHARACTERISTIC CAL_TRSP_WCurrRngHiLim_f32 "" VALUE 0x0000 /* @ECU_Address@CAL_TRSP_WCurrRngHiLim_f32@ */ Scalar_FLOAT32_IEEE 0 SWC_TRSP_CM_single 0.0 30000.0 /end CHARACTERISTIC
/begin CHARACTERISTIC CAL_TRSP_WCurrRngLoLim_f32 "" VALUE 0x0000 /* @ECU_Address@CAL_TRSP_WCurrRngLoLim_f32@ */ Scalar_FLOAT32_IEEE 0 SWC_TRSP_CM_single 0.0 30000.0 /end CHARACTERISTIC
/begin CHARACTERISTIC CAL_TRSP_iPhaUOffset_f32 "" VALUE 0x0000 /* @ECU_Address@CAL_TRSP_iPhaUOffset_f32@ */ Scalar_FLOAT32_IEEE 0 SWC_TRSP_CM_single -30000.0 0.0 /end CHARACTERISTIC
/begin CHARACTERISTIC CAL_TRSP_iPhaVOffset_f32 "" VALUE 0x0000 /* @ECU_Address@CAL_TRSP_iPhaVOffset_f32@ */ Scalar_FLOAT32_IEEE 0 SWC_TRSP_CM_single 0.0 30000.0 /end CHARACTERISTIC
/begin CHARACTERISTIC CAL_TRSP_iPhaWOffset_f32 "" VALUE 0x0000 /* @ECU_Address@CAL_TRSP_iPhaWOffset_f32@ */ Scalar_FLOAT32_IEEE 0 SWC_TRSP_CM_single 0.0 30000.0 /end CHARACTERISTIC
/begin CHARACTERISTIC CAL_TRSP_iUCnvFac_f32 "" VALUE 0x0000 /* @ECU_Address@CAL_TRSP_iUCnvFac_f32@ */ Scalar_FLOAT32_IEEE 0 SWC_TRSP_CM_single -1.0 0.0 /end CHARACTERISTIC
/begin CHARACTERISTIC CAL_TRSP_iVCnvFac_f32 "" VALUE 0x0000 /* @ECU_Address@CAL_TRSP_iVCnvFac_f32@ */ Scalar_FLOAT32_IEEE 0 SWC_TRSP_CM_single 0.0 1.0 /end CHARACTERISTIC
/begin CHARACTERISTIC CAL_TRSP_iWCnvFac_f32 "" VALUE 0x0000 /* @ECU_Address@CAL_TRSP_iWCnvFac_f32@ */ Scalar_FLOAT32_IEEE 0 SWC_TRSP_CM_single 0.0 1.0 /end CHARACTERISTIC
/begin CHARACTERISTIC CAL_TRSP_18VHSVoltCountTrh_s16 "" VALUE 0x0000 /* @ECU_Address@CAL_TRSP_18VHSVoltCountTrh_s16@ */ Scalar_SWORD 0 SWC_TRSP_CM_int16 0.0 2000.0 /end CHARACTERISTIC
/begin CHARACTERISTIC CAL_TRSP_18VHSVoltDebTrh_s16 "" VALUE 0x0000 /* @ECU_Address@CAL_TRSP_18VHSVoltDebTrh_s16@ */ Scalar_SWORD 0 SWC_TRSP_CM_int16 0.0 2000.0 /end CHARACTERISTIC
/begin CHARACTERISTIC CAL_TRSP_1V8CPLDVoltCountTrh_s16 "" VALUE 0x0000 /* @ECU_Address@CAL_TRSP_1V8CPLDVoltCountTrh_s16@ */ Scalar_SWORD 0 SWC_TRSP_CM_int16 0.0 2000.0 /end CHARACTERISTIC
/begin CHARACTERISTIC CAL_TRSP_1V8CPLDVoltDebTrh_s16 "" VALUE 0x0000 /* @ECU_Address@CAL_TRSP_1V8CPLDVoltDebTrh_s16@ */ Scalar_SWORD 0 SWC_TRSP_CM_int16 0.0 2000.0 /end CHARACTERISTIC
/begin CHARACTERISTIC CAL_TRSP_3V3CPLDVoltCountTrh_s16 "" VALUE 0x0000 /* @ECU_Address@CAL_TRSP_3V3CPLDVoltCountTrh_s16@ */ Scalar_SWORD 0 SWC_TRSP_CM_int16 0.0 2000.0 /end CHARACTERISTIC
/begin CHARACTERISTIC CAL_TRSP_3V3CPLDVoltDebTrh_s16 "" VALUE 0x0000 /* @ECU_Address@CAL_TRSP_3V3CPLDVoltDebTrh_s16@ */ Scalar_SWORD 0 SWC_TRSP_CM_int16 0.0 2000.0 /end CHARACTERISTIC
/begin CHARACTERISTIC CAL_TRSP_CurrRngCountTrh_s16 "" VALUE 0x0000 /* @ECU_Address@CAL_TRSP_CurrRngCountTrh_s16@ */ Scalar_SWORD 0 SWC_TRSP_CM_int16 -3000.0 3000.0 /end CHARACTERISTIC
/begin CHARACTERISTIC CAL_TRSP_CurrRngDebTrh_s16 "" VALUE 0x0000 /* @ECU_Address@CAL_TRSP_CurrRngDebTrh_s16@ */ Scalar_SWORD 0 SWC_TRSP_CM_int16 -3000.0 3000.0 /end CHARACTERISTIC
/begin CHARACTERISTIC CAL_TRSP_CurrSumCountTrh_s16 "" VALUE 0x0000 /* @ECU_Address@CAL_TRSP_CurrSumCountTrh_s16@ */ Scalar_SWORD 0 SWC_TRSP_CM_int16 0.0 2000.0 /end CHARACTERISTIC
/begin CHARACTERISTIC CAL_TRSP_CurrSumDebTrh_s16 "" VALUE 0x0000 /* @ECU_Address@CAL_TRSP_CurrSumDebTrh_s16@ */ Scalar_SWORD 0 SWC_TRSP_CM_int16 0.0 2000.0 /end CHARACTERISTIC
/begin CHARACTERISTIC CAL_TRSP_ReqTrqCountTrh_s16 "" VALUE 0x0000 /* @ECU_Address@CAL_TRSP_ReqTrqCountTrh_s16@ */ Scalar_SWORD 0 SWC_TRSP_CM_int16 0.0 20.0 /end CHARACTERISTIC
/begin CHARACTERISTIC CAL_TRSP_ReqTrqDebTrh_s16 "" VALUE 0x0000 /* @ECU_Address@CAL_TRSP_ReqTrqDebTrh_s16@ */ Scalar_SWORD 0 SWC_TRSP_CM_int16 0.0 20.0 /end CHARACTERISTIC
/begin CHARACTERISTIC CAL_TRSP_RslvExciCountTrh_s16 "" VALUE 0x0000 /* @ECU_Address@CAL_TRSP_RslvExciCountTrh_s16@ */ Scalar_SWORD 0 SWC_TRSP_CM_int16 0.0 2000.0 /end CHARACTERISTIC
/begin CHARACTERISTIC CAL_TRSP_RslvExciDebTrh_s16 "" VALUE 0x0000 /* @ECU_Address@CAL_TRSP_RslvExciDebTrh_s16@ */ Scalar_SWORD 0 SWC_TRSP_CM_int16 0.0 2000.0 /end CHARACTERISTIC
/begin CHARACTERISTIC CAL_TRSP_RslvRngCountTrh_s16 "" VALUE 0x0000 /* @ECU_Address@CAL_TRSP_RslvRngCountTrh_s16@ */ Scalar_SWORD 0 SWC_TRSP_CM_int16 0.0 2000.0 /end CHARACTERISTIC
/begin CHARACTERISTIC CAL_TRSP_RslvRngDebTrh_s16 "" VALUE 0x0000 /* @ECU_Address@CAL_TRSP_RslvRngDebTrh_s16@ */ Scalar_SWORD 0 SWC_TRSP_CM_int16 0.0 2000.0 /end CHARACTERISTIC
/begin CHARACTERISTIC CAL_TRSP_RslvSensVoltCountTrh_s16 "" VALUE 0x0000 /* @ECU_Address@CAL_TRSP_RslvSensVoltCountTrh_s16@ */ Scalar_SWORD 0 SWC_TRSP_CM_int16 0.0 2000.0 /end CHARACTERISTIC
/begin CHARACTERISTIC CAL_TRSP_RslvSensVoltDebTrh_s16 "" VALUE 0x0000 /* @ECU_Address@CAL_TRSP_RslvSensVoltDebTrh_s16@ */ Scalar_SWORD 0 SWC_TRSP_CM_int16 0.0 2000.0 /end CHARACTERISTIC
/begin CHARACTERISTIC CAL_TRSP_RslvSqrtCountTrh_s16 "" VALUE 0x0000 /* @ECU_Address@CAL_TRSP_RslvSqrtCountTrh_s16@ */ Scalar_SWORD 0 SWC_TRSP_CM_int16 0.0 2000.0 /end CHARACTERISTIC
/begin CHARACTERISTIC CAL_TRSP_RslvSqrtDebTrh_s16 "" VALUE 0x0000 /* @ECU_Address@CAL_TRSP_RslvSqrtDebTrh_s16@ */ Scalar_SWORD 0 SWC_TRSP_CM_int16 0.0 2000.0 /end CHARACTERISTIC
/begin CHARACTERISTIC CAL_TRSP_UBRVoltCountTrh_s16 "" VALUE 0x0000 /* @ECU_Address@CAL_TRSP_UBRVoltCountTrh_s16@ */ Scalar_SWORD 0 SWC_TRSP_CM_int16 0.0 2000.0 /end CHARACTERISTIC
/begin CHARACTERISTIC CAL_TRSP_UBRVoltDebTrh_s16 "" VALUE 0x0000 /* @ECU_Address@CAL_TRSP_UBRVoltDebTrh_s16@ */ Scalar_SWORD 0 SWC_TRSP_CM_int16 0.0 2000.0 /end CHARACTERISTIC
/begin CHARACTERISTIC CAL_TRSP_iPhasSensVoltCountTrh_s16 "" VALUE 0x0000 /* @ECU_Address@CAL_TRSP_iPhasSensVoltCountTrh_s16@ */ Scalar_SWORD 0 SWC_TRSP_CM_int16 0.0 2000.0 /end CHARACTERISTIC
/begin CHARACTERISTIC CAL_TRSP_iPhasSensVoltDebTrh_s16 "" VALUE 0x0000 /* @ECU_Address@CAL_TRSP_iPhasSensVoltDebTrh_s16@ */ Scalar_SWORD 0 SWC_TRSP_CM_int16 0.0 2000.0 /end CHARACTERISTIC
/begin CHARACTERISTIC CAL_TRSP_18VHSVoltHiLim_u16 "" VALUE 0x0000 /* @ECU_Address@CAL_TRSP_18VHSVoltHiLim_u16@ */ Scalar_UWORD 0 SWC_TRSP_CM_uint16 0.0 4096.0 /end CHARACTERISTIC
/begin CHARACTERISTIC CAL_TRSP_18VHSVoltLoLim_u16 "" VALUE 0x0000 /* @ECU_Address@CAL_TRSP_18VHSVoltLoLim_u16@ */ Scalar_UWORD 0 SWC_TRSP_CM_uint16 0.0 4096.0 /end CHARACTERISTIC
/begin CHARACTERISTIC CAL_TRSP_1V8CPLDVoltHiLim_u16 "" VALUE 0x0000 /* @ECU_Address@CAL_TRSP_1V8CPLDVoltHiLim_u16@ */ Scalar_UWORD 0 SWC_TRSP_CM_uint16 0.0 4096.0 /end CHARACTERISTIC
/begin CHARACTERISTIC CAL_TRSP_1V8CPLDVoltLoLim_u16 "" VALUE 0x0000 /* @ECU_Address@CAL_TRSP_1V8CPLDVoltLoLim_u16@ */ Scalar_UWORD 0 SWC_TRSP_CM_uint16 0.0 4096.0 /end CHARACTERISTIC
/begin CHARACTERISTIC CAL_TRSP_3V3CPLDVoltHiLim_u16 "" VALUE 0x0000 /* @ECU_Address@CAL_TRSP_3V3CPLDVoltHiLim_u16@ */ Scalar_UWORD 0 SWC_TRSP_CM_uint16 0.0 4096.0 /end CHARACTERISTIC
/begin CHARACTERISTIC CAL_TRSP_3V3CPLDVoltLoLim_u16 "" VALUE 0x0000 /* @ECU_Address@CAL_TRSP_3V3CPLDVoltLoLim_u16@ */ Scalar_UWORD 0 SWC_TRSP_CM_uint16 0.0 4096.0 /end CHARACTERISTIC
/begin CHARACTERISTIC CAL_TRSP_RslvRngCosNHiLim_u16 "" VALUE 0x0000 /* @ECU_Address@CAL_TRSP_RslvRngCosNHiLim_u16@ */ Scalar_UWORD 0 SWC_TRSP_CM_uint16 0.0 4095.0 /end CHARACTERISTIC
/begin CHARACTERISTIC CAL_TRSP_RslvRngCosNLoLim_u16 "" VALUE 0x0000 /* @ECU_Address@CAL_TRSP_RslvRngCosNLoLim_u16@ */ Scalar_UWORD 0 SWC_TRSP_CM_uint16 0.0 4095.0 /end CHARACTERISTIC
/begin CHARACTERISTIC CAL_TRSP_RslvRngCosPHiLim_u16 "" VALUE 0x0000 /* @ECU_Address@CAL_TRSP_RslvRngCosPHiLim_u16@ */ Scalar_UWORD 0 SWC_TRSP_CM_uint16 0.0 4095.0 /end CHARACTERISTIC
/begin CHARACTERISTIC CAL_TRSP_RslvRngCosPLoLim_u16 "" VALUE 0x0000 /* @ECU_Address@CAL_TRSP_RslvRngCosPLoLim_u16@ */ Scalar_UWORD 0 SWC_TRSP_CM_uint16 0.0 4095.0 /end CHARACTERISTIC
/begin CHARACTERISTIC CAL_TRSP_RslvRngExciHiLim_u16 "" VALUE 0x0000 /* @ECU_Address@CAL_TRSP_RslvRngExciHiLim_u16@ */ Scalar_UWORD 0 SWC_TRSP_CM_uint16 0.0 4096.0 /end CHARACTERISTIC
/begin CHARACTERISTIC CAL_TRSP_RslvRngExciLoLim_u16 "" VALUE 0x0000 /* @ECU_Address@CAL_TRSP_RslvRngExciLoLim_u16@ */ Scalar_UWORD 0 SWC_TRSP_CM_uint16 0.0 4096.0 /end CHARACTERISTIC
/begin CHARACTERISTIC CAL_TRSP_RslvRngSinNHiLim_u16 "" VALUE 0x0000 /* @ECU_Address@CAL_TRSP_RslvRngSinNHiLim_u16@ */ Scalar_UWORD 0 SWC_TRSP_CM_uint16 0.0 4095.0 /end CHARACTERISTIC
/begin CHARACTERISTIC CAL_TRSP_RslvRngSinNLoLim_u16 "" VALUE 0x0000 /* @ECU_Address@CAL_TRSP_RslvRngSinNLoLim_u16@ */ Scalar_UWORD 0 SWC_TRSP_CM_uint16 0.0 4095.0 /end CHARACTERISTIC
/begin CHARACTERISTIC CAL_TRSP_RslvRngSinPHiLim_u16 "" VALUE 0x0000 /* @ECU_Address@CAL_TRSP_RslvRngSinPHiLim_u16@ */ Scalar_UWORD 0 SWC_TRSP_CM_uint16 0.0 4095.0 /end CHARACTERISTIC
/begin CHARACTERISTIC CAL_TRSP_RslvRngSinPLoLim_u16 "" VALUE 0x0000 /* @ECU_Address@CAL_TRSP_RslvRngSinPLoLim_u16@ */ Scalar_UWORD 0 SWC_TRSP_CM_uint16 0.0 4095.0 /end CHARACTERISTIC
/begin CHARACTERISTIC CAL_TRSP_RslvSensVoltHiLim_u16 "" VALUE 0x0000 /* @ECU_Address@CAL_TRSP_RslvSensVoltHiLim_u16@ */ Scalar_UWORD 0 SWC_TRSP_CM_uint16 0.0 4096.0 /end CHARACTERISTIC
/begin CHARACTERISTIC CAL_TRSP_RslvSensVoltLoLim_u16 "" VALUE 0x0000 /* @ECU_Address@CAL_TRSP_RslvSensVoltLoLim_u16@ */ Scalar_UWORD 0 SWC_TRSP_CM_uint16 0.0 4096.0 /end CHARACTERISTIC
/begin CHARACTERISTIC CAL_TRSP_RslvSqrtHiLim_u16 "" VALUE 0x0000 /* @ECU_Address@CAL_TRSP_RslvSqrtHiLim_u16@ */ Scalar_UWORD 0 SWC_TRSP_CM_uint16 0.0 30000.0 /end CHARACTERISTIC
/begin CHARACTERISTIC CAL_TRSP_RslvSqrtLoLim_u16 "" VALUE 0x0000 /* @ECU_Address@CAL_TRSP_RslvSqrtLoLim_u16@ */ Scalar_UWORD 0 SWC_TRSP_CM_uint16 0.0 30000.0 /end CHARACTERISTIC
/begin CHARACTERISTIC CAL_TRSP_iPhasSensVoltHiLim_u16 "" VALUE 0x0000 /* @ECU_Address@CAL_TRSP_iPhasSensVoltHiLim_u16@ */ Scalar_UWORD 0 SWC_TRSP_CM_uint16 0.0 4096.0 /end CHARACTERISTIC
/begin CHARACTERISTIC CAL_TRSP_iPhasSensVoltLoLim_u16 "" VALUE 0x0000 /* @ECU_Address@CAL_TRSP_iPhasSensVoltLoLim_u16@ */ Scalar_UWORD 0 SWC_TRSP_CM_uint16 0.0 4096.0 /end CHARACTERISTIC
/begin CHARACTERISTIC CAL_TRSP_18VHSVoltErrRst_b "" VALUE 0x0000 /* @ECU_Address@CAL_TRSP_18VHSVoltErrRst_b@ */ Scalar_BOOLEAN 0 SWC_TRSP_CM_boolean 0.0 1.0 /end CHARACTERISTIC
/begin CHARACTERISTIC CAL_TRSP_1V8CPLDVoltErrRst_b "" VALUE 0x0000 /* @ECU_Address@CAL_TRSP_1V8CPLDVoltErrRst_b@ */ Scalar_BOOLEAN 0 SWC_TRSP_CM_boolean 0.0 1.0 /end CHARACTERISTIC
/begin CHARACTERISTIC CAL_TRSP_3V3CPLDVoltErrRst_b "" VALUE 0x0000 /* @ECU_Address@CAL_TRSP_3V3CPLDVoltErrRst_b@ */ Scalar_BOOLEAN 0 SWC_TRSP_CM_boolean 0.0 1.0 /end CHARACTERISTIC
/begin CHARACTERISTIC CAL_TRSP_CurrRngErrRst_b "" VALUE 0x0000 /* @ECU_Address@CAL_TRSP_CurrRngErrRst_b@ */ Scalar_BOOLEAN 0 SWC_TRSP_CM_boolean 0.0 1.0 /end CHARACTERISTIC
/begin CHARACTERISTIC CAL_TRSP_CurrSumErrRst_b "" VALUE 0x0000 /* @ECU_Address@CAL_TRSP_CurrSumErrRst_b@ */ Scalar_BOOLEAN 0 SWC_TRSP_CM_boolean 0.0 1.0 /end CHARACTERISTIC
/begin CHARACTERISTIC CAL_TRSP_OfstErrRst_b "" VALUE 0x0000 /* @ECU_Address@CAL_TRSP_OfstErrRst_b@ */ Scalar_BOOLEAN 0 SWC_TRSP_CM_boolean 0.0 1.0 /end CHARACTERISTIC
/begin CHARACTERISTIC CAL_TRSP_ReqTrqErrRst_b "" VALUE 0x0000 /* @ECU_Address@CAL_TRSP_ReqTrqErrRst_b@ */ Scalar_BOOLEAN 0 SWC_TRSP_CM_boolean 0.0 1.0 /end CHARACTERISTIC
/begin CHARACTERISTIC CAL_TRSP_RslvExciErrRst_b "" VALUE 0x0000 /* @ECU_Address@CAL_TRSP_RslvExciErrRst_b@ */ Scalar_BOOLEAN 0 SWC_TRSP_CM_boolean 0.0 1.0 /end CHARACTERISTIC
/begin CHARACTERISTIC CAL_TRSP_RslvRngErrRst_b "" VALUE 0x0000 /* @ECU_Address@CAL_TRSP_RslvRngErrRst_b@ */ Scalar_BOOLEAN 0 SWC_TRSP_CM_boolean 0.0 1.0 /end CHARACTERISTIC
/begin CHARACTERISTIC CAL_TRSP_RslvSensVoltErrRst_b "" VALUE 0x0000 /* @ECU_Address@CAL_TRSP_RslvSensVoltErrRst_b@ */ Scalar_BOOLEAN 0 SWC_TRSP_CM_boolean 0.0 1.0 /end CHARACTERISTIC
/begin CHARACTERISTIC CAL_TRSP_RslvSqrtErrRst_b "" VALUE 0x0000 /* @ECU_Address@CAL_TRSP_RslvSqrtErrRst_b@ */ Scalar_BOOLEAN 0 SWC_TRSP_CM_boolean 0.0 1.0 /end CHARACTERISTIC
/begin CHARACTERISTIC CAL_TRSP_UBRVoltErrRst_b "" VALUE 0x0000 /* @ECU_Address@CAL_TRSP_UBRVoltErrRst_b@ */ Scalar_BOOLEAN 0 SWC_TRSP_CM_boolean 0.0 1.0 /end CHARACTERISTIC
/begin CHARACTERISTIC CAL_TRSP_flgChangPha_b "" VALUE 0x0000 /* @ECU_Address@CAL_TRSP_flgChangPha_b@ */ Scalar_BOOLEAN 0 SWC_TRSP_CM_boolean 0.0 1.0 /end CHARACTERISTIC
/begin CHARACTERISTIC CAL_TRSP_iPhasSensVoltErrRst_b "" VALUE 0x0000 /* @ECU_Address@CAL_TRSP_iPhasSensVoltErrRst_b@ */ Scalar_BOOLEAN 0 SWC_TRSP_CM_boolean 0.0 1.0 /end CHARACTERISTIC
/begin CHARACTERISTIC CAL_TRSP_AgTimecompCtl_u8 "" VALUE 0x0000 /* @ECU_Address@CAL_TRSP_AgTimecompCtl_u8@ */ Scalar_UBYTE 0 SWC_TRSP_CM_uint8 0 255 /end CHARACTERISTIC
/begin CHARACTERISTIC CAL_TRSP_SpeedCtlMode_u8 "" VALUE 0x0000 /* @ECU_Address@CAL_TRSP_SpeedCtlMode_u8@ */ Scalar_UBYTE 0 SWC_TRSP_CM_uint8 0.0 255.0 /end CHARACTERISTIC
/begin CHARACTERISTIC CAL_TRSP_TorqueCtlMode_u8 "" VALUE 0x0000 /* @ECU_Address@CAL_TRSP_TorqueCtlMode_u8@ */ Scalar_UBYTE 0 SWC_TRSP_CM_uint8 0.0 255.0 /end CHARACTERISTIC
/begin MEASUREMENT VAR_NvM_AngAutoClbOffset_f32 "" FLOAT32_IEEE SWC_TRSP_CM_single 0 0 0.0 360.0 ECU_ADDRESS 0x0000 /* @ECU_Address@VAR_NvM_AngAutoClbOffset_f32@ */ /end MEASUREMENT
/begin MEASUREMENT VAR_L2Com_TrqSetP_f32 "" FLOAT32_IEEE SWC_TRSP_CM_single 0 0 -500.0 500.0 ECU_ADDRESS 0x0000 /* @ECU_Address@VAR_L2Com_TrqSetP_f32@ */ /end MEASUREMENT
/begin MEASUREMENT VAR_L2Sampling_IsU_Mon_f32 "" FLOAT32_IEEE SWC_TRSP_CM_single 0 0 -30000.0 0.0 ECU_ADDRESS 0x0000 /* @ECU_Address@VAR_L2Sampling_IsU_Mon_f32@ */ /end MEASUREMENT
/begin MEASUREMENT VAR_L2Sampling_IsV_Mon_f32 "" FLOAT32_IEEE SWC_TRSP_CM_single 0 0 0.0 30000.0 ECU_ADDRESS 0x0000 /* @ECU_Address@VAR_L2Sampling_IsV_Mon_f32@ */ /end MEASUREMENT
/begin MEASUREMENT VAR_L2Sampling_IsW_Mon_f32 "" FLOAT32_IEEE SWC_TRSP_CM_single 0 0 0.0 30000.0 ECU_ADDRESS 0x0000 /* @ECU_Address@VAR_L2Sampling_IsW_Mon_f32@ */ /end MEASUREMENT
/begin MEASUREMENT VAR_TRSP_UBRWIDE_f32 "" FLOAT32_IEEE SWC_TRSP_CM_single 0 0 0.0 1.0 ECU_ADDRESS 0x0000 /* @ECU_Address@VAR_TRSP_UBRWIDE_f32@ */ /end MEASUREMENT
/begin MEASUREMENT VAR_TRSP_UB_SBC_f32 "" FLOAT32_IEEE SWC_TRSP_CM_single 0 0 0.0 1.0 ECU_ADDRESS 0x0000 /* @ECU_Address@VAR_TRSP_UB_SBC_f32@ */ /end MEASUREMENT
/begin MEASUREMENT VAR_TRSP_Diff_UBR_SBC_f32 "" FLOAT32_IEEE SWC_TRSP_CM_single 0 0 0.0 1.0 ECU_ADDRESS 0x0000 /* @ECU_Address@VAR_TRSP_Diff_UBR_SBC_f32@ */ /end MEASUREMENT
/begin MEASUREMENT VAR_TRSP_RslvSqrt_f32 "" FLOAT32_IEEE SWC_TRSP_CM_single 0 0 0.0 1.0 ECU_ADDRESS 0x0000 /* @ECU_Address@VAR_TRSP_RslvSqrt_f32@ */ /end MEASUREMENT
/begin MEASUREMENT VAR_TRSP_RslvSin_f32 "" FLOAT32_IEEE SWC_TRSP_CM_single 0 0 -10000.0 10000.0 ECU_ADDRESS 0x0000 /* @ECU_Address@VAR_TRSP_RslvSin_f32@ */ /end MEASUREMENT
/begin MEASUREMENT VAR_TRSP_RslvCos_f32 "" FLOAT32_IEEE SWC_TRSP_CM_single 0 0 -10000.0 10000.0 ECU_ADDRESS 0x0000 /* @ECU_Address@VAR_TRSP_RslvCos_f32@ */ /end MEASUREMENT
/begin MEASUREMENT VAR_TRSP_iU_f32 "" FLOAT32_IEEE SWC_TRSP_CM_single 0 0 -1200.0 1200.0 ECU_ADDRESS 0x0000 /* @ECU_Address@VAR_TRSP_iU_f32@ */ /end MEASUREMENT
/begin MEASUREMENT VAR_TRSP_iW_f32 "" FLOAT32_IEEE SWC_TRSP_CM_single 0 0 -1200.0 1200.0 ECU_ADDRESS 0x0000 /* @ECU_Address@VAR_TRSP_iW_f32@ */ /end MEASUREMENT
/begin MEASUREMENT VAR_TRSP_iV_f32 "" FLOAT32_IEEE SWC_TRSP_CM_single 0 0 -1200.0 1200.0 ECU_ADDRESS 0x0000 /* @ECU_Address@VAR_TRSP_iV_f32@ */ /end MEASUREMENT
/begin MEASUREMENT VAR_TRSP_iSum_f32 "" FLOAT32_IEEE SWC_TRSP_CM_single 0 0 0.0 1.0 ECU_ADDRESS 0x0000 /* @ECU_Address@VAR_TRSP_iSum_f32@ */ /end MEASUREMENT
/begin MEASUREMENT VAR_TRSP_AgRtr_f32 "" FLOAT32_IEEE SWC_TRSP_CM_single 0 0 0.0 360.0 ECU_ADDRESS 0x0000 /* @ECU_Address@VAR_TRSP_AgRtr_f32@ */ /end MEASUREMENT
/begin MEASUREMENT VAR_L2Sampling_RslvCos_s32 "" SLONG SWC_TRSP_CM_int32 0 0 0.0 4095.0 ECU_ADDRESS 0x0000 /* @ECU_Address@VAR_L2Sampling_RslvCos_s32@ */ /end MEASUREMENT
/begin MEASUREMENT VAR_L2Sampling_RslvSin_s32 "" SLONG SWC_TRSP_CM_int32 0 0 0.0 4095.0 ECU_ADDRESS 0x0000 /* @ECU_Address@VAR_L2Sampling_RslvSin_s32@ */ /end MEASUREMENT
/begin MEASUREMENT VAR_L2Com_ModeReq_u16 "" UWORD SWC_TRSP_CM_uint16 0 0 0.0 15.0 ECU_ADDRESS 0x0000 /* @ECU_Address@VAR_L2Com_ModeReq_u16@ */ /end MEASUREMENT
/begin MEASUREMENT VAR_L2Sampling_RslvSinP_VADC_u16 "" UWORD SWC_TRSP_CM_uint16 0 0 0.0 1024.0 ARRAY_SIZE 32 ECU_ADDRESS 0x0000 /* @ECU_Address@VAR_L2Sampling_RslvSinP_VADC_u16@ */ /end MEASUREMENT
/begin MEASUREMENT VAR_L2Sampling_RslvSinN_VADC_u16 "" UWORD SWC_TRSP_CM_uint16 0 0 0.0 1024.0 ARRAY_SIZE 32 ECU_ADDRESS 0x0000 /* @ECU_Address@VAR_L2Sampling_RslvSinN_VADC_u16@ */ /end MEASUREMENT
/begin MEASUREMENT VAR_L2Sampling_RslvCosP_VADC_u16 "" UWORD SWC_TRSP_CM_uint16 0 0 0.0 1024.0 ARRAY_SIZE 32 ECU_ADDRESS 0x0000 /* @ECU_Address@VAR_L2Sampling_RslvCosP_VADC_u16@ */ /end MEASUREMENT
/begin MEASUREMENT VAR_L2Sampling_RslvCosN_VADC_u16 "" UWORD SWC_TRSP_CM_uint16 0 0 0.0 1024.0 ARRAY_SIZE 32 ECU_ADDRESS 0x0000 /* @ECU_Address@VAR_L2Sampling_RslvCosN_VADC_u16@ */ /end MEASUREMENT
/begin MEASUREMENT VAR_L2Sampling_RslvCosP_VADC_Max1_u16 "" UWORD SWC_TRSP_CM_uint16 0 0 0.0 1024.0 ECU_ADDRESS 0x0000 /* @ECU_Address@VAR_L2Sampling_RslvCosP_VADC_Max1_u16@ */ /end MEASUREMENT
/begin MEASUREMENT VAR_L2Sampling_RslvCosP_VADC_Min1_u16 "" UWORD SWC_TRSP_CM_uint16 0 0 0.0 1024.0 ECU_ADDRESS 0x0000 /* @ECU_Address@VAR_L2Sampling_RslvCosP_VADC_Min1_u16@ */ /end MEASUREMENT
/begin MEASUREMENT VAR_L2Sampling_RslvSinN_VADC_Max1_u16 "" UWORD SWC_TRSP_CM_uint16 0 0 0.0 1024.0 ECU_ADDRESS 0x0000 /* @ECU_Address@VAR_L2Sampling_RslvSinN_VADC_Max1_u16@ */ /end MEASUREMENT
/begin MEASUREMENT VAR_L2Sampling_RslvSinN_VADC_Min1_u16 "" UWORD SWC_TRSP_CM_uint16 0 0 0.0 1024.0 ECU_ADDRESS 0x0000 /* @ECU_Address@VAR_L2Sampling_RslvSinN_VADC_Min1_u16@ */ /end MEASUREMENT
/begin MEASUREMENT VAR_L2Sampling_RslvSinP_VADC_Max1_u16 "" UWORD SWC_TRSP_CM_uint16 0 0 0.0 1024.0 ECU_ADDRESS 0x0000 /* @ECU_Address@VAR_L2Sampling_RslvSinP_VADC_Max1_u16@ */ /end MEASUREMENT
/begin MEASUREMENT VAR_L2Sampling_RslvSinP_VADC_Min1_u16 "" UWORD SWC_TRSP_CM_uint16 0 0 0.0 1024.0 ECU_ADDRESS 0x0000 /* @ECU_Address@VAR_L2Sampling_RslvSinP_VADC_Min1_u16@ */ /end MEASUREMENT
/begin MEASUREMENT VAR_L2Sampling_RslvCosN_VADC_Max1_u16 "" UWORD SWC_TRSP_CM_uint16 0 0 0.0 1024.0 ECU_ADDRESS 0x0000 /* @ECU_Address@VAR_L2Sampling_RslvCosN_VADC_Max1_u16@ */ /end MEASUREMENT
/begin MEASUREMENT VAR_L2Sampling_RslvCosN_VADC_Min1_u16 "" UWORD SWC_TRSP_CM_uint16 0 0 0.0 1024.0 ECU_ADDRESS 0x0000 /* @ECU_Address@VAR_L2Sampling_RslvCosN_VADC_Min1_u16@ */ /end MEASUREMENT
/begin MEASUREMENT VAR_L2Sampling_ExciBackP_u16 "" UWORD SWC_TRSP_CM_uint16 0 0 0.0 1024.0 ECU_ADDRESS 0x0000 /* @ECU_Address@VAR_L2Sampling_ExciBackP_u16@ */ /end MEASUREMENT
/begin MEASUREMENT VAR_L2Sampling_ExciBackN_u16 "" UWORD SWC_TRSP_CM_uint16 0 0 0.0 1024.0 ECU_ADDRESS 0x0000 /* @ECU_Address@VAR_L2Sampling_ExciBackN_u16@ */ /end MEASUREMENT
/begin MEASUREMENT VAR_L2Sampling_Exci18VLS_MON_u16 "" UWORD SWC_TRSP_CM_uint16 0 0 0.0 4095.0 ECU_ADDRESS 0x0000 /* @ECU_Address@VAR_L2Sampling_Exci18VLS_MON_u16@ */ /end MEASUREMENT
/begin MEASUREMENT VAR_L2Sampling_LEM5V_MON_u16 "" UWORD SWC_TRSP_CM_uint16 0 0 0.0 4095.0 ECU_ADDRESS 0x0000 /* @ECU_Address@VAR_L2Sampling_LEM5V_MON_u16@ */ /end MEASUREMENT
/begin MEASUREMENT VAR_L2Sampling_UBRWIDE_MON_u16 "" UWORD SWC_TRSP_CM_uint16 0 0 0.0 4095.0 ECU_ADDRESS 0x0000 /* @ECU_Address@VAR_L2Sampling_UBRWIDE_MON_u16@ */ /end MEASUREMENT
/begin MEASUREMENT VAR_L2Sampling_UB_SBC_MON_u16 "" UWORD SWC_TRSP_CM_uint16 0 0 0.0 4095.0 ECU_ADDRESS 0x0000 /* @ECU_Address@VAR_L2Sampling_UB_SBC_MON_u16@ */ /end MEASUREMENT
/begin MEASUREMENT VAR_L2Sampling_18VHS_MON_u16 "" UWORD SWC_TRSP_CM_uint16 0 0 0.0 4095.0 ECU_ADDRESS 0x0000 /* @ECU_Address@VAR_L2Sampling_18VHS_MON_u16@ */ /end MEASUREMENT
/begin MEASUREMENT VAR_L2Sampling_3V3CPLD_MON_u16 "" UWORD SWC_TRSP_CM_uint16 0 0 0.0 4095.0 ECU_ADDRESS 0x0000 /* @ECU_Address@VAR_L2Sampling_3V3CPLD_MON_u16@ */ /end MEASUREMENT
/begin MEASUREMENT VAR_L2Sampling_1V8CPLD_MON_u16 "" UWORD SWC_TRSP_CM_uint16 0 0 0.0 4095.0 ECU_ADDRESS 0x0000 /* @ECU_Address@VAR_L2Sampling_1V8CPLD_MON_u16@ */ /end MEASUREMENT
/begin MEASUREMENT VAR_TRSP_OfstRngChkRslt_b "" UBYTE SWC_TRSP_CM_boolean 0 0 0.0 1.0 ECU_ADDRESS 0x0000 /* @ECU_Address@VAR_TRSP_OfstRngChkRslt_b@ */ /end MEASUREMENT
/begin MEASUREMENT VAR_TRSP_OfstRngErr_b "" UBYTE SWC_TRSP_CM_boolean 0 0 0.0 1.0 ECU_ADDRESS 0x0000 /* @ECU_Address@VAR_TRSP_OfstRngErr_b@ */ /end MEASUREMENT
/begin MEASUREMENT VAR_TRSP_TrqSetPRngChkRslt_b "" UBYTE SWC_TRSP_CM_boolean 0 0 0.0 1.0 ECU_ADDRESS 0x0000 /* @ECU_Address@VAR_TRSP_TrqSetPRngChkRslt_b@ */ /end MEASUREMENT
/begin MEASUREMENT VAR_TRSP_TrqSetPRngErr_b "" UBYTE SWC_TRSP_CM_boolean 0 0 0.0 1.0 ECU_ADDRESS 0x0000 /* @ECU_Address@VAR_TRSP_TrqSetPRngErr_b@ */ /end MEASUREMENT
/begin MEASUREMENT VAR_TRSP_RslvCosNRngChkRslt_b "" UBYTE SWC_TRSP_CM_boolean 0 0 0.0 1.0 ECU_ADDRESS 0x0000 /* @ECU_Address@VAR_TRSP_RslvCosNRngChkRslt_b@ */ /end MEASUREMENT
/begin MEASUREMENT VAR_TRSP_RslvCosNRngErr_b "" UBYTE SWC_TRSP_CM_boolean 0 0 0.0 1.0 ECU_ADDRESS 0x0000 /* @ECU_Address@VAR_TRSP_RslvCosNRngErr_b@ */ /end MEASUREMENT
/begin MEASUREMENT VAR_TRSP_RslvSinPRngChkRslt_b "" UBYTE SWC_TRSP_CM_boolean 0 0 0.0 1.0 ECU_ADDRESS 0x0000 /* @ECU_Address@VAR_TRSP_RslvSinPRngChkRslt_b@ */ /end MEASUREMENT
/begin MEASUREMENT VAR_TRSP_RslvSinPRngErr_b "" UBYTE SWC_TRSP_CM_boolean 0 0 0.0 1.0 ECU_ADDRESS 0x0000 /* @ECU_Address@VAR_TRSP_RslvSinPRngErr_b@ */ /end MEASUREMENT
/begin MEASUREMENT VAR_TRSP_RslvSinNRngChkRslt_b "" UBYTE SWC_TRSP_CM_boolean 0 0 0.0 1.0 ECU_ADDRESS 0x0000 /* @ECU_Address@VAR_TRSP_RslvSinNRngChkRslt_b@ */ /end MEASUREMENT
/begin MEASUREMENT VAR_TRSP_RslvSinNRngErr_b "" UBYTE SWC_TRSP_CM_boolean 0 0 0.0 1.0 ECU_ADDRESS 0x0000 /* @ECU_Address@VAR_TRSP_RslvSinNRngErr_b@ */ /end MEASUREMENT
/begin MEASUREMENT VAR_TRSP_RslvCosPRngChkRslt_b "" UBYTE SWC_TRSP_CM_boolean 0 0 0.0 1.0 ECU_ADDRESS 0x0000 /* @ECU_Address@VAR_TRSP_RslvCosPRngChkRslt_b@ */ /end MEASUREMENT
/begin MEASUREMENT VAR_TRSP_RslvCosPRngErr_b "" UBYTE SWC_TRSP_CM_boolean 0 0 0.0 1.0 ECU_ADDRESS 0x0000 /* @ECU_Address@VAR_TRSP_RslvCosPRngErr_b@ */ /end MEASUREMENT
/begin MEASUREMENT VAR_TRSP_RslvRngErr_b "" UBYTE SWC_TRSP_CM_boolean 0 0 0.0 1.0 ECU_ADDRESS 0x0000 /* @ECU_Address@VAR_TRSP_RslvRngErr_b@ */ /end MEASUREMENT
/begin MEASUREMENT VAR_TRSP_RslvSqrtErr_b "" UBYTE SWC_TRSP_CM_boolean 0 0 0.0 1.0 ECU_ADDRESS 0x0000 /* @ECU_Address@VAR_TRSP_RslvSqrtErr_b@ */ /end MEASUREMENT
/begin MEASUREMENT VAR_TRSP_UCurrRngChkRslt_b "" UBYTE SWC_TRSP_CM_boolean 0 0 0.0 1.0 ECU_ADDRESS 0x0000 /* @ECU_Address@VAR_TRSP_UCurrRngChkRslt_b@ */ /end MEASUREMENT
/begin MEASUREMENT VAR_TRSP_UCurrRngErr_b "" UBYTE SWC_TRSP_CM_boolean 0 0 0.0 1.0 ECU_ADDRESS 0x0000 /* @ECU_Address@VAR_TRSP_UCurrRngErr_b@ */ /end MEASUREMENT
/begin MEASUREMENT VAR_TRSP_VCurrRngChkRslt_b "" UBYTE SWC_TRSP_CM_boolean 0 0 0.0 1.0 ECU_ADDRESS 0x0000 /* @ECU_Address@VAR_TRSP_VCurrRngChkRslt_b@ */ /end MEASUREMENT
/begin MEASUREMENT VAR_TRSP_VCurrRngErr_b "" UBYTE SWC_TRSP_CM_boolean 0 0 0.0 1.0 ECU_ADDRESS 0x0000 /* @ECU_Address@VAR_TRSP_VCurrRngErr_b@ */ /end MEASUREMENT
/begin MEASUREMENT VAR_TRSP_WCurrRngChkRslt_b "" UBYTE SWC_TRSP_CM_boolean 0 0 0.0 1.0 ECU_ADDRESS 0x0000 /* @ECU_Address@VAR_TRSP_WCurrRngChkRslt_b@ */ /end MEASUREMENT
/begin MEASUREMENT VAR_TRSP_WCurrRngErr_b "" UBYTE SWC_TRSP_CM_boolean 0 0 0.0 1.0 ECU_ADDRESS 0x0000 /* @ECU_Address@VAR_TRSP_WCurrRngErr_b@ */ /end MEASUREMENT
/begin MEASUREMENT VAR_TRSP_CurrRngErr_b "" UBYTE SWC_TRSP_CM_boolean 0 0 0.0 1.0 ECU_ADDRESS 0x0000 /* @ECU_Address@VAR_TRSP_CurrRngErr_b@ */ /end MEASUREMENT
/begin MEASUREMENT VAR_TRSP_CurrSumErr_b "" UBYTE SWC_TRSP_CM_boolean 0 0 0.0 1.0 ECU_ADDRESS 0x0000 /* @ECU_Address@VAR_TRSP_CurrSumErr_b@ */ /end MEASUREMENT
/begin MEASUREMENT VAR_TRSP_RslvExciPRngChkRslt_b "" UBYTE SWC_TRSP_CM_boolean 0 0 0.0 1.0 ECU_ADDRESS 0x0000 /* @ECU_Address@VAR_TRSP_RslvExciPRngChkRslt_b@ */ /end MEASUREMENT
/begin MEASUREMENT VAR_TRSP_RslvExciPRngErr_b "" UBYTE SWC_TRSP_CM_boolean 0 0 0.0 1.0 ECU_ADDRESS 0x0000 /* @ECU_Address@VAR_TRSP_RslvExciPRngErr_b@ */ /end MEASUREMENT
/begin MEASUREMENT VAR_TRSP_RslvExciNRngChkRslt_b "" UBYTE SWC_TRSP_CM_boolean 0 0 0.0 1.0 ECU_ADDRESS 0x0000 /* @ECU_Address@VAR_TRSP_RslvExciNRngChkRslt_b@ */ /end MEASUREMENT
/begin MEASUREMENT VAR_TRSP_RslvExciNRngErr_b "" UBYTE SWC_TRSP_CM_boolean 0 0 0.0 1.0 ECU_ADDRESS 0x0000 /* @ECU_Address@VAR_TRSP_RslvExciNRngErr_b@ */ /end MEASUREMENT
/begin MEASUREMENT VAR_TRSP_RslvExciRngErr_b "" UBYTE SWC_TRSP_CM_boolean 0 0 0.0 1.0 ECU_ADDRESS 0x0000 /* @ECU_Address@VAR_TRSP_RslvExciRngErr_b@ */ /end MEASUREMENT
/begin MEASUREMENT VAR_TRSP_RslvSensVoltRngChkRslt_b "" UBYTE SWC_TRSP_CM_boolean 0 0 0.0 1.0 ECU_ADDRESS 0x0000 /* @ECU_Address@VAR_TRSP_RslvSensVoltRngChkRslt_b@ */ /end MEASUREMENT
/begin MEASUREMENT VAR_TRSP_RslvSensVoltRngErr_b "" UBYTE SWC_TRSP_CM_boolean 0 0 0.0 1.0 ECU_ADDRESS 0x0000 /* @ECU_Address@VAR_TRSP_RslvSensVoltRngErr_b@ */ /end MEASUREMENT
/begin MEASUREMENT VAR_TRSP_iPhasSensVoltRngChkRslt_b "" UBYTE SWC_TRSP_CM_boolean 0 0 0.0 1.0 ECU_ADDRESS 0x0000 /* @ECU_Address@VAR_TRSP_iPhasSensVoltRngChkRslt_b@ */ /end MEASUREMENT
/begin MEASUREMENT VAR_TRSP_iPhasSensVoltRngErr_b "" UBYTE SWC_TRSP_CM_boolean 0 0 0.0 1.0 ECU_ADDRESS 0x0000 /* @ECU_Address@VAR_TRSP_iPhasSensVoltRngErr_b@ */ /end MEASUREMENT
/begin MEASUREMENT VAR_TRSP_UBRVoltRngErr_b "" UBYTE SWC_TRSP_CM_boolean 0 0 0.0 1.0 ECU_ADDRESS 0x0000 /* @ECU_Address@VAR_TRSP_UBRVoltRngErr_b@ */ /end MEASUREMENT
/begin MEASUREMENT VAR_TRSP_18VHSVoltRngChkRslt_b "" UBYTE SWC_TRSP_CM_boolean 0 0 0.0 1.0 ECU_ADDRESS 0x0000 /* @ECU_Address@VAR_TRSP_18VHSVoltRngChkRslt_b@ */ /end MEASUREMENT
/begin MEASUREMENT VAR_TRSP_18VHSVoltRngErr_b "" UBYTE SWC_TRSP_CM_boolean 0 0 0.0 1.0 ECU_ADDRESS 0x0000 /* @ECU_Address@VAR_TRSP_18VHSVoltRngErr_b@ */ /end MEASUREMENT
/begin MEASUREMENT VAR_TRSP_3V3CPLDVoltRngChkRslt_b "" UBYTE SWC_TRSP_CM_boolean 0 0 0.0 1.0 ECU_ADDRESS 0x0000 /* @ECU_Address@VAR_TRSP_3V3CPLDVoltRngChkRslt_b@ */ /end MEASUREMENT
/begin MEASUREMENT VAR_TRSP_3V3CPLDVoltRngErr_b "" UBYTE SWC_TRSP_CM_boolean 0 0 0.0 1.0 ECU_ADDRESS 0x0000 /* @ECU_Address@VAR_TRSP_3V3CPLDVoltRngErr_b@ */ /end MEASUREMENT
/begin MEASUREMENT VAR_TRSP_1V8CPLDVoltRngChkRslt_b "" UBYTE SWC_TRSP_CM_boolean 0 0 0.0 1.0 ECU_ADDRESS 0x0000 /* @ECU_Address@VAR_TRSP_1V8CPLDVoltRngChkRslt_b@ */ /end MEASUREMENT
/begin MEASUREMENT VAR_TRSP_1V8CPLDVoltRngErr_b "" UBYTE SWC_TRSP_CM_boolean 0 0 0.0 1.0 ECU_ADDRESS 0x0000 /* @ECU_Address@VAR_TRSP_1V8CPLDVoltRngErr_b@ */ /end MEASUREMENT
/begin MEASUREMENT VAR_TRSP_UBRVoltRngChkRslt_b "" UBYTE SWC_TRSP_CM_boolean 0 0 0.0 1.0 ECU_ADDRESS 0x0000 /* @ECU_Address@VAR_TRSP_UBRVoltRngChkRslt_b@ */ /end MEASUREMENT
/begin MEASUREMENT VAR_TRSP_RslvSqrtChkRslt_b "" UBYTE SWC_TRSP_CM_boolean 0 0 0.0 1.0 ECU_ADDRESS 0x0000 /* @ECU_Address@VAR_TRSP_RslvSqrtChkRslt_b@ */ /end MEASUREMENT
/begin MEASUREMENT VAR_TRSP_CurrSumChkRslt_b "" UBYTE SWC_TRSP_CM_boolean 0 0 0.0 1.0 ECU_ADDRESS 0x0000 /* @ECU_Address@VAR_TRSP_CurrSumChkRslt_b@ */ /end MEASUREMENT
/begin COMPU_METHOD SWC_TRSP_CM_single "Q = V" RAT_FUNC "%8.6" "" COEFFS 0 1 0 0 0 1 /end COMPU_METHOD
/begin COMPU_METHOD SWC_TRSP_CM_int16 "Q = V" RAT_FUNC "%5.0" "" COEFFS 0 1 0 0 0 1 /end COMPU_METHOD
/begin COMPU_METHOD SWC_TRSP_CM_uint16 "Q = V" RAT_FUNC "%5.0" "" COEFFS 0 1 0 0 0 1 /end COMPU_METHOD
/begin COMPU_METHOD SWC_TRSP_CM_boolean "Q = V" RAT_FUNC "%1.0" "" COEFFS 0 1 0 0 0 1 /end COMPU_METHOD
/begin COMPU_METHOD SWC_TRSP_CM_uint8 "Q = V" RAT_FUNC "%3.0" "" COEFFS 0 1 0 0 0 1 /end COMPU_METHOD
/begin COMPU_METHOD SWC_TRSP_CM_int32 "Q = V" RAT_FUNC "%10.0" "" COEFFS 0 1 0 0 0 1 /end COMPU_METHOD
/begin GROUP SWC_TRSP "SWC_TRSP" /* Root */ ROOT
 /begin SUB_GROUP Root_SWC_TRSP_100us_sys Root_SWC_TRSP_10ms_sys Root_SWC_TRSP_1ms_sys /end SUB_GROUP
/end GROUP
/begin GROUP Root_SWC_TRSP_100us_sys "SWC_TRSP/SWC_TRSP_100us_sys"
 /begin SUB_GROUP S1_18VHSVoltChk S1_1V8CPLDVoltChk S1_3V3CPLDVoltChk S1_AgRtrCalc S1_CurrChk S1_RslvChk S1_RslvSensVoltChk S1_UBRVoltChk S1_iPhasSensVoltChk /end SUB_GROUP
 /begin REF_MEASUREMENT VAR_L2Sampling_18VHS_MON_u16 VAR_L2Sampling_1V8CPLD_MON_u16 VAR_L2Sampling_3V3CPLD_MON_u16 VAR_L2Sampling_Exci18VLS_MON_u16 VAR_L2Sampling_ExciBackN_u16 VAR_L2Sampling_ExciBackP_u16 VAR_L2Sampling_IsU_Mon_f32 VAR_L2Sampling_IsV_Mon_f32 VAR_L2Sampling_IsW_Mon_f32 VAR_L2Sampling_LEM5V_MON_u16 VAR_L2Sampling_RslvCosN_VADC_u16 VAR_L2Sampling_RslvCosP_VADC_u16 VAR_L2Sampling_RslvCos_s32 VAR_L2Sampling_RslvSinN_VADC_u16 VAR_L2Sampling_RslvSinP_VADC_u16 VAR_L2Sampling_RslvSin_s32 VAR_L2Sampling_UBRWIDE_MON_u16 VAR_L2Sampling_UB_SBC_MON_u16 /end REF_MEASUREMENT
/end GROUP
/begin GROUP Root_SWC_TRSP_10ms_sys "SWC_TRSP/SWC_TRSP_10ms_sys" /begin SUB_GROUP S2_CANSigChk /end SUB_GROUP /begin REF_MEASUREMENT VAR_L2Com_TrqSetP_f32 /end REF_MEASUREMENT /end GROUP
/begin GROUP Root_SWC_TRSP_1ms_sys "SWC_TRSP/SWC_TRSP_1ms_sys" /begin SUB_GROUP S3_OfstAgChk /end SUB_GROUP /begin REF_MEASUREMENT VAR_L2Com_ModeReq_u16 VAR_NvM_AngAutoClbOffset_f32 /end REF_MEASUREMENT /end GROUP
/begin GROUP S1_18VHSVoltChk "SWC_TRSP/SWC_TRSP_100us_sys/18VHSVoltChk"
 /begin REF_CHARACTERISTIC CAL_TRSP_18VHSVoltCountTrh_s16 CAL_TRSP_18VHSVoltDebTrh_s16 CAL_TRSP_18VHSVoltErrRst_b CAL_TRSP_18VHSVoltHiLim_u16 CAL_TRSP_18VHSVoltLoLim_u16 /end REF_CHARACTERISTIC
 /begin REF_MEASUREMENT VAR_TRSP_18VHSVoltRngChkRslt_b VAR_TRSP_18VHSVoltRngErr_b /end REF_MEASUREMENT
/end GROUP
/begin GROUP S1_1V8CPLDVoltChk "SWC_TRSP/SWC_TRSP_100us_sys/1V8CPLDVoltChk"
 /begin REF_CHARACTERISTIC CAL_TRSP_1V8CPLDVoltCountTrh_s16 CAL_TRSP_1V8CPLDVoltDebTrh_s16 CAL_TRSP_1V8CPLDVoltErrRst_b CAL_TRSP_1V8CPLDVoltHiLim_u16 CAL_TRSP_1V8CPLDVoltLoLim_u16 /end REF_CHARACTERISTIC
 /begin REF_MEASUREMENT VAR_TRSP_1V8CPLDVoltRngChkRslt_b VAR_TRSP_1V8CPLDVoltRngErr_b /end REF_MEASUREMENT
/end GROUP
/begin GROUP S1_3V3CPLDVoltChk "SWC_TRSP/SWC_TRSP_100us_sys/3V3CPLDVoltChk"
 /begin REF_CHARACTERISTIC CAL_TRSP_3V3CPLDVoltCountTrh_s16 CAL_TRSP_3V3CPLDVoltDebTrh_s16 CAL_TRSP_3V3CPLDVoltErrRst_b CAL_TRSP_3V3CPLDVoltHiLim_u16 CAL_TRSP_3V3CPLDVoltLoLim_u16 /end REF_CHARACTERISTIC
 /begin REF_MEASUREMENT VAR_TRSP_3V3CPLDVoltRngChkRslt_b VAR_TRSP_3V3CPLDVoltRngErr_b /end REF_MEASUREMENT
/end GROUP
/begin GROUP S1_AgRtrCalc "SWC_TRSP/SWC_TRSP_100us_sys/AgRtrCalc" /begin REF_CHARACTERISTIC CAL_TRSP_AgTimecompCtl_u8 /end REF_CHARACTERISTIC /begin REF_MEASUREMENT VAR_TRSP_AgRtr_f32 /end REF_MEASUREMENT /end GROUP
/begin GROUP S1_CurrChk "SWC_TRSP/SWC_TRSP_100us_sys/CurrChk" /begin SUB_GROUP S9_CurrSumChk S9_iPhaCalc /end SUB_GROUP
 /begin REF_CHARACTERISTIC CAL_TRSP_CurrRngCountTrh_s16 CAL_TRSP_CurrRngDebTrh_s16 CAL_TRSP_CurrRngErrRst_b CAL_TRSP_CurrSumCountTrh_s16 CAL_TRSP_CurrSumDebTrh_s16 CAL_TRSP_CurrSumErrRst_b CAL_TRSP_UCurrRngHiLim_f32 CAL_TRSP_UCurrRngLoLim_f32 CAL_TRSP_VCurrRngHiLim_f32 CAL_TRSP_VCurrRngLoLim_f32 CAL_TRSP_WCurrRngHiLim_f32 CAL_TRSP_WCurrRngLoLim_f32 /end REF_CHARACTERISTIC
 /begin REF_MEASUREMENT VAR_TRSP_CurrRngErr_b VAR_TRSP_CurrSumErr_b VAR_TRSP_UCurrRngChkRslt_b VAR_TRSP_UCurrRngErr_b VAR_TRSP_VCurrRngChkRslt_b VAR_TRSP_VCurrRngErr_b VAR_TRSP_WCurrRngChkRslt_b VAR_TRSP_WCurrRngErr_b /end REF_MEASUREMENT
/end GROUP
/begin GROUP S1_RslvChk "SWC_TRSP/SWC_TRSP_100us_sys/RslvChk" /begin SUB_GROUP S10_RslvSigCalc S10_RslvSqrtChk /end SUB_GROUP
 /begin REF_CHARACTERISTIC CAL_TRSP_RslvExciCountTrh_s16 CAL_TRSP_RslvExciDebTrh_s16 CAL_TRSP_RslvExciErrRst_b CAL_TRSP_RslvRngCosNHiLim_u16 CAL_TRSP_RslvRngCosNLoLim_u16 CAL_TRSP_RslvRngCosPHiLim_u16 CAL_TRSP_RslvRngCosPLoLim_u16 CAL_TRSP_RslvRngCountTrh_s16 CAL_TRSP_RslvRngDebTrh_s16 CAL_TRSP_RslvRngErrRst_b CAL_TRSP_RslvRngExciHiLim_u16 CAL_TRSP_RslvRngExciLoLim_u16 CAL_TRSP_RslvRngSinNHiLim_u16 CAL_TRSP_RslvRngSinNLoLim_u16 CAL_TRSP_RslvRngSinPHiLim_u16 CAL_TRSP_RslvRngSinPLoLim_u16 CAL_TRSP_RslvSqrtCountTrh_s16 CAL_TRSP_RslvSqrtDebTrh_s16 CAL_TRSP_RslvSqrtErrRst_b /end REF_CHARACTERISTIC
 /begin REF_MEASUREMENT VAR_L2Sampling_RslvCosN_VADC_Max1_u16 VAR_L2Sampling_RslvCosN_VADC_Min1_u16 VAR_L2Sampling_RslvCosP_VADC_Max1_u16 VAR_L2Sampling_RslvCosP_VADC_Min1_u16 VAR_L2Sampling_RslvSinN_VADC_Max1_u16 VAR_L2Sampling_RslvSinN_VADC_Min1_u16 VAR_L2Sampling_RslvSinP_VADC_Max1_u16 VAR_L2Sampling_RslvSinP_VADC_Min1_u16 VAR_TRSP_RslvCosNRngChkRslt_b VAR_TRSP_RslvCosNRngErr_b VAR_TRSP_RslvCosPRngChkRslt_b VAR_TRSP_RslvCosPRngErr_b VAR_TRSP_RslvExciNRngChkRslt_b VAR_TRSP_RslvExciNRngErr_b VAR_TRSP_RslvExciPRngChkRslt_b VAR_TRSP_RslvExciPRngErr_b VAR_TRSP_RslvExciRngErr_b VAR_TRSP_RslvRngErr_b VAR_TRSP_RslvSinNRngChkRslt_b VAR_TRSP_RslvSinNRngErr_b VAR_TRSP_RslvSinPRngChkRslt_b VAR_TRSP_RslvSinPRngErr_b VAR_TRSP_RslvSqrtErr_b /end REF_MEASUREMENT
/end GROUP
/begin GROUP S1_RslvSensVoltChk "SWC_TRSP/SWC_TRSP_100us_sys/RslvSensVoltChk"
 /begin REF_CHARACTERISTIC CAL_TRSP_RslvSensVoltCountTrh_s16 CAL_TRSP_RslvSensVoltDebTrh_s16 CAL_TRSP_RslvSensVoltErrRst_b CAL_TRSP_RslvSensVoltHiLim_u16 CAL_TRSP_RslvSensVoltLoLim_u16 /end REF_CHARACTERISTIC
 /begin REF_MEASUREMENT VAR_TRSP_RslvSensVoltRngChkRslt_b VAR_TRSP_RslvSensVoltRngErr_b /end REF_MEASUREMENT
/end GROUP
/begin GROUP S1_UBRVoltChk "SWC_TRSP/SWC_TRSP_100us_sys/UBRVoltChk" /begin SUB_GROUP S12_UBRVoltCompChk S12_UBR_SBCVoltCalc /end SUB_GROUP
 /begin REF_CHARACTERISTIC CAL_TRSP_UBRVoltCountTrh_s16 CAL_TRSP_UBRVoltDebTrh_s16 CAL_TRSP_UBRVoltErrRst_b /end REF_CHARACTERISTIC
 /begin REF_MEASUREMENT VAR_TRSP_UBRVoltRngErr_b /end REF_MEASUREMENT
/end GROUP
/begin GROUP S1_iPhasSensVoltChk "SWC_TRSP/SWC_TRSP_100us_sys/iPhasSensVoltChk"
 /begin REF_CHARACTERISTIC CAL_TRSP_iPhasSensVoltCountTrh_s16 CAL_TRSP_iPhasSensVoltDebTrh_s16 CAL_TRSP_iPhasSensVoltErrRst_b CAL_TRSP_iPhasSensVoltHiLim_u16 CAL_TRSP_iPhasSensVoltLoLim_u16 /end REF_CHARACTERISTIC
 /begin REF_MEASUREMENT VAR_TRSP_iPhasSensVoltRngChkRslt_b VAR_TRSP_iPhasSensVoltRngErr_b /end REF_MEASUREMENT
/end GROUP
/begin GROUP S2_CANSigChk "SWC_TRSP/SWC_TRSP_10ms_sys/CANSigChk"
 /begin REF_CHARACTERISTIC CAL_TRSP_ReqTrqCountTrh_s16 CAL_TRSP_ReqTrqDebTrh_s16 CAL_TRSP_ReqTrqErrRst_b CAL_TRSP_ReqTrqHiLim_f32 CAL_TRSP_ReqTrqLoLim_f32 /end REF_CHARACTERISTIC
 /begin REF_MEASUREMENT VAR_TRSP_TrqSetPRngChkRslt_b VAR_TRSP_TrqSetPRngErr_b /end REF_MEASUREMENT
/end GROUP
/begin GROUP S3_OfstAgChk "SWC_TRSP/SWC_TRSP_1ms_sys/OfstAgChk" /begin SUB_GROUP S94_OfstChk S94_OfstChkEnable /end SUB_GROUP /end GROUP
/begin GROUP S9_CurrSumChk "SWC_TRSP/SWC_TRSP_100us_sys/CurrChk/CurrSumChk" /begin REF_CHARACTERISTIC CAL_TRSP_CurrSumLim_f32 /end REF_CHARACTERISTIC /begin REF_MEASUREMENT VAR_TRSP_CurrSumChkRslt_b VAR_TRSP_iSum_f32 /end REF_MEASUREMENT /end GROUP
/begin GROUP S9_iPhaCalc "SWC_TRSP/SWC_TRSP_100us_sys/CurrChk/iPhaCalc"
 /begin REF_CHARACTERISTIC CAL_TRSP_flgChangPha_b CAL_TRSP_iPhaUOffset_f32 CAL_TRSP_iPhaVOffset_f32 CAL_TRSP_iPhaWOffset_f32 CAL_TRSP_iUCnvFac_f32 CAL_TRSP_iVCnvFac_f32 CAL_TRSP_iWCnvFac_f32 /end REF_CHARACTERISTIC
 /begin REF_MEASUREMENT VAR_TRSP_iU_f32 VAR_TRSP_iV_f32 VAR_TRSP_iW_f32 /end REF_MEASUREMENT
/end GROUP
/begin GROUP S10_RslvSigCalc "SWC_TRSP/SWC_TRSP_100us_sys/RslvChk/RslvSigCalc" /begin REF_MEASUREMENT VAR_TRSP_RslvCos_f32 VAR_TRSP_RslvSin_f32 /end REF_MEASUREMENT /end GROUP
/begin GROUP S10_RslvSqrtChk "SWC_TRSP/SWC_TRSP_100us_sys/RslvChk/RslvSqrtChk" /begin REF_CHARACTERISTIC CAL_TRSP_RslvSqrtHiLim_u16 CAL_TRSP_RslvSqrtLoLim_u16 /end REF_CHARACTERISTIC /begin REF_MEASUREMENT VAR_TRSP_RslvSqrtChkRslt_b VAR_TRSP_RslvSqrt_f32 /end REF_MEASUREMENT /end GROUP
/begin GROUP S12_UBRVoltCompChk "SWC_TRSP/SWC_TRSP_100us_sys/UBRVoltChk/UBRVoltCompChk" /begin REF_CHARACTERISTIC CAL_TRSP_Diff_UBR_SBCLim_f32 /end REF_CHARACTERISTIC /begin REF_MEASUREMENT VAR_TRSP_Diff_UBR_SBC_f32 VAR_TRSP_UBRVoltRngChkRslt_b /end REF_MEASUREMENT /end GROUP
/begin GROUP S12_UBR_SBCVoltCalc "SWC_TRSP/SWC_TRSP_100us_sys/UBRVoltChk/UBR_SBCVoltCalc" /begin REF_CHARACTERISTIC CAL_TRSP_UBRWIDECnvFac_f32 CAL_TRSP_UB_SBCCnvFac_f32 /end REF_CHARACTERISTIC /begin REF_MEASUREMENT VAR_TRSP_UBRWIDE_f32 VAR_TRSP_UB_SBC_f32 /end REF_MEASUREMENT /end GROUP
/begin GROUP S94_OfstChk "SWC_TRSP/SWC_TRSP_1ms_sys/OfstAgChk/OfstChk" /begin SUB_GROUP S97_Lock /end SUB_GROUP
 /begin REF_CHARACTERISTIC CAL_TRSP_OfstErrRst_b CAL_TRSP_OfstRngHiLim_f32 CAL_TRSP_OfstRngLoLim_f32 /end REF_CHARACTERISTIC
 /begin REF_MEASUREMENT VAR_TRSP_OfstRngChkRslt_b /end REF_MEASUREMENT
/end GROUP
/begin GROUP S94_OfstChkEnable "SWC_TRSP/SWC_TRSP_1ms_sys/OfstAgChk/OfstChkEnable" /begin REF_CHARACTERISTIC CAL_TRSP_SpeedCtlMode_u8 CAL_TRSP_TorqueCtlMode_u8 /end REF_CHARACTERISTIC /end GROUP
/begin GROUP S97_Lock "SWC_TRSP/SWC_TRSP_1ms_sys/OfstAgChk/OfstChk/Lock" /begin REF_MEASUREMENT VAR_TRSP_OfstRngErr_b /end REF_MEASUREMENT /end GROUP
/end MODULE
/end PROJECT
/* (add any file trailer comments here) */
/* EOF SWC_TRSP.a2l */
