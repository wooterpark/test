/******************************************************************************
* ASAP2 file: SWC_HSPF.a2l
* Code generation for model "SWC_HSPF".
* Model version : 1.24
* Simulink Coder version : 9.3 (R2020a) 18-Nov-2019
* C source code generated on : Tue Jan 19 14:59:09 2021
* Target selection: autosar.tlc
* Embedded hardware selection: Intel->x86-64 (Windows64)
* Code generation objectives: Unspecified
* Validation result: Not run
* (add additional file header information here)
******************************************************************************/ ASAP2_VERSION 1 31
/* Version 1.31 */
/begin PROJECT ProjectName "Project Comment Goes Here"
/begin HEADER "Header Comments go here" /end HEADER
/begin MODULE ModuleName "Module Comment Goes Here"
/begin MOD_PAR "MOD PAR Comment Goes Here" /end MOD_PAR
/begin MOD_COMMON "Mod Common Comment Here" BYTE_ORDER MSB_LAST /end MOD_COMMON
/begin RECORD_LAYOUT Scalar_BOOLEAN FNC_VALUES 1 UBYTE COLUMN_DIR DIRECT /end RECORD_LAYOUT
/begin RECORD_LAYOUT Scalar_UBYTE FNC_VALUES 1 UBYTE COLUMN_DIR DIRECT /end RECORD_LAYOUT
/begin RECORD_LAYOUT Scalar_BYTE FNC_VALUES 1 SBYTE COLUMN_DIR DIRECT /end RECORD_LAYOUT
/begin RECORD_LAYOUT Scalar_UWORD FNC_VALUES 1 UWORD COLUMN_DIR DIRECT /end RECORD_LAYOUT
/begin RECORD_LAYOUT Scalar_SWORD FNC_VALUES 1 SWORD COLUMN_DIR DIRECT /end RECORD_LAYOUT
/begin RECORD_LAYOUT Scalar_ULONG FNC_VALUES 1 ULONG COLUMN_DIR DIRECT /end RECORD_LAYOUT
/begin RECORD_LAYOUT Scalar_LONG FNC_VALUES 1 SLONG COLUMN_DIR DIRECT /end RECORD_LAYOUT
/begin RECORD_LAYOUT Scalar_FLOAT32_IEEE FNC_VALUES 1 FLOAT32_IEEE COLUMN_DIR DIRECT /end RECORD_LAYOUT
/begin RECORD_LAYOUT Scalar_FLOAT64_IEEE FNC_VALUES 1 FLOAT64_IEEE COLUMN_DIR DIRECT /end RECORD_LAYOUT
/begin RECORD_LAYOUT Lookup1D_BOOLEAN FNC_VALUES 1 UBYTE COLUMN_DIR DIRECT /end RECORD_LAYOUT
/begin RECORD_LAYOUT Lookup1D_X_BOOLEAN AXIS_PTS_X 1 UBYTE INDEX_INCR DIRECT /end RECORD_LAYOUT
/begin RECORD_LAYOUT Lookup1D_BYTE FNC_VALUES 1 SBYTE COLUMN_DIR DIRECT /end RECORD_LAYOUT
/begin RECORD_LAYOUT Lookup1D_X_BYTE AXIS_PTS_X 1 SBYTE INDEX_INCR DIRECT /end RECORD_LAYOUT
/begin RECORD_LAYOUT Lookup1D_UBYTE FNC_VALUES 1 UBYTE COLUMN_DIR DIRECT /end RECORD_LAYOUT
/begin RECORD_LAYOUT Lookup1D_X_UBYTE AXIS_PTS_X 1 UBYTE INDEX_INCR DIRECT /end RECORD_LAYOUT
/begin RECORD_LAYOUT Lookup1D_UWORD FNC_VALUES 1 UWORD COLUMN_DIR DIRECT /end RECORD_LAYOUT
/begin RECORD_LAYOUT Lookup1D_X_UWORD AXIS_PTS_X 1 UWORD INDEX_INCR DIRECT /end RECORD_LAYOUT
/begin RECORD_LAYOUT Lookup1D_WORD FNC_VALUES 1 SWORD COLUMN_DIR DIRECT /end RECORD_LAYOUT
/begin RECORD_LAYOUT Lookup1D_X_WORD AXIS_PTS_X 1 SWORD INDEX_INCR DIRECT /end RECORD_LAYOUT
/begin RECORD_LAYOUT Lookup1D_ULONG FNC_VALUES 1 ULONG COLUMN_DIR DIRECT /end RECORD_LAYOUT
/begin RECORD_LAYOUT Lookup1D_X_ULONG AXIS_PTS_X 1 ULONG INDEX_INCR DIRECT /end RECORD_LAYOUT
/begin RECORD_LAYOUT Lookup1D_SLONG FNC_VALUES 1 SLONG COLUMN_DIR DIRECT /end RECORD_LAYOUT
/begin RECORD_LAYOUT Lookup1D_X_LONG AXIS_PTS_X 1 SLONG INDEX_INCR DIRECT /end RECORD_LAYOUT
/begin RECORD_LAYOUT Lookup1D_FLOAT32_IEEE FNC_VALUES 1 FLOAT32_IEEE COLUMN_DIR DIRECT /end RECORD_LAYOUT
/begin RECORD_LAYOUT Lookup1D_X_FLOAT32_IEEE AXIS_PTS_X 1 FLOAT32_IEEE INDEX_INCR DIRECT /end RECORD_LAYOUT
/begin RECORD_LAYOUT Lookup1D_FLOAT64_IEEE FNC_VALUES 1 FLOAT64_IEEE COLUMN_DIR DIRECT /end RECORD_LAYOUT
/begin RECORD_LAYOUT Lookup1D_X_FLOAT64_IEEE AXIS_PTS_X 1 FLOAT64_IEEE INDEX_INCR DIRECT /end RECORD_LAYOUT
/begin RECORD_LAYOUT Lookup2D_BOOLEAN FNC_VALUES 1 UBYTE COLUMN_DIR DIRECT /end RECORD_LAYOUT
/begin RECORD_LAYOUT Lookup2D_X_BOOLEAN AXIS_PTS_X 1 UBYTE INDEX_INCR DIRECT /end RECORD_LAYOUT
/begin RECORD_LAYOUT Lookup2D_UBYTE FNC_VALUES 1 UBYTE COLUMN_DIR DIRECT /end RECORD_LAYOUT
/begin RECORD_LAYOUT Lookup2D_X_UBYTE AXIS_PTS_X 1 UBYTE INDEX_INCR DIRECT /end RECORD_LAYOUT
/begin RECORD_LAYOUT Lookup2D_BYTE FNC_VALUES 1 SBYTE COLUMN_DIR DIRECT /end RECORD_LAYOUT
/begin RECORD_LAYOUT Lookup2D_X_BYTE AXIS_PTS_X 1 SBYTE INDEX_INCR DIRECT /end RECORD_LAYOUT
/begin RECORD_LAYOUT Lookup2D_UWORD FNC_VALUES 1 UWORD COLUMN_DIR DIRECT /end RECORD_LAYOUT
/begin RECORD_LAYOUT Lookup2D_X_UWORD AXIS_PTS_X 1 UWORD INDEX_INCR DIRECT /end RECORD_LAYOUT
/begin RECORD_LAYOUT Lookup2D_WORD FNC_VALUES 1 SWORD COLUMN_DIR DIRECT /end RECORD_LAYOUT
/begin RECORD_LAYOUT Lookup2D_X_WORD AXIS_PTS_X 1 SWORD INDEX_INCR DIRECT /end RECORD_LAYOUT
/begin RECORD_LAYOUT Lookup2D_ULONG FNC_VALUES 1 ULONG COLUMN_DIR DIRECT /end RECORD_LAYOUT
/begin RECORD_LAYOUT Lookup2D_X_ULONG AXIS_PTS_X 1 ULONG INDEX_INCR DIRECT /end RECORD_LAYOUT
/begin RECORD_LAYOUT Lookup2D_LONG FNC_VALUES 1 SLONG COLUMN_DIR DIRECT /end RECORD_LAYOUT
/begin RECORD_LAYOUT Lookup2D_X_LONG AXIS_PTS_X 1 SLONG INDEX_INCR DIRECT /end RECORD_LAYOUT
/begin RECORD_LAYOUT Lookup2D_FLOAT32_IEEE FNC_VALUES 1 FLOAT32_IEEE COLUMN_DIR DIRECT /end RECORD_LAYOUT
/begin RECORD_LAYOUT Lookup2D_X_FLOAT32_IEEE AXIS_PTS_X 1 FLOAT32_IEEE INDEX_INCR DIRECT /end RECORD_LAYOUT
/begin RECORD_LAYOUT Lookup2D_FLOAT64_IEEE FNC_VALUES 1 FLOAT64_IEEE COLUMN_DIR DIRECT /end RECORD_LAYOUT
/begin RECORD_LAYOUT Lookup2D_X_FLOAT64_IEEE AXIS_PTS_X 1 FLOAT64_IEEE INDEX_INCR DIRECT /end RECORD_LAYOUT
/begin CHARACTERISTIC CAL_Hspf_CodeDataMatchTable_af32 "软件和数据匹配表" MAP 0x0000 /* @ECU_Address@CAL_Hspf_CodeDataMatchTable_af32@ */ Lookup2D_FLOAT32_IEEE 0 SWC_HSPF_CM_single -3.4E+38 3.4E+38
 /begin AXIS_DESCR COM_AXIS NO_INPUT_QUANTITY SWC_HSPF_CM_single 7 -3.4E+38 3.4E+38 AXIS_PTS_REF CAL_Hspf_CodeTable_af32 /end AXIS_DESCR
 /begin AXIS_DESCR COM_AXIS NO_INPUT_QUANTITY SWC_HSPF_CM_single 6 -3.4E+38 3.4E+38 AXIS_PTS_REF CAL_Hspf_DataTable_af32 /end AXIS_DESCR
/end CHARACTERISTIC
/begin AXIS_PTS CAL_Hspf_DataTable_af32 "数据版本号" 0x0000 /* @ECU_Address@CAL_Hspf_DataTable_af32@ */ NO_INPUT_QUANTITY Lookup2D_X_FLOAT32_IEEE 0 SWC_HSPF_CM_single 6 -3.4E+38 3.4E+38 /end AXIS_PTS
/begin AXIS_PTS CAL_Hspf_CodeTable_af32 "软件版本号" 0x0000 /* @ECU_Address@CAL_Hspf_CodeTable_af32@ */ NO_INPUT_QUANTITY Lookup2D_X_FLOAT32_IEEE 0 SWC_HSPF_CM_single 7 -3.4E+38 3.4E+38 /end AXIS_PTS
/begin CHARACTERISTIC CAL_Hspf_ProjectNumMatchTable_af32 "项目匹配表" MAP 0x0000 /* @ECU_Address@CAL_Hspf_ProjectNumMatchTable_af32@ */ Lookup2D_FLOAT32_IEEE 0 SWC_HSPF_CM_single -3.4E+38 3.4E+38
 /begin AXIS_DESCR COM_AXIS NO_INPUT_QUANTITY SWC_HSPF_CM_single 7 -3.4E+38 3.4E+38 AXIS_PTS_REF CAL_Hspf_ProjectNuminSWTable_af32 /end AXIS_DESCR
 /begin AXIS_DESCR COM_AXIS NO_INPUT_QUANTITY SWC_HSPF_CM_single 6 -3.4E+38 3.4E+38 AXIS_PTS_REF CAL_Hspf_CPLDProjectNumTable_af32 /end AXIS_DESCR
/end CHARACTERISTIC
/begin AXIS_PTS CAL_Hspf_CPLDProjectNumTable_af32 "CPLD项目号" 0x0000 /* @ECU_Address@CAL_Hspf_CPLDProjectNumTable_af32@ */ NO_INPUT_QUANTITY Lookup2D_X_FLOAT32_IEEE 0 SWC_HSPF_CM_single 6 -3.4E+38 3.4E+38 /end AXIS_PTS
/begin AXIS_PTS CAL_Hspf_ProjectNuminSWTable_af32 "解析出来的项目号" 0x0000 /* @ECU_Address@CAL_Hspf_ProjectNuminSWTable_af32@ */ NO_INPUT_QUANTITY Lookup2D_X_FLOAT32_IEEE 0 SWC_HSPF_CM_single 7 -3.4E+38 3.4E+38 /end AXIS_PTS
/begin CHARACTERISTIC CAL_Hspf_CodeCpldSwMatchTable_af32 "软件和CPLD软件版本号匹配表" MAP 0x0000 /* @ECU_Address@CAL_Hspf_CodeCpldSwMatchTable_af32@ */ Lookup2D_FLOAT32_IEEE 0 SWC_HSPF_CM_single -3.4E+38 3.4E+38
 /begin AXIS_DESCR COM_AXIS NO_INPUT_QUANTITY SWC_HSPF_CM_single 7 -3.4E+38 3.4E+38 AXIS_PTS_REF CAL_Hspf_CodeTable_af32 /end AXIS_DESCR
 /begin AXIS_DESCR COM_AXIS NO_INPUT_QUANTITY SWC_HSPF_CM_single 4 -3.4E+38 3.4E+38 AXIS_PTS_REF CAL_Hspf_CpldSwTable_af32 /end AXIS_DESCR
/end CHARACTERISTIC
/begin AXIS_PTS CAL_Hspf_CpldSwTable_af32 "CPLD软件版本" 0x0000 /* @ECU_Address@CAL_Hspf_CpldSwTable_af32@ */ NO_INPUT_QUANTITY Lookup2D_X_FLOAT32_IEEE 0 SWC_HSPF_CM_single 4 -3.4E+38 3.4E+38 /end AXIS_PTS
/begin CHARACTERISTIC CAL_Hspf_CodeHvMcuMatchTable_af32 "软件和高压MCU版本号匹配表" MAP 0x0000 /* @ECU_Address@CAL_Hspf_CodeHvMcuMatchTable_af32@ */ Lookup2D_FLOAT32_IEEE 0 SWC_HSPF_CM_single -3.4E+38 3.4E+38
 /begin AXIS_DESCR COM_AXIS NO_INPUT_QUANTITY SWC_HSPF_CM_single 7 -3.4E+38 3.4E+38 AXIS_PTS_REF CAL_Hspf_CodeTable_af32 /end AXIS_DESCR
 /begin AXIS_DESCR COM_AXIS NO_INPUT_QUANTITY SWC_HSPF_CM_single 6 -3.4E+38 3.4E+38 AXIS_PTS_REF CAL_Hspf_HvMcuTable_af32 /end AXIS_DESCR
/end CHARACTERISTIC
/begin AXIS_PTS CAL_Hspf_HvMcuTable_af32 "高压MCU版本号" 0x0000 /* @ECU_Address@CAL_Hspf_HvMcuTable_af32@ */ NO_INPUT_QUANTITY Lookup2D_X_FLOAT32_IEEE 0 SWC_HSPF_CM_single 6 -3.4E+38 3.4E+38 /end AXIS_PTS
/begin CHARACTERISTIC CAL_Hspf_HwAnalHwVerMatchTable_af32 "硬件匹配表" MAP 0x0000 /* @ECU_Address@CAL_Hspf_HwAnalHwVerMatchTable_af32@ */ Lookup2D_FLOAT32_IEEE 0 SWC_HSPF_CM_single -3.4E+38 3.4E+38
 /begin AXIS_DESCR COM_AXIS VAR_Bsw_Hwver_f32 SWC_HSPF_CM_single 6 -3.4E+38 3.4E+38 AXIS_PTS_REF CAL_Hspf_HwVerTable_af32 /end AXIS_DESCR
 /begin AXIS_DESCR COM_AXIS NO_INPUT_QUANTITY SWC_HSPF_CM_single 2 -3.4E+38 3.4E+38 AXIS_PTS_REF CAL_Hspf_HwAnalTable_af32 /end AXIS_DESCR
/end CHARACTERISTIC
/begin AXIS_PTS CAL_Hspf_HwAnalTable_af32 "解析匹配" 0x0000 /* @ECU_Address@CAL_Hspf_HwAnalTable_af32@ */ NO_INPUT_QUANTITY Lookup2D_X_FLOAT32_IEEE 0 SWC_HSPF_CM_single 2 -3.4E+38 3.4E+38 /end AXIS_PTS
/begin AXIS_PTS CAL_Hspf_HwVerTable_af32 "硬件版本号" 0x0000 /* @ECU_Address@CAL_Hspf_HwVerTable_af32@ */ VAR_Bsw_Hwver_f32 Lookup2D_X_FLOAT32_IEEE 0 SWC_HSPF_CM_single 6 -3.4E+38 3.4E+38 /end AXIS_PTS
/begin CHARACTERISTIC CAL_Hspf_CltInletTempFltFrq_f32 "" VALUE 0x0000 /* @ECU_Address@CAL_Hspf_CltInletTempFltFrq_f32@ */ Scalar_FLOAT32_IEEE 0 SWC_HSPF_CM_single -3.4E+38 3.4E+38 /end CHARACTERISTIC
/begin CHARACTERISTIC CAL_Hspf_TmpCoolanTjFltFrq_f32 "估算水温滤波频率" VALUE 0x0000 /* @ECU_Address@CAL_Hspf_TmpCoolanTjFltFrq_f32@ */ Scalar_FLOAT32_IEEE 0 SWC_HSPF_CM_single -3.4E+38 3.4E+38 /end CHARACTERISTIC
/begin CHARACTERISTIC CAL_Hspf_TmpUFltFrq_f32 "Temperature filter cut off frequency" VALUE 0x0000 /* @ECU_Address@CAL_Hspf_TmpUFltFrq_f32@ */ Scalar_FLOAT32_IEEE 0 SWC_HSPF_CM_single 0.0 100.0 /end CHARACTERISTIC
/begin CHARACTERISTIC CAL_Hspf_TmpVFltFrq_f32 "" VALUE 0x0000 /* @ECU_Address@CAL_Hspf_TmpVFltFrq_f32@ */ Scalar_FLOAT32_IEEE 0 SWC_HSPF_CM_single -3.4E+38 3.4E+38 /end CHARACTERISTIC
/begin CHARACTERISTIC CAL_Hspf_TmpWFltFrq_f32 "" VALUE 0x0000 /* @ECU_Address@CAL_Hspf_TmpWFltFrq_f32@ */ Scalar_FLOAT32_IEEE 0 SWC_HSPF_CM_single -3.4E+38 3.4E+38 /end CHARACTERISTIC
/begin CHARACTERISTIC CAL_Hspf_iDcLnkEstFltFrq_f32 "母线电流慢滤波值" VALUE 0x0000 /* @ECU_Address@CAL_Hspf_iDcLnkEstFltFrq_f32@ */ Scalar_FLOAT32_IEEE 0 SWC_HSPF_CM_single -3.4E+38 3.4E+38 /end CHARACTERISTIC
/begin CHARACTERISTIC CAL_Hspf_nFltFrq_f32 "电机转速慢滤波截止频率 " VALUE 0x0000 /* @ECU_Address@CAL_Hspf_nFltFrq_f32@ */ Scalar_FLOAT32_IEEE 0 SWC_HSPF_CM_single -3.4E+38 3.4E+38 /end CHARACTERISTIC
/begin CHARACTERISTIC CAL_Hspf_tCoolantFltFrq_f32 "冷却水滤波截止频率" VALUE 0x0000 /* @ECU_Address@CAL_Hspf_tCoolantFltFrq_f32@ */ Scalar_FLOAT32_IEEE 0 SWC_HSPF_CM_single -3.4E+38 3.4E+38 /end CHARACTERISTIC
/begin CHARACTERISTIC CAL_Hspf_tStrrTmp1FltFrq_f32 "" VALUE 0x0000 /* @ECU_Address@CAL_Hspf_tStrrTmp1FltFrq_f32@ */ Scalar_FLOAT32_IEEE 0 SWC_HSPF_CM_single -3.4E+38 3.4E+38 /end CHARACTERISTIC
/begin CHARACTERISTIC CAL_Hspf_tStrrTmp2FltFrq_f32 "" VALUE 0x0000 /* @ECU_Address@CAL_Hspf_tStrrTmp2FltFrq_f32@ */ Scalar_FLOAT32_IEEE 0 SWC_HSPF_CM_single -3.4E+38 3.4E+38 /end CHARACTERISTIC
/begin CHARACTERISTIC CAL_Hspf_tSwtTempSttrHiLim_f32 "" VALUE 0x0000 /* @ECU_Address@CAL_Hspf_tSwtTempSttrHiLim_f32@ */ Scalar_FLOAT32_IEEE 0 SWC_HSPF_CM_single -3.4E+38 3.4E+38 /end CHARACTERISTIC
/begin CHARACTERISTIC CAL_Hspf_tSwtTempSttrLoLim_f32 "" VALUE 0x0000 /* @ECU_Address@CAL_Hspf_tSwtTempSttrLoLim_f32@ */ Scalar_FLOAT32_IEEE 0 SWC_HSPF_CM_single -3.4E+38 3.4E+38 /end CHARACTERISTIC
/begin CHARACTERISTIC CAL_Hspf_uDcLnkFltFrq_f32 "母线电压慢滤波截止频率 " VALUE 0x0000 /* @ECU_Address@CAL_Hspf_uDcLnkFltFrq_f32@ */ Scalar_FLOAT32_IEEE 0 SWC_HSPF_CM_single -3.4E+38 3.4E+38 /end CHARACTERISTIC
/begin CHARACTERISTIC CAL_Hspf_uKl30FltFrq_f32 "" VALUE 0x0000 /* @ECU_Address@CAL_Hspf_uKl30FltFrq_f32@ */ Scalar_FLOAT32_IEEE 0 SWC_HSPF_CM_single 0.0 100.0 /end CHARACTERISTIC
/begin CHARACTERISTIC CAL_Hspf_VerChkTime_u16 "软件匹配超时" VALUE 0x0000 /* @ECU_Address@CAL_Hspf_VerChkTime_u16@ */ Scalar_UWORD 0 SWC_HSPF_CM_uint16 0 65535 /end CHARACTERISTIC
/begin CHARACTERISTIC CAL_Hspf_cntIPhCalOffTolCnt_u16 "相电流采样总计数" VALUE 0x0000 /* @ECU_Address@CAL_Hspf_cntIPhCalOffTolCnt_u16@ */ Scalar_UWORD 0 SWC_HSPF_CM_uint16 0 65535 /end CHARACTERISTIC
/begin CHARACTERISTIC CAL_Hspf_cntIPhCalOffValCnt_u16 "相电流采样有效计数" VALUE 0x0000 /* @ECU_Address@CAL_Hspf_cntIPhCalOffValCnt_u16@ */ Scalar_UWORD 0 SWC_HSPF_CM_uint16 0 65535 /end CHARACTERISTIC
/begin CHARACTERISTIC CAL_Hspf_iPhaHighSet_u16 "相电流采样有效上限" VALUE 0x0000 /* @ECU_Address@CAL_Hspf_iPhaHighSet_u16@ */ Scalar_UWORD 0 SWC_HSPF_CM_uint16 0 65535 /end CHARACTERISTIC
/begin CHARACTERISTIC CAL_Hspf_iPhaLowSet_u16 "相电流采样有效下限" VALUE 0x0000 /* @ECU_Address@CAL_Hspf_iPhaLowSet_u16@ */ Scalar_UWORD 0 SWC_HSPF_CM_uint16 0 65535 /end CHARACTERISTIC
/begin CHARACTERISTIC CAL_Hspf_tDBCCmpTime_u16 "" VALUE 0x0000 /* @ECU_Address@CAL_Hspf_tDBCCmpTime_u16@ */ Scalar_UWORD 0 SWC_HSPF_CM_uint16 0 65535 /end CHARACTERISTIC
/begin CHARACTERISTIC CAL_Hspf_CrashChkCntLoLim_s8 "" VALUE 0x0000 /* @ECU_Address@CAL_Hspf_CrashChkCntLoLim_s8@ */ Scalar_BYTE 0 SWC_HSPF_CM_int8 -128 127 /end CHARACTERISTIC
/begin CHARACTERISTIC CAL_Hspf_CrashChkSubCnt_s8 "" VALUE 0x0000 /* @ECU_Address@CAL_Hspf_CrashChkSubCnt_s8@ */ Scalar_BYTE 0 SWC_HSPF_CM_int8 -128 127 /end CHARACTERISTIC
/begin CHARACTERISTIC CAL_Hspf_INVOpenChkCntLoLim_s8 "" VALUE 0x0000 /* @ECU_Address@CAL_Hspf_INVOpenChkCntLoLim_s8@ */ Scalar_BYTE 0 SWC_HSPF_CM_int8 -128 127 /end CHARACTERISTIC
/begin CHARACTERISTIC CAL_Hspf_INVOpenChkSubCnt_s8 "" VALUE 0x0000 /* @ECU_Address@CAL_Hspf_INVOpenChkSubCnt_s8@ */ Scalar_BYTE 0 SWC_HSPF_CM_int8 -128 127 /end CHARACTERISTIC
/begin CHARACTERISTIC CAL_Hspf_MotTemLowTable_af32 "" VAL_BLK 0x0000 /* @ECU_Address@CAL_Hspf_MotTemLowTable_af32@ */ Scalar_BYTE 0 SWC_HSPF_CM_int8 -128 127 /* Array Size */ NUMBER 1024 /end CHARACTERISTIC
/begin CHARACTERISTIC CAL_Hspf_MotorOpenChkCntLoLim_s8 "" VALUE 0x0000 /* @ECU_Address@CAL_Hspf_MotorOpenChkCntLoLim_s8@ */ Scalar_BYTE 0 SWC_HSPF_CM_int8 -128 127 /end CHARACTERISTIC
/begin CHARACTERISTIC CAL_Hspf_MototOpenChkSubCnt_s8 "" VALUE 0x0000 /* @ECU_Address@CAL_Hspf_MototOpenChkSubCnt_s8@ */ Scalar_BYTE 0 SWC_HSPF_CM_int8 -128 127 /end CHARACTERISTIC
/begin CHARACTERISTIC CAL_Hspf_bt15ChkCntLoLim_s8 "点火信号消除下限限值" VALUE 0x0000 /* @ECU_Address@CAL_Hspf_bt15ChkCntLoLim_s8@ */ Scalar_BYTE 0 SWC_HSPF_CM_int8 -128 127 /end CHARACTERISTIC
/begin CHARACTERISTIC CAL_Hspf_bt15ChkSubCnt_s8 "点火信号确认下减个数" VALUE 0x0000 /* @ECU_Address@CAL_Hspf_bt15ChkSubCnt_s8@ */ Scalar_BYTE 0 SWC_HSPF_CM_int8 -128 127 /end CHARACTERISTIC
/begin CHARACTERISTIC CAL_Hspf_CrashChkAddCnt_u8 "" VALUE 0x0000 /* @ECU_Address@CAL_Hspf_CrashChkAddCnt_u8@ */ Scalar_UBYTE 0 SWC_HSPF_CM_uint8 0 255 /end CHARACTERISTIC
/begin CHARACTERISTIC CAL_Hspf_CrashChkCntHiLim_u8 "" VALUE 0x0000 /* @ECU_Address@CAL_Hspf_CrashChkCntHiLim_u8@ */ Scalar_UBYTE 0 SWC_HSPF_CM_uint8 0 255 /end CHARACTERISTIC
/begin CHARACTERISTIC CAL_Hspf_DBCTempROCLimChkCnt_u8 "" VALUE 0x0000 /* @ECU_Address@CAL_Hspf_DBCTempROCLimChkCnt_u8@ */ Scalar_UBYTE 0 SWC_HSPF_CM_uint8 0 255 /end CHARACTERISTIC
/begin CHARACTERISTIC CAL_Hspf_INVOpenChkAddCnt_u8 "" VALUE 0x0000 /* @ECU_Address@CAL_Hspf_INVOpenChkAddCnt_u8@ */ Scalar_UBYTE 0 SWC_HSPF_CM_uint8 0 255 /end CHARACTERISTIC
/begin CHARACTERISTIC CAL_Hspf_INVOpenChkCntHiLim_u8 "" VALUE 0x0000 /* @ECU_Address@CAL_Hspf_INVOpenChkCntHiLim_u8@ */ Scalar_UBYTE 0 SWC_HSPF_CM_uint8 0 255 /end CHARACTERISTIC
/begin CHARACTERISTIC CAL_Hspf_MotTemHigTable_af32 "" VAL_BLK 0x0000 /* @ECU_Address@CAL_Hspf_MotTemHigTable_af32@ */ Scalar_UBYTE 0 SWC_HSPF_CM_uint8 0 255 /* Array Size */ NUMBER 1024 /end CHARACTERISTIC
/begin CHARACTERISTIC CAL_Hspf_MotorOpenChkAddCnt_u8 "" VALUE 0x0000 /* @ECU_Address@CAL_Hspf_MotorOpenChkAddCnt_u8@ */ Scalar_UBYTE 0 SWC_HSPF_CM_uint8 0 255 /end CHARACTERISTIC
/begin CHARACTERISTIC CAL_Hspf_MotorOpenChkCntHiLim_u8 "" VALUE 0x0000 /* @ECU_Address@CAL_Hspf_MotorOpenChkCntHiLim_u8@ */ Scalar_UBYTE 0 SWC_HSPF_CM_uint8 0 255 /end CHARACTERISTIC
/begin CHARACTERISTIC CAL_Hspf_Multiple_u8 "信号采样频率" VALUE 0x0000 /* @ECU_Address@CAL_Hspf_Multiple_u8@ */ Scalar_UBYTE 0 SWC_HSPF_CM_uint8 0 255 /end CHARACTERISTIC
/begin CHARACTERISTIC CAL_Hspf_VerMatchFailure_u8 "自检失败" VALUE 0x0000 /* @ECU_Address@CAL_Hspf_VerMatchFailure_u8@ */ Scalar_UBYTE 0 SWC_HSPF_CM_uint8 0 255 /end CHARACTERISTIC
/begin CHARACTERISTIC CAL_Hspf_VerMatchSucceed_u8 "自检成功" VALUE 0x0000 /* @ECU_Address@CAL_Hspf_VerMatchSucceed_u8@ */ Scalar_UBYTE 0 SWC_HSPF_CM_uint8 0 255 /end CHARACTERISTIC
/begin CHARACTERISTIC CAL_Hspf_VerMatchTimeOutErr_u8 "自检进行中" VALUE 0x0000 /* @ECU_Address@CAL_Hspf_VerMatchTimeOutErr_u8@ */ Scalar_UBYTE 0 SWC_HSPF_CM_uint8 0 255 /end CHARACTERISTIC
/begin CHARACTERISTIC CAL_Hspf_VerMatchUncheck_u8 "自检未进行" VALUE 0x0000 /* @ECU_Address@CAL_Hspf_VerMatchUncheck_u8@ */ Scalar_UBYTE 0 SWC_HSPF_CM_uint8 0 255 /end CHARACTERISTIC
/begin CHARACTERISTIC CAL_Hspf_bt15ChkAddCnt_u8 "点火信号确认上加个数" VALUE 0x0000 /* @ECU_Address@CAL_Hspf_bt15ChkAddCnt_u8@ */ Scalar_UBYTE 0 SWC_HSPF_CM_uint8 0 255 /end CHARACTERISTIC
/begin CHARACTERISTIC CAL_Hspf_bt15ChkCntHiLim_u8 "点火信号确认上限限值" VALUE 0x0000 /* @ECU_Address@CAL_Hspf_bt15ChkCntHiLim_u8@ */ Scalar_UBYTE 0 SWC_HSPF_CM_uint8 0 255 /end CHARACTERISTIC
/begin CHARACTERISTIC CAL_Hspf_stPreDrvCtl_u8 "" VALUE 0x0000 /* @ECU_Address@CAL_Hspf_stPreDrvCtl_u8@ */ Scalar_UBYTE 0 SWC_HSPF_CM_uint8 0 255 /end CHARACTERISTIC
/begin CHARACTERISTIC CAL_Hspf_tDBCTempROCLim_u8 "" VALUE 0x0000 /* @ECU_Address@CAL_Hspf_tDBCTempROCLim_u8@ */ Scalar_UBYTE 0 SWC_HSPF_CM_uint8 0 255 /end CHARACTERISTIC
/begin CHARACTERISTIC CAL_Hspf_tDBCtempOffset_u8 "IGBT温度偏差阈值" VALUE 0x0000 /* @ECU_Address@CAL_Hspf_tDBCtempOffset_u8@ */ Scalar_UBYTE 0 SWC_HSPF_CM_uint8 0 255 /end CHARACTERISTIC
/begin MEASUREMENT VAR_Bsw_Hwver_f32 "" FLOAT32_IEEE SWC_HSPF_CM_single 0 0 -3.4E+38 3.4E+38 ECU_ADDRESS 0x0000 /* @ECU_Address@VAR_Bsw_Hwver_f32@ */ /end MEASUREMENT
/begin MEASUREMENT VAR_Hspf_tDBCTempU_f32 "" FLOAT32_IEEE SWC_HSPF_CM_single 0 0 -3.4E+38 3.4E+38 ECU_ADDRESS 0x0000 /* @ECU_Address@VAR_Hspf_tDBCTempU_f32@ */ /end MEASUREMENT
/begin MEASUREMENT VAR_Hspf_tDBCTempV_f32 "" FLOAT32_IEEE SWC_HSPF_CM_single 0 0 -3.4E+38 3.4E+38 ECU_ADDRESS 0x0000 /* @ECU_Address@VAR_Hspf_tDBCTempV_f32@ */ /end MEASUREMENT
/begin MEASUREMENT VAR_Hspf_tDBCTempW_f32 "" FLOAT32_IEEE SWC_HSPF_CM_single 0 0 -3.4E+38 3.4E+38 ECU_ADDRESS 0x0000 /* @ECU_Address@VAR_Hspf_tDBCTempW_f32@ */ /end MEASUREMENT
/begin MEASUREMENT VAR_Bsw_tCoolantTemp_f32 "" FLOAT32_IEEE SWC_HSPF_CM_single 0 0 -3.4E+38 3.4E+38 ECU_ADDRESS 0x0000 /* @ECU_Address@VAR_Bsw_tCoolantTemp_f32@ */ /end MEASUREMENT
/begin MEASUREMENT VAR_Hspf_uKl30_f32 "" FLOAT32_IEEE SWC_HSPF_CM_single 0 0 -3.4E+38 3.4E+38 ECU_ADDRESS 0x0000 /* @ECU_Address@VAR_Hspf_uKl30_f32@ */ /end MEASUREMENT
/begin MEASUREMENT VAR_Hspf_tCoolantTemp_f32 "" FLOAT32_IEEE SWC_HSPF_CM_single 0 0 -3.4E+38 3.4E+38 ECU_ADDRESS 0x0000 /* @ECU_Address@VAR_Hspf_tCoolantTemp_f32@ */ /end MEASUREMENT
/begin MEASUREMENT VAR_Hspf_tDrvBoardTemp_f32 "" FLOAT32_IEEE SWC_HSPF_CM_single 0 0 -3.4E+38 3.4E+38 ECU_ADDRESS 0x0000 /* @ECU_Address@VAR_Hspf_tDrvBoardTemp_f32@ */ /end MEASUREMENT
/begin MEASUREMENT VAR_Hspf_uDcLnk_f32 "" FLOAT32_IEEE SWC_HSPF_CM_single 0 0 -3.4E+38 3.4E+38 ECU_ADDRESS 0x0000 /* @ECU_Address@VAR_Hspf_uDcLnk_f32@ */ /end MEASUREMENT
/begin MEASUREMENT VAR_Bsw_tStrrTemp1_u16 "" UWORD SWC_HSPF_CM_uint16 0 0 0 65535 ECU_ADDRESS 0x0000 /* @ECU_Address@VAR_Bsw_tStrrTemp1_u16@ */ /end MEASUREMENT
/begin MEASUREMENT VAR_Bsw_tStrrTemp2_u16 "" UWORD SWC_HSPF_CM_uint16 0 0 0 65535 ECU_ADDRESS 0x0000 /* @ECU_Address@VAR_Bsw_tStrrTemp2_u16@ */ /end MEASUREMENT
/begin MEASUREMENT VAR_Bsw_tDBCTempU_u16 "" UWORD SWC_HSPF_CM_uint16 0 0 0 65535 ECU_ADDRESS 0x0000 /* @ECU_Address@VAR_Bsw_tDBCTempU_u16@ */ /end MEASUREMENT
/begin MEASUREMENT VAR_Bsw_tDBCTempV_u16 "" UWORD SWC_HSPF_CM_uint16 0 0 0 65535 ECU_ADDRESS 0x0000 /* @ECU_Address@VAR_Bsw_tDBCTempV_u16@ */ /end MEASUREMENT
/begin MEASUREMENT VAR_Bsw_tDBCTempW_u16 "" UWORD SWC_HSPF_CM_uint16 0 0 0 65535 ECU_ADDRESS 0x0000 /* @ECU_Address@VAR_Bsw_tDBCTempW_u16@ */ /end MEASUREMENT
/begin MEASUREMENT VAR_Bsw_tDrvBoardTemp_u16 "" UWORD SWC_HSPF_CM_uint16 0 0 0 65535 ECU_ADDRESS 0x0000 /* @ECU_Address@VAR_Bsw_tDrvBoardTemp_u16@ */ /end MEASUREMENT
/begin MEASUREMENT VAR_Hspf_tStrrTemp1_s16 "" SWORD SWC_HSPF_CM_int16 0 0 -32768 32767 ECU_ADDRESS 0x0000 /* @ECU_Address@VAR_Hspf_tStrrTemp1_s16@ */ /end MEASUREMENT
/begin MEASUREMENT VAR_Hspf_tStrrTemp2_s16 "" SWORD SWC_HSPF_CM_int16 0 0 -32768 32767 ECU_ADDRESS 0x0000 /* @ECU_Address@VAR_Hspf_tStrrTemp2_s16@ */ /end MEASUREMENT
/begin MEASUREMENT VAR_Hspf_stVerChk_u8 "" UBYTE SWC_HSPF_CM_uint8 0 0 0 255 ECU_ADDRESS 0x0000 /* @ECU_Address@VAR_Hspf_stVerChk_u8@ */ /end MEASUREMENT
/begin MEASUREMENT VAR_Hspf_VerMatchFailureErr_u8 "" UBYTE SWC_HSPF_CM_uint8 0 0 0 255 ECU_ADDRESS 0x0000 /* @ECU_Address@VAR_Hspf_VerMatchFailureErr_u8@ */ /end MEASUREMENT
/begin MEASUREMENT VAR_Hspf_HWVer_u8 "" UBYTE SWC_HSPF_CM_uint8 0 0 0 255 ECU_ADDRESS 0x0000 /* @ECU_Address@VAR_Hspf_HWVer_u8@ */ /end MEASUREMENT
/begin MEASUREMENT VAR_Hspf_bSwtTempSttr1_b "" UBYTE SWC_HSPF_CM_boolean 0 0 0 1 ECU_ADDRESS 0x0000 /* @ECU_Address@VAR_Hspf_bSwtTempSttr1_b@ */ /end MEASUREMENT
/begin MEASUREMENT VAR_Hspf_bSwtTempSttr2_b "" UBYTE SWC_HSPF_CM_boolean 0 0 0 1 ECU_ADDRESS 0x0000 /* @ECU_Address@VAR_Hspf_bSwtTempSttr2_b@ */ /end MEASUREMENT
/begin MEASUREMENT VAR_Bsw_INV_Open_b "" UBYTE SWC_HSPF_CM_boolean 0 0 0 1 ECU_ADDRESS 0x0000 /* @ECU_Address@VAR_Bsw_INV_Open_b@ */ /end MEASUREMENT
/begin MEASUREMENT VAR_Bsw_Motor_Open_b "" UBYTE SWC_HSPF_CM_boolean 0 0 0 1 ECU_ADDRESS 0x0000 /* @ECU_Address@VAR_Bsw_Motor_Open_b@ */ /end MEASUREMENT
/begin MEASUREMENT VAR_Hspf_tDBCCmpErrDelay_b "" UBYTE SWC_HSPF_CM_boolean 0 0 0 1 ECU_ADDRESS 0x0000 /* @ECU_Address@VAR_Hspf_tDBCCmpErrDelay_b@ */ /end MEASUREMENT
/begin MEASUREMENT VAR_Bsw_Wake_b "" UBYTE SWC_HSPF_CM_boolean 0 0 0 1 ECU_ADDRESS 0x0000 /* @ECU_Address@VAR_Bsw_Wake_b@ */ /end MEASUREMENT
/begin MEASUREMENT VAR_Bsw_bt15_b "" UBYTE SWC_HSPF_CM_boolean 0 0 0 1 ECU_ADDRESS 0x0000 /* @ECU_Address@VAR_Bsw_bt15_b@ */ /end MEASUREMENT
/begin MEASUREMENT VAR_Bsw_Crash_b "" UBYTE SWC_HSPF_CM_boolean 0 0 0 1 ECU_ADDRESS 0x0000 /* @ECU_Address@VAR_Bsw_Crash_b@ */ /end MEASUREMENT
/begin MEASUREMENT VAR_Hspf_flgSttr2NoErr_b "" UBYTE SWC_HSPF_CM_boolean 0 0 0 1 ECU_ADDRESS 0x0000 /* @ECU_Address@VAR_Hspf_flgSttr2NoErr_b@ */ /end MEASUREMENT
/begin MEASUREMENT VAR_Hspf_flgSttr1NoErr_b "" UBYTE SWC_HSPF_CM_boolean 0 0 0 1 ECU_ADDRESS 0x0000 /* @ECU_Address@VAR_Hspf_flgSttr1NoErr_b@ */ /end MEASUREMENT
/begin COMPU_METHOD SWC_HSPF_CM_single "Q = V" RAT_FUNC "%8.6" "" COEFFS 0 1 0 0 0 1 /end COMPU_METHOD
/begin COMPU_METHOD SWC_HSPF_CM_uint16 "Q = V" RAT_FUNC "%5.0" "" COEFFS 0 1 0 0 0 1 /end COMPU_METHOD
/begin COMPU_METHOD SWC_HSPF_CM_int8 "Q = V" RAT_FUNC "%3.0" "" COEFFS 0 1 0 0 0 1 /end COMPU_METHOD
/begin COMPU_METHOD SWC_HSPF_CM_uint8 "Q = V" RAT_FUNC "%3.0" "" COEFFS 0 1 0 0 0 1 /end COMPU_METHOD
/begin COMPU_METHOD SWC_HSPF_CM_int16 "Q = V" RAT_FUNC "%5.0" "" COEFFS 0 1 0 0 0 1 /end COMPU_METHOD
/begin COMPU_METHOD SWC_HSPF_CM_boolean "Q = V" RAT_FUNC "%1.0" "" COEFFS 0 1 0 0 0 1 /end COMPU_METHOD
/begin GROUP SWC_HSPF "SWC_HSPF" /* Root */ ROOT /begin SUB_GROUP Root_RE_SWC_HSPF_10ms_sys /end SUB_GROUP /end GROUP
/begin GROUP Root_RE_SWC_HSPF_10ms_sys "SWC_HSPF/RE_SWC_HSPF_10ms_sys" /begin SUB_GROUP S1_Subsystem /end SUB_GROUP
 /begin REF_MEASUREMENT VAR_Bsw_Crash_b VAR_Bsw_Hwver_f32 VAR_Bsw_INV_Open_b VAR_Bsw_Motor_Open_b VAR_Bsw_Wake_b VAR_Bsw_bt15_b VAR_Bsw_tCoolantTemp_f32 VAR_Hspf_uKl30_f32 /end REF_MEASUREMENT
/end GROUP
/begin GROUP S1_Subsystem "SWC_HSPF/RE_SWC_HSPF_10ms_sys/Subsystem"
 /begin SUB_GROUP S3_HSPF_GsDia S3_HSPF_SelfTest S3_HSPF_SigDebounce S3_HSPF_TjProcess S3_HSPF_VerChk S3_SPF_SigFlt /end SUB_GROUP
/end GROUP
/begin GROUP S3_HSPF_GsDia "SWC_HSPF/RE_SWC_HSPF_10ms_sys/Subsystem/HSPF_GsDia" /begin SUB_GROUP S4_HSPF_sttrTempDia S4_HSPF_tDBCTempDia /end SUB_GROUP /end GROUP
/begin GROUP S3_HSPF_SelfTest "SWC_HSPF/RE_SWC_HSPF_10ms_sys/Subsystem/HSPF_SelfTest" /begin SUB_GROUP S5_IPhaSenOffCal1 /end SUB_GROUP /end GROUP
/begin GROUP S3_HSPF_SigDebounce "SWC_HSPF/RE_SWC_HSPF_10ms_sys/Subsystem/HSPF_SigDebounce"
 /begin SUB_GROUP S6_HSPF_CrashDebounce S6_HSPF_INV_OpenDebounce S6_HSPF_Motor_OpenDebounce S6_HSPF_WakeDebounce S6_HSPF_bt15Debounce /end SUB_GROUP
/end GROUP
/begin GROUP S3_HSPF_TjProcess "SWC_HSPF/RE_SWC_HSPF_10ms_sys/Subsystem/HSPF_TjProcess" /begin SUB_GROUP S7_HSPF_tDBCTempUFilter /end SUB_GROUP /begin REF_CHARACTERISTIC CAL_Hspf_TmpCoolanTjFltFrq_f32 /end REF_CHARACTERISTIC /end GROUP
/begin GROUP S3_HSPF_VerChk "SWC_HSPF/RE_SWC_HSPF_10ms_sys/Subsystem/HSPF_VerChk" /begin SUB_GROUP S8_HspfVerChk /end SUB_GROUP /begin REF_CHARACTERISTIC CAL_Hspf_VerMatchUncheck_u8 /end REF_CHARACTERISTIC /end GROUP
/begin GROUP S3_SPF_SigFlt "SWC_HSPF/RE_SWC_HSPF_10ms_sys/Subsystem/SPF_SigFlt"
 /begin SUB_GROUP S9_DrvBoardTemp S9_HSPF_nFilter S9_HSPF_tCoolantFilter S9_HSPF_tCoolantFilter2 S9_HSPF_tCoolantTemp S9_HSPF_tDBCTempUCnv S9_HSPF_tDBCTempUFilter S9_HSPF_tDBCTempVCnv S9_HSPF_tDBCTempVFilter S9_HSPF_tDBCTempWFilter S9_HSPF_tDrvBoardTemp S9_HSPF_tStrrTemp1Filter S9_HSPF_tStrrTemp2Filter S9_HSPF_tSttrTemp2Cnv S9_HSPF_uDcLnkFilter S9_HSPF_uKl30Filter S9_SPF_tDBCTempWCnv S9_SPF_tSttrTemp1Cnv /end SUB_GROUP
 /begin REF_CHARACTERISTIC CAL_Hspf_CltInletTempFltFrq_f32 CAL_Hspf_TmpUFltFrq_f32 CAL_Hspf_TmpVFltFrq_f32 CAL_Hspf_TmpWFltFrq_f32 CAL_Hspf_iDcLnkEstFltFrq_f32 CAL_Hspf_nFltFrq_f32 CAL_Hspf_tCoolantFltFrq_f32 CAL_Hspf_tStrrTmp1FltFrq_f32 CAL_Hspf_tStrrTmp2FltFrq_f32 CAL_Hspf_uDcLnkFltFrq_f32 CAL_Hspf_uKl30FltFrq_f32 /end REF_CHARACTERISTIC
 /begin REF_MEASUREMENT VAR_Bsw_tDBCTempU_u16 VAR_Bsw_tDBCTempV_u16 VAR_Bsw_tDBCTempW_u16 VAR_Bsw_tDrvBoardTemp_u16 VAR_Bsw_tStrrTemp1_u16 VAR_Bsw_tStrrTemp2_u16 VAR_Hspf_uDcLnk_f32 /end REF_MEASUREMENT
/end GROUP
/begin GROUP S4_HSPF_sttrTempDia "SWC_HSPF/RE_SWC_HSPF_10ms_sys/Subsystem/HSPF_GsDia/HSPF_sttrTempDia" /begin REF_MEASUREMENT VAR_Hspf_flgSttr1NoErr_b VAR_Hspf_flgSttr2NoErr_b /end REF_MEASUREMENT /end GROUP
/begin GROUP S4_HSPF_tDBCTempDia "SWC_HSPF/RE_SWC_HSPF_10ms_sys/Subsystem/HSPF_GsDia/HSPF_tDBCTempDia" /begin SUB_GROUP S12_ErrDelay /end SUB_GROUP /begin REF_CHARACTERISTIC CAL_Hspf_tDBCtempOffset_u8 /end REF_CHARACTERISTIC /end GROUP
/begin GROUP S5_IPhaSenOffCal1 "SWC_HSPF/RE_SWC_HSPF_10ms_sys/Subsystem/HSPF_SelfTest/IPhaSenOffCal1"
 /begin REF_CHARACTERISTIC CAL_Hspf_cntIPhCalOffTolCnt_u16 CAL_Hspf_cntIPhCalOffValCnt_u16 CAL_Hspf_iPhaHighSet_u16 CAL_Hspf_iPhaLowSet_u16 CAL_Hspf_stPreDrvCtl_u8 /end REF_CHARACTERISTIC
/end GROUP
/begin GROUP S6_HSPF_CrashDebounce "SWC_HSPF/RE_SWC_HSPF_10ms_sys/Subsystem/HSPF_SigDebounce/HSPF_CrashDebounce"
 /begin REF_CHARACTERISTIC CAL_Hspf_CrashChkAddCnt_u8 CAL_Hspf_CrashChkCntHiLim_u8 CAL_Hspf_CrashChkCntLoLim_s8 CAL_Hspf_CrashChkSubCnt_s8 /end REF_CHARACTERISTIC
/end GROUP
/begin GROUP S6_HSPF_INV_OpenDebounce "SWC_HSPF/RE_SWC_HSPF_10ms_sys/Subsystem/HSPF_SigDebounce/HSPF_INV_OpenDebounce"
 /begin REF_CHARACTERISTIC CAL_Hspf_INVOpenChkAddCnt_u8 CAL_Hspf_INVOpenChkCntHiLim_u8 CAL_Hspf_INVOpenChkCntLoLim_s8 CAL_Hspf_INVOpenChkSubCnt_s8 /end REF_CHARACTERISTIC
/end GROUP
/begin GROUP S6_HSPF_Motor_OpenDebounce "SWC_HSPF/RE_SWC_HSPF_10ms_sys/Subsystem/HSPF_SigDebounce/HSPF_Motor_OpenDebounce"
 /begin REF_CHARACTERISTIC CAL_Hspf_MotorOpenChkAddCnt_u8 CAL_Hspf_MotorOpenChkCntHiLim_u8 CAL_Hspf_MotorOpenChkCntLoLim_s8 CAL_Hspf_MototOpenChkSubCnt_s8 /end REF_CHARACTERISTIC
/end GROUP
/begin GROUP S6_HSPF_WakeDebounce "SWC_HSPF/RE_SWC_HSPF_10ms_sys/Subsystem/HSPF_SigDebounce/HSPF_WakeDebounce"
 /begin REF_CHARACTERISTIC CAL_Hspf_bt15ChkAddCnt_u8 CAL_Hspf_bt15ChkCntHiLim_u8 CAL_Hspf_bt15ChkCntLoLim_s8 CAL_Hspf_bt15ChkSubCnt_s8 /end REF_CHARACTERISTIC
/end GROUP
/begin GROUP S6_HSPF_bt15Debounce "SWC_HSPF/RE_SWC_HSPF_10ms_sys/Subsystem/HSPF_SigDebounce/HSPF_bt15Debounce"
 /begin REF_CHARACTERISTIC CAL_Hspf_bt15ChkAddCnt_u8 CAL_Hspf_bt15ChkCntHiLim_u8 CAL_Hspf_bt15ChkCntLoLim_s8 CAL_Hspf_bt15ChkSubCnt_s8 /end REF_CHARACTERISTIC
/end GROUP
/begin GROUP S7_HSPF_tDBCTempUFilter "SWC_HSPF/RE_SWC_HSPF_10ms_sys/Subsystem/HSPF_TjProcess/HSPF_tDBCTempUFilter" /begin REF_CHARACTERISTIC CAL_Hspf_Multiple_u8 /end REF_CHARACTERISTIC /end GROUP
/begin GROUP S8_HspfVerChk "SWC_HSPF/RE_SWC_HSPF_10ms_sys/Subsystem/HSPF_VerChk/HspfVerChk"
 /begin REF_CHARACTERISTIC CAL_Hspf_CodeCpldSwMatchTable_af32 CAL_Hspf_CodeDataMatchTable_af32 CAL_Hspf_CodeHvMcuMatchTable_af32 CAL_Hspf_HwAnalHwVerMatchTable_af32 CAL_Hspf_ProjectNumMatchTable_af32 CAL_Hspf_VerChkTime_u16 CAL_Hspf_VerMatchFailure_u8 CAL_Hspf_VerMatchSucceed_u8 CAL_Hspf_VerMatchTimeOutErr_u8 CAL_Hspf_VerMatchUncheck_u8 /end REF_CHARACTERISTIC
 /begin REF_MEASUREMENT VAR_Hspf_HWVer_u8 VAR_Hspf_VerMatchFailureErr_u8 VAR_Hspf_stVerChk_u8 /end REF_MEASUREMENT
/end GROUP
/begin GROUP S9_DrvBoardTemp "SWC_HSPF/RE_SWC_HSPF_10ms_sys/Subsystem/SPF_SigFlt/DrvBoardTemp" /begin REF_MEASUREMENT VAR_Hspf_tDrvBoardTemp_f32 /end REF_MEASUREMENT /end GROUP
/begin GROUP S9_HSPF_nFilter "SWC_HSPF/RE_SWC_HSPF_10ms_sys/Subsystem/SPF_SigFlt/HSPF_nFilter" /begin REF_CHARACTERISTIC CAL_Hspf_Multiple_u8 /end REF_CHARACTERISTIC /end GROUP
/begin GROUP S9_HSPF_tCoolantFilter "SWC_HSPF/RE_SWC_HSPF_10ms_sys/Subsystem/SPF_SigFlt/HSPF_tCoolantFilter" /begin REF_CHARACTERISTIC CAL_Hspf_Multiple_u8 /end REF_CHARACTERISTIC /end GROUP
/begin GROUP S9_HSPF_tCoolantFilter2 "SWC_HSPF/RE_SWC_HSPF_10ms_sys/Subsystem/SPF_SigFlt/HSPF_tCoolantFilter2" /begin REF_CHARACTERISTIC CAL_Hspf_Multiple_u8 /end REF_CHARACTERISTIC /end GROUP
/begin GROUP S9_HSPF_tCoolantTemp "SWC_HSPF/RE_SWC_HSPF_10ms_sys/Subsystem/SPF_SigFlt/HSPF_tCoolantTemp" /begin REF_MEASUREMENT VAR_Hspf_tCoolantTemp_f32 /end REF_MEASUREMENT /end GROUP
/begin GROUP S9_HSPF_tDBCTempUCnv "SWC_HSPF/RE_SWC_HSPF_10ms_sys/Subsystem/SPF_SigFlt/HSPF_tDBCTempUCnv" /begin REF_CHARACTERISTIC CAL_Hspf_DBCTempROCLimChkCnt_u8 CAL_Hspf_tDBCTempROCLim_u8 /end REF_CHARACTERISTIC /begin REF_MEASUREMENT VAR_Hspf_tDBCTempU_f32 /end REF_MEASUREMENT /end GROUP
/begin GROUP S9_HSPF_tDBCTempUFilter "SWC_HSPF/RE_SWC_HSPF_10ms_sys/Subsystem/SPF_SigFlt/HSPF_tDBCTempUFilter" /begin REF_CHARACTERISTIC CAL_Hspf_Multiple_u8 /end REF_CHARACTERISTIC /end GROUP
/begin GROUP S9_HSPF_tDBCTempVCnv "SWC_HSPF/RE_SWC_HSPF_10ms_sys/Subsystem/SPF_SigFlt/HSPF_tDBCTempVCnv" /begin REF_CHARACTERISTIC CAL_Hspf_DBCTempROCLimChkCnt_u8 CAL_Hspf_tDBCTempROCLim_u8 /end REF_CHARACTERISTIC /begin REF_MEASUREMENT VAR_Hspf_tDBCTempV_f32 /end REF_MEASUREMENT /end GROUP
/begin GROUP S9_HSPF_tDBCTempVFilter "SWC_HSPF/RE_SWC_HSPF_10ms_sys/Subsystem/SPF_SigFlt/HSPF_tDBCTempVFilter" /begin REF_CHARACTERISTIC CAL_Hspf_Multiple_u8 /end REF_CHARACTERISTIC /end GROUP
/begin GROUP S9_HSPF_tDBCTempWFilter "SWC_HSPF/RE_SWC_HSPF_10ms_sys/Subsystem/SPF_SigFlt/HSPF_tDBCTempWFilter" /begin REF_CHARACTERISTIC CAL_Hspf_Multiple_u8 /end REF_CHARACTERISTIC /end GROUP
/begin GROUP S9_HSPF_tDrvBoardTemp "SWC_HSPF/RE_SWC_HSPF_10ms_sys/Subsystem/SPF_SigFlt/HSPF_tDrvBoardTemp" /begin REF_CHARACTERISTIC CAL_Hspf_Multiple_u8 /end REF_CHARACTERISTIC /end GROUP
/begin GROUP S9_HSPF_tStrrTemp1Filter "SWC_HSPF/RE_SWC_HSPF_10ms_sys/Subsystem/SPF_SigFlt/HSPF_tStrrTemp1Filter" /begin REF_CHARACTERISTIC CAL_Hspf_Multiple_u8 /end REF_CHARACTERISTIC /end GROUP
/begin GROUP S9_HSPF_tStrrTemp2Filter "SWC_HSPF/RE_SWC_HSPF_10ms_sys/Subsystem/SPF_SigFlt/HSPF_tStrrTemp2Filter" /begin REF_CHARACTERISTIC CAL_Hspf_Multiple_u8 /end REF_CHARACTERISTIC /end GROUP
/begin GROUP S9_HSPF_tSttrTemp2Cnv "SWC_HSPF/RE_SWC_HSPF_10ms_sys/Subsystem/SPF_SigFlt/HSPF_tSttrTemp2Cnv"
 /begin REF_CHARACTERISTIC CAL_Hspf_MotTemHigTable_af32 CAL_Hspf_MotTemLowTable_af32 CAL_Hspf_tSwtTempSttrHiLim_f32 CAL_Hspf_tSwtTempSttrLoLim_f32 /end REF_CHARACTERISTIC
 /begin REF_MEASUREMENT VAR_Hspf_bSwtTempSttr2_b VAR_Hspf_tStrrTemp2_s16 /end REF_MEASUREMENT
/end GROUP
/begin GROUP S9_HSPF_uDcLnkFilter "SWC_HSPF/RE_SWC_HSPF_10ms_sys/Subsystem/SPF_SigFlt/HSPF_uDcLnkFilter" /begin REF_CHARACTERISTIC CAL_Hspf_Multiple_u8 /end REF_CHARACTERISTIC /end GROUP
/begin GROUP S9_HSPF_uKl30Filter "SWC_HSPF/RE_SWC_HSPF_10ms_sys/Subsystem/SPF_SigFlt/HSPF_uKl30Filter" /begin REF_CHARACTERISTIC CAL_Hspf_Multiple_u8 /end REF_CHARACTERISTIC /end GROUP
/begin GROUP S9_SPF_tDBCTempWCnv "SWC_HSPF/RE_SWC_HSPF_10ms_sys/Subsystem/SPF_SigFlt/SPF_tDBCTempWCnv" /begin REF_CHARACTERISTIC CAL_Hspf_DBCTempROCLimChkCnt_u8 CAL_Hspf_tDBCTempROCLim_u8 /end REF_CHARACTERISTIC /begin REF_MEASUREMENT VAR_Hspf_tDBCTempW_f32 /end REF_MEASUREMENT /end GROUP
/begin GROUP S9_SPF_tSttrTemp1Cnv "SWC_HSPF/RE_SWC_HSPF_10ms_sys/Subsystem/SPF_SigFlt/SPF_tSttrTemp1Cnv"
 /begin REF_CHARACTERISTIC CAL_Hspf_MotTemHigTable_af32 CAL_Hspf_MotTemLowTable_af32 CAL_Hspf_tSwtTempSttrHiLim_f32 CAL_Hspf_tSwtTempSttrLoLim_f32 /end REF_CHARACTERISTIC
 /begin REF_MEASUREMENT VAR_Hspf_bSwtTempSttr1_b VAR_Hspf_tStrrTemp1_s16 /end REF_MEASUREMENT
/end GROUP
/begin GROUP S12_ErrDelay "SWC_HSPF/RE_SWC_HSPF_10ms_sys/Subsystem/HSPF_GsDia/HSPF_tDBCTempDia/ErrDelay" /begin REF_CHARACTERISTIC CAL_Hspf_tDBCCmpTime_u16 /end REF_CHARACTERISTIC /begin REF_MEASUREMENT VAR_Hspf_tDBCCmpErrDelay_b /end REF_MEASUREMENT /end GROUP
/end MODULE
/end PROJECT
/* (add any file trailer comments here) */
/* EOF SWC_HSPF.a2l */
