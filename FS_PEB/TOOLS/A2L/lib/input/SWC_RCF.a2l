/******************************************************************************
* ASAP2 file: SWC_RCF.a2l
* Code generation for model "SWC_RCF".
* Model version : 1.29
* Simulink Coder version : 9.3 (R2020a) 18-Nov-2019
* C source code generated on : Mon Jan 18 14:13:15 2021
* Target selection: autosar.tlc
* Embedded hardware selection: Intel->x86-64 (Windows64)
* Code generation objectives: Unspecified
* Validation result: Not run
* (add additional file header information here)
******************************************************************************/ ASAP2_VERSION 1 31
/* Version 1.31 */
/begin PROJECT ProjectName "Project Comment Goes Here"
/begin HEADER "Header Comments go here" /end HEADER
/begin MODULE ModuleName "Module Comment Goes Here"
/begin MOD_PAR "MOD PAR Comment Goes Here" /end MOD_PAR
/begin MOD_COMMON "Mod Common Comment Here" BYTE_ORDER MSB_LAST /end MOD_COMMON
/begin RECORD_LAYOUT Scalar_BOOLEAN FNC_VALUES 1 UBYTE COLUMN_DIR DIRECT /end RECORD_LAYOUT
/begin RECORD_LAYOUT Scalar_UBYTE FNC_VALUES 1 UBYTE COLUMN_DIR DIRECT /end RECORD_LAYOUT
/begin RECORD_LAYOUT Scalar_BYTE FNC_VALUES 1 SBYTE COLUMN_DIR DIRECT /end RECORD_LAYOUT
/begin RECORD_LAYOUT Scalar_UWORD FNC_VALUES 1 UWORD COLUMN_DIR DIRECT /end RECORD_LAYOUT
/begin RECORD_LAYOUT Scalar_SWORD FNC_VALUES 1 SWORD COLUMN_DIR DIRECT /end RECORD_LAYOUT
/begin RECORD_LAYOUT Scalar_ULONG FNC_VALUES 1 ULONG COLUMN_DIR DIRECT /end RECORD_LAYOUT
/begin RECORD_LAYOUT Scalar_LONG FNC_VALUES 1 SLONG COLUMN_DIR DIRECT /end RECORD_LAYOUT
/begin RECORD_LAYOUT Scalar_FLOAT32_IEEE FNC_VALUES 1 FLOAT32_IEEE COLUMN_DIR DIRECT /end RECORD_LAYOUT
/begin RECORD_LAYOUT Scalar_FLOAT64_IEEE FNC_VALUES 1 FLOAT64_IEEE COLUMN_DIR DIRECT /end RECORD_LAYOUT
/begin RECORD_LAYOUT Lookup1D_BOOLEAN FNC_VALUES 1 UBYTE COLUMN_DIR DIRECT /end RECORD_LAYOUT
/begin RECORD_LAYOUT Lookup1D_X_BOOLEAN AXIS_PTS_X 1 UBYTE INDEX_INCR DIRECT /end RECORD_LAYOUT
/begin RECORD_LAYOUT Lookup1D_BYTE FNC_VALUES 1 SBYTE COLUMN_DIR DIRECT /end RECORD_LAYOUT
/begin RECORD_LAYOUT Lookup1D_X_BYTE AXIS_PTS_X 1 SBYTE INDEX_INCR DIRECT /end RECORD_LAYOUT
/begin RECORD_LAYOUT Lookup1D_UBYTE FNC_VALUES 1 UBYTE COLUMN_DIR DIRECT /end RECORD_LAYOUT
/begin RECORD_LAYOUT Lookup1D_X_UBYTE AXIS_PTS_X 1 UBYTE INDEX_INCR DIRECT /end RECORD_LAYOUT
/begin RECORD_LAYOUT Lookup1D_UWORD FNC_VALUES 1 UWORD COLUMN_DIR DIRECT /end RECORD_LAYOUT
/begin RECORD_LAYOUT Lookup1D_X_UWORD AXIS_PTS_X 1 UWORD INDEX_INCR DIRECT /end RECORD_LAYOUT
/begin RECORD_LAYOUT Lookup1D_WORD FNC_VALUES 1 SWORD COLUMN_DIR DIRECT /end RECORD_LAYOUT
/begin RECORD_LAYOUT Lookup1D_X_WORD AXIS_PTS_X 1 SWORD INDEX_INCR DIRECT /end RECORD_LAYOUT
/begin RECORD_LAYOUT Lookup1D_ULONG FNC_VALUES 1 ULONG COLUMN_DIR DIRECT /end RECORD_LAYOUT
/begin RECORD_LAYOUT Lookup1D_X_ULONG AXIS_PTS_X 1 ULONG INDEX_INCR DIRECT /end RECORD_LAYOUT
/begin RECORD_LAYOUT Lookup1D_SLONG FNC_VALUES 1 SLONG COLUMN_DIR DIRECT /end RECORD_LAYOUT
/begin RECORD_LAYOUT Lookup1D_X_LONG AXIS_PTS_X 1 SLONG INDEX_INCR DIRECT /end RECORD_LAYOUT
/begin RECORD_LAYOUT Lookup1D_FLOAT32_IEEE FNC_VALUES 1 FLOAT32_IEEE COLUMN_DIR DIRECT /end RECORD_LAYOUT
/begin RECORD_LAYOUT Lookup1D_X_FLOAT32_IEEE AXIS_PTS_X 1 FLOAT32_IEEE INDEX_INCR DIRECT /end RECORD_LAYOUT
/begin RECORD_LAYOUT Lookup1D_FLOAT64_IEEE FNC_VALUES 1 FLOAT64_IEEE COLUMN_DIR DIRECT /end RECORD_LAYOUT
/begin RECORD_LAYOUT Lookup1D_X_FLOAT64_IEEE AXIS_PTS_X 1 FLOAT64_IEEE INDEX_INCR DIRECT /end RECORD_LAYOUT
/begin RECORD_LAYOUT Lookup2D_BOOLEAN FNC_VALUES 1 UBYTE COLUMN_DIR DIRECT /end RECORD_LAYOUT
/begin RECORD_LAYOUT Lookup2D_X_BOOLEAN AXIS_PTS_X 1 UBYTE INDEX_INCR DIRECT /end RECORD_LAYOUT
/begin RECORD_LAYOUT Lookup2D_UBYTE FNC_VALUES 1 UBYTE COLUMN_DIR DIRECT /end RECORD_LAYOUT
/begin RECORD_LAYOUT Lookup2D_X_UBYTE AXIS_PTS_X 1 UBYTE INDEX_INCR DIRECT /end RECORD_LAYOUT
/begin RECORD_LAYOUT Lookup2D_BYTE FNC_VALUES 1 SBYTE COLUMN_DIR DIRECT /end RECORD_LAYOUT
/begin RECORD_LAYOUT Lookup2D_X_BYTE AXIS_PTS_X 1 SBYTE INDEX_INCR DIRECT /end RECORD_LAYOUT
/begin RECORD_LAYOUT Lookup2D_UWORD FNC_VALUES 1 UWORD COLUMN_DIR DIRECT /end RECORD_LAYOUT
/begin RECORD_LAYOUT Lookup2D_X_UWORD AXIS_PTS_X 1 UWORD INDEX_INCR DIRECT /end RECORD_LAYOUT
/begin RECORD_LAYOUT Lookup2D_WORD FNC_VALUES 1 SWORD COLUMN_DIR DIRECT /end RECORD_LAYOUT
/begin RECORD_LAYOUT Lookup2D_X_WORD AXIS_PTS_X 1 SWORD INDEX_INCR DIRECT /end RECORD_LAYOUT
/begin RECORD_LAYOUT Lookup2D_ULONG FNC_VALUES 1 ULONG COLUMN_DIR DIRECT /end RECORD_LAYOUT
/begin RECORD_LAYOUT Lookup2D_X_ULONG AXIS_PTS_X 1 ULONG INDEX_INCR DIRECT /end RECORD_LAYOUT
/begin RECORD_LAYOUT Lookup2D_LONG FNC_VALUES 1 SLONG COLUMN_DIR DIRECT /end RECORD_LAYOUT
/begin RECORD_LAYOUT Lookup2D_X_LONG AXIS_PTS_X 1 SLONG INDEX_INCR DIRECT /end RECORD_LAYOUT
/begin RECORD_LAYOUT Lookup2D_FLOAT32_IEEE FNC_VALUES 1 FLOAT32_IEEE COLUMN_DIR DIRECT /end RECORD_LAYOUT
/begin RECORD_LAYOUT Lookup2D_X_FLOAT32_IEEE AXIS_PTS_X 1 FLOAT32_IEEE INDEX_INCR DIRECT /end RECORD_LAYOUT
/begin RECORD_LAYOUT Lookup2D_FLOAT64_IEEE FNC_VALUES 1 FLOAT64_IEEE COLUMN_DIR DIRECT /end RECORD_LAYOUT
/begin RECORD_LAYOUT Lookup2D_X_FLOAT64_IEEE AXIS_PTS_X 1 FLOAT64_IEEE INDEX_INCR DIRECT /end RECORD_LAYOUT
/begin CHARACTERISTIC CAL_RCF_360EdgeRag_f32 "150度边界范围" VALUE 0x0000 /* @ECU_Address@CAL_RCF_360EdgeRag_f32@ */ Scalar_FLOAT32_IEEE 0 SWC_RCF_CM_single -3.4E+38 3.4E+38 /end CHARACTERISTIC
/begin CHARACTERISTIC CAL_RCF_AlRtrOfsDvtMax_f32 "最大允许的偏移角标定值与预估值的差值" VALUE 0x0000 /* @ECU_Address@CAL_RCF_AlRtrOfsDvtMax_f32@ */ Scalar_FLOAT32_IEEE 0 SWC_RCF_CM_single -3.4E+38 3.4E+38 /end CHARACTERISTIC
/begin CHARACTERISTIC CAL_RCF_OffsetAngFiltCoef_f32 "旋变偏移角滤波系数" VALUE 0x0000 /* @ECU_Address@CAL_RCF_OffsetAngFiltCoef_f32@ */ Scalar_FLOAT32_IEEE 0 SWC_RCF_CM_single -3.4E+38 3.4E+38 /end CHARACTERISTIC
/begin CHARACTERISTIC CAL_RCF_TrqDesAcc_f32 "自动加速过程扭矩" VALUE 0x0000 /* @ECU_Address@CAL_RCF_TrqDesAcc_f32@ */ Scalar_FLOAT32_IEEE 0 SWC_RCF_CM_single -3.4E+38 3.4E+38 /end CHARACTERISTIC
/begin CHARACTERISTIC CAL_RCF_UsAlfaScalSet_f32 "Ubeta电压值" VALUE 0x0000 /* @ECU_Address@CAL_RCF_UsAlfaScalSet_f32@ */ Scalar_FLOAT32_IEEE 0 SWC_RCF_CM_single -3.4E+38 3.4E+38 /end CHARACTERISTIC
/begin CHARACTERISTIC CAL_RCF_UsBetaScalSet_f32 "Ualfa电压值" VALUE 0x0000 /* @ECU_Address@CAL_RCF_UsBetaScalSet_f32@ */ Scalar_FLOAT32_IEEE 0 SWC_RCF_CM_single -3.4E+38 3.4E+38 /end CHARACTERISTIC
/begin CHARACTERISTIC CAL_RCF_agReferenceBwd_f32 "反转反电势基准角" VALUE 0x0000 /* @ECU_Address@CAL_RCF_agReferenceBwd_f32@ */ Scalar_FLOAT32_IEEE 0 SWC_RCF_CM_single -3.4E+38 3.4E+38 /end CHARACTERISTIC
/begin CHARACTERISTIC CAL_RCF_agReferenceFwd_f32 "正转反电势基准角" VALUE 0x0000 /* @ECU_Address@CAL_RCF_agReferenceFwd_f32@ */ Scalar_FLOAT32_IEEE 0 SWC_RCF_CM_single -3.4E+38 3.4E+38 /end CHARACTERISTIC
/begin CHARACTERISTIC CAL_RCF_cTrqSlopAcc_f32 "自动加速过程扭矩上升斜率" VALUE 0x0000 /* @ECU_Address@CAL_RCF_cTrqSlopAcc_f32@ */ Scalar_FLOAT32_IEEE 0 SWC_RCF_CM_single -3.4E+38 3.4E+38 /end CHARACTERISTIC
/begin CHARACTERISTIC CAL_RCF_nAlRtrDesAcc_f32 "加速到偏移角标定所需转速值" VALUE 0x0000 /* @ECU_Address@CAL_RCF_nAlRtrDesAcc_f32@ */ Scalar_FLOAT32_IEEE 0 SWC_RCF_CM_single -3.4E+38 3.4E+38 /end CHARACTERISTIC
/begin CHARACTERISTIC CAL_RCF_nCalcSec1_f32 "Fwl标定转速区间1" VALUE 0x0000 /* @ECU_Address@CAL_RCF_nCalcSec1_f32@ */ Scalar_FLOAT32_IEEE 0 SWC_RCF_CM_single -3.4E+38 3.4E+38 /end CHARACTERISTIC
/begin CHARACTERISTIC CAL_RCF_nCalcSec2_f32 "Fwl标定转速区间2" VALUE 0x0000 /* @ECU_Address@CAL_RCF_nCalcSec2_f32@ */ Scalar_FLOAT32_IEEE 0 SWC_RCF_CM_single -3.4E+38 3.4E+38 /end CHARACTERISTIC
/begin CHARACTERISTIC CAL_RCF_nCalcSec3_f32 "Fwl标定转速区间3" VALUE 0x0000 /* @ECU_Address@CAL_RCF_nCalcSec3_f32@ */ Scalar_FLOAT32_IEEE 0 SWC_RCF_CM_single -3.4E+38 3.4E+38 /end CHARACTERISTIC
/begin CHARACTERISTIC CAL_RCF_nCalcSec4_f32 "Fwl标定转速区间4" VALUE 0x0000 /* @ECU_Address@CAL_RCF_nCalcSec4_f32@ */ Scalar_FLOAT32_IEEE 0 SWC_RCF_CM_single -3.4E+38 3.4E+38 /end CHARACTERISTIC
/begin CHARACTERISTIC CAL_RCF_nCalcSec5_f32 "Fwl标定转速区间5" VALUE 0x0000 /* @ECU_Address@CAL_RCF_nCalcSec5_f32@ */ Scalar_FLOAT32_IEEE 0 SWC_RCF_CM_single -3.4E+38 3.4E+38 /end CHARACTERISTIC
/begin CHARACTERISTIC CAL_RCF_nCalcSec6_f32 "Fwl标定转速区间6" VALUE 0x0000 /* @ECU_Address@CAL_RCF_nCalcSec6_f32@ */ Scalar_FLOAT32_IEEE 0 SWC_RCF_CM_single -3.4E+38 3.4E+38 /end CHARACTERISTIC
/begin CHARACTERISTIC CAL_RCF_nCalcSec7_f32 "Fwl标定转速区间7" VALUE 0x0000 /* @ECU_Address@CAL_RCF_nCalcSec7_f32@ */ Scalar_FLOAT32_IEEE 0 SWC_RCF_CM_single -3.4E+38 3.4E+38 /end CHARACTERISTIC
/begin CHARACTERISTIC CAL_RCF_nCalcSec8_f32 "Fwl标定转速区间8" VALUE 0x0000 /* @ECU_Address@CAL_RCF_nCalcSec8_f32@ */ Scalar_FLOAT32_IEEE 0 SWC_RCF_CM_single -3.4E+38 3.4E+38 /end CHARACTERISTIC
/begin CHARACTERISTIC CAL_RCF_nEstAlOfsStop_f32 "偏移角预估完成转速阈值" VALUE 0x0000 /* @ECU_Address@CAL_RCF_nEstAlOfsStop_f32@ */ Scalar_FLOAT32_IEEE 0 SWC_RCF_CM_single -3.4E+38 3.4E+38 /end CHARACTERISTIC
/begin CHARACTERISTIC CAL_RCF_nExtClbFrewhlBwd_f32 "反向Fwl标定成功加速停止最大转速" VALUE 0x0000 /* @ECU_Address@CAL_RCF_nExtClbFrewhlBwd_f32@ */ Scalar_FLOAT32_IEEE 0 SWC_RCF_CM_single -3.4E+38 3.4E+38 /end CHARACTERISTIC
/begin CHARACTERISTIC CAL_RCF_nExtClbFrewhlFwd_f32 "退出正转Freewheel模式偏移角标定的转速" VALUE 0x0000 /* @ECU_Address@CAL_RCF_nExtClbFrewhlFwd_f32@ */ Scalar_FLOAT32_IEEE 0 SWC_RCF_CM_single -3.4E+38 3.4E+38 /end CHARACTERISTIC
/begin CHARACTERISTIC CAL_RCF_nLimitSucToDef_f32 "" VALUE 0x0000 /* @ECU_Address@CAL_RCF_nLimitSucToDef_f32@ */ Scalar_FLOAT32_IEEE 0 SWC_RCF_CM_single -3.4E+38 3.4E+38 /end CHARACTERISTIC
/begin CHARACTERISTIC CAL_RCF_nMaxStartAcc_f32 "允许进行Acceleration的最大转速" VALUE 0x0000 /* @ECU_Address@CAL_RCF_nMaxStartAcc_f32@ */ Scalar_FLOAT32_IEEE 0 SWC_RCF_CM_single -3.4E+38 3.4E+38 /end CHARACTERISTIC
/begin CHARACTERISTIC CAL_RCF_nMinSkipAcc_f32 "跳过加速状态所需的最小转速" VALUE 0x0000 /* @ECU_Address@CAL_RCF_nMinSkipAcc_f32@ */ Scalar_FLOAT32_IEEE 0 SWC_RCF_CM_single -3.4E+38 3.4E+38 /end CHARACTERISTIC
/begin CHARACTERISTIC CAL_RCF_nMinSuccessStp_f32 "标定成功加速停止最小转速" VALUE 0x0000 /* @ECU_Address@CAL_RCF_nMinSuccessStp_f32@ */ Scalar_FLOAT32_IEEE 0 SWC_RCF_CM_single -3.4E+38 3.4E+38 /end CHARACTERISTIC
/begin CHARACTERISTIC CAL_RCF_nOfValBwdStp_f32 "反转标定结束转速阈值" VALUE 0x0000 /* @ECU_Address@CAL_RCF_nOfValBwdStp_f32@ */ Scalar_FLOAT32_IEEE 0 SWC_RCF_CM_single -3.4E+38 3.4E+38 /end CHARACTERISTIC
/begin CHARACTERISTIC CAL_RCF_nOfValFwdStp_f32 "正转标定结束转速阈值" VALUE 0x0000 /* @ECU_Address@CAL_RCF_nOfValFwdStp_f32@ */ Scalar_FLOAT32_IEEE 0 SWC_RCF_CM_single -3.4E+38 3.4E+38 /end CHARACTERISTIC
/begin CHARACTERISTIC CAL_RCF_nOfsClbMaxBwd_f32 "反转Freewheel转速上限" VALUE 0x0000 /* @ECU_Address@CAL_RCF_nOfsClbMaxBwd_f32@ */ Scalar_FLOAT32_IEEE 0 SWC_RCF_CM_single -3.4E+38 3.4E+38 /end CHARACTERISTIC
/begin CHARACTERISTIC CAL_RCF_nOfsClbMaxFwd_f32 "正转Freewheel转速上限" VALUE 0x0000 /* @ECU_Address@CAL_RCF_nOfsClbMaxFwd_f32@ */ Scalar_FLOAT32_IEEE 0 SWC_RCF_CM_single -3.4E+38 3.4E+38 /end CHARACTERISTIC
/begin CHARACTERISTIC CAL_RCF_nOfsClbMinBwd_f32 "反转Freewheel转速下限" VALUE 0x0000 /* @ECU_Address@CAL_RCF_nOfsClbMinBwd_f32@ */ Scalar_FLOAT32_IEEE 0 SWC_RCF_CM_single -3.4E+38 3.4E+38 /end CHARACTERISTIC
/begin CHARACTERISTIC CAL_RCF_nOfsClbMinFwd_f32 "正转Freewheel转速下限" VALUE 0x0000 /* @ECU_Address@CAL_RCF_nOfsClbMinFwd_f32@ */ Scalar_FLOAT32_IEEE 0 SWC_RCF_CM_single -3.4E+38 3.4E+38 /end CHARACTERISTIC
/begin CHARACTERISTIC CAL_RCF_cntOfValBwd_u32 "反转偏移角标定计数阈值" VALUE 0x0000 /* @ECU_Address@CAL_RCF_cntOfValBwd_u32@ */ Scalar_ULONG 0 SWC_RCF_CM_uint32 0 4294967295 /end CHARACTERISTIC
/begin CHARACTERISTIC CAL_RCF_cntOfValFwd_u32 "正转偏移角标定计数阈值" VALUE 0x0000 /* @ECU_Address@CAL_RCF_cntOfValFwd_u32@ */ Scalar_ULONG 0 SWC_RCF_CM_uint32 0 4294967295 /end CHARACTERISTIC
/begin CHARACTERISTIC CAL_RCF_tHiEstAlOfs_u32 "偏移角预估计数器超时阈值" VALUE 0x0000 /* @ECU_Address@CAL_RCF_tHiEstAlOfs_u32@ */ Scalar_ULONG 0 SWC_RCF_CM_uint32 0 4294967295 /end CHARACTERISTIC
/begin CHARACTERISTIC CAL_RCF_tMaxEstAlOfs1_u32 "预估等待时间" VALUE 0x0000 /* @ECU_Address@CAL_RCF_tMaxEstAlOfs1_u32@ */ Scalar_ULONG 0 SWC_RCF_CM_uint32 0 4294967295 /end CHARACTERISTIC
/begin CHARACTERISTIC CAL_RCF_tMaxEstAlOfs_u32 "偏移角预估计数器阈值" VALUE 0x0000 /* @ECU_Address@CAL_RCF_tMaxEstAlOfs_u32@ */ Scalar_ULONG 0 SWC_RCF_CM_uint32 0 4294967295 /end CHARACTERISTIC
/begin CHARACTERISTIC CAL_RCF_tUAlfaSet_u32 "给Ua时间限值" VALUE 0x0000 /* @ECU_Address@CAL_RCF_tUAlfaSet_u32@ */ Scalar_ULONG 0 SWC_RCF_CM_uint32 0 4294967295 /end CHARACTERISTIC
/begin CHARACTERISTIC CAL_RCF_tUbetaSet_u32 "给Ub时间限值" VALUE 0x0000 /* @ECU_Address@CAL_RCF_tUbetaSet_u32@ */ Scalar_ULONG 0 SWC_RCF_CM_uint32 0 4294967295 /end CHARACTERISTIC
/begin CHARACTERISTIC CAL_RCF_cntMovAveFilBwd_u16 "反转均值计数次数" VALUE 0x0000 /* @ECU_Address@CAL_RCF_cntMovAveFilBwd_u16@ */ Scalar_UWORD 0 SWC_RCF_CM_uint16 0 65535 /end CHARACTERISTIC
/begin CHARACTERISTIC CAL_RCF_cntMovAveFilFwd_u16 "正转均值计数次数" VALUE 0x0000 /* @ECU_Address@CAL_RCF_cntMovAveFilFwd_u16@ */ Scalar_UWORD 0 SWC_RCF_CM_uint16 0 65535 /end CHARACTERISTIC
/begin CHARACTERISTIC CAL_RCF_tMaxAcc_u16 "加速状态超时阈值" VALUE 0x0000 /* @ECU_Address@CAL_RCF_tMaxAcc_u16@ */ Scalar_UWORD 0 SWC_RCF_CM_uint16 0 65535 /end CHARACTERISTIC
/begin CHARACTERISTIC CAL_RCF_tMaxFwlBwd_u16 "反转反电势法标定超时阈值" VALUE 0x0000 /* @ECU_Address@CAL_RCF_tMaxFwlBwd_u16@ */ Scalar_UWORD 0 SWC_RCF_CM_uint16 0 65535 /end CHARACTERISTIC
/begin CHARACTERISTIC CAL_RCF_tMaxFwlFwd_u16 "正转反电势法标定超时阈值" VALUE 0x0000 /* @ECU_Address@CAL_RCF_tMaxFwlFwd_u16@ */ Scalar_UWORD 0 SWC_RCF_CM_uint16 0 65535 /end CHARACTERISTIC
/begin CHARACTERISTIC CAL_RCF_EstToDefault_b "初始角预估主动复位到默认状态标志" VALUE 0x0000 /* @ECU_Address@CAL_RCF_EstToDefault_b@ */ Scalar_BOOLEAN 0 SWC_RCF_CM_boolean 0 1 /end CHARACTERISTIC
/begin CHARACTERISTIC CAL_RCF_SuccdToDefault_b "偏移角主状态机完成状态主动复位到默认状态标志" VALUE 0x0000 /* @ECU_Address@CAL_RCF_SuccdToDefault_b@ */ Scalar_BOOLEAN 0 SWC_RCF_CM_boolean 0 1 /end CHARACTERISTIC
/begin CHARACTERISTIC CAL_RCF_flgEnOfsClb_b "自标定100us模块启用标定量" VALUE 0x0000 /* @ECU_Address@CAL_RCF_flgEnOfsClb_b@ */ Scalar_BOOLEAN 0 SWC_RCF_CM_boolean 0 1 /end CHARACTERISTIC
/begin CHARACTERISTIC CAL_RCF_flgReAutoClbSuc_b "使用自标定角度NVM存储完成标志位" VALUE 0x0000 /* @ECU_Address@CAL_RCF_flgReAutoClbSuc_b@ */ Scalar_BOOLEAN 0 SWC_RCF_CM_boolean 0 1 /end CHARACTERISTIC
/begin CHARACTERISTIC CAL_RCF_flgUseClbSucNvm_b "" VALUE 0x0000 /* @ECU_Address@CAL_RCF_flgUseClbSucNvm_b@ */ Scalar_BOOLEAN 0 SWC_RCF_CM_boolean 0 1 /end CHARACTERISTIC
/begin CHARACTERISTIC CAL_RCF_WithoutStatorCurrent_u8 "此刻无定子电流" VALUE 0x0000 /* @ECU_Address@CAL_RCF_WithoutStatorCurrent_u8@ */ Scalar_UBYTE 0 SWC_RCF_CM_uint8 0 255 /end CHARACTERISTIC
/begin MEASUREMENT VAR_RCF_TrqEmDesOfsClb_f32 "" FLOAT32_IEEE SWC_RCF_CM_single 0 0 -3.4E+38 3.4E+38 ECU_ADDRESS 0x0000 /* @ECU_Address@VAR_RCF_TrqEmDesOfsClb_f32@ */ /end MEASUREMENT
/begin MEASUREMENT VAR_RCF_cTrqSlpOfsClb_f32 "" FLOAT32_IEEE SWC_RCF_CM_single 0 0 -3.4E+38 3.4E+38 ECU_ADDRESS 0x0000 /* @ECU_Address@VAR_RCF_cTrqSlpOfsClb_f32@ */ /end MEASUREMENT
/begin MEASUREMENT VAR_RCF_agRtrOffsEstimd_f32 "" FLOAT32_IEEE SWC_RCF_CM_single 0 0 -3.4E+38 3.4E+38 ECU_ADDRESS 0x0000 /* @ECU_Address@VAR_RCF_agRtrOffsEstimd_f32@ */ /end MEASUREMENT
/begin MEASUREMENT VAR_RCF_UsAlfaScalSet_f32 "" FLOAT32_IEEE SWC_RCF_CM_single 0 0 -3.4E+38 3.4E+38 ECU_ADDRESS 0x0000 /* @ECU_Address@VAR_RCF_UsAlfaScalSet_f32@ */ /end MEASUREMENT
/begin MEASUREMENT VAR_RCF_UsBetaScalSet_f32 "" FLOAT32_IEEE SWC_RCF_CM_single 0 0 -3.4E+38 3.4E+38 ECU_ADDRESS 0x0000 /* @ECU_Address@VAR_RCF_UsBetaScalSet_f32@ */ /end MEASUREMENT
/begin MEASUREMENT VAR_RCF_AutoClbOffset_f32 "" FLOAT32_IEEE SWC_RCF_CM_single 0 0 -3.4E+38 3.4E+38 ECU_ADDRESS 0x0000 /* @ECU_Address@VAR_RCF_AutoClbOffset_f32@ */ /end MEASUREMENT
/begin MEASUREMENT VAR_RCF_OfsClbAngBwd_f32 "" FLOAT32_IEEE SWC_RCF_CM_single 0 0 -3.4E+38 3.4E+38 ECU_ADDRESS 0x0000 /* @ECU_Address@VAR_RCF_OfsClbAngBwd_f32@ */ /end MEASUREMENT
/begin MEASUREMENT VAR_RCF_OfsFlt4800Bwd_f32 "" FLOAT32_IEEE SWC_RCF_CM_single 0 0 -3.4E+38 3.4E+38 ECU_ADDRESS 0x0000 /* @ECU_Address@VAR_RCF_OfsFlt4800Bwd_f32@ */ /end MEASUREMENT
/begin MEASUREMENT VAR_RCF_OfsFlt4600Bwd_f32 "" FLOAT32_IEEE SWC_RCF_CM_single 0 0 -3.4E+38 3.4E+38 ECU_ADDRESS 0x0000 /* @ECU_Address@VAR_RCF_OfsFlt4600Bwd_f32@ */ /end MEASUREMENT
/begin MEASUREMENT VAR_RCF_OfsFlt4400Bwd_f32 "" FLOAT32_IEEE SWC_RCF_CM_single 0 0 -3.4E+38 3.4E+38 ECU_ADDRESS 0x0000 /* @ECU_Address@VAR_RCF_OfsFlt4400Bwd_f32@ */ /end MEASUREMENT
/begin MEASUREMENT VAR_RCF_OfsFlt4200Bwd_f32 "" FLOAT32_IEEE SWC_RCF_CM_single 0 0 -3.4E+38 3.4E+38 ECU_ADDRESS 0x0000 /* @ECU_Address@VAR_RCF_OfsFlt4200Bwd_f32@ */ /end MEASUREMENT
/begin MEASUREMENT VAR_RCF_OfsFlt4000Bwd_f32 "" FLOAT32_IEEE SWC_RCF_CM_single 0 0 -3.4E+38 3.4E+38 ECU_ADDRESS 0x0000 /* @ECU_Address@VAR_RCF_OfsFlt4000Bwd_f32@ */ /end MEASUREMENT
/begin MEASUREMENT VAR_RCF_OfsFlt3800Bwd_f32 "" FLOAT32_IEEE SWC_RCF_CM_single 0 0 -3.4E+38 3.4E+38 ECU_ADDRESS 0x0000 /* @ECU_Address@VAR_RCF_OfsFlt3800Bwd_f32@ */ /end MEASUREMENT
/begin MEASUREMENT VAR_RCF_OfsFlt3600Bwd_f32 "" FLOAT32_IEEE SWC_RCF_CM_single 0 0 -3.4E+38 3.4E+38 ECU_ADDRESS 0x0000 /* @ECU_Address@VAR_RCF_OfsFlt3600Bwd_f32@ */ /end MEASUREMENT
/begin MEASUREMENT VAR_RCF_OfsClbAngFwd_f32 "" FLOAT32_IEEE SWC_RCF_CM_single 0 0 -3.4E+38 3.4E+38 ECU_ADDRESS 0x0000 /* @ECU_Address@VAR_RCF_OfsClbAngFwd_f32@ */ /end MEASUREMENT
/begin MEASUREMENT VAR_RCF_OfsFlt4800Fwd_f32 "" FLOAT32_IEEE SWC_RCF_CM_single 0 0 -3.4E+38 3.4E+38 ECU_ADDRESS 0x0000 /* @ECU_Address@VAR_RCF_OfsFlt4800Fwd_f32@ */ /end MEASUREMENT
/begin MEASUREMENT VAR_RCF_OfsFlt4600Fwd_f32 "" FLOAT32_IEEE SWC_RCF_CM_single 0 0 -3.4E+38 3.4E+38 ECU_ADDRESS 0x0000 /* @ECU_Address@VAR_RCF_OfsFlt4600Fwd_f32@ */ /end MEASUREMENT
/begin MEASUREMENT VAR_RCF_OfsFlt4400Fwd_f32 "" FLOAT32_IEEE SWC_RCF_CM_single 0 0 -3.4E+38 3.4E+38 ECU_ADDRESS 0x0000 /* @ECU_Address@VAR_RCF_OfsFlt4400Fwd_f32@ */ /end MEASUREMENT
/begin MEASUREMENT VAR_RCF_OfsFlt4200Fwd_f32 "" FLOAT32_IEEE SWC_RCF_CM_single 0 0 -3.4E+38 3.4E+38 ECU_ADDRESS 0x0000 /* @ECU_Address@VAR_RCF_OfsFlt4200Fwd_f32@ */ /end MEASUREMENT
/begin MEASUREMENT VAR_RCF_OfsFlt4000Fwd_f32 "" FLOAT32_IEEE SWC_RCF_CM_single 0 0 -3.4E+38 3.4E+38 ECU_ADDRESS 0x0000 /* @ECU_Address@VAR_RCF_OfsFlt4000Fwd_f32@ */ /end MEASUREMENT
/begin MEASUREMENT VAR_RCF_OfsFlt3800Fwd_f32 "" FLOAT32_IEEE SWC_RCF_CM_single 0 0 -3.4E+38 3.4E+38 ECU_ADDRESS 0x0000 /* @ECU_Address@VAR_RCF_OfsFlt3800Fwd_f32@ */ /end MEASUREMENT
/begin MEASUREMENT VAR_RCF_OfsFlt3600Fwd_f32 "" FLOAT32_IEEE SWC_RCF_CM_single 0 0 -3.4E+38 3.4E+38 ECU_ADDRESS 0x0000 /* @ECU_Address@VAR_RCF_OfsFlt3600Fwd_f32@ */ /end MEASUREMENT
/begin MEASUREMENT VAR_RCF_stAgRtrOfsCal_u8 "" UBYTE SWC_RCF_CM_uint8 0 0 0 255 ECU_ADDRESS 0x0000 /* @ECU_Address@VAR_RCF_stAgRtrOfsCal_u8@ */ /end MEASUREMENT
/begin MEASUREMENT VAR_RCF_stDiagOfsClb_u8 "自标定诊断状态" UBYTE SWC_RCF_CM_uint8 0 0 0 255 ECU_ADDRESS 0x0000 /* @ECU_Address@VAR_RCF_stDiagOfsClb_u8@ */ /end MEASUREMENT
/begin MEASUREMENT VAR_RCF_stEstAlRtrOfs_u8 "" UBYTE SWC_RCF_CM_uint8 0 0 0 255 ECU_ADDRESS 0x0000 /* @ECU_Address@VAR_RCF_stEstAlRtrOfs_u8@ */ /end MEASUREMENT
/begin MEASUREMENT VAR_RCF_stOfsFrwhlFwd_u8 "" UBYTE SWC_RCF_CM_uint8 0 0 0 255 ECU_ADDRESS 0x0000 /* @ECU_Address@VAR_RCF_stOfsFrwhlFwd_u8@ */ /end MEASUREMENT
/begin MEASUREMENT VAR_RCF_stOfsFrwhlBwd_u8 "" UBYTE SWC_RCF_CM_uint8 0 0 0 255 ECU_ADDRESS 0x0000 /* @ECU_Address@VAR_RCF_stOfsFrwhlBwd_u8@ */ /end MEASUREMENT
/begin MEASUREMENT VAR_RCF_stOfsClbFrwhl_u8 "" UBYTE SWC_RCF_CM_uint8 0 0 0 255 ECU_ADDRESS 0x0000 /* @ECU_Address@VAR_RCF_stOfsClbFrwhl_u8@ */ /end MEASUREMENT
/begin MEASUREMENT VAR_RCF_flgDefaultToWait_b "" UBYTE SWC_RCF_CM_boolean 0 0 0 1 ECU_ADDRESS 0x0000 /* @ECU_Address@VAR_RCF_flgDefaultToWait_b@ */ /end MEASUREMENT
/begin MEASUREMENT VAR_RCF_flgDefaultToClbFreFwd_b "" UBYTE SWC_RCF_CM_boolean 0 0 0 1 ECU_ADDRESS 0x0000 /* @ECU_Address@VAR_RCF_flgDefaultToClbFreFwd_b@ */ /end MEASUREMENT
/begin MEASUREMENT VAR_RCF_flgDefaultToFrewhlBwd_b "" UBYTE SWC_RCF_CM_boolean 0 0 0 1 ECU_ADDRESS 0x0000 /* @ECU_Address@VAR_RCF_flgDefaultToFrewhlBwd_b@ */ /end MEASUREMENT
/begin MEASUREMENT VAR_RCF_flgWaitToAcc_b "" UBYTE SWC_RCF_CM_boolean 0 0 0 1 ECU_ADDRESS 0x0000 /* @ECU_Address@VAR_RCF_flgWaitToAcc_b@ */ /end MEASUREMENT
/begin MEASUREMENT VAR_RCF_flgAccToClbFreFwd_b "" UBYTE SWC_RCF_CM_boolean 0 0 0 1 ECU_ADDRESS 0x0000 /* @ECU_Address@VAR_RCF_flgAccToClbFreFwd_b@ */ /end MEASUREMENT
/begin MEASUREMENT VAR_RCF_flgClbFreFwdToAcc_b "" UBYTE SWC_RCF_CM_boolean 0 0 0 1 ECU_ADDRESS 0x0000 /* @ECU_Address@VAR_RCF_flgClbFreFwdToAcc_b@ */ /end MEASUREMENT
/begin MEASUREMENT VAR_RCF_flgAccToClbFreBwd_b "" UBYTE SWC_RCF_CM_boolean 0 0 0 1 ECU_ADDRESS 0x0000 /* @ECU_Address@VAR_RCF_flgAccToClbFreBwd_b@ */ /end MEASUREMENT
/begin MEASUREMENT VAR_RCF_flgBwClbSucdToAcc_b "" UBYTE SWC_RCF_CM_boolean 0 0 0 1 ECU_ADDRESS 0x0000 /* @ECU_Address@VAR_RCF_flgBwClbSucdToAcc_b@ */ /end MEASUREMENT
/begin MEASUREMENT VAR_RCF_flgSucdToDefault_b "" UBYTE SWC_RCF_CM_boolean 0 0 0 1 ECU_ADDRESS 0x0000 /* @ECU_Address@VAR_RCF_flgSucdToDefault_b@ */ /end MEASUREMENT
/begin MEASUREMENT VAR_RCF_flgFwdorBwdToDefault_b "" UBYTE SWC_RCF_CM_boolean 0 0 0 1 ECU_ADDRESS 0x0000 /* @ECU_Address@VAR_RCF_flgFwdorBwdToDefault_b@ */ /end MEASUREMENT
/begin MEASUREMENT VAR_RCF_flgAccToDefault_b "" UBYTE SWC_RCF_CM_boolean 0 0 0 1 ECU_ADDRESS 0x0000 /* @ECU_Address@VAR_RCF_flgAccToDefault_b@ */ /end MEASUREMENT
/begin MEASUREMENT VAR_RCF_flgFailToDefault_b "" UBYTE SWC_RCF_CM_boolean 0 0 0 1 ECU_ADDRESS 0x0000 /* @ECU_Address@VAR_RCF_flgFailToDefault_b@ */ /end MEASUREMENT
/begin MEASUREMENT VAR_RCF_flgWaitToFail_b "" UBYTE SWC_RCF_CM_boolean 0 0 0 1 ECU_ADDRESS 0x0000 /* @ECU_Address@VAR_RCF_flgWaitToFail_b@ */ /end MEASUREMENT
/begin MEASUREMENT VAR_RCF_flgPsiToFail_b "" UBYTE SWC_RCF_CM_boolean 0 0 0 1 ECU_ADDRESS 0x0000 /* @ECU_Address@VAR_RCF_flgPsiToFail_b@ */ /end MEASUREMENT
/begin MEASUREMENT VAR_RCF_flgClbToFail_b "" UBYTE SWC_RCF_CM_boolean 0 0 0 1 ECU_ADDRESS 0x0000 /* @ECU_Address@VAR_RCF_flgClbToFail_b@ */ /end MEASUREMENT
/begin MEASUREMENT VAR_RCF_flgAccToSucd_b "" UBYTE SWC_RCF_CM_boolean 0 0 0 1 ECU_ADDRESS 0x0000 /* @ECU_Address@VAR_RCF_flgAccToSucd_b@ */ /end MEASUREMENT
/begin MEASUREMENT VAR_RCF_flgEnblEstAlRtrOfs_b "" UBYTE SWC_RCF_CM_boolean 0 0 0 1 ECU_ADDRESS 0x0000 /* @ECU_Address@VAR_RCF_flgEnblEstAlRtrOfs_b@ */ /end MEASUREMENT
/begin MEASUREMENT VAR_RCF_flgEnblOfsClbFrwhlFwd_b "" UBYTE SWC_RCF_CM_boolean 0 0 0 1 ECU_ADDRESS 0x0000 /* @ECU_Address@VAR_RCF_flgEnblOfsClbFrwhlFwd_b@ */ /end MEASUREMENT
/begin MEASUREMENT VAR_RCF_flgEnblOfsClbFrwhlBwd_b "" UBYTE SWC_RCF_CM_boolean 0 0 0 1 ECU_ADDRESS 0x0000 /* @ECU_Address@VAR_RCF_flgEnblOfsClbFrwhlBwd_b@ */ /end MEASUREMENT
/begin MEASUREMENT VAR_RCF_flgEnblOfsClbFrwhl_b "" UBYTE SWC_RCF_CM_boolean 0 0 0 1 ECU_ADDRESS 0x0000 /* @ECU_Address@VAR_RCF_flgEnblOfsClbFrwhl_b@ */ /end MEASUREMENT
/begin MEASUREMENT VAR_RCF_flgFailorFnhToDefault_b "" UBYTE SWC_RCF_CM_boolean 0 0 0 1 ECU_ADDRESS 0x0000 /* @ECU_Address@VAR_RCF_flgFailorFnhToDefault_b@ */ /end MEASUREMENT
/begin MEASUREMENT VAR_RCF_flgstDefTostEst_b "" UBYTE SWC_RCF_CM_boolean 0 0 0 1 ECU_ADDRESS 0x0000 /* @ECU_Address@VAR_RCF_flgstDefTostEst_b@ */ /end MEASUREMENT
/begin MEASUREMENT VAR_RCF_flgstEstTostDef_b "" UBYTE SWC_RCF_CM_boolean 0 0 0 1 ECU_ADDRESS 0x0000 /* @ECU_Address@VAR_RCF_flgstEstTostDef_b@ */ /end MEASUREMENT
/begin MEASUREMENT VAR_RCF_flgstEstToFail_b "" UBYTE SWC_RCF_CM_boolean 0 0 0 1 ECU_ADDRESS 0x0000 /* @ECU_Address@VAR_RCF_flgstEstToFail_b@ */ /end MEASUREMENT
/begin MEASUREMENT VAR_RCF_flgstEstToWait_b "" UBYTE SWC_RCF_CM_boolean 0 0 0 1 ECU_ADDRESS 0x0000 /* @ECU_Address@VAR_RCF_flgstEstToWait_b@ */ /end MEASUREMENT
/begin MEASUREMENT VAR_RCF_flgInactToFwdClb_b "" UBYTE SWC_RCF_CM_boolean 0 0 0 1 ECU_ADDRESS 0x0000 /* @ECU_Address@VAR_RCF_flgInactToFwdClb_b@ */ /end MEASUREMENT
/begin MEASUREMENT VAR_RCF_flgClbToInact_b "" UBYTE SWC_RCF_CM_boolean 0 0 0 1 ECU_ADDRESS 0x0000 /* @ECU_Address@VAR_RCF_flgClbToInact_b@ */ /end MEASUREMENT
/begin MEASUREMENT VAR_RCF_flgClbReset_b "" UBYTE SWC_RCF_CM_boolean 0 0 0 1 ECU_ADDRESS 0x0000 /* @ECU_Address@VAR_RCF_flgClbReset_b@ */ /end MEASUREMENT
/begin MEASUREMENT VAR_RCF_flgFwdClbToWait_b "" UBYTE SWC_RCF_CM_boolean 0 0 0 1 ECU_ADDRESS 0x0000 /* @ECU_Address@VAR_RCF_flgFwdClbToWait_b@ */ /end MEASUREMENT
/begin MEASUREMENT VAR_RCF_flgWaitToBwdClb_b "" UBYTE SWC_RCF_CM_boolean 0 0 0 1 ECU_ADDRESS 0x0000 /* @ECU_Address@VAR_RCF_flgWaitToBwdClb_b@ */ /end MEASUREMENT
/begin MEASUREMENT VAR_RCF_flgBwdClbToCalc_b "" UBYTE SWC_RCF_CM_boolean 0 0 0 1 ECU_ADDRESS 0x0000 /* @ECU_Address@VAR_RCF_flgBwdClbToCalc_b@ */ /end MEASUREMENT
/begin MEASUREMENT VAR_RCF_flgInactToBwdClb_b "" UBYTE SWC_RCF_CM_boolean 0 0 0 1 ECU_ADDRESS 0x0000 /* @ECU_Address@VAR_RCF_flgInactToBwdClb_b@ */ /end MEASUREMENT
/begin MEASUREMENT VAR_RCF_flgUseUsSet_b "" UBYTE SWC_RCF_CM_boolean 0 0 0 1 ECU_ADDRESS 0x0000 /* @ECU_Address@VAR_RCF_flgUseUsSet_b@ */ /end MEASUREMENT
/begin MEASUREMENT VAR_RCF_flg360Edge_b "" UBYTE SWC_RCF_CM_boolean 0 0 0 1 ECU_ADDRESS 0x0000 /* @ECU_Address@VAR_RCF_flg360Edge_b@ */ /end MEASUREMENT
/begin COMPU_METHOD SWC_RCF_CM_single "Q = V" RAT_FUNC "%8.6" "" COEFFS 0 1 0 0 0 1 /end COMPU_METHOD
/begin COMPU_METHOD SWC_RCF_CM_uint32 "Q = V" RAT_FUNC "%10.0" "" COEFFS 0 1 0 0 0 1 /end COMPU_METHOD
/begin COMPU_METHOD SWC_RCF_CM_uint16 "Q = V" RAT_FUNC "%5.0" "" COEFFS 0 1 0 0 0 1 /end COMPU_METHOD
/begin COMPU_METHOD SWC_RCF_CM_boolean "Q = V" RAT_FUNC "%1.0" "" COEFFS 0 1 0 0 0 1 /end COMPU_METHOD
/begin COMPU_METHOD SWC_RCF_CM_uint8 "Q = V" RAT_FUNC "%3.0" "" COEFFS 0 1 0 0 0 1 /end COMPU_METHOD
/begin GROUP SWC_RCF "SWC_RCF" /* Root */ ROOT /begin SUB_GROUP Root_RE_SWC_RCF_100us_sys Root_RE_SWC_RCF_10ms_sys /end SUB_GROUP /end GROUP
/begin GROUP Root_RE_SWC_RCF_100us_sys "SWC_RCF/RE_SWC_RCF_100us_sys" /begin SUB_GROUP S1_RCF_100us /end SUB_GROUP /end GROUP
/begin GROUP Root_RE_SWC_RCF_10ms_sys "SWC_RCF/RE_SWC_RCF_10ms_sys" /begin SUB_GROUP S2_RCF_10ms /end SUB_GROUP /end GROUP
/begin GROUP S1_RCF_100us "SWC_RCF/RE_SWC_RCF_100us_sys/RCF_100us" /begin SUB_GROUP S4_Subsystem /end SUB_GROUP /begin REF_CHARACTERISTIC CAL_RCF_flgEnOfsClb_b /end REF_CHARACTERISTIC /end GROUP
/begin GROUP S2_RCF_10ms "SWC_RCF/RE_SWC_RCF_10ms_sys/RCF_10ms" /begin SUB_GROUP S53_RCF_DEM S53_RCF_flgState /end SUB_GROUP
 /begin REF_CHARACTERISTIC CAL_RCF_TrqDesAcc_f32 CAL_RCF_cTrqSlopAcc_f32 CAL_RCF_tMaxAcc_u16 CAL_RCF_tMaxFwlBwd_u16 CAL_RCF_tMaxFwlFwd_u16 /end REF_CHARACTERISTIC
 /begin REF_MEASUREMENT VAR_RCF_TrqEmDesOfsClb_f32 VAR_RCF_cTrqSlpOfsClb_f32 VAR_RCF_flgEnblEstAlRtrOfs_b VAR_RCF_flgEnblOfsClbFrwhlBwd_b VAR_RCF_flgEnblOfsClbFrwhlFwd_b VAR_RCF_flgEnblOfsClbFrwhl_b VAR_RCF_stAgRtrOfsCal_u8 VAR_RCF_stDiagOfsClb_u8 /end REF_MEASUREMENT
/end GROUP
/begin GROUP S4_Subsystem "SWC_RCF/RE_SWC_RCF_100us_sys/RCF_100us/Subsystem"
 /begin SUB_GROUP S5_RCF_AlRtrOfsClbFrwhl S5_RCF_InitAlRtrOfsEst S5_Subsystem1 S5_secflgstClb S5_secflgstEst /end SUB_GROUP
 /begin REF_CHARACTERISTIC CAL_RCF_UsAlfaScalSet_f32 CAL_RCF_UsBetaScalSet_f32 CAL_RCF_cntOfValBwd_u32 CAL_RCF_cntOfValFwd_u32 CAL_RCF_nOfValBwdStp_f32 CAL_RCF_nOfValFwdStp_f32 CAL_RCF_tHiEstAlOfs_u32 CAL_RCF_tMaxEstAlOfs1_u32 CAL_RCF_tMaxEstAlOfs_u32 CAL_RCF_tUAlfaSet_u32 CAL_RCF_tUbetaSet_u32 /end REF_CHARACTERISTIC
 /begin REF_MEASUREMENT VAR_RCF_AutoClbOffset_f32 VAR_RCF_UsAlfaScalSet_f32 VAR_RCF_UsBetaScalSet_f32 VAR_RCF_flgUseUsSet_b VAR_RCF_stEstAlRtrOfs_u8 VAR_RCF_stOfsClbFrwhl_u8 VAR_RCF_stOfsFrwhlBwd_u8 VAR_RCF_stOfsFrwhlFwd_u8 /end REF_MEASUREMENT
/end GROUP
/begin GROUP S53_RCF_DEM "SWC_RCF/RE_SWC_RCF_10ms_sys/RCF_10ms/RCF_DEM" /begin REF_CHARACTERISTIC CAL_RCF_flgReAutoClbSuc_b CAL_RCF_flgUseClbSucNvm_b /end REF_CHARACTERISTIC /end GROUP
/begin GROUP S53_RCF_flgState "SWC_RCF/RE_SWC_RCF_10ms_sys/RCF_10ms/RCF_flgState"
 /begin SUB_GROUP S56_RCF_flgAccToClbFreBwd S56_RCF_flgAccToClbFreFwd S56_RCF_flgAccToDefault S56_RCF_flgAccToSucd S56_RCF_flgClbFreFwdToAcc S56_RCF_flgClbToFail S56_RCF_flgDefaultToClbFreFwd S56_RCF_flgDefaultToFrewhlBwd S56_RCF_flgDefaultToWait S56_RCF_flgFailToDefault S56_RCF_flgFwdorBwdToDefault S56_RCF_flgPsiToFail S56_RCF_flgSucdToDefault S56_RCF_flgWaitToAcc S56_RCF_flgWaitToFail S56_SmgOfs_flgBwClbSucdToAcc /end SUB_GROUP
 /begin REF_CHARACTERISTIC CAL_RCF_WithoutStatorCurrent_u8 CAL_RCF_nAlRtrDesAcc_f32 CAL_RCF_nMaxStartAcc_f32 CAL_RCF_nMinSkipAcc_f32 /end REF_CHARACTERISTIC
/end GROUP
/begin GROUP S5_Subsystem1 "SWC_RCF/RE_SWC_RCF_100us_sys/RCF_100us/Subsystem/Subsystem1" /begin REF_MEASUREMENT VAR_RCF_agRtrOffsEstimd_f32 /end REF_MEASUREMENT /end GROUP
/begin GROUP S5_secflgstClb "SWC_RCF/RE_SWC_RCF_100us_sys/RCF_100us/Subsystem/secflgstClb"
 /begin SUB_GROUP S11_RCF_flgBwdClbToCalc S11_RCF_flgClbReset S11_RCF_flgClbToInact S11_RCF_flgFwdClbToWait S11_RCF_flgInactToBwdClb S11_RCF_flgInactToFwdClb S11_RCF_flgWaitToBwdClb /end SUB_GROUP
/end GROUP
/begin GROUP S5_secflgstEst "SWC_RCF/RE_SWC_RCF_100us_sys/RCF_100us/Subsystem/secflgstEst"
 /begin SUB_GROUP S12_RCF_flgFailorFnhToDefault S12_RCF_flgstDefTostEst S12_RCF_flgstEstToFail S12_RCF_flgstEstToWait S12_RCF_flgstEstTostDef /end SUB_GROUP
 /begin REF_CHARACTERISTIC CAL_RCF_EstToDefault_b CAL_RCF_nEstAlOfsStop_f32 /end REF_CHARACTERISTIC
/end GROUP
/begin GROUP S5_RCF_AlRtrOfsClbFrwhl "SWC_RCF/RE_SWC_RCF_100us_sys/RCF_100us/Subsystem/RCF_AlRtrOfsClbFrwhl" /begin SUB_GROUP S7_simfcnBwd S7_simfcnFwd S7_simfcnSt /end SUB_GROUP /end GROUP
/begin GROUP S5_RCF_InitAlRtrOfsEst "SWC_RCF/RE_SWC_RCF_100us_sys/RCF_100us/Subsystem/RCF_InitAlRtrOfsEst" /begin SUB_GROUP S8_simFcnUaUb /end SUB_GROUP /end GROUP
/begin GROUP S56_RCF_flgAccToClbFreBwd "SWC_RCF/RE_SWC_RCF_10ms_sys/RCF_10ms/RCF_flgState/RCF_flgAccToClbFreBwd" /begin REF_MEASUREMENT VAR_RCF_flgAccToClbFreBwd_b /end REF_MEASUREMENT /end GROUP
/begin GROUP S56_RCF_flgAccToClbFreFwd "SWC_RCF/RE_SWC_RCF_10ms_sys/RCF_10ms/RCF_flgState/RCF_flgAccToClbFreFwd" /begin REF_MEASUREMENT VAR_RCF_flgAccToClbFreFwd_b /end REF_MEASUREMENT /end GROUP
/begin GROUP S56_RCF_flgAccToDefault "SWC_RCF/RE_SWC_RCF_10ms_sys/RCF_10ms/RCF_flgState/RCF_flgAccToDefault" /begin REF_MEASUREMENT VAR_RCF_flgAccToDefault_b /end REF_MEASUREMENT /end GROUP
/begin GROUP S56_RCF_flgAccToSucd "SWC_RCF/RE_SWC_RCF_10ms_sys/RCF_10ms/RCF_flgState/RCF_flgAccToSucd" /begin REF_CHARACTERISTIC CAL_RCF_nMinSuccessStp_f32 /end REF_CHARACTERISTIC /begin REF_MEASUREMENT VAR_RCF_flgAccToSucd_b /end REF_MEASUREMENT /end GROUP
/begin GROUP S56_RCF_flgClbFreFwdToAcc "SWC_RCF/RE_SWC_RCF_10ms_sys/RCF_10ms/RCF_flgState/RCF_flgClbFreFwdToAcc" /begin REF_CHARACTERISTIC CAL_RCF_nExtClbFrewhlFwd_f32 /end REF_CHARACTERISTIC /begin REF_MEASUREMENT VAR_RCF_flgClbFreFwdToAcc_b /end REF_MEASUREMENT /end GROUP
/begin GROUP S56_RCF_flgClbToFail "SWC_RCF/RE_SWC_RCF_10ms_sys/RCF_10ms/RCF_flgState/RCF_flgClbToFail" /begin REF_MEASUREMENT VAR_RCF_flgClbToFail_b /end REF_MEASUREMENT /end GROUP
/begin GROUP S56_RCF_flgDefaultToClbFreFwd "SWC_RCF/RE_SWC_RCF_10ms_sys/RCF_10ms/RCF_flgState/RCF_flgDefaultToClbFreFwd" /begin REF_MEASUREMENT VAR_RCF_flgDefaultToClbFreFwd_b /end REF_MEASUREMENT /end GROUP
/begin GROUP S56_RCF_flgDefaultToFrewhlBwd "SWC_RCF/RE_SWC_RCF_10ms_sys/RCF_10ms/RCF_flgState/RCF_flgDefaultToFrewhlBwd" /begin REF_MEASUREMENT VAR_RCF_flgDefaultToFrewhlBwd_b /end REF_MEASUREMENT /end GROUP
/begin GROUP S56_RCF_flgDefaultToWait "SWC_RCF/RE_SWC_RCF_10ms_sys/RCF_10ms/RCF_flgState/RCF_flgDefaultToWait" /begin REF_MEASUREMENT VAR_RCF_flgDefaultToWait_b /end REF_MEASUREMENT /end GROUP
/begin GROUP S56_RCF_flgFailToDefault "SWC_RCF/RE_SWC_RCF_10ms_sys/RCF_10ms/RCF_flgState/RCF_flgFailToDefault" /begin REF_MEASUREMENT VAR_RCF_flgFailToDefault_b /end REF_MEASUREMENT /end GROUP
/begin GROUP S56_RCF_flgFwdorBwdToDefault "SWC_RCF/RE_SWC_RCF_10ms_sys/RCF_10ms/RCF_flgState/RCF_flgFwdorBwdToDefault" /begin REF_MEASUREMENT VAR_RCF_flgFwdorBwdToDefault_b /end REF_MEASUREMENT /end GROUP
/begin GROUP S56_RCF_flgPsiToFail "SWC_RCF/RE_SWC_RCF_10ms_sys/RCF_10ms/RCF_flgState/RCF_flgPsiToFail" /begin REF_MEASUREMENT VAR_RCF_flgPsiToFail_b /end REF_MEASUREMENT /end GROUP
/begin GROUP S56_RCF_flgSucdToDefault "SWC_RCF/RE_SWC_RCF_10ms_sys/RCF_10ms/RCF_flgState/RCF_flgSucdToDefault" /begin REF_CHARACTERISTIC CAL_RCF_SuccdToDefault_b CAL_RCF_nLimitSucToDef_f32 /end REF_CHARACTERISTIC /begin REF_MEASUREMENT VAR_RCF_flgSucdToDefault_b /end REF_MEASUREMENT /end GROUP
/begin GROUP S56_RCF_flgWaitToAcc "SWC_RCF/RE_SWC_RCF_10ms_sys/RCF_10ms/RCF_flgState/RCF_flgWaitToAcc" /begin REF_MEASUREMENT VAR_RCF_flgWaitToAcc_b /end REF_MEASUREMENT /end GROUP
/begin GROUP S56_RCF_flgWaitToFail "SWC_RCF/RE_SWC_RCF_10ms_sys/RCF_10ms/RCF_flgState/RCF_flgWaitToFail" /begin REF_MEASUREMENT VAR_RCF_flgWaitToFail_b /end REF_MEASUREMENT /end GROUP
/begin GROUP S56_SmgOfs_flgBwClbSucdToAcc "SWC_RCF/RE_SWC_RCF_10ms_sys/RCF_10ms/RCF_flgState/SmgOfs_flgBwClbSucdToAcc" /begin REF_CHARACTERISTIC CAL_RCF_nExtClbFrewhlBwd_f32 /end REF_CHARACTERISTIC /begin REF_MEASUREMENT VAR_RCF_flgBwClbSucdToAcc_b /end REF_MEASUREMENT /end GROUP
/begin GROUP S11_RCF_flgBwdClbToCalc "SWC_RCF/RE_SWC_RCF_100us_sys/RCF_100us/Subsystem/secflgstClb/RCF_flgBwdClbToCalc" /begin REF_CHARACTERISTIC CAL_RCF_nOfValBwdStp_f32 /end REF_CHARACTERISTIC /begin REF_MEASUREMENT VAR_RCF_flgBwdClbToCalc_b /end REF_MEASUREMENT /end GROUP
/begin GROUP S11_RCF_flgClbReset "SWC_RCF/RE_SWC_RCF_100us_sys/RCF_100us/Subsystem/secflgstClb/RCF_flgClbReset" /begin REF_MEASUREMENT VAR_RCF_flgClbReset_b /end REF_MEASUREMENT /end GROUP
/begin GROUP S11_RCF_flgClbToInact "SWC_RCF/RE_SWC_RCF_100us_sys/RCF_100us/Subsystem/secflgstClb/RCF_flgClbToInact" /begin REF_MEASUREMENT VAR_RCF_flgClbToInact_b /end REF_MEASUREMENT /end GROUP
/begin GROUP S11_RCF_flgFwdClbToWait "SWC_RCF/RE_SWC_RCF_100us_sys/RCF_100us/Subsystem/secflgstClb/RCF_flgFwdClbToWait" /begin REF_CHARACTERISTIC CAL_RCF_nOfValFwdStp_f32 /end REF_CHARACTERISTIC /begin REF_MEASUREMENT VAR_RCF_flgFwdClbToWait_b /end REF_MEASUREMENT /end GROUP
/begin GROUP S11_RCF_flgInactToBwdClb "SWC_RCF/RE_SWC_RCF_100us_sys/RCF_100us/Subsystem/secflgstClb/RCF_flgInactToBwdClb" /begin REF_MEASUREMENT VAR_RCF_flgInactToBwdClb_b /end REF_MEASUREMENT /end GROUP
/begin GROUP S11_RCF_flgInactToFwdClb "SWC_RCF/RE_SWC_RCF_100us_sys/RCF_100us/Subsystem/secflgstClb/RCF_flgInactToFwdClb" /begin REF_MEASUREMENT VAR_RCF_flgInactToFwdClb_b /end REF_MEASUREMENT /end GROUP
/begin GROUP S11_RCF_flgWaitToBwdClb "SWC_RCF/RE_SWC_RCF_100us_sys/RCF_100us/Subsystem/secflgstClb/RCF_flgWaitToBwdClb" /begin REF_MEASUREMENT VAR_RCF_flgWaitToBwdClb_b /end REF_MEASUREMENT /end GROUP
/begin GROUP S12_RCF_flgFailorFnhToDefault "SWC_RCF/RE_SWC_RCF_100us_sys/RCF_100us/Subsystem/secflgstEst/RCF_flgFailorFnhToDefault" /begin REF_MEASUREMENT VAR_RCF_flgFailorFnhToDefault_b /end REF_MEASUREMENT /end GROUP
/begin GROUP S12_RCF_flgstDefTostEst "SWC_RCF/RE_SWC_RCF_100us_sys/RCF_100us/Subsystem/secflgstEst/RCF_flgstDefTostEst" /begin REF_MEASUREMENT VAR_RCF_flgstDefTostEst_b /end REF_MEASUREMENT /end GROUP
/begin GROUP S12_RCF_flgstEstToFail "SWC_RCF/RE_SWC_RCF_100us_sys/RCF_100us/Subsystem/secflgstEst/RCF_flgstEstToFail" /begin REF_MEASUREMENT VAR_RCF_flgstEstToFail_b /end REF_MEASUREMENT /end GROUP
/begin GROUP S12_RCF_flgstEstToWait "SWC_RCF/RE_SWC_RCF_100us_sys/RCF_100us/Subsystem/secflgstEst/RCF_flgstEstToWait" /begin REF_MEASUREMENT VAR_RCF_flgstEstToWait_b /end REF_MEASUREMENT /end GROUP
/begin GROUP S12_RCF_flgstEstTostDef "SWC_RCF/RE_SWC_RCF_100us_sys/RCF_100us/Subsystem/secflgstEst/RCF_flgstEstTostDef" /begin REF_MEASUREMENT VAR_RCF_flgstEstTostDef_b /end REF_MEASUREMENT /end GROUP
/begin GROUP S7_simfcnBwd "SWC_RCF/RE_SWC_RCF_100us_sys/RCF_100us/Subsystem/RCF_AlRtrOfsClbFrwhl/simfcnBwd" /begin SUB_GROUP S13_Enabled_Subsystem1 S13_Subsystem S13_Subsystem3 /end SUB_GROUP
 /begin REF_CHARACTERISTIC CAL_RCF_agReferenceBwd_f32 CAL_RCF_nOfsClbMaxBwd_f32 CAL_RCF_nOfsClbMinBwd_f32 /end REF_CHARACTERISTIC
 /begin REF_MEASUREMENT VAR_RCF_OfsClbAngBwd_f32 /end REF_MEASUREMENT
/end GROUP
/begin GROUP S7_simfcnFwd "SWC_RCF/RE_SWC_RCF_100us_sys/RCF_100us/Subsystem/RCF_AlRtrOfsClbFrwhl/simfcnFwd" /begin SUB_GROUP S14_Enabled_Subsystem1 S14_Subsystem S14_Subsystem3 /end SUB_GROUP
 /begin REF_CHARACTERISTIC CAL_RCF_agReferenceFwd_f32 CAL_RCF_nOfsClbMaxFwd_f32 CAL_RCF_nOfsClbMinFwd_f32 /end REF_CHARACTERISTIC
 /begin REF_MEASUREMENT VAR_RCF_OfsClbAngFwd_f32 /end REF_MEASUREMENT
/end GROUP
/begin GROUP S7_simfcnSt "SWC_RCF/RE_SWC_RCF_100us_sys/RCF_100us/Subsystem/RCF_AlRtrOfsClbFrwhl/simfcnSt" /begin REF_CHARACTERISTIC CAL_RCF_AlRtrOfsDvtMax_f32 /end REF_CHARACTERISTIC /end GROUP
/begin GROUP S8_simFcnUaUb "SWC_RCF/RE_SWC_RCF_100us_sys/RCF_100us/Subsystem/RCF_InitAlRtrOfsEst/simFcnUaUb"
 /begin REF_CHARACTERISTIC CAL_RCF_UsAlfaScalSet_f32 CAL_RCF_UsBetaScalSet_f32 CAL_RCF_tUAlfaSet_u32 CAL_RCF_tUbetaSet_u32 /end REF_CHARACTERISTIC
/end GROUP
/begin GROUP S13_Enabled_Subsystem1 "SWC_RCF/RE_SWC_RCF_100us_sys/RCF_100us/Subsystem/RCF_AlRtrOfsClbFrwhl/simfcnBwd/Enabled Subsystem1" /begin REF_CHARACTERISTIC CAL_RCF_cntMovAveFilBwd_u16 /end REF_CHARACTERISTIC /end GROUP
/begin GROUP S13_Subsystem "SWC_RCF/RE_SWC_RCF_100us_sys/RCF_100us/Subsystem/RCF_AlRtrOfsClbFrwhl/simfcnBwd/Subsystem"
 /begin SUB_GROUP S17_If_Action_Subsystem10 S17_If_Action_Subsystem11 S17_If_Action_Subsystem12 S17_If_Action_Subsystem13 S17_If_Action_Subsystem6 S17_If_Action_Subsystem7 S17_If_Action_Subsystem9 /end SUB_GROUP
 /begin REF_CHARACTERISTIC CAL_RCF_nCalcSec1_f32 CAL_RCF_nCalcSec2_f32 CAL_RCF_nCalcSec3_f32 CAL_RCF_nCalcSec4_f32 CAL_RCF_nCalcSec5_f32 CAL_RCF_nCalcSec6_f32 CAL_RCF_nCalcSec7_f32 CAL_RCF_nCalcSec8_f32 /end REF_CHARACTERISTIC
/end GROUP
/begin GROUP S13_Subsystem3 "SWC_RCF/RE_SWC_RCF_100us_sys/RCF_100us/Subsystem/RCF_AlRtrOfsClbFrwhl/simfcnBwd/Subsystem3" /begin REF_CHARACTERISTIC CAL_RCF_360EdgeRag_f32 /end REF_CHARACTERISTIC /end GROUP
/begin GROUP S14_Enabled_Subsystem1 "SWC_RCF/RE_SWC_RCF_100us_sys/RCF_100us/Subsystem/RCF_AlRtrOfsClbFrwhl/simfcnFwd/Enabled Subsystem1" /begin REF_CHARACTERISTIC CAL_RCF_cntMovAveFilFwd_u16 /end REF_CHARACTERISTIC /end GROUP
/begin GROUP S14_Subsystem "SWC_RCF/RE_SWC_RCF_100us_sys/RCF_100us/Subsystem/RCF_AlRtrOfsClbFrwhl/simfcnFwd/Subsystem"
 /begin SUB_GROUP S29_If_Action_Subsystem1 S29_If_Action_Subsystem2 S29_If_Action_Subsystem3 S29_If_Action_Subsystem4 S29_If_Action_Subsystem5 S29_If_Action_Subsystem6 S29_If_Action_Subsystem8 /end SUB_GROUP
 /begin REF_CHARACTERISTIC CAL_RCF_nCalcSec1_f32 CAL_RCF_nCalcSec2_f32 CAL_RCF_nCalcSec3_f32 CAL_RCF_nCalcSec4_f32 CAL_RCF_nCalcSec5_f32 CAL_RCF_nCalcSec6_f32 CAL_RCF_nCalcSec7_f32 CAL_RCF_nCalcSec8_f32 /end REF_CHARACTERISTIC
/end GROUP
/begin GROUP S14_Subsystem3 "SWC_RCF/RE_SWC_RCF_100us_sys/RCF_100us/Subsystem/RCF_AlRtrOfsClbFrwhl/simfcnFwd/Subsystem3" /begin REF_CHARACTERISTIC CAL_RCF_360EdgeRag_f32 /end REF_CHARACTERISTIC /begin REF_MEASUREMENT VAR_RCF_flg360Edge_b /end REF_MEASUREMENT /end GROUP
/begin GROUP S17_If_Action_Subsystem10 "SWC_RCF/RE_SWC_RCF_100us_sys/RCF_100us/Subsystem/RCF_AlRtrOfsClbFrwhl/simfcnBwd/Subsystem/If Action Subsystem10" /begin REF_CHARACTERISTIC CAL_RCF_OffsetAngFiltCoef_f32 /end REF_CHARACTERISTIC /begin REF_MEASUREMENT VAR_RCF_OfsFlt4400Bwd_f32 /end REF_MEASUREMENT /end GROUP
/begin GROUP S17_If_Action_Subsystem11 "SWC_RCF/RE_SWC_RCF_100us_sys/RCF_100us/Subsystem/RCF_AlRtrOfsClbFrwhl/simfcnBwd/Subsystem/If Action Subsystem11" /begin REF_CHARACTERISTIC CAL_RCF_OffsetAngFiltCoef_f32 /end REF_CHARACTERISTIC /begin REF_MEASUREMENT VAR_RCF_OfsFlt4600Bwd_f32 /end REF_MEASUREMENT /end GROUP
/begin GROUP S17_If_Action_Subsystem12 "SWC_RCF/RE_SWC_RCF_100us_sys/RCF_100us/Subsystem/RCF_AlRtrOfsClbFrwhl/simfcnBwd/Subsystem/If Action Subsystem12" /begin REF_CHARACTERISTIC CAL_RCF_OffsetAngFiltCoef_f32 /end REF_CHARACTERISTIC /begin REF_MEASUREMENT VAR_RCF_OfsFlt4800Bwd_f32 /end REF_MEASUREMENT /end GROUP
/begin GROUP S17_If_Action_Subsystem13 "SWC_RCF/RE_SWC_RCF_100us_sys/RCF_100us/Subsystem/RCF_AlRtrOfsClbFrwhl/simfcnBwd/Subsystem/If Action Subsystem13" /begin REF_CHARACTERISTIC CAL_RCF_OffsetAngFiltCoef_f32 /end REF_CHARACTERISTIC /begin REF_MEASUREMENT VAR_RCF_OfsFlt3600Bwd_f32 /end REF_MEASUREMENT /end GROUP
/begin GROUP S17_If_Action_Subsystem6 "SWC_RCF/RE_SWC_RCF_100us_sys/RCF_100us/Subsystem/RCF_AlRtrOfsClbFrwhl/simfcnBwd/Subsystem/If Action Subsystem6" /begin REF_CHARACTERISTIC CAL_RCF_OffsetAngFiltCoef_f32 /end REF_CHARACTERISTIC /begin REF_MEASUREMENT VAR_RCF_OfsFlt3800Bwd_f32 /end REF_MEASUREMENT /end GROUP
/begin GROUP S17_If_Action_Subsystem7 "SWC_RCF/RE_SWC_RCF_100us_sys/RCF_100us/Subsystem/RCF_AlRtrOfsClbFrwhl/simfcnBwd/Subsystem/If Action Subsystem7" /begin REF_CHARACTERISTIC CAL_RCF_OffsetAngFiltCoef_f32 /end REF_CHARACTERISTIC /begin REF_MEASUREMENT VAR_RCF_OfsFlt4000Bwd_f32 /end REF_MEASUREMENT /end GROUP
/begin GROUP S17_If_Action_Subsystem9 "SWC_RCF/RE_SWC_RCF_100us_sys/RCF_100us/Subsystem/RCF_AlRtrOfsClbFrwhl/simfcnBwd/Subsystem/If Action Subsystem9" /begin REF_CHARACTERISTIC CAL_RCF_OffsetAngFiltCoef_f32 /end REF_CHARACTERISTIC /begin REF_MEASUREMENT VAR_RCF_OfsFlt4200Bwd_f32 /end REF_MEASUREMENT /end GROUP
/begin GROUP S29_If_Action_Subsystem1 "SWC_RCF/RE_SWC_RCF_100us_sys/RCF_100us/Subsystem/RCF_AlRtrOfsClbFrwhl/simfcnFwd/Subsystem/If Action Subsystem1" /begin REF_CHARACTERISTIC CAL_RCF_OffsetAngFiltCoef_f32 /end REF_CHARACTERISTIC /begin REF_MEASUREMENT VAR_RCF_OfsFlt3800Fwd_f32 /end REF_MEASUREMENT /end GROUP
/begin GROUP S29_If_Action_Subsystem2 "SWC_RCF/RE_SWC_RCF_100us_sys/RCF_100us/Subsystem/RCF_AlRtrOfsClbFrwhl/simfcnFwd/Subsystem/If Action Subsystem2" /begin REF_CHARACTERISTIC CAL_RCF_OffsetAngFiltCoef_f32 /end REF_CHARACTERISTIC /begin REF_MEASUREMENT VAR_RCF_OfsFlt4000Fwd_f32 /end REF_MEASUREMENT /end GROUP
/begin GROUP S29_If_Action_Subsystem3 "SWC_RCF/RE_SWC_RCF_100us_sys/RCF_100us/Subsystem/RCF_AlRtrOfsClbFrwhl/simfcnFwd/Subsystem/If Action Subsystem3" /begin REF_CHARACTERISTIC CAL_RCF_OffsetAngFiltCoef_f32 /end REF_CHARACTERISTIC /begin REF_MEASUREMENT VAR_RCF_OfsFlt4200Fwd_f32 /end REF_MEASUREMENT /end GROUP
/begin GROUP S29_If_Action_Subsystem4 "SWC_RCF/RE_SWC_RCF_100us_sys/RCF_100us/Subsystem/RCF_AlRtrOfsClbFrwhl/simfcnFwd/Subsystem/If Action Subsystem4" /begin REF_CHARACTERISTIC CAL_RCF_OffsetAngFiltCoef_f32 /end REF_CHARACTERISTIC /begin REF_MEASUREMENT VAR_RCF_OfsFlt4400Fwd_f32 /end REF_MEASUREMENT /end GROUP
/begin GROUP S29_If_Action_Subsystem5 "SWC_RCF/RE_SWC_RCF_100us_sys/RCF_100us/Subsystem/RCF_AlRtrOfsClbFrwhl/simfcnFwd/Subsystem/If Action Subsystem5" /begin REF_CHARACTERISTIC CAL_RCF_OffsetAngFiltCoef_f32 /end REF_CHARACTERISTIC /begin REF_MEASUREMENT VAR_RCF_OfsFlt4600Fwd_f32 /end REF_MEASUREMENT /end GROUP
/begin GROUP S29_If_Action_Subsystem6 "SWC_RCF/RE_SWC_RCF_100us_sys/RCF_100us/Subsystem/RCF_AlRtrOfsClbFrwhl/simfcnFwd/Subsystem/If Action Subsystem6" /begin REF_CHARACTERISTIC CAL_RCF_OffsetAngFiltCoef_f32 /end REF_CHARACTERISTIC /begin REF_MEASUREMENT VAR_RCF_OfsFlt4800Fwd_f32 /end REF_MEASUREMENT /end GROUP
/begin GROUP S29_If_Action_Subsystem8 "SWC_RCF/RE_SWC_RCF_100us_sys/RCF_100us/Subsystem/RCF_AlRtrOfsClbFrwhl/simfcnFwd/Subsystem/If Action Subsystem8" /begin REF_CHARACTERISTIC CAL_RCF_OffsetAngFiltCoef_f32 /end REF_CHARACTERISTIC /begin REF_MEASUREMENT VAR_RCF_OfsFlt3600Fwd_f32 /end REF_MEASUREMENT /end GROUP
/end MODULE
/end PROJECT
/* (add any file trailer comments here) */
/* EOF SWC_RCF.a2l */
