AUTOSAR XML (schema 4-0-3)
# Copyright (C) Infineon Technologies (2015)
# All rights reserved.
package /AUTOSAR_Icu/BswModuleDescriptions
  bsw module description Icu: category=BSW_MODULE, module-id=122  # ICU Driver
    provided-entrys:
      Icu_Init
      Icu_SetActivationCondition
      Icu_DisableEdgeDetection
      Icu_EnableEdgeDetection
      Icu_DisableNotification
      Icu_EnableNotification
      Icu_GetInputState
      Icu_StartSignalMeasurement
      Icu_StopSignalMeasurement
      Icu_GetDutyCycleValues
      Icu_Eru_Isr
      Icu_Isr
      Icu_Ccu_Isr
      Icu_InitCheck
      Icu_17_GtmCcu6_GetMode
      Icu_17_GtmCcu6_EnableMultiEdgeDetection
    bsw module dependency DetDependency: target-module-id=15, required-entrys=Det_ReportError
    bsw module dependency McalLIBDependency: target-module-id=255, required-entrys=[Mcal_ResetENDINIT, Mcal_SetENDINIT]
    bsw module dependency SafeMcalDependency: target-module-id=255, required-entrys=SafeMcal_ReportError
    bsw internal behavior IcuBehavior
      constant-memorys:
        parameter data prototype Icu_kConfigPtr: category=DATA_REFERENCE, sw-pointer-target-props={target-category=TYPE_REFERENCE, implementation-data-type=Icu_17_GtmCcu6_ConfigType}, type=Icu_17_GtmCcu6_ConfigType
      6 x exclusive area:
        EnableWakeup
        Ccu6IenUpdate
        EnableNotification
        ResetEdgeCount
        CcuVariableupdate
        CcuInterruptHandle
      static-memorys:
        7 x data:
          Icu_WakeupChannelInfo: implementation-data-type=EcuM_WakeupSourceType, type=EcuM_WakeupSourceType
          Icu_GlobMode: implementation-data-type=Icu_17_GtmCcu6_ModeType, type=Icu_17_GtmCcu6_ModeType
          Icu_InitStatus: implementation-data-type=uint8, type=uint8
          Icu_QmVarlist: implementation-data-type=Icu_17_GtmCcu6_QmType, type=Icu_17_GtmCcu6_QmType
          Icu_AsilCcu6Varlist: implementation-data-type=Icu_17_GtmCcu6_AsilCcu6Type, type=Icu_17_GtmCcu6_AsilCcu6Type
          Icu_AsilGtmVarlist: implementation-data-type=Icu_17_GtmCcu6_AsilGtmType, type=Icu_17_GtmCcu6_AsilGtmType
          Icu_17_CcuChannelMap: implementation-data-type=Icu_17_GtmCcu6_ChannelType, type=Icu_17_GtmCcu6_ChannelType
      13 x bsw called entity:
        Icu_Init: implemented-entry=Icu_Init
        Icu_SetActivationCondition: can-enter-exclusive-area=Ccu6IenUpdate, implemented-entry=Icu_SetActivationCondition
        Icu_DisableEdgeDetection: implemented-entry=Icu_DisableEdgeDetection
        Icu_EnableEdgeDetection: implemented-entry=Icu_EnableEdgeDetection
        Icu_DisableNotification: implemented-entry=Icu_DisableNotification
        Icu_EnableNotification: can-enter-exclusive-area=EnableNotification, implemented-entry=Icu_EnableNotification
        Icu_GetInputState: implemented-entry=Icu_GetInputState
        Icu_StartSignalMeasurement: implemented-entry=Icu_StartSignalMeasurement
        Icu_StopSignalMeasurement: implemented-entry=Icu_StopSignalMeasurement
        Icu_GetDutyCycleValues: implemented-entry=Icu_GetDutyCycleValues
        Icu_InitCheck: implemented-entry=Icu_InitCheck
        Icu_17_GtmCcu6_GetMode: implemented-entry=Icu_17_GtmCcu6_GetMode
        Icu_17_GtmCcu6_EnableMultiEdgeDetection: implemented-entry=Icu_17_GtmCcu6_EnableMultiEdgeDetection
      bsw interrupt entity Icu_Eru_Isr: implemented-entry=Icu_Eru_Isr, interrupt-category=CAT-1, interrupt-source=SRC_SCUERU0
      bsw interrupt entity Icu_Isr: implemented-entry=Icu_Isr, interrupt-category=CAT-1, interrupt-source=SRC_GTMTIMxy
      bsw interrupt entity Icu_Ccu_Isr: implemented-entry=Icu_Ccu_Isr, interrupt-category=CAT-1, interrupt-source=SRC_CCU6xSR0
package /AUTOSAR_Icu/BswModuleEntrys
  16 x bsw module entry, all with is-synchronous=true, sw-service-impl-policy=STANDARD:
    Icu_Init: service-id=0, is-reentrant=false, call-type=REGULAR, execution-context=TASK
      sw service arg ConfigPtr: category=DATA_REFERENCE, sw-pointer-target-props={target-category=TYPE_REFERENCE, implementation-data-type=Icu_ConfigType}
    Icu_SetActivationCondition: service-id=5, is-reentrant=true, call-type=REGULAR, execution-context=UNSPECIFIED
      sw service arg Channel: implementation-data-type=Icu_ChannelType
      sw service arg Activation: implementation-data-type=Icu_ActivationType
    Icu_DisableEdgeDetection: service-id=23, is-reentrant=true, call-type=REGULAR, execution-context=UNSPECIFIED
      sw service arg Channel: implementation-data-type=Icu_ChannelType
    Icu_EnableEdgeDetection: service-id=22, is-reentrant=true, call-type=REGULAR, execution-context=UNSPECIFIED
      sw service arg Channel: implementation-data-type=Icu_ChannelType
    Icu_DisableNotification: service-id=6, is-reentrant=true, call-type=REGULAR, execution-context=UNSPECIFIED
      sw service arg Channel: implementation-data-type=Icu_ChannelType
    Icu_EnableNotification: service-id=7, is-reentrant=true, call-type=REGULAR, execution-context=UNSPECIFIED
      sw service arg Channel: implementation-data-type=Icu_ChannelType
    Icu_GetInputState: service-id=8, is-reentrant=true, call-type=REGULAR, execution-context=UNSPECIFIED
      return type Return: implementation-data-type=Icu_17_GtmCcu6_InputStateType
      sw service arg Channel: implementation-data-type=Icu_ChannelType
    Icu_StartSignalMeasurement: service-id=19, is-reentrant=true, call-type=REGULAR, execution-context=UNSPECIFIED
      sw service arg Channel: implementation-data-type=Icu_ChannelType
    Icu_StopSignalMeasurement: service-id=20, is-reentrant=true, call-type=REGULAR, execution-context=UNSPECIFIED
      sw service arg Channel: implementation-data-type=Icu_ChannelType
    Icu_GetDutyCycleValues: service-id=17, is-reentrant=true, call-type=REGULAR, execution-context=UNSPECIFIED
      sw service arg Channel: implementation-data-type=Icu_ChannelType
      sw service arg DutyCycleValues: category=DATA_REFERENCE, sw-pointer-target-props={target-category=TYPE_REFERENCE, implementation-data-type=Icu_DutyCycleType}
    Icu_Eru_Isr: service-id=0, is-reentrant=false, call-type=INTERRUPT, execution-context=INTERRUPT-CAT-1
    Icu_Isr: service-id=0, is-reentrant=false, call-type=INTERRUPT, execution-context=INTERRUPT-CAT-1
      4 x sw service arg, all with implementation-data-type=uint8:
        ModuleType
        ModuleNo
        ChannelNo
        IrqSrc
    Icu_Ccu_Isr: service-id=0, is-reentrant=false, call-type=INTERRUPT, execution-context=INTERRUPT-CAT-1
      sw service arg CcuKernalNumber: implementation-data-type=uint8
    Icu_InitCheck: service-id=0, is-reentrant=false, call-type=REGULAR, execution-context=UNSPECIFIED
      return type Return: implementation-data-type=Std_ReturnType
      sw service arg ConfigPtr: category=DATA_REFERENCE, sw-pointer-target-props={target-category=TYPE_REFERENCE, implementation-data-type=Icu_ConfigType}
    Icu_17_GtmCcu6_GetMode: service-id=0, is-reentrant=false, call-type=REGULAR, execution-context=UNSPECIFIED
      return type Return: implementation-data-type=Icu_17_GtmCcu6_ModeType
    Icu_17_GtmCcu6_EnableMultiEdgeDetection: service-id=25, is-reentrant=true, call-type=REGULAR, execution-context=UNSPECIFIED
      sw service arg Channel: implementation-data-type=Icu_ChannelType
      sw service arg EdgeCount: implementation-data-type=uint32
package /AUTOSAR_Icu/Implementations
  bsw implementation Icu: programming-language=C, sw-version=0.0.0, vendor-id=17, ar-release-version=4.0.3, behavior=IcuBehavior, vendor-api-infix=GtmCcu6, vendor-specific-module-def=Icu
    code-descriptors:
      code Files
        artifact-descriptors:
          short-label=ssc::src::Icu_17_GtmCcu6.c, category=SWSRC
          short-label=ssc::src::Icu_17_GtmCcu6_Safe.c, category=SWSRC
          short-label=ssc::src::Icu_17_GtmCcu6_Ver.c, category=SWSRC
          short-label=ssc::inc::Icu_17_GtmCcu6.h, category=SWHDR
          short-label=ssc::inc::Icu_17_GtmCcu6_Ver.h, category=SWHDR
          short-label=ssc::inc::Icu_17_GtmCcu6_Safe.h, category=SWHDR
          short-label=ssc::inc::Icu_17_GtmCcu6_Dbg.h, category=SWHDR
          short-label=ssc::inc::Icu_17_GtmCcu6_Local.h, category=SWHDR
          short-label=mak::icu_17_gtmccu6_infineon_tricore::ssc::mak::infineon_icu_17_gtmccu6_cfg.mak, category=SWMAKE
          short-label=mak::icu_17_gtmccu6_infineon_tricore::ssc::mak::infineon_icu_17_gtmccu6_check.mak, category=SWMAKE
          short-label=mak::icu_17_gtmccu6_infineon_tricore::ssc::mak::infineon_icu_17_gtmccu6_defs.mak, category=SWMAKE
          short-label=mak::icu_17_gtmccu6_infineon_tricore::ssc::mak::infineon_icu_17_gtmccu6_rules.mak, category=SWMAKE
    compiler TASKING_COMPILE: name=TASKING, options="-c --core=tc1.6.x -t -Wa-gAHLs --emit-locals=-equ,-symbols -Wa-Ogs -Wa--error-limit=42 --iso=90 --eabi-compliant --integer-enumeration --language=-comments,-gcc,+volatile,-strings --switch=auto --align=0 --default-near-size=0 --default-a0-size=0 --default-a1-size=0 -O2ROPYG --tradeoff=4 -g --source -D_TASKING_C_TRICORE_=1 $(CALLFUNCTION)", vendor=Tasking, version=Tasking
    compiler DIAB_COMPILE: name=DIAB, options="-c -tTC27xAstep16PMG:cross -Xdialect-c89 -Xno-common -Xalign-functions=4 -Xfp-fast -Xsection-split=1 -Xkeep-assembly-file=2 -g3 -ew4084 -ei4177,4550,4549,4068,5388 -XO -D_DIABDATA_C_TRICORE_=1 $(CALLFUNCTION)", vendor=WindRiver, version=WindRiver
    compiler GNU_COMPILE:
      name=GNU
      options="-c -save-temps=obj -std=iso9899:1990 -ansi -fno-asm -ffreestanding -Wundef -Wp,-std=iso9899:1990 -fno-short-enums -fpeel-loops -falign-functions=4 -frecord-gcc-switches -fsection-anchors -funsigned-bitfields -ffunction-sections -fno-ivopts -fno-peephole2 -nostartfiles -O3 -g3 -W -Wall -Wuninitialized -DTRIBOARD_TC27XX -mcpu=tc27xx -D_GNU_C_TRICORE_=1 $(CALLFUNCTION)"
      vendor=Hightec
      version=Hightec
    generated-artifacts:
      4 x dependency on artifact, all with usages=CODEGENERATION:
        Icu_PBCfg_c: artifact-descriptor={short-label=generate::src::Icu_17_GtmCcu6_PBCfg.c, category=SWSRC}
        Icu_Cfg_h: artifact-descriptor={short-label=generate::inc::Icu_17_GtmCcu6_Cfg.h, category=SWHDR}
        Icu_xdm: artifact-descriptor={short-label=config::Icu_17_GtmCcu6.xdm, category=SWTOOL}
        Icu_bmd: artifact-descriptor={short-label=autosar::Icu_17_GtmCcu6.bmd, category=SWTOOL}
    linker TASKING_LINK: name=TASKING, options="-t -d_mcal_pjt.lsl -D__CPU__=tc27x -Cmpe:vtc -Otxycl --error-limit=42 -M -mcrfiklsmnoduq -lc -lfp -lrt", vendor=Tasking, version=Tasking
    linker DIAB_LINK: name=DIAB, options="-m6 "_mcal_pjt.dld" -lc", vendor=WindRiver, version=WindRiver
    linker GNU_LINK: name=GNU, options="-T"_mcal_pjt.ld" -nostartfiles -Wl,--allow-multiple-definition -Wl,--cref -Wl,--oformat=elf32-tricore -Wl,--mcpu=tc161 -Wl,--mem-holes -Wl,--extmap="a"", vendor=Hightec, version=Hightec
    resource consumption ResourceConsumption
      9 x memory section:
        ICU_17_GTMCCU6_VAR_8BIT: alignment=8, size=11, sw-addrmethod=VAR
        ICU_17_GTMCCU6_VAR_UNSPECIFIED: alignment=UNSPECIFIED, size=162, sw-addrmethod=VAR
        ICU_17_GTMCCU6_VAR_32BIT: alignment=32, size=4, sw-addrmethod=VAR
        ICU_17_GTMCCU6_CONST_32BIT: alignment=32, size=58, sw-addrmethod=CONST
        ICU_17_GTMCCU6_CODE: alignment=UNSPECIFIED, size=14048, sw-addrmethod=CODE
        ICU_17_GTMCCU6_POSTBUILDCFG: alignment=UNSPECIFIED, size=58, sw-addrmethod=CONFIG_DATA
        ICU_17_GTMCCU6_CALLOUT_CODE: alignment=UNSPECIFIED, size=1594, sw-addrmethod=CODE
        ICU_17_GTMCCU6_ASIL1_VAR_UNSPECIFIED: alignment=UNSPECIFIED, size=140, sw-addrmethod=VAR
        ICU_17_GTMCCU6_ASIL0_VAR_UNSPECIFIED: alignment=UNSPECIFIED, size=52, sw-addrmethod=VAR
      section name prefix ICU_17_GTMCCU6
package /AUTOSAR_Icu/ImplementationDataTypes
  14 x impl type, all with type-emitter=BSW:
    Icu_17_GtmCcu6_ModeType: implementation-data-type=uint8
    Icu_17_GtmCcu6_SignalMeasurementPropertyType: implementation-data-type=uint8
    Icu_17_GtmCcu6_TimestampBufferType: implementation-data-type=uint8
    Icu_17_GtmCcu6_ConfigType: category=STRUCTURE
      element Icu_17_GtmCcu6_ChannelConfigType
    Icu_17_GtmCcu6_ChannelType: implementation-data-type=uint8
    Icu_17_GtmCcu6_ActivationType: implementation-data-type=uint8
    Icu_17_GtmCcu6_ValueType: implementation-data-type=uint32
    Icu_17_GtmCcu6_DutyCycleType: category=STRUCTURE
      element Icu_17_GtmCcu6_ValueType
    Icu_17_GtmCcu6_InputStateType: implementation-data-type=uint8
    Icu_17_GtmCcu6_IndexType: implementation-data-type=uint16
    Icu_17_GtmCcu6_EdgeNumberType: implementation-data-type=uint32
    Icu_17_GtmCcu6_QmType: category=STRUCTURE
      element uint32
    Icu_17_GtmCcu6_AsilCcu6Type: category=STRUCTURE
      element uint32
    Icu_17_GtmCcu6_AsilGtmType: category=STRUCTURE
      element uint32
