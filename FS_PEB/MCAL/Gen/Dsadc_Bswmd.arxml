AUTOSAR XML (schema 4-0-3)
# Copyright (C) Infineon Technologies (2015)
# All rights reserved.
package /AURIX_Dsadc/BswModuleDescriptions
  bsw module description Dsadc: category=BSW_MODULE, module-id=255  # Delta Sigma Analog To Digital Converter Driver
    provided-entrys:
      Dsadc_Init
      Dsadc_GetMainResult
      Dsadc_GetAuxiliaryResult
      Dsadc_StartChannel
      Dsadc_StopChannel
      Dsadc_SetCarrierMode
      Dsadc_GetResultEventStatus
      Dsadc_ClearResultEventStatus
      Dsadc_GetSdposVal
      Dsadc_SetSdposVal
      Dsadc_GetSdnegVal
      Dsadc_SetSdnegVal
      Dsadc_GetSdcvalStatus
      Dsadc_GetSdcapVal
      Dsadc_EnableRectification
      Dsadc_CalGroupDelay
      Dsadc_GetChOutputFreq
    bsw module dependency DetDependency: target-module-id=15, required-entrys=Det_ReportError
    bsw internal behavior DsadcBehavior
      static-memorys:
        data Dsadc_DriverState: implementation-data-type=uint8, type=uint8
      17 x bsw called entity:
        Dsadc_Init: implemented-entry=Dsadc_Init
        Dsadc_GetMainResult: implemented-entry=Dsadc_GetMainResult
        Dsadc_GetAuxiliaryResult: implemented-entry=Dsadc_GetAuxiliaryResult
        Dsadc_StartChannel: implemented-entry=Dsadc_StartChannel
        Dsadc_StopChannel: implemented-entry=Dsadc_StopChannel
        Dsadc_SetCarrierMode: implemented-entry=Dsadc_SetCarrierMode
        Dsadc_GetResultEventStatus: implemented-entry=Dsadc_GetResultEventStatus
        Dsadc_ClearResultEventStatus: implemented-entry=Dsadc_ClearResultEventStatus
        Dsadc_GetSdposVal: implemented-entry=Dsadc_GetSdposVal
        Dsadc_SetSdposVal: implemented-entry=Dsadc_SetSdposVal
        Dsadc_GetSdnegVal: implemented-entry=Dsadc_GetSdnegVal
        Dsadc_SetSdnegVal: implemented-entry=Dsadc_SetSdnegVal
        Dsadc_GetSdcvalStatus: implemented-entry=Dsadc_GetSdcvalStatus
        Dsadc_GetSdcapVal: implemented-entry=Dsadc_GetSdcapVal
        Dsadc_EnableRectification: implemented-entry=Dsadc_EnableRectification
        Dsadc_CalGroupDelay: implemented-entry=Dsadc_CalGroupDelay
        Dsadc_GetChOutputFreq: implemented-entry=Dsadc_GetChOutputFreq
package /AURIX_Dsadc/BswModuleEntrys
  17 x bsw module entry, all with is-synchronous=true, call-type=REGULAR, execution-context=TASK:
    Dsadc_Init: service-id=0, is-reentrant=false, sw-service-impl-policy=STANDARD
      sw service arg ConfigPtr: category=DATA_REFERENCE, sw-pointer-target-props={target-category=TYPE_REFERENCE, implementation-data-type=Dsadc_ConfigType}
    Dsadc_GetMainResult: service-id=2, is-reentrant=true, sw-service-impl-policy=INLINE
      return type Return: implementation-data-type=Dsadc_ChannelDataType
      sw service arg ChannelId: implementation-data-type=Dsadc_ChannelType
    Dsadc_GetAuxiliaryResult: service-id=3, is-reentrant=true, sw-service-impl-policy=INLINE
      return type Return: implementation-data-type=Dsadc_ChannelDataType
      sw service arg ChannelId: implementation-data-type=Dsadc_ChannelType
    Dsadc_StartChannel: service-id=4, is-reentrant=true, sw-service-impl-policy=INLINE
      sw service arg ChannelsGroup: implementation-data-type=uint32
    Dsadc_StopChannel: service-id=5, is-reentrant=true, sw-service-impl-policy=INLINE
      sw service arg ChannelsGroup: implementation-data-type=uint32
    Dsadc_SetCarrierMode: service-id=6, is-reentrant=true, sw-service-impl-policy=INLINE
      sw service arg CGMode: implementation-data-type=Dsadc_CarrierWaveformModeType
    Dsadc_GetResultEventStatus: service-id=7, is-reentrant=true, sw-service-impl-policy=INLINE
      return type Return: implementation-data-type=uint32
    Dsadc_ClearResultEventStatus: service-id=8, is-reentrant=true, sw-service-impl-policy=INLINE
      sw service arg EventGroup: implementation-data-type=uint32
    Dsadc_GetSdposVal: service-id=9, is-reentrant=true, sw-service-impl-policy=INLINE
      return type Return: implementation-data-type=uint8
      sw service arg ChannelId: implementation-data-type=Dsadc_ChannelType
    Dsadc_SetSdposVal: service-id=10, is-reentrant=true, sw-service-impl-policy=INLINE
      sw service arg ChannelId: implementation-data-type=Dsadc_ChannelType
      sw service arg SdposVal: implementation-data-type=uint8
    Dsadc_GetSdnegVal: service-id=11, is-reentrant=true, sw-service-impl-policy=INLINE
      return type Return: implementation-data-type=uint8
      sw service arg ChannelId: implementation-data-type=Dsadc_ChannelType
    Dsadc_SetSdnegVal: service-id=12, is-reentrant=true, sw-service-impl-policy=INLINE
      sw service arg ChannelId: implementation-data-type=Dsadc_ChannelType
      sw service arg SdnegVal: implementation-data-type=uint8
    Dsadc_GetSdcvalStatus: service-id=13, is-reentrant=true, sw-service-impl-policy=INLINE
      return type Return: implementation-data-type=uint8
      sw service arg ChannelId: implementation-data-type=Dsadc_ChannelType
    Dsadc_GetSdcapVal: service-id=14, is-reentrant=true, sw-service-impl-policy=INLINE
      return type Return: implementation-data-type=uint8
      sw service arg ChannelId: implementation-data-type=Dsadc_ChannelType
    Dsadc_EnableRectification: service-id=15, is-reentrant=true, sw-service-impl-policy=INLINE
      sw service arg ChannelId: implementation-data-type=Dsadc_ChannelType
    Dsadc_CalGroupDelay: service-id=18, is-reentrant=true, sw-service-impl-policy=STANDARD
      return type Return: implementation-data-type=float32
      sw service arg ChannelId: implementation-data-type=Dsadc_ChannelType
    Dsadc_GetChOutputFreq: service-id=19, is-reentrant=true, sw-service-impl-policy=STANDARD
      return type Return: implementation-data-type=float32
      sw service arg ChannelId: implementation-data-type=Dsadc_ChannelType
package /AURIX_Dsadc/Implementations
  bsw implementation Dsadc: programming-language=C, sw-version=0.0.0, vendor-id=17, ar-release-version=4.0.3, behavior=DsadcBehavior, vendor-specific-module-def=Dsadc
    code-descriptors:
      code Files
        artifact-descriptors:
          short-label=ssc::src::Dsadc.c, category=SWSRC
          short-label=ssc::inc::Dsadc.h, category=SWHDR
          short-label=mak::dsadc_infineon_tricore::ssc::mak::infineon_dsadc_cfg.mak, category=SWMAKE
          short-label=mak::dsadc_infineon_tricore::ssc::mak::infineon_dsadc_check.mak, category=SWMAKE
          short-label=mak::dsadc_infineon_tricore::ssc::mak::infineon_dsadc_defs.mak, category=SWMAKE
          short-label=mak::dsadc_infineon_tricore::ssc::mak::infineon_dsadc_rules.mak, category=SWMAKE
    compiler TASKING_COMPILE: name=TASKING, options="-c --core=tc1.6.x -t -Wa-gAHLs --emit-locals=-equ,-symbols -Wa-Ogs -Wa--error-limit=42 --iso=90 --eabi-compliant --integer-enumeration --language=-comments,-gcc,+volatile,-strings --switch=auto --align=0 --default-near-size=0 --default-a0-size=0 --default-a1-size=0 -O2ROPYG --tradeoff=4 -g --source -D_TASKING_C_TRICORE_=1 $(CALLFUNCTION)", vendor=Tasking, version=Tasking
    compiler DIAB_COMPILE: name=DIAB, options="-c -tTC27xAstep16PMG:cross -Xdialect-c89 -Xno-common -Xalign-functions=4 -Xfp-fast -Xsection-split=1 -Xkeep-assembly-file=2 -g3 -ew4084 -ei4177,4550,4549,4068,5388 -XO -D_DIABDATA_C_TRICORE_=1 $(CALLFUNCTION)", vendor=WindRiver, version=WindRiver
    compiler GNU_COMPILE:
      name=GNU
      options="-c -save-temps=obj -std=iso9899:1990 -ansi -fno-asm -ffreestanding -Wundef -Wp,-std=iso9899:1990 -fno-short-enums -fpeel-loops -falign-functions=4 -frecord-gcc-switches -fsection-anchors -funsigned-bitfields -ffunction-sections -fno-ivopts -fno-peephole2 -nostartfiles -O3 -g3 -W -Wall -Wuninitialized -DTRIBOARD_TC27XX -mcpu=tc27xx -D_GNU_C_TRICORE_=1 $(CALLFUNCTION)"
      vendor=Hightec
      version=Hightec
    generated-artifacts:
      4 x dependency on artifact, all with usages=CODEGENERATION:
        Dsadc_PBCfg_c: artifact-descriptor={short-label=generate::src::Dsadc_PBCfg.c, category=SWSRC}
        Dsadc_Cfg_h: artifact-descriptor={short-label=generate::inc::Dsadc_Cfg.h, category=SWHDR}
        Dsadc_xdm: artifact-descriptor={short-label=config::Dsadc.xdm, category=SWTOOL}
        Dsadc_bmd: artifact-descriptor={short-label=autosar::Dsadc.bmd, category=SWTOOL}
    linker TASKING_LINK: name=TASKING, options="-t -d_mcal_pjt.lsl -D__CPU__=tc27x -Cmpe:vtc -Otxycl --error-limit=42 -M -mcrfiklsmnoduq -lc -lfp -lrt", vendor=Tasking, version=Tasking
    linker DIAB_LINK: name=DIAB, options="-m6 "_mcal_pjt.dld" -lc", vendor=WindRiver, version=WindRiver
    linker GNU_LINK: name=GNU, options="-T"_mcal_pjt.ld" -nostartfiles -Wl,--allow-multiple-definition -Wl,--cref -Wl,--oformat=elf32-tricore -Wl,--mcpu=tc161 -Wl,--mem-holes -Wl,--extmap="a"", vendor=Hightec, version=Hightec
    resource consumption ResourceConsumption
      5 x memory section:
        DSADC_CONST_32BIT: alignment=32, size=4, sw-addrmethod=CONST
        DSADC_VAR_32BIT: alignment=32, size=4, sw-addrmethod=VAR
        DSADC_VAR_8BIT: alignment=8, size=1, sw-addrmethod=VAR
        DSADC_POSTBUILDCFG: alignment=UNSPECIFIED, size=160, sw-addrmethod=CONFIG_DATA
        DSADC_CODE: alignment=32, size=2006, sw-addrmethod=CODE
      section name prefix DSADC
package /AURIX_Dsadc/ImplementationDataTypes
  5 x impl type, all with type-emitter=BSW:
    Dsadc_ConfigType: category=STRUCTURE
      element uint32
    Dsadc_ChannelConfigType: category=STRUCTURE
      element uint32
    Dsadc_CarrierWaveformModeType: compu {0=DSADC_WAVEFORM_STOPPED, 0=DSADC_SQUARE_WAVEFORM, 0=DSADC_TRIANGLE_WAVEFORM, 0=DSADC_SINE_WAVEFORM}, implementation-data-type=uint32
    Dsadc_ChannelType: implementation-data-type=uint8
    Dsadc_ChannelDataType: implementation-data-type=sint16
