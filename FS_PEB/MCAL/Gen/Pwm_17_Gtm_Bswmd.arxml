AUTOSAR XML (schema 4-0-3)
# Copyright (C) Infineon Technologies (2015)
# All rights reserved.
package /AUTOSAR_Pwm/BswModuleDescriptions
  bsw module description Pwm: category=BSW_MODULE, module-id=121  # PWM Driver
    provided-entrys:
      Pwm_Init
      Pwm_DeInit
      Pwm_SetDutyCycle
      Pwm_SetPeriodAndDuty
      Pwm_SetOutputToIdle
      Pwm_GetOutputState
      Pwm_GetVersionInfo
      Pwm_Isr
    bsw module dependency DetDependency: target-module-id=15, required-entrys=Det_ReportError
    bsw module dependency SafeMcalDependency: target-module-id=255, required-entrys=SafeMcal_ReportError
    bsw internal behavior PwmBehavior
      constant-memorys:
        parameter data prototype Pwm_kConfigPtr: category=DATA_REFERENCE, sw-pointer-target-props={target-category=TYPE_REFERENCE, implementation-data-type=Pwm_17_Gtm_ConfigType}, type=Pwm_17_Gtm_ConfigType
      exclusive area StartChannel
      static-memorys:
        data Pwm_InitStatus: implementation-data-type=uint8, type=uint8
        data Pwm_GlobChn_Asil: implementation-data-type=uint32, type=uint32
        data Pwm_GlobChn_Qm: implementation-data-type=uint32, type=uint32
      7 x bsw called entity:
        Pwm_Init: implemented-entry=Pwm_Init
        Pwm_DeInit: implemented-entry=Pwm_DeInit
        Pwm_SetDutyCycle: can-enter-exclusive-area=StartChannel, implemented-entry=Pwm_SetDutyCycle
        Pwm_SetPeriodAndDuty: can-enter-exclusive-area=StartChannel, implemented-entry=Pwm_SetPeriodAndDuty
        Pwm_SetOutputToIdle: can-enter-exclusive-area=StartChannel, implemented-entry=Pwm_SetOutputToIdle
        Pwm_GetOutputState: implemented-entry=Pwm_GetOutputState
        Pwm_GetVersionInfo: implemented-entry=Pwm_GetVersionInfo
      bsw interrupt entity Pwm_Isr: implemented-entry=Pwm_Isr, interrupt-category=CAT-1, interrupt-source=SRC_GTMTOMxy, SRC_GTMATOMxy
package /AUTOSAR_Pwm/BswModuleEntrys
  8 x bsw module entry, all with is-synchronous=true:
    Pwm_Init: service-id=0, is-reentrant=false, call-type=REGULAR, execution-context=UNSPECIFIED, sw-service-impl-policy=STANDARD
      sw service arg ConfigPtr: category=DATA_REFERENCE, sw-pointer-target-props={target-category=TYPE_REFERENCE, implementation-data-type=Pwm_ConfigType}
    Pwm_DeInit: service-id=1, is-reentrant=false, call-type=REGULAR, execution-context=UNSPECIFIED, sw-service-impl-policy=STANDARD
    Pwm_SetDutyCycle: service-id=2, is-reentrant=true, call-type=REGULAR, execution-context=UNSPECIFIED, sw-service-impl-policy=STANDARD
      sw service arg ChannelNumber: implementation-data-type=Pwm_ChannelType
      sw service arg DutyCycle: implementation-data-type=uint16
    Pwm_SetPeriodAndDuty: service-id=3, is-reentrant=true, call-type=REGULAR, execution-context=UNSPECIFIED, sw-service-impl-policy=STANDARD
      sw service arg ChannelNumber: implementation-data-type=Pwm_ChannelType
      sw service arg Period: implementation-data-type=Pwm_PeriodType
      sw service arg DutyCycle: implementation-data-type=uint16
    Pwm_SetOutputToIdle: service-id=4, is-reentrant=true, call-type=REGULAR, execution-context=UNSPECIFIED, sw-service-impl-policy=STANDARD
      sw service arg ChannelNumber: implementation-data-type=Pwm_ChannelType
    Pwm_GetOutputState: service-id=5, is-reentrant=true, call-type=REGULAR, execution-context=UNSPECIFIED, sw-service-impl-policy=STANDARD
      return type Return: implementation-data-type=Pwm_17_Gtm_OutputStateType
      sw service arg ChannelNumber: implementation-data-type=Pwm_ChannelType
    Pwm_GetVersionInfo: service-id=8, is-reentrant=false, call-type=REGULAR, execution-context=UNSPECIFIED, sw-service-impl-policy=MACRO
      sw service arg versioninfo: category=DATA_REFERENCE, sw-pointer-target-props={target-category=TYPE_REFERENCE, implementation-data-type=Std_VersionInfoType}
    Pwm_Isr: service-id=9, is-reentrant=false, call-type=INTERRUPT, execution-context=INTERRUPT-CAT-1, sw-service-impl-policy=STANDARD
      sw service arg ChannelNumber: implementation-data-type=Pwm_ChannelType
package /AUTOSAR_Pwm/Implementations
  bsw implementation Pwm: programming-language=C, sw-version=0.0.0, vendor-id=17, ar-release-version=4.0.3, behavior=PwmBehavior, vendor-api-infix=Gtm, vendor-specific-module-def=Pwm
    code-descriptors:
      code Files
        artifact-descriptors:
          short-label=Pwm_17_Gtm_infineon_tricore::ssc::src::Pwm_17_Gtm.c, category=SWSRC
          short-label=Pwm_17_Gtm_infineon_tricore::ssc::inc::Pwm_17_Gtm.h, category=SWHDR
          short-label=Pwm_17_Gtm_infineon_tricore::ssc::inc::Pwm_17_Gtm_Ver.h, category=SWHDR
          short-label=Pwm_17_Gtm_infineon_tricore::ssc::src::Pwm_17_Gtm_Ver.c, category=SWSRC
          short-label=irq_infineon_tricore::ssc::src::Gtm_Irq.c, category=SWSRC
          short-label=mak::pwm_17_gtm_infineon_tricore::ssc::mak::infineon_pwm_17_gtm_cfg.mak, category=SWMAKE
          short-label=mak::pwm_17_gtm_infineon_tricore::ssc::mak::infineon_pwm_17_gtm_check.mak, category=SWMAKE
          short-label=mak::pwm_17_gtm_infineon_tricore::ssc::mak::infineon_pwm_17_gtm_defs.mak, category=SWMAKE
          short-label=mak::pwm_17_gtm_infineon_tricore::ssc::mak::infineon_pwm_17_gtm_rules.mak, category=SWMAKE
    compiler TASKING_COMPILE: name=TASKING, options="-c --core=tc1.6.x -t -Wa-gAHLs --emit-locals=-equ,-symbols -Wa-Ogs -Wa--error-limit=42 --iso=90 --eabi-compliant --integer-enumeration --language=-comments,-gcc,+volatile,-strings --switch=auto --align=0 --default-near-size=0 --default-a0-size=0 --default-a1-size=0 -O2ROPYG --tradeoff=4 -g --source -D_TASKING_C_TRICORE_=1 $(CALLFUNCTION)", vendor=Tasking, version=Tasking
    compiler DIAB_COMPILE: name=DIAB, options="-c -tTC27xAstep16PMG:cross -Xdialect-c89 -Xno-common -Xalign-functions=4 -Xfp-fast -Xsection-split=1 -Xkeep-assembly-file=2 -g3 -ew4084 -ei4177,4550,4549,4068,5388 -XO -D_DIABDATA_C_TRICORE_=1 $(CALLFUNCTION)", vendor=WindRiver, version=WindRiver
    compiler GNU_COMPILE:
      name=GNU
      options="-c -save-temps=obj -std=iso9899:1990 -ansi -fno-asm -ffreestanding -Wundef -Wp,-std=iso9899:1990 -fno-short-enums -fpeel-loops -falign-functions=4 -frecord-gcc-switches -fsection-anchors -funsigned-bitfields -ffunction-sections -fno-ivopts -fno-peephole2 -nostartfiles -O3 -g3 -W -Wall -Wuninitialized -DTRIBOARD_TC27XX -mcpu=tc27xx -D_GNU_C_TRICORE_=1 $(CALLFUNCTION)"
      vendor=Hightec
      version=Hightec
    generated-artifacts:
      dependency on artifact Pwm_PBCfg_c: artifact-descriptor={short-label=plugins::Pwm_17_Gtm_Aurix::generate::src::Pwm_17_Gtm_PBCfg.c, category=SWSRC}, usages=CODEGENERATION
      dependency on artifact Pwm_Cfg_h: artifact-descriptor={short-label=plugins::Pwm_17_Gtm_Aurix::generate::inc::Pwm_17_Gtm_Cfg.h, category=SWHDR}, usages=CODEGENERATION
      dependency on artifact Pwm_m: artifact-descriptor={short-label=plugins::Pwm_17_Gtm_Aurix::generate::Pwm_17_Gtm.m, category=SWTOOL}, usages=CODEGENERATION
    linker TASKING_LINK: name=TASKING, options="-t -d_mcal_pjt.lsl -D__CPU__=tc27x -Cmpe:vtc -Otxycl --error-limit=42 -M -mcrfiklsmnoduq -lc -lfp -lrt", vendor=Tasking, version=Tasking
    linker DIAB_LINK: name=DIAB, options="-m6 "_mcal_pjt.dld" -lc", vendor=WindRiver, version=WindRiver
    linker GNU_LINK: name=GNU, options="-T"_mcal_pjt.ld" -nostartfiles -Wl,--allow-multiple-definition -Wl,--cref -Wl,--oformat=elf32-tricore -Wl,--mcpu=tc161 -Wl,--mem-holes -Wl,--extmap="a"", vendor=Hightec, version=Hightec
    resource consumption ResourceConsumption
      8 x memory section:
        PWM_17_GTM_VAR_32BIT: alignment=32, size=4, sw-addrmethod=VAR
        PWM_17_GTM_CONST_32BIT: alignment=32, size=4, sw-addrmethod=CONST
        PWM_17_GTM_VAR_8BIT: alignment=8, size=1, sw-addrmethod=VAR
        PWM_17_GTM_VAR_FAST_32BIT: alignment=32, size=160, sw-addrmethod=VAR_FAST
        PWM_17_GTM_CODE: alignment=UNSPECIFIED, size=5476, sw-addrmethod=CODE
        PWM_17_GTM_POSTBUILDCFG: alignment=UNSPECIFIED, size=128, sw-addrmethod=CONFIG_DATA
        PWM_17_GTM_CALLOUT_CODE: alignment=UNSPECIFIED, size=34, sw-addrmethod=CODE
        PWM_17_GTM_ASIL0_VAR_32BIT: alignment=32, size=160, sw-addrmethod=VAR_FAST
      section name prefix PWM_17_GTM
package /AUTOSAR_Pwm/ImplementationDataTypes
  7 x impl type, all with type-emitter=BSW:
    Pwm_17_Gtm_ChannelType: implementation-data-type=uint32
    Pwm_17_Gtm_PeriodType: implementation-data-type=uint32
    Pwm_17_Gtm_EdgeNotificationType: implementation-data-type=uint8
    Pwm_17_Gtm_OutputStateType: implementation-data-type=uint8
    Pwm_17_Gtm_ConfigType: category=STRUCTURE
      element Pwm_17_Gtm_ChannelType
    Pwm_GlobalChannelNumberType: implementation-data-type=uint8
    Pwm_ChannelIdentifierType: category=STRUCTURE
      element uint8
