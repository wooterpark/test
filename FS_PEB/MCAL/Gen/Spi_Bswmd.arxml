AUTOSAR XML (schema 4-0-3)
# Copyright (C) Infineon Technologies (2015)
# All rights reserved.
package /AUTOSAR_Spi/BswModuleDescriptions
  bsw module description Spi: category=BSW_MODULE, module-id=83  # SPI Driver
    provided-entrys:
      Spi_Init
      Spi_DeInit
      Spi_AsyncTransmit
      Spi_SetupEB
      Spi_GetStatus
      Spi_GetJobResult
      Spi_GetSequenceResult
      Spi_SyncTransmit
      Spi_SetAsyncMode
      Spi_IsrDmaQspiRx
      Spi_IsrDmaQspiTx
      Spi_IsrQspiError
      Spi_IsrDmaError
      Spi_IsrQspiPt
      Spi_IsrQspiUsr
      Spi_IsrCheckDmaError
      Spi_MainFunction_Handling
    bsw module dependency DetDependency: target-module-id=20, required-entrys=Det_ReportError
    bsw module dependency DemDependency: target-module-id=30, required-entrys=Dem_ReportErrorStatus
    bsw internal behavior SpiBehavior
      constant-memorys:
        parameter data prototype Spi_kConfigPtr: category=DATA_REFERENCE, sw-pointer-target-props={target-category=TYPE_REFERENCE, implementation-data-type=Spi_ConfigType}, type=Spi_ConfigType
        parameter data prototype Spi_kSlaveConfigPtr: category=DATA_REFERENCE, sw-pointer-target-props={target-category=TYPE_REFERENCE, implementation-data-type=Spi_ConfigType}, type=Spi_ConfigType
      7 x exclusive area:
        Init
        DeInit
        WriteIB
        AsyncTransmit
        GetSequenceResult
        SyncTransmit
        Cancel
      static-memorys:
        24 x data:
          Spi_BusStatus: implementation-data-type=Spi_StatusType, type=Spi_StatusType
          Spi_AsyncMode: implementation-data-type=uint8, type=uint8
          Spi_NoOfIBChannels: implementation-data-type=uint8, type=uint8
          Spi_DriverState: implementation-data-type=uint8, type=uint8
          Spi_InitStatus: implementation-data-type=uint8, type=uint8
          Spi_EBBuffer: implementation-data-type=Spi_EBBufferType, type=Spi_EBBufferType
          Spi_AsyncBusStatus: implementation-data-type=Spi_StatusType, type=Spi_StatusType
          Spi_QmJobAndSeqAccess: implementation-data-type=Spi_JobAndSeqAccessType, type=Spi_JobAndSeqAccessType
          Spi_QmChnlAccess: implementation-data-type=Spi_ChnlAccessType, type=Spi_ChnlAccessType
          Spi_QmSeqStatus: implementation-data-type=Spi_QmSeqStatusType, type=Spi_QmSeqStatusType
          Spi_IBBufferAccess: implementation-data-type=Spi_IBBufferAccessType, type=Spi_IBBufferAccessType
          Spi_AsilAsyncBusStatus: implementation-data-type=Spi_StatusType, type=Spi_StatusType
          Spi_AsilJobAndSeqAccess: implementation-data-type=Spi_JobAndSeqAccessType, type=Spi_JobAndSeqAccessType
          Spi_AsilChnlAccess: implementation-data-type=Spi_ChnlAccessType, type=Spi_ChnlAccessType
          Spi_AsilSeqStatus: implementation-data-type=Spi_AsilSeqStatusType, type=Spi_AsilSeqStatusType
          Spi_SyncLock: implementation-data-type=uint32, type=uint32
          Spi_DMARXDummy: implementation-data-type=uint32, type=uint32
          Spi_AsilJobResult: implementation-data-type=uint32, type=uint32
          Spi_QmJobResult: implementation-data-type=uint32, type=uint32
          Spi_SlaveJobAndSeqAccess: implementation-data-type=Spi_JobAndSeqAccessType, type=Spi_JobAndSeqAccessType
          Spi_SlaveEBBuffer: implementation-data-type=Spi_SlaveEBBufferType, type=Spi_SlaveEBBufferType
          Spi_SlaveBusStatus: implementation-data-type=Spi_StatusType, type=Spi_StatusType
          Spi_SlaveSeqStatus: implementation-data-type=Spi_AsilSeqStatusType, type=Spi_AsilSeqStatusType
          Spi_SlaveJobResult: implementation-data-type=uint32, type=uint32
      9 x bsw called entity:
        Spi_Init: can-enter-exclusive-area=Init, implemented-entry=Spi_Init
        Spi_DeInit: can-enter-exclusive-area=DeInit, implemented-entry=Spi_DeInit
        Spi_AsyncTransmit: can-enter-exclusive-area=AsyncTransmit, implemented-entry=Spi_AsyncTransmit
        Spi_SetupEB: implemented-entry=Spi_SetupEB
        Spi_GetStatus: implemented-entry=Spi_GetStatus
        Spi_GetJobResult: implemented-entry=Spi_GetJobResult
        Spi_GetSequenceResult: can-enter-exclusive-area=GetSequenceResult, implemented-entry=Spi_GetSequenceResult
        Spi_SyncTransmit: can-enter-exclusive-area=SyncTransmit, implemented-entry=Spi_SyncTransmit
        Spi_SetAsyncMode: implemented-entry=Spi_SetAsyncMode
      bsw schedulable entity Spi_MainFunction_Handling: can-enter-exclusive-area=AsyncTransmit, implemented-entry=Spi_MainFunction_Handling
      7 x bsw interrupt entity, all with interrupt-category=CAT-1:
        Spi_IsrDmaQspiRx: implemented-entry=Spi_IsrDmaQspiRx, interrupt-source=SRC_DMACHm
        Spi_IsrDmaQspiTx: implemented-entry=Spi_IsrDmaQspiTx, interrupt-source=SRC_DMACHm
        Spi_IsrQspiError: implemented-entry=Spi_IsrQspiError, interrupt-source=SRC_QSPImERR
        Spi_IsrDmaError: implemented-entry=Spi_IsrDmaError, interrupt-source=SRC_DMAERR
        Spi_IsrQspiPt: implemented-entry=Spi_IsrQspiPt, interrupt-source=SRC_QSPImPT
        Spi_IsrQspiUsr: implemented-entry=Spi_IsrQspiUsr, interrupt-source=SRC_QSPImU
        Spi_IsrCheckDmaError: implemented-entry=Spi_IsrCheckDmaError, interrupt-source=SRC_DMACHm
      bsw timing event TimingEvent_Spi_MainFunction_Handling: starts-on-event=Spi_MainFunction_Handling, period=0.01
package /AUTOSAR_Spi/BswModuleEntrys
  17 x bsw module entry, all with sw-service-impl-policy=STANDARD:
    Spi_Init: service-id=0, is-reentrant=false, is-synchronous=true, call-type=REGULAR, execution-context=UNSPECIFIED
      sw service arg ConfigPtr: category=DATA_REFERENCE, sw-pointer-target-props={target-category=TYPE_REFERENCE, implementation-data-type=Spi_ConfigType}
    Spi_DeInit: service-id=1, is-reentrant=false, is-synchronous=true, call-type=REGULAR, execution-context=UNSPECIFIED
      return type Return: implementation-data-type=Std_ReturnType
    Spi_AsyncTransmit: service-id=3, is-reentrant=true, is-synchronous=false, call-type=REGULAR, execution-context=UNSPECIFIED
      return type Return: implementation-data-type=Std_ReturnType
      sw service arg Sequence: implementation-data-type=Spi_SequenceType
    Spi_SetupEB: service-id=5, is-reentrant=true, is-synchronous=true, call-type=REGULAR, execution-context=UNSPECIFIED
      return type Return: implementation-data-type=Std_ReturnType
      4 x sw service arg:
        Channel: implementation-data-type=Spi_ChannelType
        SrcDataBufferPtr: category=DATA_REFERENCE, sw-pointer-target-props={target-category=TYPE_REFERENCE, implementation-data-type=Spi_DataType}
        DesDataBufferPtr: category=DATA_REFERENCE, sw-pointer-target-props={target-category=TYPE_REFERENCE, implementation-data-type=Spi_DataType}
        Length: implementation-data-type=Spi_NumberOfDataType
    Spi_GetStatus: service-id=6, is-reentrant=true, is-synchronous=true, call-type=REGULAR, execution-context=UNSPECIFIED
      return type Return: implementation-data-type=Spi_StatusType
    Spi_GetJobResult: service-id=7, is-reentrant=true, is-synchronous=true, call-type=REGULAR, execution-context=UNSPECIFIED
      return type Return: implementation-data-type=Spi_JobResultType
      sw service arg Job: implementation-data-type=Spi_JobType
    Spi_GetSequenceResult: service-id=8, is-reentrant=true, is-synchronous=true, call-type=REGULAR, execution-context=UNSPECIFIED
      return type Return: implementation-data-type=Spi_SeqResultType
      sw service arg Sequence: implementation-data-type=Spi_SequenceType
    Spi_SyncTransmit: service-id=10, is-reentrant=true, is-synchronous=true, call-type=REGULAR, execution-context=UNSPECIFIED
      return type Return: implementation-data-type=Std_ReturnType
      sw service arg Sequence: implementation-data-type=Spi_SequenceType
    Spi_SetAsyncMode: service-id=13, is-reentrant=false, is-synchronous=true, call-type=REGULAR, execution-context=UNSPECIFIED
      return type Return: implementation-data-type=Std_ReturnType
      sw service arg Mode: implementation-data-type=Spi_AsyncModeType
    Spi_IsrDmaQspiRx: service-id=52, is-reentrant=false, is-synchronous=true, call-type=INTERRUPT, execution-context=INTERRUPT-CAT-1
      sw service arg ModuleNo: implementation-data-type=uint32
    Spi_IsrDmaQspiTx: service-id=51, is-reentrant=false, is-synchronous=true, call-type=INTERRUPT, execution-context=INTERRUPT-CAT-1
      sw service arg ModuleNo: implementation-data-type=uint32
    Spi_IsrQspiError: service-id=55, is-reentrant=false, is-synchronous=true, call-type=INTERRUPT, execution-context=INTERRUPT-CAT-1
      sw service arg ModuleNo: implementation-data-type=uint32
    Spi_IsrDmaError: service-id=50, is-reentrant=false, is-synchronous=true, call-type=INTERRUPT, execution-context=INTERRUPT-CAT-1
      sw service arg ModuleNo: implementation-data-type=uint32
    Spi_IsrQspiPt: service-id=53, is-reentrant=false, is-synchronous=true, call-type=INTERRUPT, execution-context=INTERRUPT-CAT-1
      sw service arg ModuleNo: implementation-data-type=uint32
    Spi_IsrQspiUsr: service-id=54, is-reentrant=false, is-synchronous=true, call-type=INTERRUPT, execution-context=INTERRUPT-CAT-1
      sw service arg ModuleNo: implementation-data-type=uint32
    Spi_IsrCheckDmaError: service-id=49, is-reentrant=false, is-synchronous=true, call-type=INTERRUPT, execution-context=INTERRUPT-CAT-1
      return type Return: implementation-data-type=uint32
      sw service arg ModuleNo: implementation-data-type=uint32
    Spi_MainFunction_Handling: service-id=16, is-reentrant=false, is-synchronous=true, call-type=SCHEDULED, execution-context=TASK
package /AUTOSAR_Spi/Implementations
  bsw implementation Spi: programming-language=C, sw-version=0.0.0, vendor-id=17, ar-release-version=4.0.3, behavior=SpiBehavior, vendor-specific-module-def=Spi
    code-descriptors:
      code Files
        artifact-descriptors:
          short-label=ssc::src::Spi.c, category=SWSRC
          short-label=ssc::inc::Spi.h, category=SWHDR
          short-label=ssc::inc::Spi_Ver.h, category=SWHDR
          short-label=ssc::inc::Spi_Dbg.h, category=SWHDR
          short-label=ssc::src::SpiSlave.c, category=SWSRC
          short-label=ssc::src::Spi_Ver.c, category=SWSRC
          short-label=ssc::inc::SpiSlave.h, category=SWHDR
          short-label=ssc::inc::Spi_Local.h, category=SWHDR
          short-label=mak::spi_infineon_tricore::ssc::mak::infineon_spi_cfg.mak, category=SWMAKE
          short-label=mak::spi_infineon_tricore::ssc::mak::infineon_spi_check.mak, category=SWMAKE
          short-label=mak::spi_infineon_tricore::ssc::mak::infineon_spi_defs.mak, category=SWMAKE
          short-label=mak::spi_infineon_tricore::ssc::mak::infineon_spi_rules.mak, category=SWMAKE
          short-label=mak::spi_infineon_tricore::cfg1::mak::infineon_spi_rules.mak, category=SWMAKE
    compiler TASKING_COMPILE: name=TASKING, options="-c --core=tc1.6.x -t -Wa-gAHLs --emit-locals=-equ,-symbols -Wa-Ogs -Wa--error-limit=42 --iso=90 --eabi-compliant --integer-enumeration --language=-comments,-gcc,+volatile,-strings --switch=auto --align=0 --default-near-size=0 --default-a0-size=0 --default-a1-size=0 -O2ROPYG --tradeoff=4 -g --source -D_TASKING_C_TRICORE_=1 $(CALLFUNCTION)", vendor=Tasking, version=Tasking
    compiler DIAB_COMPILE: name=DIAB, options="-c -tTC27xAstep16PMG:cross -Xdialect-c89 -Xno-common -Xalign-functions=4 -Xfp-fast -Xsection-split=1 -Xkeep-assembly-file=2 -g3 -ew4084 -ei4177,4550,4549,4068,5388 -XO -D_DIABDATA_C_TRICORE_=1 $(CALLFUNCTION)", vendor=WindRiver, version=WindRiver
    compiler GNU_COMPILE:
      name=GNU
      options="-c -save-temps=obj -std=iso9899:1990 -ansi -fno-asm -ffreestanding -Wundef -Wp,-std=iso9899:1990 -fno-short-enums -fpeel-loops -falign-functions=4 -frecord-gcc-switches -fsection-anchors -funsigned-bitfields -ffunction-sections -fno-ivopts -fno-peephole2 -nostartfiles -O3 -g3 -W -Wall -Wuninitialized -DTRIBOARD_TC27XX -mcpu=tc27xx -D_GNU_C_TRICORE_=1 $(CALLFUNCTION)"
      vendor=Hightec
      version=Hightec
    generated-artifacts:
      5 x dependency on artifact, all with usages=CODEGENERATION:
        Spi_Cfg_h: artifact-descriptor={short-label=generate::inc::Spi_Cfg.h, category=SWHDR}
        Spi_PBcfg_c: artifact-descriptor={short-label=generate::src::Spi_PBcfg.c, category=SWSRC}
        Spi_xdm: artifact-descriptor={short-label=Config::Spi.xdm, category=SWTOOL}
        plugin_xml: artifact-descriptor={short-label=Spi_Aurix::plugin.xml, category=SWTOOL}
        Spi_bmd: artifact-descriptor={short-label=autosar::Spi.bmd, category=SWTOOL}
    linker TASKING_LINK: name=TASKING, options="-t -d_mcal_pjt.lsl -D__CPU__=tc27x -Cmpe:vtc -Otxycl --error-limit=42 -M -mcrfiklsmnoduq -lc -lfp -lrt", vendor=Tasking, version=Tasking
    linker DIAB_LINK: name=DIAB, options="-m6 "_mcal_pjt.dld" -lc", vendor=WindRiver, version=WindRiver
    linker GNU_LINK: name=GNU, options="-T"_mcal_pjt.ld" -nostartfiles -Wl,--allow-multiple-definition -Wl,--cref -Wl,--oformat=elf32-tricore -Wl,--mcpu=tc161 -Wl,--mem-holes -Wl,--extmap="a"", vendor=Hightec, version=Hightec
    resource consumption ResourceConsumption
      10 x memory section:
        SPI_CODE: alignment=UNSPECIFIED, size=12500, sw-addrmethod=CODE
        SPI_ASIL0_VAR_32BIT: alignment=32, size=40, sw-addrmethod=VAR
        SPI_ASIL0_VAR_UNSPECIFIED: alignment=UNSPECIFIED, size=220, sw-addrmethod=VAR
        SPI_ASIL1_VAR_FAST_32BIT: alignment=32, size=350, sw-addrmethod=VAR_FAST
        SPI_ASIL1_VAR_UNSPECIFIED: alignment=UNSPECIFIED, size=164, sw-addrmethod=VAR
        SPI_CONST_32BIT: alignment=32, size=600, sw-addrmethod=CONST
        SPI_VAR_32BIT: alignment=32, size=8, sw-addrmethod=VAR
        SPI_VAR_8BIT: alignment=8, size=4, sw-addrmethod=VAR
        SPI_VAR_FAST_32BIT: alignment=32, size=8, sw-addrmethod=VAR_FAST
        SPI_VAR_UNSPECIFIED: alignment=UNSPECIFIED, size=948, sw-addrmethod=VAR
      section name prefix SPI
package /AUTOSAR_Spi/ImplementationDataTypes
  30 x impl type, all with type-emitter=BSW:
    Spi_StatusType: compu {0=SPI_UNINIT, 0=SPI_IDLE, 0=SPI_BUSY}, implementation-data-type=uint32
    Spi_ConfigType: category=STRUCTURE
      element Spi_ChannelConfigType*
    Spi_ChannelType: implementation-data-type=uint8
    Spi_JobType: implementation-data-type=uint16
    Spi_SequenceType: implementation-data-type=uint8
    Spi_DataType: implementation-data-type=uint8
    Spi_NumberOfDataType: implementation-data-type=uint16
    Spi_HWUnitType: implementation-data-type=uint8
    Spi_AsyncModeType: compu {0=SPI_POLLING_MODE, 0=SPI_INTERRUPT_MODE}, implementation-data-type=uint32
    Spi_SeqResultType: compu {0=SPI_SEQ_OK, 0=SPI_SEQ_PENDING, 0=SPI_SEQ_FAILED, 0=SPI_SEQ_CANCELED}, implementation-data-type=uint32
    Spi_JobResultType: compu {0=SPI_JOB_OK, 0=SPI_JOB_PENDING, 0=SPI_JOB_FAILED, 0=SPI_JOB_QUEUED}, implementation-data-type=uint32
    Spi_AsilSeqStatusType: category=STRUCTURE
      element uint32
    Spi_ChannelConfigType: category=STRUCTURE
      element uint32
    Spi_ChnlAccessType: category=STRUCTURE
      element uint16
    Spi_DelayConfigType: implementation-data-type=uint32
    Spi_DmaConfigType: category=STRUCTURE
      element Dma_ChannelType
    Spi_HWModuleConfigType: category=STRUCTURE
      element uint32
    Spi_IBBufferAccessType: category=STRUCTURE
      element Spi_DataType
    Spi_JobAndSeqAccessType: category=STRUCTURE
      element Spi_JobType
    Spi_JobConfigType: category=STRUCTURE
      element Spi_ChannelType
    Spi_LastChannelDataType: category=STRUCTURE
      element uint32
    Spi_MapConfigType: category=STRUCTURE
      element Spi_JobType
    Spi_QmSeqStatusType: category=STRUCTURE
      element uint32
    Spi_SafetyJobType: compu {0=SPI_QM_JOB, 0=SPI_ASIL_JOB}, implementation-data-type=uint32
    Spi_SafetySeqType: compu {0=SPI_QM_SEQUENCE, 0=SPI_ASIL_SEQUENCE}, implementation-data-type=uint32
    Spi_SequenceConfigType: category=STRUCTURE
      element uint16
    Spi_EBBufferType: category=STRUCTURE
      element Spi_DataType*
    Spi_SyncTransParamType: category=STRUCTURE
      element uint32
    Spi_SlaveChnlAccessType: category=STRUCTURE
      element Spi_DmaConfigType
    Spi_SlaveEBBufferType: category=STRUCTURE
      element Spi_DataType*
