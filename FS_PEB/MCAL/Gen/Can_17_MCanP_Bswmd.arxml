AUTOSAR XML (schema 4-0-3)
# Copyright (C) Infineon Technologies (2015)
# All rights reserved.
package /AUTOSAR_Can/BswModuleDescriptions
  bsw module description Can: category=BSW_MODULE, module-id=80  # CAN Driver
    provided-entrys:
      Can_Init
      Can_SetControllerMode
      Can_DisableControllerInterrupts
      Can_EnableControllerInterrupts
      Can_Write
      Can_MainFunction_Write
      Can_MainFunction_Read
      Can_MainFunction_BusOff
      Can_MainFunction_Wakeup
      Can_MainFunction_Mode
      Can_CheckWakeup
      Can_IsrReceiveHandler
      Can_IsrTransmitHandler
      Can_IsrBusOffHandler
    4 x bsw module dependency:
      DemDependency: target-module-id=54, required-entrys=Dem_ReportErrorStatus
      DetDependency: target-module-id=15, required-entrys=Det_ReportError
      CanIfDependency: target-module-id=60, required-entrys=[CanIf_ControllerModeIndication, CanIf_TxConfirmation, CanIf_ControllerBusOff, CanIf_RxIndication]
      EcuMDependency: target-module-id=10, required-entrys=EcuM_CheckWakeup
    bsw internal behavior CanBehavior
      constant-memorys:
        parameter data prototype Can_kConfigPtr: category=DATA_REFERENCE, sw-pointer-target-props={target-category=TYPE_REFERENCE, implementation-data-type=Can_17_MCanP_ConfigType}, type=Can_17_MCanP_ConfigType
      exclusive area CanDisInt
      exclusive area CanEnInt
      exclusive area CanWrMO
      static-memorys:
        data Can_InterruptDisableCount: implementation-data-type=uint8, type=uint8
        data Can_ControllerWakeupStatus: implementation-data-type=uint8, type=uint8
        data Can_DriverState: implementation-data-type=uint8, type=uint8
      6 x bsw called entity:
        Can_Init: implemented-entry=Can_Init
        Can_SetControllerMode: implemented-entry=Can_SetControllerMode
        Can_DisableControllerInterrupts: can-enter-exclusive-area=CanDisInt, implemented-entry=Can_DisableControllerInterrupts
        Can_EnableControllerInterrupts: can-enter-exclusive-area=CanEnInt, implemented-entry=Can_EnableControllerInterrupts
        Can_Write: can-enter-exclusive-area=CanWrMO, implemented-entry=Can_Write
        Can_CheckWakeup: implemented-entry=Can_CheckWakeup
      5 x bsw schedulable entity:
        Can_MainFunction_Write: implemented-entry=Can_MainFunction_Write
        Can_MainFunction_Read: implemented-entry=Can_MainFunction_Read
        Can_MainFunction_BusOff: implemented-entry=Can_MainFunction_BusOff
        Can_MainFunction_Wakeup: implemented-entry=Can_MainFunction_Wakeup
        Can_MainFunction_Mode: implemented-entry=Can_MainFunction_Mode
      bsw interrupt entity Can_IsrReceiveHandler: implemented-entry=Can_IsrReceiveHandler, interrupt-category=CAT-1, interrupt-source=SRC_CANINTx
      bsw interrupt entity Can_IsrTransmitHandler: implemented-entry=Can_IsrTransmitHandler, interrupt-category=CAT-1, interrupt-source=SRC_CANINTy
      bsw interrupt entity Can_IsrBusOffHandler: implemented-entry=Can_IsrBusOffHandler, interrupt-category=CAT-1, interrupt-source=SRC_CANINTz
      5 x bsw timing event:
        TimingEvent_Can_MainFunction_Write: starts-on-event=Can_MainFunction_Write, period=0.001
        TimingEvent_Can_MainFunction_Read: starts-on-event=Can_MainFunction_Read, period=0.001
        TimingEvent_Can_MainFunction_BusOff: starts-on-event=Can_MainFunction_BusOff, period=0.001
        TimingEvent_Can_MainFunction_Wakeup: starts-on-event=Can_MainFunction_Wakeup, period=0.001
        TimingEvent_Can_MainFunction_Mode: starts-on-event=Can_MainFunction_Mode, period=0.01
package /AUTOSAR_Can/BswModuleEntrys
  14 x bsw module entry, all with is-synchronous=true, sw-service-impl-policy=STANDARD:
    Can_Init: service-id=0, is-reentrant=false, call-type=REGULAR, execution-context=UNSPECIFIED
      sw service arg Config: category=DATA_REFERENCE, sw-pointer-target-props={target-category=TYPE_REFERENCE, implementation-data-type=Can_ConfigType}
    Can_SetControllerMode: service-id=3, is-reentrant=false, call-type=REGULAR, execution-context=UNSPECIFIED
      return type Return: implementation-data-type=Can_ReturnType
      sw service arg Controller: implementation-data-type=uint8
      sw service arg Transition: implementation-data-type=Can_StateTransitionType
    Can_DisableControllerInterrupts: service-id=4, is-reentrant=true, call-type=REGULAR, execution-context=UNSPECIFIED
      sw service arg Controller: implementation-data-type=uint8
    Can_EnableControllerInterrupts: service-id=5, is-reentrant=true, call-type=REGULAR, execution-context=UNSPECIFIED
      sw service arg Controller: implementation-data-type=uint8
    Can_Write: service-id=6, is-reentrant=true, call-type=REGULAR, execution-context=UNSPECIFIED
      return type Return: implementation-data-type=Can_ReturnType
      sw service arg Hth: implementation-data-type=Can_HwHandleType
      sw service arg PduInfo: category=DATA_REFERENCE, sw-pointer-target-props={target-category=TYPE_REFERENCE, implementation-data-type=Can_PduType}
    Can_MainFunction_Write: service-id=1, is-reentrant=false, call-type=SCHEDULED, execution-context=TASK
    Can_MainFunction_Read: service-id=8, is-reentrant=false, call-type=SCHEDULED, execution-context=TASK
    Can_MainFunction_BusOff: service-id=9, is-reentrant=false, call-type=SCHEDULED, execution-context=TASK
    Can_MainFunction_Wakeup: service-id=10, is-reentrant=false, call-type=SCHEDULED, execution-context=TASK
    Can_MainFunction_Mode: service-id=12, is-reentrant=false, call-type=SCHEDULED, execution-context=TASK
    Can_CheckWakeup: service-id=11, is-reentrant=false, call-type=REGULAR, execution-context=UNSPECIFIED
      return type Return: implementation-data-type=Can_ReturnType
      sw service arg Controller: implementation-data-type=uint8
    Can_IsrReceiveHandler: service-id=32, is-reentrant=true, call-type=INTERRUPT, execution-context=INTERRUPT-CAT-1
      sw service arg HwControllerId: implementation-data-type=uint8
    Can_IsrTransmitHandler: service-id=0, is-reentrant=true, call-type=INTERRUPT, execution-context=INTERRUPT-CAT-1
      sw service arg HwControllerId: implementation-data-type=uint8
    Can_IsrBusOffHandler: service-id=0, is-reentrant=true, call-type=INTERRUPT, execution-context=INTERRUPT-CAT-1
      sw service arg HwControllerId: implementation-data-type=uint8
package /AUTOSAR_Can/Implementations
  bsw implementation Can: programming-language=C, sw-version=0.0.0, vendor-id=17, ar-release-version=4.0.3, behavior=CanBehavior, vendor-api-infix=MCanP, vendor-specific-module-def=Can
    code-descriptors:
      code Files
        artifact-descriptors:
          short-label=ssc::inc::Can_17_MCanP.h, category=SWHDR
          short-label=ssc::inc::Can_17_MCanP_Dbg.h, category=SWHDR
          short-label=ssc::src::Can_17_MCanP.c, category=SWSRC
          short-label=irq_infineon_tricore::ssc::src::Can_Irq.c, category=SWSRC
          short-label=ssc::mak::infineon_can_17_mcanp_cfg.mak, category=SWMAKE
          short-label=ssc::mak::infineon_can_17_mcanp_check.mak, category=SWMAKE
          short-label=ssc::mak::infineon_can_17_mcanp_defs.mak, category=SWMAKE
          short-label=ssc::mak::infineon_can_17_mcanp_rules.mak, category=SWMAKE
    compiler TASKING_COMPILE: name=TASKING, options="-c --core=tc1.6.x -t -Wa-gAHLs --emit-locals=-equ,-symbols -Wa-Ogs -Wa--error-limit=42 --iso=90 --eabi-compliant --integer-enumeration --language=-comments,-gcc,+volatile,-strings --switch=auto --align=0 --default-near-size=0 --default-a0-size=0 --default-a1-size=0 -O2ROPYG --tradeoff=4 -g --source -D_TASKING_C_TRICORE_=1 $(CALLFUNCTION)", vendor=Tasking, version=Tasking
    compiler DIAB_COMPILE: name=DIAB, options="-c -tTC27xAstep16PMG:cross -Xdialect-c89 -Xno-common -Xalign-functions=4 -Xfp-fast -Xsection-split=1 -Xkeep-assembly-file=2 -g3 -ew4084 -ei4177,4550,4549,4068,5388 -XO -D_DIABDATA_C_TRICORE_=1 $(CALLFUNCTION)", vendor=WindRiver, version=WindRiver
    compiler GNU_COMPILE:
      name=GNU
      options="-c -save-temps=obj -std=iso9899:1990 -ansi -fno-asm -ffreestanding -Wundef -Wp,-std=iso9899:1990 -fno-short-enums -fpeel-loops -falign-functions=4 -frecord-gcc-switches -fsection-anchors -funsigned-bitfields -ffunction-sections -fno-ivopts -fno-peephole2 -nostartfiles -O3 -g3 -W -Wall -Wuninitialized -DTRIBOARD_TC27XX -mcpu=tc27xx -D_GNU_C_TRICORE_=1 $(CALLFUNCTION)"
      vendor=Hightec
      version=Hightec
    generated-artifacts:
      5 x dependency on artifact, all with usages=CODEGENERATION:
        Can_Cfg_h: artifact-descriptor={short-label=generate::inc::Can_17_MCanP_Cfg.h, category=SWSRC}
        Can_PBCfg_c: artifact-descriptor={short-label=generate::src::Can_17_MCanP_PBCfg.c, category=SWHDR}
        Can_xdm: artifact-descriptor={short-label=config::Can_17_MCanP.xdm, category=SWTOOL}
        Can_bmd: artifact-descriptor={short-label=autosar::Can_17_MCanP.bmd, category=SWTOOL}
        Can_m: artifact-descriptor={short-label=generate::Can_17_MCanP.m, category=SWTOOL}
    linker TASKING_LINK: name=TASKING, options="-t -d_mcal_pjt.lsl -D__CPU__=tc27x -Cmpe:vtc -Otxycl --error-limit=42 -M -mcrfiklsmnoduq -lc -lfp -lrt", vendor=Tasking, version=Tasking
    linker DIAB_LINK: name=DIAB, options="-m6 "_mcal_pjt.dld" -lc", vendor=WindRiver, version=WindRiver
    linker GNU_LINK: name=GNU, options="-T"_mcal_pjt.ld" -nostartfiles -Wl,--allow-multiple-definition -Wl,--cref -Wl,--oformat=elf32-tricore -Wl,--mcpu=tc161 -Wl,--mem-holes -Wl,--extmap="a"", vendor=Hightec, version=Hightec
    resource consumption ResourceConsumption
      7 x memory section:
        CAN_17_MCANP_CODE: alignment=UNSPECIFIED, size=4862, sw-addrmethod=CODE
        CAN_17_MCANP_CONST_8BIT: alignment=8, size=1, sw-addrmethod=CONST
        CAN_17_MCANP_CONST_32BIT: alignment=32, size=4, sw-addrmethod=CONST
        CAN_17_MCANP_VAR_8BIT: alignment=8, size=305, sw-addrmethod=VAR
        CAN_17_MCANP_VAR_16BIT: alignment=16, size=256, sw-addrmethod=VAR
        CAN_17_MCANP_VAR_32BIT: alignment=32, size=260, sw-addrmethod=VAR
        CAN_17_MCANP_POSTBUILDCFG: alignment=UNSPECIFIED, size=484, sw-addrmethod=CONFIG_DATA
      section name prefix CAN_17_MCANP
package /AUTOSAR_Can/ImplementationDataTypes
  5 x impl type, all with type-emitter=BSW:
    Can_ReturnType: compu {0=CAN_OK, 0=CAN_NOT_OK, 0=CAN_BUSY}, implementation-data-type=uint32
    Can_17_MCanP_ConfigType: category=STRUCTURE
      element Can_NPCRValueType
    Can_StateTransitionType: compu {0=CAN_T_START, 0=CAN_T_STOP, 0=CAN_T_SLEEP, 0=CAN_T_WAKEUP}, implementation-data-type=uint32
    Can_HwHandleType: implementation-data-type=uint8
    Can_PduType: category=STRUCTURE
      element PduIdType
