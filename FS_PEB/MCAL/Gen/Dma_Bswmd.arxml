AUTOSAR XML (schema 4-0-3)
# Copyright (C) Infineon Technologies (2015)
# All rights reserved.
package /AURIX_Dma/BswModuleDescriptions
  bsw module description Dma: category=BSW_MODULE, module-id=255  # Direct Memory Access
    provided-entrys:
      Dma_Init
      Dma_StartSwTransaction
      Dma_StartHwTransaction
      Dma_DisableHwTransaction
      Dma_GetChannelStatus
      Dma_GetMoveEngineErrFlags
      Dma_ClearMoveEngineErrFlags
      Dma_ClearInterruptStatus
      Dma_GetTransferCount
      Dma_ConfigHaltChannel
      Dma_ConfigChannelInterrupt
      Dma_GiveSwTrigger
      Dma_GetCRC
      Dma_ConfigShadowAddress
      Dma_ReconfigureChannel
    bsw module dependency DetDependency: target-module-id=15, required-entrys=Det_ReportError
    bsw internal behavior DmaBehavior
      constant-memorys:
        parameter data prototype Dma_kConfigPtr: category=DATA_REFERENCE, sw-pointer-target-props={target-category=TYPE_REFERENCE, implementation-data-type=Dma_ConfigType}, type=Dma_ConfigType
      static-memorys:
        data Dma_DriverState: implementation-data-type=uint8, type=uint8
        data Dma_ChannelState: implementation-data-type=uint8, type=uint8
      15 x bsw called entity:
        Dma_Init: implemented-entry=Dma_Init
        Dma_StartSwTransaction: implemented-entry=Dma_StartSwTransaction
        Dma_StartHwTransaction: implemented-entry=Dma_StartHwTransaction
        Dma_DisableHwTransaction: implemented-entry=Dma_DisableHwTransaction
        Dma_GetChannelStatus: implemented-entry=Dma_GetChannelStatus
        Dma_GetMoveEngineErrFlags: implemented-entry=Dma_GetMoveEngineErrFlags
        Dma_ClearMoveEngineErrFlags: implemented-entry=Dma_ClearMoveEngineErrFlags
        Dma_ClearInterruptStatus: implemented-entry=Dma_ClearInterruptStatus
        Dma_GetTransferCount: implemented-entry=Dma_GetTransferCount
        Dma_ConfigHaltChannel: implemented-entry=Dma_ConfigHaltChannel
        Dma_ConfigChannelInterrupt: implemented-entry=Dma_ConfigChannelInterrupt
        Dma_GiveSwTrigger: implemented-entry=Dma_GiveSwTrigger
        Dma_GetCRC: implemented-entry=Dma_GetCRC
        Dma_ConfigShadowAddress: implemented-entry=Dma_ConfigShadowAddress
        Dma_ReconfigureChannel: implemented-entry=Dma_ReconfigureChannel
package /AURIX_Dma/BswModuleEntrys
  15 x bsw module entry, all with is-synchronous=true, call-type=REGULAR, execution-context=TASK, sw-service-impl-policy=STANDARD:
    Dma_Init: service-id=0, is-reentrant=false
      sw service arg ConfigPtr: category=DATA_REFERENCE, sw-pointer-target-props={target-category=TYPE_REFERENCE, implementation-data-type=Dma_ConfigType}
    Dma_StartSwTransaction: service-id=2, is-reentrant=true
      return type Return: implementation-data-type=Std_ReturnType
      4 x sw service arg:
        Channel: implementation-data-type=Dma_ChType
        SrcAddress: category=DATA_REFERENCE, sw-pointer-target-props={target-category=TYPE_REFERENCE, implementation-data-type=uint32}
        DestAddress: category=DATA_REFERENCE, sw-pointer-target-props={target-category=TYPE_REFERENCE, implementation-data-type=uint32}
        TCount: implementation-data-type=uint16
    Dma_StartHwTransaction: service-id=3, is-reentrant=true
      return type Return: implementation-data-type=Std_ReturnType
      4 x sw service arg:
        Channel: implementation-data-type=Dma_ChType
        SrcAddress: category=DATA_REFERENCE, sw-pointer-target-props={target-category=TYPE_REFERENCE, implementation-data-type=uint32}
        DestAddress: category=DATA_REFERENCE, sw-pointer-target-props={target-category=TYPE_REFERENCE, implementation-data-type=uint32}
        TCount: implementation-data-type=uint16
    Dma_DisableHwTransaction: service-id=4, is-reentrant=true
      return type Return: implementation-data-type=Std_ReturnType
      sw service arg Channel: implementation-data-type=Dma_ChType
    Dma_GetChannelStatus: service-id=5, is-reentrant=true
      return type Return: implementation-data-type=Dma_ChannelStatusType
      sw service arg Channel: implementation-data-type=Dma_ChType
    Dma_GetMoveEngineErrFlags: service-id=6, is-reentrant=true
      return type Return: implementation-data-type=Dma_ErrorType
      sw service arg MoveEngine: implementation-data-type=uint8
    Dma_ClearMoveEngineErrFlags: service-id=7, is-reentrant=true
      return type Return: implementation-data-type=Std_ReturnType
      sw service arg MoveEngine: implementation-data-type=uint8
      sw service arg ClrErrMask: implementation-data-type=uint32
    Dma_ClearInterruptStatus: service-id=8, is-reentrant=true
      return type Return: implementation-data-type=Std_ReturnType
      sw service arg Channel: implementation-data-type=Dma_ChType
    Dma_GetTransferCount: service-id=9, is-reentrant=true
      return type Return: implementation-data-type=uint16
      sw service arg Channel: implementation-data-type=Dma_ChType
    Dma_ConfigHaltChannel: service-id=10, is-reentrant=true
      return type Return: implementation-data-type=Std_ReturnType
      sw service arg Channel: implementation-data-type=Dma_ChType
      sw service arg HaltMode: implementation-data-type=Dma_ChannelHaltType
    Dma_ConfigChannelInterrupt: service-id=11, is-reentrant=true
      return type Return: implementation-data-type=Std_ReturnType
      sw service arg Channel: implementation-data-type=Dma_ChType
      sw service arg InterruptMode: implementation-data-type=Dma_InterruptModeType
    Dma_GiveSwTrigger: service-id=14, is-reentrant=true
      return type Return: implementation-data-type=Std_ReturnType
      sw service arg Channel: implementation-data-type=Dma_ChType
    Dma_GetCRC: service-id=15, is-reentrant=true
      return type Return: implementation-data-type=Dma_CrcSetType
      sw service arg Channel: implementation-data-type=Dma_ChType
    Dma_ConfigShadowAddress: service-id=17, is-reentrant=true
      return type Return: implementation-data-type=Std_ReturnType
      sw service arg Channel: implementation-data-type=Dma_ChType
      sw service arg ShadowAddrPtr: category=DATA_REFERENCE, sw-pointer-target-props={target-category=TYPE_REFERENCE, implementation-data-type=uint32}
    Dma_ReconfigureChannel: service-id=18, is-reentrant=true
      return type Return: implementation-data-type=Std_ReturnType
      sw service arg Channel: implementation-data-type=Dma_ChType
      sw service arg ChAddrConfigPtr: category=DATA_REFERENCE, sw-pointer-target-props={target-category=TYPE_REFERENCE, implementation-data-type=Dma_ChannelAddressConfigType}
package /AURIX_Dma/Implementations
  bsw implementation Dma: programming-language=C, sw-version=0.0.0, vendor-id=17, ar-release-version=4.0.3, behavior=DmaBehavior, vendor-specific-module-def=Dma
    code-descriptors:
      code Files
        artifact-descriptors:
          short-label=ssc::src::Dma.c, category=SWSRC
          short-label=ssc::inc::Dma.h, category=SWHDR
          short-label=ssc::inc::Dma_Dbg.h, category=SWHDR
          short-label=mak::dma_infineon_tricore::ssc::mak::infineon_dma_cfg.mak, category=SWMAKE
          short-label=mak::dma_infineon_tricore::ssc::mak::infineon_dma_check.mak, category=SWMAKE
          short-label=mak::dma_infineon_tricore::ssc::mak::infineon_dma_defs.mak, category=SWMAKE
          short-label=mak::dma_infineon_tricore::ssc::mak::infineon_dma_rules.mak, category=SWMAKE
    compiler TASKING_COMPILE: name=TASKING, options="-c --core=tc1.6.x -t -Wa-gAHLs --emit-locals=-equ,-symbols -Wa-Ogs -Wa--error-limit=42 --iso=90 --eabi-compliant --integer-enumeration --language=-comments,-gcc,+volatile,-strings --switch=auto --align=0 --default-near-size=0 --default-a0-size=0 --default-a1-size=0 -O2ROPYG --tradeoff=4 -g --source -D_TASKING_C_TRICORE_=1 $(CALLFUNCTION)", vendor=Tasking, version=Tasking
    compiler DIAB_COMPILE: name=DIAB, options="-c -tTC27xAstep16PMG:cross -Xdialect-c89 -Xno-common -Xalign-functions=4 -Xfp-fast -Xsection-split=1 -Xkeep-assembly-file=2 -g3 -ew4084 -ei4177,4550,4549,4068,5388 -XO -D_DIABDATA_C_TRICORE_=1 $(CALLFUNCTION)", vendor=WindRiver, version=WindRiver
    compiler GNU_COMPILE:
      name=GNU
      options="-c -save-temps=obj -std=iso9899:1990 -ansi -fno-asm -ffreestanding -Wundef -Wp,-std=iso9899:1990 -fno-short-enums -fpeel-loops -falign-functions=4 -frecord-gcc-switches -fsection-anchors -funsigned-bitfields -ffunction-sections -fno-ivopts -fno-peephole2 -nostartfiles -O3 -g3 -W -Wall -Wuninitialized -DTRIBOARD_TC27XX -mcpu=tc27xx -D_GNU_C_TRICORE_=1 $(CALLFUNCTION)"
      vendor=Hightec
      version=Hightec
    generated-artifacts:
      4 x dependency on artifact, all with usages=CODEGENERATION:
        Dma_PBCfg_c: artifact-descriptor={short-label=generate::src::Dma_PBCfg.c, category=SWSRC}
        Dma_Cfg_h: artifact-descriptor={short-label=generate::inc::Dma_Cfg.h, category=SWHDR}
        Dma_xdm: artifact-descriptor={short-label=config::Dma.xdm, category=SWTOOL}
        Dma_bmd: artifact-descriptor={short-label=autosar::Dma.bmd, category=SWTOOL}
    linker TASKING_LINK: name=TASKING, options="-t -d_mcal_pjt.lsl -D__CPU__=tc27x -Cmpe:vtc -Otxycl --error-limit=42 -M -mcrfiklsmnoduq -lc -lfp -lrt", vendor=Tasking, version=Tasking
    linker DIAB_LINK: name=DIAB, options="-m6 "_mcal_pjt.dld" -lc", vendor=WindRiver, version=WindRiver
    linker GNU_LINK: name=GNU, options="-T"_mcal_pjt.ld" -nostartfiles -Wl,--allow-multiple-definition -Wl,--cref -Wl,--oformat=elf32-tricore -Wl,--mcpu=tc161 -Wl,--mem-holes -Wl,--extmap="a"", vendor=Hightec, version=Hightec
    resource consumption ResourceConsumption
      5 x memory section:
        DMA_CONST_32BIT: alignment=32, size=4, sw-addrmethod=CONST
        DMA_VAR_32BIT: alignment=32, size=4, sw-addrmethod=VAR
        DMA_VAR_8BIT: alignment=8, size=2, sw-addrmethod=VAR
        DMA_POSTBUILDCFG: alignment=UNSPECIFIED, size=144, sw-addrmethod=CONFIG_DATA
        DMA_CODE: alignment=32, size=2278, sw-addrmethod=CODE
      section name prefix DMA
package /AURIX_Dma/ImplementationDataTypes
  11 x impl type, all with type-emitter=BSW:
    Dma_ChType: compu {0=DMA_CH0, 0=DMA_CH1, 0=DMA_CH2, 0=DMA_CH3, 0=DMA_CH4, 0=DMA_CH5, 0=DMA_CH6, 0=DMA_CH7, 0=DMA_CH8, 0=DMA_CH9, 0=DMA_CH10, 0=DMA_CH11, 0=DMA_CH12, 0=DMA_CH13, 0=DMA_CH14, 0=DMA_CH15, 0=DMA_CH16, 0=DMA_CH17, 0=DMA_CH18, 0=DMA_CH19, 0=DMA_CH20, 0=DMA_CH21, 0=DMA_CH22, 0=DMA_CH23, 0=DMA_CH24, 0=DMA_CH25, 0=DMA_CH26, 0=DMA_CH27, 0=DMA_CH28, 0=DMA_CH29, 0=DMA_CH30, 0=DMA_CH31, 0=DMA_CH32, 0=DMA_CH33, 0=DMA_CH34, 0=DMA_CH35, 0=DMA_CH36, 0=DMA_CH37, 0=DMA_CH38, 0=DMA_CH39, 0=DMA_CH40, 0=DMA_CH41, 0=DMA_CH42, 0=DMA_CH43, 0=DMA_CH44, 0=DMA_CH45, 0=DMA_CH46, 0=DMA_CH47, 0=DMA_CH48, 0=DMA_CH49, 0=DMA_CH50, 0=DMA_CH51, 0=DMA_CH52, 0=DMA_CH53, 0=DMA_CH54, 0=DMA_CH55, 0=DMA_CH56, 0=DMA_CH57, 0=DMA_CH58, 0=DMA_CH59, 0=DMA_CH60, 0=DMA_CH61, 0=DMA_CH62, 0=DMA_CH63, 0=DMA_CH64, 0=DMA_CH65, 0=DMA_CH66, 0=DMA_CH67, 0=DMA_CH68, 0=DMA_CH69, 0=DMA_CH70, 0=DMA_CH71, 0=DMA_CH72, 0=DMA_CH73, 0=DMA_CH74, 0=DMA_CH75, 0=DMA_CH76, 0=DMA_CH77, 0=DMA_CH78, 0=DMA_CH79, 0=DMA_CH80, 0=DMA_CH81, 0=DMA_CH82, 0=DMA_CH83, 0=DMA_CH84, 0=DMA_CH85, 0=DMA_CH86, 0=DMA_CH87, 0=DMA_CH88, 0=DMA_CH89, 0=DMA_CH90, 0=DMA_CH91, 0=DMA_CH92, 0=DMA_CH93, 0=DMA_CH94, 0=DMA_CH95, 0=DMA_CH96, 0=DMA_CH97, 0=DMA_CH98, 0=DMA_CH99, 0=DMA_CH100, 0=DMA_CH101, 0=DMA_CH102, 0=DMA_CH103, 0=DMA_CH104, 0=DMA_CH105, 0=DMA_CH106, 0=DMA_CH107, 0=DMA_CH108, 0=DMA_CH109, 0=DMA_CH110, 0=DMA_CH111, 0=DMA_CH112, 0=DMA_CH113, 0=DMA_CH114, 0=DMA_CH115, 0=DMA_CH116, 0=DMA_CH117, 0=DMA_CH118, 0=DMA_CH119, 0=DMA_CH120, 0=DMA_CH121, 0=DMA_CH122, 0=DMA_CH123, 0=DMA_CH124, 0=DMA_CH125, 0=DMA_CH126, 0=DMA_CH127, 0=DMA_CH_INVALID}, implementation-data-type=uint32
    Dma_ChannelStatusType: category=STRUCTURE
      element uint32
    Dma_ErrorType: category=STRUCTURE
      element uint32
    Dma_ChannelHaltType: compu {0=DMA_HALT_OFF, 0=DMA_HALT_ON}, implementation-data-type=uint32
    Dma_InterruptModeType: compu {0=DMA_CH_INT_OFF, 0=DMA_CH_INT_ON}, implementation-data-type=uint32
    Dma_CrcSetType: category=STRUCTURE
      element uint32
    Dma_TransactionSetType: category=STRUCTURE
      element uint32
    Dma_FullTxCtrlSetType: category=STRUCTURE
      element uint32
    Dma_ChannelConfigType: category=STRUCTURE
      element uint32
    Dma_ConfigType: category=STRUCTURE
      element Dma_ChannelConfigType
    Dma_ChannelAddressConfigType: category=STRUCTURE
      element Dma_ChIncrementDirectionType
