ASAP2_VERSION 1 60
/begin PROJECT ETAS_AUTOSAR "XCP on CAN"
/begin HEADER "" VERSION "1.0.0.0" PROJECT_NO ETAS_AUTOSAR /end HEADER
/begin MODULE ETAS_AUTOSAR ""
/begin MOD_COMMON "" DEPOSIT ABSOLUTE BYTE_ORDER MSB_LAST /end MOD_COMMON
/begin COMPU_METHOD BSW_A2L_Ident_Float "Q = V" RAT_FUNC "%8.6" "" COEFFS 0 1 0 0 0 1 /end COMPU_METHOD
/begin COMPU_METHOD BSW_A2L_Ident_Int "Q = V" RAT_FUNC "%8.0" "" COEFFS 0 1 0 0 0 1 /end COMPU_METHOD
/begin COMPU_METHOD SWC_MCF_CM_single "Q = V" RAT_FUNC "%8.6" "" COEFFS 0 1 0 0 0 1 /end COMPU_METHOD
/begin COMPU_METHOD SWC_MCF_CM_boolean "Q = V" RAT_FUNC "%1.0" "" COEFFS 0 1 0 0 0 1 /end COMPU_METHOD
/begin COMPU_METHOD SWC_MDF_CM_single "Q = V" RAT_FUNC "%8.6" "" COEFFS 0 1 0 0 0 1 /end COMPU_METHOD
/begin COMPU_METHOD SWC_MDF_CM_boolean "Q = V" RAT_FUNC "%1.0" "" COEFFS 0 1 0 0 0 1 /end COMPU_METHOD
/begin COMPU_METHOD SWC_MDF_CM_uint8 "Q = V" RAT_FUNC "%3.0" "" COEFFS 0 1 0 0 0 1 /end COMPU_METHOD
/begin COMPU_METHOD SWC_MPC_CM_single "Q = V" RAT_FUNC "%8.6" "" COEFFS 0 1 0 0 0 1 /end COMPU_METHOD
/begin COMPU_METHOD SWC_PCF_CM_single "Q = V" RAT_FUNC "%8.6" "" COEFFS 0 1 0 0 0 1 /end COMPU_METHOD
/begin COMPU_METHOD SWC_PCF_CM_uint16 "Q = V" RAT_FUNC "%5.0" "" COEFFS 0 1 0 0 0 1 /end COMPU_METHOD
/begin COMPU_METHOD SWC_PCF_CM_boolean "Q = V" RAT_FUNC "%1.0" "" COEFFS 0 1 0 0 0 1 /end COMPU_METHOD
/begin COMPU_METHOD SWC_PCF_CM_uint8 "Q = V" RAT_FUNC "%3.0" "" COEFFS 0 1 0 0 0 1 /end COMPU_METHOD
/begin COMPU_METHOD SWC_RCF_CM_single "Q = V" RAT_FUNC "%8.6" "" COEFFS 0 1 0 0 0 1 /end COMPU_METHOD
/begin COMPU_METHOD SWC_RCF_CM_boolean "Q = V" RAT_FUNC "%1.0" "" COEFFS 0 1 0 0 0 1 /end COMPU_METHOD
/begin COMPU_METHOD SWC_RCF_CM_uint8 "Q = V" RAT_FUNC "%3.0" "" COEFFS 0 1 0 0 0 1 /end COMPU_METHOD
/begin COMPU_METHOD SWC_SCF_CM_single "Q = V" RAT_FUNC "%8.6" "" COEFFS 0 1 0 0 0 1 /end COMPU_METHOD
/begin COMPU_METHOD SWC_SCF_CM_boolean "Q = V" RAT_FUNC "%1.0" "" COEFFS 0 1 0 0 0 1 /end COMPU_METHOD
/begin COMPU_METHOD SWC_SCF_CM_uint8 "Q = V" RAT_FUNC "%3.0" "" COEFFS 0 1 0 0 0 1 /end COMPU_METHOD
/begin COMPU_METHOD SWC_SWD_CM_uint16 "Q = V" RAT_FUNC "%5.0" "" COEFFS 0 1 0 0 0 1 /end COMPU_METHOD
/begin COMPU_METHOD SWC_SWD_CM_uint32 "Q = V" RAT_FUNC "%10.0" "" COEFFS 0 1 0 0 0 1 /end COMPU_METHOD
/begin COMPU_METHOD SWC_SWD_CM_uint8 "Q = V" RAT_FUNC "%3.0" "" COEFFS 0 1 0 0 0 1 /end COMPU_METHOD
/begin COMPU_METHOD SWC_TCF_CM_int16 "Q = V" RAT_FUNC "%5.0" "" COEFFS 0 1 0 0 0 1 /end COMPU_METHOD
/begin COMPU_METHOD SWC_TDC_CM_single_m_0 "Q = V" RAT_FUNC "%8.6" "m^0" COEFFS 0 1 0 0 0 1 /end COMPU_METHOD
/begin COMPU_METHOD SWC_TDC_CM_single_nm "Q = V" RAT_FUNC "%8.6" "nm" COEFFS 0 1 0 0 0 1 /end COMPU_METHOD
/begin COMPU_METHOD SWC_TPC_CM_uint16 "Q = V" RAT_FUNC "%5.0" "" COEFFS 0 1 0 0 0 1 /end COMPU_METHOD
/begin COMPU_METHOD SWC_TRSP_CM_int16 "Q = V" RAT_FUNC "%5.0" "" COEFFS 0 1 0 0 0 1 /end COMPU_METHOD
/begin COMPU_METHOD SWC_TRSP_CM_uint8 "Q = V" RAT_FUNC "%3.0" "" COEFFS 0 1 0 0 0 1 /end COMPU_METHOD
/begin COMPU_METHOD SWC_VCF_CM_uint16 "Q = V" RAT_FUNC "%5.0" "" COEFFS 0 1 0 0 0 1 /end COMPU_METHOD
/begin COMPU_METHOD ident "" RAT_FUNC "%8.4" "" COEFFS 0 1 0 0 0 1 /end COMPU_METHOD
/begin COMPU_METHOD stDrvCtl_Verb "" TAB_VERB "%2.1" "-" COMPU_TAB_REF stDrvCtl_List /end COMPU_METHOD
/begin COMPU_VTAB stDrvCtl_List "" TAB_VERB 20 0 "Drv_Initial" 1 "Drv_MocSop" 2 "Drv_SensCalFW" 3 "Drv_Standby" 4 "Drv_Run" 5 "Drv_OffsetAcc" 6 "Drv_OffsetFw" 7 "Drv_Discharge" 8 "Drv_Failure" 9 "Drv_TrqCtl" 10 "Drv_nCtlExt" 11 "Drv_inActive" 12 "Drv_nCtlInt" 13 "Drv_IsCtl" 14 "Drv_UdcCtl" 15 "Drv_UdcBatCtl" 16 "Drv_FrWCtl" 17 "Drv_IdLe" 18 "Drv_TestBench" 19 "Drv_OffsetCal" DEFAULT_VALUE "---" /end COMPU_VTAB
/begin RECORD_LAYOUT Scalar_BOOLEAN FNC_VALUES 1 UBYTE COLUMN_DIR DIRECT /end RECORD_LAYOUT
/begin RECORD_LAYOUT Scalar_UBYTE FNC_VALUES 1 UBYTE COLUMN_DIR DIRECT /end RECORD_LAYOUT
/begin RECORD_LAYOUT Scalar_UWORD FNC_VALUES 1 UWORD COLUMN_DIR DIRECT /end RECORD_LAYOUT
/begin RECORD_LAYOUT Scalar_ULONG FNC_VALUES 1 ULONG COLUMN_DIR DIRECT /end RECORD_LAYOUT
/begin RECORD_LAYOUT Scalar_FLOAT32_IEEE FNC_VALUES 1 FLOAT32_IEEE COLUMN_DIR DIRECT /end RECORD_LAYOUT
/begin RECORD_LAYOUT Lookup1D_FLOAT32_IEEE FNC_VALUES 1 FLOAT32_IEEE COLUMN_DIR DIRECT /end RECORD_LAYOUT
/begin RECORD_LAYOUT Lookup1D_X_FLOAT32_IEEE AXIS_PTS_X 1 FLOAT32_IEEE INDEX_INCR DIRECT /end RECORD_LAYOUT
/begin RECORD_LAYOUT Lookup2D_FLOAT32_IEEE FNC_VALUES 1 FLOAT32_IEEE COLUMN_DIR DIRECT /end RECORD_LAYOUT
/begin RECORD_LAYOUT Lookup2D_X_FLOAT32_IEEE AXIS_PTS_X 1 FLOAT32_IEEE INDEX_INCR DIRECT /end RECORD_LAYOUT
/begin CHARACTERISTIC CAL_MPC_IsCutOffFrq_f32 "CAL_MPC_IsCutOffFrq_f32" VALUE 0x801430B8 Scalar_FLOAT32_IEEE 0 BSW_A2L_Ident_Float -3.4E+38 3.4E+38 /end CHARACTERISTIC
/begin CHARACTERISTIC CAL_PcfCtl_flgManual_b "CAL_PcfCtl_flgManual_b" VALUE 0x80143370 Scalar_BOOLEAN 0 BSW_A2L_Ident_Int 0 1 /end CHARACTERISTIC
/begin CHARACTERISTIC CAL_RCF_nCalcSec4_f32 "CAL_RCF_nCalcSec4_f32" VALUE 0x80143408 Scalar_FLOAT32_IEEE 0 BSW_A2L_Ident_Float -3.4E+38 3.4E+38 /end CHARACTERISTIC
/begin CHARACTERISTIC CAL_PcfSig_flgP_b "CAL_PcfSig_flgP_b" VALUE 0x801431CA Scalar_BOOLEAN 0 BSW_A2L_Ident_Int 0 1 /end CHARACTERISTIC
/begin CHARACTERISTIC CAL_RCF_AlRtrOfsDvtMax_f32 "CAL_RCF_AlRtrOfsDvtMax_f32" VALUE 0x80143454 Scalar_FLOAT32_IEEE 0 BSW_A2L_Ident_Float -3.4E+38 3.4E+38 /end CHARACTERISTIC
/begin CHARACTERISTIC CAL_RCF_nOfsClbMaxBwd_f32 "CAL_RCF_nOfsClbMaxBwd_f32" VALUE 0x801433D0 Scalar_FLOAT32_IEEE 0 BSW_A2L_Ident_Float -3.4E+38 3.4E+38 /end CHARACTERISTIC
/begin CHARACTERISTIC CAL_PcfSig_flgstBeltSwt_b "CAL_PcfSig_flgstBeltSwt_b" VALUE 0x801431C5 Scalar_BOOLEAN 0 BSW_A2L_Ident_Int 0 1 /end CHARACTERISTIC
/begin CHARACTERISTIC CAL_RCF_nExtClbFrewhlBwd_f32 "CAL_RCF_nExtClbFrewhlBwd_f32" VALUE 0x801433F0 Scalar_FLOAT32_IEEE 0 BSW_A2L_Ident_Float -3.4E+38 3.4E+38 /end CHARACTERISTIC
/begin CHARACTERISTIC CAL_MPC_flgUseLdq_b "CAL_MPC_flgUseLdq_b" VALUE 0x80142111 Scalar_BOOLEAN 0 BSW_A2L_Ident_Int 0 1 /end CHARACTERISTIC
/begin CHARACTERISTIC CAL_PcfDia_flgLockedlSwt_b "CAL_PcfDia_flgLockedlSwt_b" VALUE 0x801432EA Scalar_BOOLEAN 0 BSW_A2L_Ident_Int 0 1 /end CHARACTERISTIC
/begin CHARACTERISTIC CAL_MDF_nAbsThreshCirNoPsbl_f32 "CAL_MDF_nAbsThreshCirNoPsbl_f32" VALUE 0x801414D8 Scalar_FLOAT32_IEEE 0 BSW_A2L_Ident_Float -3.4E+38 3.4E+38 /end CHARACTERISTIC
/begin CHARACTERISTIC CAL_RCF_nOfsClbMaxFwd_f32 "CAL_RCF_nOfsClbMaxFwd_f32" VALUE 0x801433CC Scalar_FLOAT32_IEEE 0 BSW_A2L_Ident_Float -3.4E+38 3.4E+38 /end CHARACTERISTIC
/begin CHARACTERISTIC CAL_PcfStm_SLRetryTimesLimt_u8 "CAL_PcfStm_SLRetryTimesLimt_u8" VALUE 0x801430CB Scalar_UBYTE 0 BSW_A2L_Ident_Int 0 255 /end CHARACTERISTIC
/begin CHARACTERISTIC CAL_RCF_nOfsClbMinBwd_f32 "CAL_RCF_nOfsClbMinBwd_f32" VALUE 0x801433C8 Scalar_FLOAT32_IEEE 0 BSW_A2L_Ident_Float -3.4E+38 3.4E+38 /end CHARACTERISTIC
/begin CHARACTERISTIC CAL_RCF_UsBetaScalSet_f32 "CAL_RCF_UsBetaScalSet_f32" VALUE 0x8014343C Scalar_FLOAT32_IEEE 0 BSW_A2L_Ident_Float -3.4E+38 3.4E+38 /end CHARACTERISTIC
/begin CHARACTERISTIC CAL_PcfSig_flgTestPSwt_b "CAL_PcfSig_flgTestPSwt_b" VALUE 0x801431C7 Scalar_BOOLEAN 0 BSW_A2L_Ident_Int 0 1 /end CHARACTERISTIC
/begin CHARACTERISTIC CAL_Scf_curSenChgToDrv_f32 "CAL_Scf_curSenChgToDrv_f32" VALUE 0x801434C8 Scalar_FLOAT32_IEEE 0 BSW_A2L_Ident_Float -3.4E+38 3.4E+38 /end CHARACTERISTIC
/begin CHARACTERISTIC CAL_Scf_UdcLnkAbsDiffLim_f32 "CAL_Scf_UdcLnkAbsDiffLim_f32" VALUE 0x801434D8 Scalar_FLOAT32_IEEE 0 BSW_A2L_Ident_Float -3.4E+38 3.4E+38 /end CHARACTERISTIC
/begin CHARACTERISTIC CAL_RCF_TrqDesAcc_f32 "CAL_RCF_TrqDesAcc_f32" VALUE 0x80143444 Scalar_FLOAT32_IEEE 0 BSW_A2L_Ident_Float -3.4E+38 3.4E+38 /end CHARACTERISTIC
/begin CHARACTERISTIC CAL_PcfSig_nMotFltCoe_f32 "CAL_PcfSig_nMotFltCoe_f32" VALUE 0x801431B8 Scalar_FLOAT32_IEEE 0 BSW_A2L_Ident_Float -3.4E+38 3.4E+38 /end CHARACTERISTIC
/begin CHARACTERISTIC CAL_PcfCtl_ManualEn_b "CAL_PcfCtl_ManualEn_b" VALUE 0x80143394 Scalar_BOOLEAN 0 BSW_A2L_Ident_Int 0 1 /end CHARACTERISTIC
/begin CHARACTERISTIC CAL_PcfSig_GernMot_f32 "CAL_PcfSig_GernMot_f32" VALUE 0x801432BC Scalar_FLOAT32_IEEE 0 BSW_A2L_Ident_Float -3.4E+38 3.4E+38 /end CHARACTERISTIC
/begin CHARACTERISTIC CAL_MPC_Rcmp_f32 "CAL_MPC_Rcmp_f32" VALUE 0x801421B8 Scalar_FLOAT32_IEEE 0 BSW_A2L_Ident_Float -3.4E+38 3.4E+38 /end CHARACTERISTIC
/begin CHARACTERISTIC CAL_PcfStm_flgUseBlindCtl_b "CAL_PcfStm_flgUseBlindCtl_b" VALUE 0x801430C3 Scalar_BOOLEAN 0 BSW_A2L_Ident_Int 0 1 /end CHARACTERISTIC
/begin CHARACTERISTIC CAL_Scf_nSafeTestMaxLim_f32 "CAL_Scf_nSafeTestMaxLim_f32" VALUE 0x8014348C Scalar_FLOAT32_IEEE 0 BSW_A2L_Ident_Float -3.4E+38 3.4E+38 /end CHARACTERISTIC
/begin CHARACTERISTIC CAL_RCF_flgReAutoClbSuc_b "CAL_RCF_flgReAutoClbSuc_b" VALUE 0x8014341D Scalar_BOOLEAN 0 BSW_A2L_Ident_Int 0 1 /end CHARACTERISTIC
/begin CHARACTERISTIC CAL_PcfDia_flgBCLockedSwt_b "CAL_PcfDia_flgBCLockedSwt_b" VALUE 0x801432EF Scalar_BOOLEAN 0 BSW_A2L_Ident_Int 0 1 /end CHARACTERISTIC
/begin CHARACTERISTIC CAL_MDF_3PhaUnbalance_f32 "CAL_MDF_3PhaUnbalance_f32" VALUE 0x801416C4 Scalar_FLOAT32_IEEE 0 BSW_A2L_Ident_Float -3.4E+38 3.4E+38 /end CHARACTERISTIC
/begin CHARACTERISTIC CAL_MDF_tiOffsetSteady_f32 "CAL_MDF_tiOffsetSteady_f32" VALUE 0x801414A4 Scalar_FLOAT32_IEEE 0 BSW_A2L_Ident_Float -3.4E+38 3.4E+38 /end CHARACTERISTIC
/begin CHARACTERISTIC CAL_RCF_tMaxEstAlOfs_u32 "CAL_RCF_tMaxEstAlOfs_u32" VALUE 0x801433B4 Scalar_ULONG 0 BSW_A2L_Ident_Int 0 4294967295 /end CHARACTERISTIC
/begin CHARACTERISTIC CAL_Scf_uDisChgOutTim_f32 "CAL_Scf_uDisChgOutTim_f32" VALUE 0x80143474 Scalar_FLOAT32_IEEE 0 BSW_A2L_Ident_Float -3.4E+38 3.4E+38 /end CHARACTERISTIC
/begin CHARACTERISTIC CAL_MDF_FwWoIs_f32 "CAL_MDF_FwWoIs_f32" VALUE 0x801416B4 Scalar_FLOAT32_IEEE 0 BSW_A2L_Ident_Float -3.4E+38 3.4E+38 /end CHARACTERISTIC
/begin CHARACTERISTIC CAL_PcfSig_flgBrakeSwt_b "CAL_PcfSig_flgBrakeSwt_b" VALUE 0x801431D2 Scalar_BOOLEAN 0 BSW_A2L_Ident_Int 0 1 /end CHARACTERISTIC
/begin CHARACTERISTIC CAL_Scf_nPsmThresToDrv_f32 "CAL_Scf_nPsmThresToDrv_f32" VALUE 0x801434A8 Scalar_FLOAT32_IEEE 0 BSW_A2L_Ident_Float -3.4E+38 3.4E+38 /end CHARACTERISTIC
/begin CHARACTERISTIC CAL_Scf_nPsmThresToPostDrv_f32 "CAL_Scf_nPsmThresToPostDrv_f32" VALUE 0x801434A4 Scalar_FLOAT32_IEEE 0 BSW_A2L_Ident_Float -3.4E+38 3.4E+38 /end CHARACTERISTIC
/begin CHARACTERISTIC CAL_PowerMotHeat_f32 "CAL_PowerMotHeat_f32" VALUE 0x80140F14 Scalar_FLOAT32_IEEE 0 BSW_A2L_Ident_Float -3.4E+38 3.4E+38 /end CHARACTERISTIC
/begin CHARACTERISTIC CAL_PcfSig_deltaAimInP_f32 "CAL_PcfSig_deltaAimInP_f32" VALUE 0x801431E0 Scalar_FLOAT32_IEEE 0 BSW_A2L_Ident_Float -3.4E+38 3.4E+38 /end CHARACTERISTIC
/begin CHARACTERISTIC CAL_RCF_WithoutStatorCurrent_u8 "CAL_RCF_WithoutStatorCurrent_u8" VALUE 0x80143438 Scalar_UBYTE 0 BSW_A2L_Ident_Int 0 255 /end CHARACTERISTIC
/begin CHARACTERISTIC CAL_RCF_cntMovAveFilBwd_u16 "CAL_RCF_cntMovAveFilBwd_u16" VALUE 0x8014342A Scalar_UWORD 0 BSW_A2L_Ident_Int 0 65535 /end CHARACTERISTIC
/begin CHARACTERISTIC CAL_PcfCtl_PosKi_f32 "CAL_PcfCtl_PosKi_f32" VALUE 0x8014338C Scalar_FLOAT32_IEEE 0 BSW_A2L_Ident_Float -3.4E+38 3.4E+38 /end CHARACTERISTIC
/begin CHARACTERISTIC CAL_Scf_IntDchaSwt_b "CAL_Scf_IntDchaSwt_b" VALUE 0x801434E3 Scalar_BOOLEAN 0 BSW_A2L_Ident_Int 0 1 /end CHARACTERISTIC
/begin CHARACTERISTIC CAL_PcfSig_stDoor_u8 "CAL_PcfSig_stDoor_u8" VALUE 0x801431B4 Scalar_UBYTE 0 BSW_A2L_Ident_Int 0 255 /end CHARACTERISTIC
/begin CHARACTERISTIC CAL_Scf_ShtDwnReqByVcuSwt_b "CAL_Scf_ShtDwnReqByVcuSwt_b" VALUE 0x801434DE Scalar_BOOLEAN 0 BSW_A2L_Ident_Int 0 1 /end CHARACTERISTIC
/begin CHARACTERISTIC CAL_MCF_KpMotHeat_f32 "CAL_MCF_KpMotHeat_f32" VALUE 0x80141138 Scalar_FLOAT32_IEEE 0 BSW_A2L_Ident_Float -3.4E+38 3.4E+38 /end CHARACTERISTIC
/begin CHARACTERISTIC CAL_PcfDia_flgFaultSwt_b "CAL_PcfDia_flgFaultSwt_b" VALUE 0x801432ED Scalar_BOOLEAN 0 BSW_A2L_Ident_Int 0 1 /end CHARACTERISTIC
/begin CHARACTERISTIC CAL_Scf_nSubPsmSpdVal_f32 "CAL_Scf_nSubPsmSpdVal_f32" VALUE 0x80143480 Scalar_FLOAT32_IEEE 0 BSW_A2L_Ident_Float -3.4E+38 3.4E+38 /end CHARACTERISTIC
/begin CHARACTERISTIC CAL_PcfDia_tMosHighSet_f32 "CAL_PcfDia_tMosHighSet_f32" VALUE 0x801432D0 Scalar_FLOAT32_IEEE 0 BSW_A2L_Ident_Float -3.4E+38 3.4E+38 /end CHARACTERISTIC
/begin CHARACTERISTIC CAL_MDF_nDidMin_f32 "CAL_MDF_nDidMin_f32" VALUE 0x801414D0 Scalar_FLOAT32_IEEE 0 BSW_A2L_Ident_Float -3.4E+38 3.4E+38 /end CHARACTERISTIC
/begin CHARACTERISTIC CAL_RCF_nCalcSec8_f32 "CAL_RCF_nCalcSec8_f32" VALUE 0x801433F8 Scalar_FLOAT32_IEEE 0 BSW_A2L_Ident_Float -3.4E+38 3.4E+38 /end CHARACTERISTIC
/begin CHARACTERISTIC CAL_PcfCtl_ManualDty_f32 "CAL_PcfCtl_ManualDty_f32" VALUE 0x80143398 Scalar_FLOAT32_IEEE 0 BSW_A2L_Ident_Float -3.4E+38 3.4E+38 /end CHARACTERISTIC
/begin CHARACTERISTIC CAL_MDF_tiAlfOfsNoPlauseFault_f32 "CAL_MDF_tiAlfOfsNoPlauseFault_f32" VALUE 0x801414AC Scalar_FLOAT32_IEEE 0 BSW_A2L_Ident_Float -3.4E+38 3.4E+38 /end CHARACTERISTIC
/begin CHARACTERISTIC CAL_MCF_SpdOffActiveHeat_f32 "CAL_MCF_SpdOffActiveHeat_f32" VALUE 0x801410AC Scalar_FLOAT32_IEEE 0 BSW_A2L_Ident_Float -3.4E+38 3.4E+38 /end CHARACTERISTIC
/begin CHARACTERISTIC CAL_RCF_agReferenceBwd_f32 "CAL_RCF_agReferenceBwd_f32" VALUE 0x80143434 Scalar_FLOAT32_IEEE 0 BSW_A2L_Ident_Float -3.4E+38 3.4E+38 /end CHARACTERISTIC
/begin CHARACTERISTIC CAL_RCF_UsAlfaScalSet_f32 "CAL_RCF_UsAlfaScalSet_f32" VALUE 0x80143440 Scalar_FLOAT32_IEEE 0 BSW_A2L_Ident_Float -3.4E+38 3.4E+38 /end CHARACTERISTIC
/begin CHARACTERISTIC CAL_MDF_PwrDcLinkEstFlt_f32 "CAL_MDF_PwrDcLinkEstFlt_f32" VALUE 0x80141690 Scalar_FLOAT32_IEEE 0 BSW_A2L_Ident_Float -3.4E+38 3.4E+38 /end CHARACTERISTIC
/begin CHARACTERISTIC CAL_MDF_tiPhaFaultDelay_f32 "CAL_MDF_tiPhaFaultDelay_f32" VALUE 0x801414A0 Scalar_FLOAT32_IEEE 0 BSW_A2L_Ident_Float -3.4E+38 3.4E+38 /end CHARACTERISTIC
/begin CHARACTERISTIC CAL_MPC_Lq_f32 "CAL_MPC_Lq_f32" VALUE 0x801427BC Scalar_FLOAT32_IEEE 0 BSW_A2L_Ident_Float -3.4E+38 3.4E+38 /end CHARACTERISTIC
/begin CHARACTERISTIC CAL_MDF_Pwr3PhaFlt_f32 "CAL_MDF_Pwr3PhaFlt_f32" VALUE 0x80141694 Scalar_FLOAT32_IEEE 0 BSW_A2L_Ident_Float -3.4E+38 3.4E+38 /end CHARACTERISTIC
/begin CHARACTERISTIC CAL_RCF_tUAlfaSet_u32 "CAL_RCF_tUAlfaSet_u32" VALUE 0x801433AC Scalar_ULONG 0 BSW_A2L_Ident_Int 0 4294967295 /end CHARACTERISTIC
/begin CHARACTERISTIC CAL_PcfStm_SLActimeLimt_u16 "CAL_PcfStm_SLActimeLimt_u16" VALUE 0x801430CE Scalar_UWORD 0 BSW_A2L_Ident_Int 0 65535 /end CHARACTERISTIC
/begin CHARACTERISTIC CAL_MDF_nAbsThresOpenCirNoPsbl_f32 "CAL_MDF_nAbsThresOpenCirNoPsbl_f32" VALUE 0x801414E0 Scalar_FLOAT32_IEEE 0 BSW_A2L_Ident_Float -3.4E+38 3.4E+38 /end CHARACTERISTIC
/begin CHARACTERISTIC CAL_MDF_nDidMax_f32 "CAL_MDF_nDidMax_f32" VALUE 0x801414D4 Scalar_FLOAT32_IEEE 0 BSW_A2L_Ident_Float -3.4E+38 3.4E+38 /end CHARACTERISTIC
/begin CHARACTERISTIC CAL_Scf_nAllwPwrDcha_f32 "CAL_Scf_nAllwPwrDcha_f32" VALUE 0x801434AC Scalar_FLOAT32_IEEE 0 BSW_A2L_Ident_Float -3.4E+38 3.4E+38 /end CHARACTERISTIC
/begin CHARACTERISTIC CAL_MDF_IsErrThres_f32 "CAL_MDF_IsErrThres_f32" VALUE 0x801416A8 Scalar_FLOAT32_IEEE 0 BSW_A2L_Ident_Float -3.4E+38 3.4E+38 /end CHARACTERISTIC
/begin CHARACTERISTIC CAL_MDF_IsErrFlt_f32 "CAL_MDF_IsErrFlt_f32" VALUE 0x801416AC Scalar_FLOAT32_IEEE 0 BSW_A2L_Ident_Float -3.4E+38 3.4E+38 /end CHARACTERISTIC
/begin CHARACTERISTIC CAL_Scf_iSubSttrisVal_f32 "CAL_Scf_iSubSttrisVal_f32" VALUE 0x801434B0 Scalar_FLOAT32_IEEE 0 BSW_A2L_Ident_Float -3.4E+38 3.4E+38 /end CHARACTERISTIC
/begin CHARACTERISTIC CAL_PcfDia_SLInPUp_f32 "CAL_PcfDia_SLInPUp_f32" VALUE 0x80143324 Scalar_FLOAT32_IEEE 0 BSW_A2L_Ident_Float -3.4E+38 3.4E+38 /end CHARACTERISTIC
/begin CHARACTERISTIC CAL_PcfCtl_flgFnhSwt_b "CAL_PcfCtl_flgFnhSwt_b" VALUE 0x80143372 Scalar_BOOLEAN 0 BSW_A2L_Ident_Int 0 1 /end CHARACTERISTIC
/begin CHARACTERISTIC CAL_MDF_OfsDeltaAgFltFrq_f32 "CAL_MDF_OfsDeltaAgFltFrq_f32" VALUE 0x80141698 Scalar_FLOAT32_IEEE 0 BSW_A2L_Ident_Float -3.4E+38 3.4E+38 /end CHARACTERISTIC
/begin CHARACTERISTIC CAL_Scf_flgDrvToPostWihDisSwt_b "CAL_Scf_flgDrvToPostWihDisSwt_b" VALUE 0x801434BB Scalar_BOOLEAN 0 BSW_A2L_Ident_Int 0 1 /end CHARACTERISTIC
/begin CHARACTERISTIC CAL_PcfStm_SLAccTrqDes_f32 "CAL_PcfStm_SLAccTrqDes_f32" VALUE 0x801430D4 Scalar_FLOAT32_IEEE 0 BSW_A2L_Ident_Float -3.4E+38 3.4E+38 /end CHARACTERISTIC
/begin CHARACTERISTIC CAL_PcfDia_SLOutPUp_f32 "CAL_PcfDia_SLOutPUp_f32" VALUE 0x80143318 Scalar_FLOAT32_IEEE 0 BSW_A2L_Ident_Float -3.4E+38 3.4E+38 /end CHARACTERISTIC
/begin CHARACTERISTIC CAL_RCF_nMinSuccessStp_f32 "CAL_RCF_nMinSuccessStp_f32" VALUE 0x801433DC Scalar_FLOAT32_IEEE 0 BSW_A2L_Ident_Float -3.4E+38 3.4E+38 /end CHARACTERISTIC
/begin CHARACTERISTIC CAL_MDF_UdcFwMin_f32 "CAL_MDF_UdcFwMin_f32" VALUE 0x8014166C Scalar_FLOAT32_IEEE 0 BSW_A2L_Ident_Float -3.4E+38 3.4E+38 /end CHARACTERISTIC
/begin CHARACTERISTIC CAL_PcfSig_stBelt_u8 "CAL_PcfSig_stBelt_u8" VALUE 0x801431B5 Scalar_UBYTE 0 BSW_A2L_Ident_Int 0 255 /end CHARACTERISTIC
/begin CHARACTERISTIC CAL_PcfSig_flgPSwt_b "CAL_PcfSig_flgPSwt_b" VALUE 0x801431CB Scalar_BOOLEAN 0 BSW_A2L_Ident_Int 0 1 /end CHARACTERISTIC
/begin CHARACTERISTIC CAL_PcfCtl_PrePos_f32 "CAL_PcfCtl_PrePos_f32" VALUE 0x80143384 Scalar_FLOAT32_IEEE 0 BSW_A2L_Ident_Float -3.4E+38 3.4E+38 /end CHARACTERISTIC
/begin CHARACTERISTIC CAL_PcfDia_UdcMotLowSet_f32 "CAL_PcfDia_UdcMotLowSet_f32" VALUE 0x80143308 Scalar_FLOAT32_IEEE 0 BSW_A2L_Ident_Float -3.4E+38 3.4E+38 /end CHARACTERISTIC
/begin CHARACTERISTIC CAL_PcfDia_SLOutPInit_f32 "CAL_PcfDia_SLOutPInit_f32" VALUE 0x8014331C Scalar_FLOAT32_IEEE 0 BSW_A2L_Ident_Float -3.4E+38 3.4E+38 /end CHARACTERISTIC
/begin CHARACTERISTIC CAL_PcfSig_flgBrake_u8 "CAL_PcfSig_flgBrake_u8" VALUE 0x801431D1 Scalar_UBYTE 0 BSW_A2L_Ident_Int 0 255 /end CHARACTERISTIC
/begin CHARACTERISTIC CAL_MDF_nThresAlOfsNoPlauseFaultMin_f32 "CAL_MDF_nThresAlOfsNoPlauseFaultMin_f32" VALUE 0x801414C8 Scalar_FLOAT32_IEEE 0 BSW_A2L_Ident_Float -3.4E+38 3.4E+38 /end CHARACTERISTIC
/begin CHARACTERISTIC CAL_PcfDia_PosDebounce_f32 "CAL_PcfDia_PosDebounce_f32" VALUE 0x8014333C Scalar_FLOAT32_IEEE 0 BSW_A2L_Ident_Float -3.4E+38 3.4E+38 /end CHARACTERISTIC
/begin CHARACTERISTIC CAL_PcfDia_VDD5Highset_f32 "CAL_PcfDia_VDD5Highset_f32" VALUE 0x801432F8 Scalar_FLOAT32_IEEE 0 BSW_A2L_Ident_Float -3.4E+38 3.4E+38 /end CHARACTERISTIC
/begin CHARACTERISTIC CAL_MDF_tiAgComp_f32 "CAL_MDF_tiAgComp_f32" VALUE 0x801414B0 Scalar_FLOAT32_IEEE 0 BSW_A2L_Ident_Float -3.4E+38 3.4E+38 /end CHARACTERISTIC
/begin CHARACTERISTIC CAL_MDF_cErrPwrDcEstMax_f32 "CAL_MDF_cErrPwrDcEstMax_f32" VALUE 0x80141658 Scalar_FLOAT32_IEEE 0 BSW_A2L_Ident_Float -3.4E+38 3.4E+38 /end CHARACTERISTIC
/begin CHARACTERISTIC CAL_RCF_nCalcSec7_f32 "CAL_RCF_nCalcSec7_f32" VALUE 0x801433FC Scalar_FLOAT32_IEEE 0 BSW_A2L_Ident_Float -3.4E+38 3.4E+38 /end CHARACTERISTIC
/begin CHARACTERISTIC CAL_Scf_FFActionDisab_u8 "CAL_Scf_FFActionDisab_u8" VALUE 0x801434E8 Scalar_UBYTE 0 BSW_A2L_Ident_Int 0 255 /end CHARACTERISTIC
/begin CHARACTERISTIC CAL_PcfSig_flgUseISENorIUB_b "CAL_PcfSig_flgUseISENorIUB_b" VALUE 0x801431C6 Scalar_BOOLEAN 0 BSW_A2L_Ident_Int 0 1 /end CHARACTERISTIC
/begin CHARACTERISTIC CAL_Scf_SenChkErr_u8 "CAL_Scf_SenChkErr_u8" VALUE 0x801434E0 Scalar_UBYTE 0 BSW_A2L_Ident_Int 0 255 /end CHARACTERISTIC
/begin CHARACTERISTIC CAL_RCF_nEstAlOfsStop_f32 "CAL_RCF_nEstAlOfsStop_f32" VALUE 0x801433F4 Scalar_FLOAT32_IEEE 0 BSW_A2L_Ident_Float -3.4E+38 3.4E+38 /end CHARACTERISTIC
/begin CHARACTERISTIC CAL_RCF_cTrqSlopAcc_f32 "CAL_RCF_cTrqSlopAcc_f32" VALUE 0x8014342C Scalar_FLOAT32_IEEE 0 BSW_A2L_Ident_Float -3.4E+38 3.4E+38 /end CHARACTERISTIC
/begin CHARACTERISTIC CAL_PcfSig_tDelayTestP_f32 "CAL_PcfSig_tDelayTestP_f32" VALUE 0x801431B0 Scalar_FLOAT32_IEEE 0 BSW_A2L_Ident_Float -3.4E+38 3.4E+38 /end CHARACTERISTIC
/begin CHARACTERISTIC CAL_Scf_nSafeTestMinLim_f32 "CAL_Scf_nSafeTestMinLim_f32" VALUE 0x80143488 Scalar_FLOAT32_IEEE 0 BSW_A2L_Ident_Float -3.4E+38 3.4E+38 /end CHARACTERISTIC
/begin CHARACTERISTIC CAL_Scf_nSafeMaxLim_f32 "CAL_Scf_nSafeMaxLim_f32" VALUE 0x80143494 Scalar_FLOAT32_IEEE 0 BSW_A2L_Ident_Float -3.4E+38 3.4E+38 /end CHARACTERISTIC
/begin CHARACTERISTIC CAL_PcfDia_posSenHiRngSet_f32 "CAL_PcfDia_posSenHiRngSet_f32" VALUE 0x801432D4 Scalar_FLOAT32_IEEE 0 BSW_A2L_Ident_Float -3.4E+38 3.4E+38 /end CHARACTERISTIC
/begin CHARACTERISTIC CAL_Scf_flgJumpRunBy15Swt_b "CAL_Scf_flgJumpRunBy15Swt_b" VALUE 0x801434B6 Scalar_BOOLEAN 0 BSW_A2L_Ident_Int 0 1 /end CHARACTERISTIC
/begin CHARACTERISTIC CAL_PcfStm_flgTestPSwt_b "CAL_PcfStm_flgTestPSwt_b" VALUE 0x801430C5 Scalar_BOOLEAN 0 BSW_A2L_Ident_Int 0 1 /end CHARACTERISTIC
/begin CHARACTERISTIC CAL_PcfSig_TimesTestP_u16 "CAL_PcfSig_TimesTestP_u16" VALUE 0x80143288 Scalar_UWORD 0 BSW_A2L_Ident_Int 0 65535 /end CHARACTERISTIC
/begin CHARACTERISTIC CAL_PcfDia_cntOverAct_u16 "CAL_PcfDia_cntOverAct_u16" VALUE 0x801432F0 Scalar_UWORD 0 BSW_A2L_Ident_Int 0 65535 /end CHARACTERISTIC
/begin CHARACTERISTIC CAL_Scf_nSafeMinLim_f32 "CAL_Scf_nSafeMinLim_f32" VALUE 0x80143490 Scalar_FLOAT32_IEEE 0 BSW_A2L_Ident_Float -3.4E+38 3.4E+38 /end CHARACTERISTIC
/begin CHARACTERISTIC CAL_Scf_FFActionArea2_u8 "CAL_Scf_FFActionArea2_u8" VALUE 0x801434EA Scalar_UBYTE 0 BSW_A2L_Ident_Int 0 255 /end CHARACTERISTIC
/begin CHARACTERISTIC CAL_Scf_curSenChgToPostDrv_f32 "CAL_Scf_curSenChgToPostDrv_f32" VALUE 0x801434C4 Scalar_FLOAT32_IEEE 0 BSW_A2L_Ident_Float -3.4E+38 3.4E+38 /end CHARACTERISTIC
/begin CHARACTERISTIC CAL_PcfStm_SLWaitimeLimt_u16 "CAL_PcfStm_SLWaitimeLimt_u16" VALUE 0x801430C8 Scalar_UWORD 0 BSW_A2L_Ident_Int 0 65535 /end CHARACTERISTIC
/begin CHARACTERISTIC CAL_MPC_flgDesOrAct_b "CAL_MPC_flgDesOrAct_b" VALUE 0x80142113 Scalar_BOOLEAN 0 BSW_A2L_Ident_Int 0 1 /end CHARACTERISTIC
/begin CHARACTERISTIC CAL_Scf_LowPwrSetUpErr_u8 "CAL_Scf_LowPwrSetUpErr_u8" VALUE 0x801434E2 Scalar_UBYTE 0 BSW_A2L_Ident_Int 0 255 /end CHARACTERISTIC
/begin CHARACTERISTIC CAL_MPC_nTrqMonMax_f32 "CAL_MPC_nTrqMonMax_f32" VALUE 0x801418D4 Scalar_FLOAT32_IEEE 0 BSW_A2L_Ident_Float -3.4E+38 3.4E+38 /end CHARACTERISTIC
/begin CHARACTERISTIC CAL_Scf_StandbyVcuReq_u8 "CAL_Scf_StandbyVcuReq_u8" VALUE 0x801434DD Scalar_UBYTE 0 BSW_A2L_Ident_Int 0 255 /end CHARACTERISTIC
/begin CHARACTERISTIC CAL_PcfDia_flgBCLocked_b "CAL_PcfDia_flgBCLocked_b" VALUE 0x801432EE Scalar_BOOLEAN 0 BSW_A2L_Ident_Int 0 1 /end CHARACTERISTIC
/begin CHARACTERISTIC CAL_PcfSig_IUBSet_f32 "CAL_PcfSig_IUBSet_f32" VALUE 0x801432B4 Scalar_FLOAT32_IEEE 0 BSW_A2L_Ident_Float -3.4E+38 3.4E+38 /end CHARACTERISTIC
/begin CHARACTERISTIC CAL_PcfDia_SpdHi_f32 "CAL_PcfDia_SpdHi_f32" VALUE 0x80143310 Scalar_FLOAT32_IEEE 0 BSW_A2L_Ident_Float -3.4E+38 3.4E+38 /end CHARACTERISTIC
/begin CHARACTERISTIC CAL_RCF_nOfsClbMinFwd_f32 "CAL_RCF_nOfsClbMinFwd_f32" VALUE 0x801433C4 Scalar_FLOAT32_IEEE 0 BSW_A2L_Ident_Float -3.4E+38 3.4E+38 /end CHARACTERISTIC
/begin CHARACTERISTIC CAL_Scf_nSnsrClbFw_f32 "CAL_Scf_nSnsrClbFw_f32" VALUE 0x80143484 Scalar_FLOAT32_IEEE 0 BSW_A2L_Ident_Float -3.4E+38 3.4E+38 /end CHARACTERISTIC
/begin CHARACTERISTIC CAL_RCF_nOfValFwdStp_f32 "CAL_RCF_nOfValFwdStp_f32" VALUE 0x801433D4 Scalar_FLOAT32_IEEE 0 BSW_A2L_Ident_Float -3.4E+38 3.4E+38 /end CHARACTERISTIC
/begin CHARACTERISTIC CAL_Scf_uSafeVolt_f32 "CAL_Scf_uSafeVolt_f32" VALUE 0x80143470 Scalar_FLOAT32_IEEE 0 BSW_A2L_Ident_Float -3.4E+38 3.4E+38 /end CHARACTERISTIC
/begin CHARACTERISTIC CAL_RCF_tMaxAcc_u16 "CAL_RCF_tMaxAcc_u16" VALUE 0x801433BC Scalar_UWORD 0 BSW_A2L_Ident_Int 0 65535 /end CHARACTERISTIC
/begin CHARACTERISTIC CAL_MCF_KiMotHeat_f32 "CAL_MCF_KiMotHeat_f32" VALUE 0x80141148 Scalar_FLOAT32_IEEE 0 BSW_A2L_Ident_Float -3.4E+38 3.4E+38 /end CHARACTERISTIC
/begin CHARACTERISTIC CAL_RCF_nLimitSucToDef_f32 "CAL_RCF_nLimitSucToDef_f32" VALUE 0x801433E8 Scalar_FLOAT32_IEEE 0 BSW_A2L_Ident_Float -3.4E+38 3.4E+38 /end CHARACTERISTIC
/begin CHARACTERISTIC CAL_RCF_360EdgeRag_f32 "CAL_RCF_360EdgeRag_f32" VALUE 0x80143458 Scalar_FLOAT32_IEEE 0 BSW_A2L_Ident_Float -3.4E+38 3.4E+38 /end CHARACTERISTIC
/begin CHARACTERISTIC CAL_Scf_flgActvSubisSwt_b "CAL_Scf_flgActvSubisSwt_b" VALUE 0x801434BE Scalar_BOOLEAN 0 BSW_A2L_Ident_Int 0 1 /end CHARACTERISTIC
/begin CHARACTERISTIC CAL_PcfStm_cntSLWaitRunLimt_u16 "CAL_PcfStm_cntSLWaitRunLimt_u16" VALUE 0x801430C6 Scalar_UWORD 0 BSW_A2L_Ident_Int 0 65535 /end CHARACTERISTIC
/begin CHARACTERISTIC CAL_PcfStm_SLActRunSpdUp_f32 "CAL_PcfStm_SLActRunSpdUp_f32" VALUE 0x801430D0 Scalar_FLOAT32_IEEE 0 BSW_A2L_Ident_Float -3.4E+38 3.4E+38 /end CHARACTERISTIC
/begin CHARACTERISTIC CAL_PcfSig_deltaAimOutP_f32 "CAL_PcfSig_deltaAimOutP_f32" VALUE 0x801431DC Scalar_FLOAT32_IEEE 0 BSW_A2L_Ident_Float -3.4E+38 3.4E+38 /end CHARACTERISTIC
/begin CHARACTERISTIC CAL_RCF_SuccdToDefault_b "CAL_RCF_SuccdToDefault_b" VALUE 0x80143448 Scalar_BOOLEAN 0 BSW_A2L_Ident_Int 0 1 /end CHARACTERISTIC
/begin CHARACTERISTIC CAL_MDF_tiQuitEMBlk_f32 "CAL_MDF_tiQuitEMBlk_f32" VALUE 0x8014149C Scalar_FLOAT32_IEEE 0 BSW_A2L_Ident_Float -3.4E+38 3.4E+38 /end CHARACTERISTIC
/begin CHARACTERISTIC CAL_PcfSig_flgACC_b "CAL_PcfSig_flgACC_b" VALUE 0x801431D4 Scalar_BOOLEAN 0 BSW_A2L_Ident_Int 0 1 /end CHARACTERISTIC
/begin CHARACTERISTIC CAL_PcfSig_flgKL15_b "CAL_PcfSig_flgKL15_b" VALUE 0x801431CE Scalar_BOOLEAN 0 BSW_A2L_Ident_Int 0 1 /end CHARACTERISTIC
/begin CHARACTERISTIC CAL_PcfDia_PosHighset_f32 "CAL_PcfDia_PosHighset_f32" VALUE 0x80143338 Scalar_FLOAT32_IEEE 0 BSW_A2L_Ident_Float -3.4E+38 3.4E+38 /end CHARACTERISTIC
/begin CHARACTERISTIC CAL_PcfDia_PosLowset_f32 "CAL_PcfDia_PosLowset_f32" VALUE 0x80143334 Scalar_FLOAT32_IEEE 0 BSW_A2L_Ident_Float -3.4E+38 3.4E+38 /end CHARACTERISTIC
/begin CHARACTERISTIC CAL_PcfSig_iSENCnvFac_f32 "CAL_PcfSig_iSENCnvFac_f32" VALUE 0x801431C0 Scalar_FLOAT32_IEEE 0 BSW_A2L_Ident_Float -3.4E+38 3.4E+38 /end CHARACTERISTIC
/begin CHARACTERISTIC CAL_MDF_stFrwhlWiIs_u8 "CAL_MDF_stFrwhlWiIs_u8" VALUE 0x801414C2 Scalar_UBYTE 0 BSW_A2L_Ident_Int 0 255 /end CHARACTERISTIC
/begin CHARACTERISTIC CAL_Scf_uAllwPwrDcha_f32 "CAL_Scf_uAllwPwrDcha_f32" VALUE 0x8014347C Scalar_FLOAT32_IEEE 0 BSW_A2L_Ident_Float -3.4E+38 3.4E+38 /end CHARACTERISTIC
/begin CHARACTERISTIC CAL_PcfDia_AimInPRdd_f32 "CAL_PcfDia_AimInPRdd_f32" VALUE 0x80143358 Scalar_FLOAT32_IEEE 0 BSW_A2L_Ident_Float -3.4E+38 3.4E+38 /end CHARACTERISTIC
/begin CHARACTERISTIC CAL_PcfDia_AimOutPRdd_f32 "CAL_PcfDia_AimOutPRdd_f32" VALUE 0x80143354 Scalar_FLOAT32_IEEE 0 BSW_A2L_Ident_Float -3.4E+38 3.4E+38 /end CHARACTERISTIC
/begin CHARACTERISTIC CAL_PcfDia_flgLocked_b "CAL_PcfDia_flgLocked_b" VALUE 0x801432EB Scalar_BOOLEAN 0 BSW_A2L_Ident_Int 0 1 /end CHARACTERISTIC
/begin CHARACTERISTIC CAL_PcfSig_flgKL15Swt_b "CAL_PcfSig_flgKL15Swt_b" VALUE 0x801431CF Scalar_BOOLEAN 0 BSW_A2L_Ident_Int 0 1 /end CHARACTERISTIC
/begin CHARACTERISTIC CAL_Scf_uSubHiVoltVal_f32 "CAL_Scf_uSubHiVoltVal_f32" VALUE 0x8014346C Scalar_FLOAT32_IEEE 0 BSW_A2L_Ident_Float -3.4E+38 3.4E+38 /end CHARACTERISTIC
/begin CHARACTERISTIC CAL_MDF_IsMaxSet_f32 "CAL_MDF_IsMaxSet_f32" VALUE 0x801416A4 Scalar_FLOAT32_IEEE 0 BSW_A2L_Ident_Float -3.4E+38 3.4E+38 /end CHARACTERISTIC
/begin CHARACTERISTIC CAL_MDF_Inactive_u8 "CAL_MDF_Inactive_u8" VALUE 0x801416B0 Scalar_UBYTE 0 BSW_A2L_Ident_Int 0 255 /end CHARACTERISTIC
/begin CHARACTERISTIC CAL_PcfDia_cntNorAct_u16 "CAL_PcfDia_cntNorAct_u16" VALUE 0x801432F2 Scalar_UWORD 0 BSW_A2L_Ident_Int 0 65535 /end CHARACTERISTIC
/begin CHARACTERISTIC CAL_Scf_flgPcfAllowPwmRunSwt_b "CAL_Scf_flgPcfAllowPwmRunSwt_b" VALUE 0x801434B4 Scalar_BOOLEAN 0 BSW_A2L_Ident_Int 0 1 /end CHARACTERISTIC
/begin CHARACTERISTIC CAL_MPC_TrqMechCutOffFrq_f32 "CAL_MPC_TrqMechCutOffFrq_f32" VALUE 0x80142158 Scalar_FLOAT32_IEEE 0 BSW_A2L_Ident_Float -3.4E+38 3.4E+38 /end CHARACTERISTIC
/begin CHARACTERISTIC CAL_Scf_nSafeLoSpdMaxLim_f32 "CAL_Scf_nSafeLoSpdMaxLim_f32" VALUE 0x8014349C Scalar_FLOAT32_IEEE 0 BSW_A2L_Ident_Float -3.4E+38 3.4E+38 /end CHARACTERISTIC
/begin CHARACTERISTIC CAL_PcfDia_IdcLockedHi_f32 "CAL_PcfDia_IdcLockedHi_f32" VALUE 0x80143348 Scalar_FLOAT32_IEEE 0 BSW_A2L_Ident_Float -3.4E+38 3.4E+38 /end CHARACTERISTIC
/begin CHARACTERISTIC CAL_Scf_nRunTostb_f32 "CAL_Scf_nRunTostb_f32" VALUE 0x801434A0 Scalar_FLOAT32_IEEE 0 BSW_A2L_Ident_Float -3.4E+38 3.4E+38 /end CHARACTERISTIC
/begin CHARACTERISTIC CAL_RCF_tHiEstAlOfs_u32 "CAL_RCF_tHiEstAlOfs_u32" VALUE 0x801433C0 Scalar_ULONG 0 BSW_A2L_Ident_Int 0 4294967295 /end CHARACTERISTIC
/begin CHARACTERISTIC CAL_RCF_cntOfValBwd_u32 "CAL_RCF_cntOfValBwd_u32" VALUE 0x80143424 Scalar_ULONG 0 BSW_A2L_Ident_Int 0 4294967295 /end CHARACTERISTIC
/begin CHARACTERISTIC CAL_PcfSig_flgNVMSLFnhSwt_b "CAL_PcfSig_flgNVMSLFnhSwt_b" VALUE 0x801431CD Scalar_BOOLEAN 0 BSW_A2L_Ident_Int 0 1 /end CHARACTERISTIC
/begin CHARACTERISTIC CAL_PcfCtl_intPIDuplim_f32 "CAL_PcfCtl_intPIDuplim_f32" VALUE 0x80143368 Scalar_FLOAT32_IEEE 0 BSW_A2L_Ident_Float -3.4E+38 3.4E+38 /end CHARACTERISTIC
/begin CHARACTERISTIC CAL_Scf_flgIntVcuComErr_b "CAL_Scf_flgIntVcuComErr_b" VALUE 0x801434B8 Scalar_BOOLEAN 0 BSW_A2L_Ident_Int 0 1 /end CHARACTERISTIC
/begin CHARACTERISTIC CAL_PcfDia_LockedNum_u16 "CAL_PcfDia_LockedNum_u16" VALUE 0x80143344 Scalar_UWORD 0 BSW_A2L_Ident_Int 0 65535 /end CHARACTERISTIC
/begin CHARACTERISTIC CAL_RCF_nCalcSec2_f32 "CAL_RCF_nCalcSec2_f32" VALUE 0x80143410 Scalar_FLOAT32_IEEE 0 BSW_A2L_Ident_Float -3.4E+38 3.4E+38 /end CHARACTERISTIC
/begin CHARACTERISTIC CAL_MDF_UdcThreshCirNoPsbl_f32 "CAL_MDF_UdcThreshCirNoPsbl_f32" VALUE 0x80141668 Scalar_FLOAT32_IEEE 0 BSW_A2L_Ident_Float -3.4E+38 3.4E+38 /end CHARACTERISTIC
/begin CHARACTERISTIC CAL_PcfCtl_SLdeltaAimOutP_f32 "CAL_PcfCtl_SLdeltaAimOutP_f32" VALUE 0x80143378 Scalar_FLOAT32_IEEE 0 BSW_A2L_Ident_Float -3.4E+38 3.4E+38 /end CHARACTERISTIC
/begin CHARACTERISTIC CAL_PcfDia_IdcLockedHiHyst_f32 "CAL_PcfDia_IdcLockedHiHyst_f32" VALUE 0x8014334C Scalar_FLOAT32_IEEE 0 BSW_A2L_Ident_Float -3.4E+38 3.4E+38 /end CHARACTERISTIC
/begin CHARACTERISTIC CAL_Scf_flgIntVcuComSwt_b "CAL_Scf_flgIntVcuComSwt_b" VALUE 0x801434B7 Scalar_BOOLEAN 0 BSW_A2L_Ident_Int 0 1 /end CHARACTERISTIC
/begin CHARACTERISTIC CAL_PcfSig_AngMotPos_f32 "CAL_PcfSig_AngMotPos_f32" VALUE 0x801432C0 Scalar_FLOAT32_IEEE 0 BSW_A2L_Ident_Float -3.4E+38 3.4E+38 /end CHARACTERISTIC
/begin CHARACTERISTIC CAL_PcfSig_VehSpd_f32 "CAL_PcfSig_VehSpd_f32" VALUE 0x801431E4 Scalar_FLOAT32_IEEE 0 BSW_A2L_Ident_Float -3.4E+38 3.4E+38 /end CHARACTERISTIC
/begin CHARACTERISTIC CAL_PcfSig_PosOffset_f32 "CAL_PcfSig_PosOffset_f32" VALUE 0x8014328C Scalar_FLOAT32_IEEE 0 BSW_A2L_Ident_Float -3.4E+38 3.4E+38 /end CHARACTERISTIC
/begin CHARACTERISTIC CAL_PcfDia_flgRetrySwt_b "CAL_PcfDia_flgRetrySwt_b" VALUE 0x801432E9 Scalar_BOOLEAN 0 BSW_A2L_Ident_Int 0 1 /end CHARACTERISTIC
/begin CHARACTERISTIC CAL_MDF_trqOfsNoPlausFault_f32 "CAL_MDF_trqOfsNoPlausFault_f32" VALUE 0x80141498 Scalar_FLOAT32_IEEE 0 BSW_A2L_Ident_Float -3.4E+38 3.4E+38 /end CHARACTERISTIC
/begin CHARACTERISTIC CAL_Scf_cntDisChgOvTi_u16 "CAL_Scf_cntDisChgOvTi_u16" VALUE 0x801434D2 Scalar_UWORD 0 BSW_A2L_Ident_Int 0 65535 /end CHARACTERISTIC
/begin CHARACTERISTIC CAL_MDF_nAbsPhaseFault_f32 "CAL_MDF_nAbsPhaseFault_f32" VALUE 0x801414E4 Scalar_FLOAT32_IEEE 0 BSW_A2L_Ident_Float -3.4E+38 3.4E+38 /end CHARACTERISTIC
/begin CHARACTERISTIC CAL_PcfDia_UdcCANLowSet_f32 "CAL_PcfDia_UdcCANLowSet_f32" VALUE 0x8014330C Scalar_FLOAT32_IEEE 0 BSW_A2L_Ident_Float -3.4E+38 3.4E+38 /end CHARACTERISTIC
/begin CHARACTERISTIC CAL_PcfCtl_SoftDyc_f32 "CAL_PcfCtl_SoftDyc_f32" VALUE 0x80143374 Scalar_FLOAT32_IEEE 0 BSW_A2L_Ident_Float -3.4E+38 3.4E+38 /end CHARACTERISTIC
/begin CHARACTERISTIC CAL_PcfStm_flgUseFaultRec_b "CAL_PcfStm_flgUseFaultRec_b" VALUE 0x801430C2 Scalar_BOOLEAN 0 BSW_A2L_Ident_Int 0 1 /end CHARACTERISTIC
/begin CHARACTERISTIC CAL_PcfCtl_PosKp_f32 "CAL_PcfCtl_PosKp_f32" VALUE 0x80143388 Scalar_FLOAT32_IEEE 0 BSW_A2L_Ident_Float -3.4E+38 3.4E+38 /end CHARACTERISTIC
/begin CHARACTERISTIC CAL_Scf_WithoutStatorCurrent_u8 "CAL_Scf_WithoutStatorCurrent_u8" VALUE 0x801434D7 Scalar_UBYTE 0 BSW_A2L_Ident_Int 0 255 /end CHARACTERISTIC
/begin CHARACTERISTIC CAL_MDF_stFrwhlWoIs_u8 "CAL_MDF_stFrwhlWoIs_u8" VALUE 0x801414C1 Scalar_UBYTE 0 BSW_A2L_Ident_Int 0 255 /end CHARACTERISTIC
/begin CHARACTERISTIC CAL_PcfDia_nMechHi_f32 "CAL_PcfDia_nMechHi_f32" VALUE 0x801432E0 Scalar_FLOAT32_IEEE 0 BSW_A2L_Ident_Float -3.4E+38 3.4E+38 /end CHARACTERISTIC
/begin CHARACTERISTIC CAL_MDF_IsThreshCirNoPsbl_f32 "CAL_MDF_IsThreshCirNoPsbl_f32" VALUE 0x8014169C Scalar_FLOAT32_IEEE 0 BSW_A2L_Ident_Float -3.4E+38 3.4E+38 /end CHARACTERISTIC
/begin CHARACTERISTIC CAL_PcfSig_PosCnvFac_f32 "CAL_PcfSig_PosCnvFac_f32" VALUE 0x80143290 Scalar_FLOAT32_IEEE 0 BSW_A2L_Ident_Float -3.4E+38 3.4E+38 /end CHARACTERISTIC
/begin CHARACTERISTIC CAL_Scf_FLOATZERO_f32 "CAL_Scf_FLOATZERO_f32" VALUE 0x801434E4 Scalar_FLOAT32_IEEE 0 BSW_A2L_Ident_Float -3.4E+38 3.4E+38 /end CHARACTERISTIC
/begin CHARACTERISTIC CAL_RCF_cntOfValFwd_u32 "CAL_RCF_cntOfValFwd_u32" VALUE 0x80143420 Scalar_ULONG 0 BSW_A2L_Ident_Int 0 4294967295 /end CHARACTERISTIC
/begin CHARACTERISTIC CAL_RCF_nAlRtrDesAcc_f32 "CAL_RCF_nAlRtrDesAcc_f32" VALUE 0x80143418 Scalar_FLOAT32_IEEE 0 BSW_A2L_Ident_Float -3.4E+38 3.4E+38 /end CHARACTERISTIC
/begin CHARACTERISTIC CAL_PcfCtl_SLRunDyc_f32 "CAL_PcfCtl_SLRunDyc_f32" VALUE 0x8014337C Scalar_FLOAT32_IEEE 0 BSW_A2L_Ident_Float -3.4E+38 3.4E+38 /end CHARACTERISTIC
/begin CHARACTERISTIC CAL_RCF_nCalcSec3_f32 "CAL_RCF_nCalcSec3_f32" VALUE 0x8014340C Scalar_FLOAT32_IEEE 0 BSW_A2L_Ident_Float -3.4E+38 3.4E+38 /end CHARACTERISTIC
/begin CHARACTERISTIC CAL_PcfStm_SLMotorAcctimeLimt_u16 "CAL_PcfStm_SLMotorAcctimeLimt_u16" VALUE 0x801430CC Scalar_UWORD 0 BSW_A2L_Ident_Int 0 65535 /end CHARACTERISTIC
/begin CHARACTERISTIC CAL_Scf_uTnetHysToPostDrv_f32 "CAL_Scf_uTnetHysToPostDrv_f32" VALUE 0x80143464 Scalar_FLOAT32_IEEE 0 BSW_A2L_Ident_Float -3.4E+38 3.4E+38 /end CHARACTERISTIC
/begin CHARACTERISTIC CAL_PcfDia_nMotLockedLow_f32 "CAL_PcfDia_nMotLockedLow_f32" VALUE 0x801432D8 Scalar_FLOAT32_IEEE 0 BSW_A2L_Ident_Float -3.4E+38 3.4E+38 /end CHARACTERISTIC
/begin CHARACTERISTIC CAL_PcfSig_iSENFltCoe_f32 "CAL_PcfSig_iSENFltCoe_f32" VALUE 0x801431BC Scalar_FLOAT32_IEEE 0 BSW_A2L_Ident_Float -3.4E+38 3.4E+38 /end CHARACTERISTIC
/begin CHARACTERISTIC CAL_PcfDia_MinPosOutP_f32 "CAL_PcfDia_MinPosOutP_f32" VALUE 0x80143340 Scalar_FLOAT32_IEEE 0 BSW_A2L_Ident_Float -3.4E+38 3.4E+38 /end CHARACTERISTIC
/begin CHARACTERISTIC CAL_MCF_DownLimitIMotHeat_f32 "CAL_MCF_DownLimitIMotHeat_f32" VALUE 0x801412E8 Scalar_FLOAT32_IEEE 0 BSW_A2L_Ident_Float -3.4E+38 3.4E+38 /end CHARACTERISTIC
/begin CHARACTERISTIC CAL_RCF_nMaxStartAcc_f32 "CAL_RCF_nMaxStartAcc_f32" VALUE 0x801433E4 Scalar_FLOAT32_IEEE 0 BSW_A2L_Ident_Float -3.4E+38 3.4E+38 /end CHARACTERISTIC
/begin CHARACTERISTIC CAL_PcfDia_tMosLowSet_f32 "CAL_PcfDia_tMosLowSet_f32" VALUE 0x801432CC Scalar_FLOAT32_IEEE 0 BSW_A2L_Ident_Float -3.4E+38 3.4E+38 /end CHARACTERISTIC
/begin CHARACTERISTIC CAL_MPC_udActCutOffFrq_f32 "CAL_MPC_udActCutOffFrq_f32" VALUE 0x801416CC Scalar_FLOAT32_IEEE 0 BSW_A2L_Ident_Float -3.4E+38 3.4E+38 /end CHARACTERISTIC
/begin CHARACTERISTIC CAL_MDF_tOperOutdRngSelState_b "CAL_MDF_tOperOutdRngSelState_b" VALUE 0x801414C0 Scalar_BOOLEAN 0 BSW_A2L_Ident_Int 0 1 /end CHARACTERISTIC
/begin CHARACTERISTIC CAL_PcfDia_UdcMotManSet_f32 "CAL_PcfDia_UdcMotManSet_f32" VALUE 0x80143304 Scalar_FLOAT32_IEEE 0 BSW_A2L_Ident_Float -3.4E+38 3.4E+38 /end CHARACTERISTIC
/begin CHARACTERISTIC CAL_MDF_nThresAlOfsNoPlauseFaultMax_f32 "CAL_MDF_nThresAlOfsNoPlauseFaultMax_f32" VALUE 0x801414CC Scalar_FLOAT32_IEEE 0 BSW_A2L_Ident_Float -3.4E+38 3.4E+38 /end CHARACTERISTIC
/begin CHARACTERISTIC CAL_PcfStm_SLRunTimesLimt_u8 "CAL_PcfStm_SLRunTimesLimt_u8" VALUE 0x801430CA Scalar_UBYTE 0 BSW_A2L_Ident_Int 0 255 /end CHARACTERISTIC
/begin CHARACTERISTIC CAL_PcfDia_nMotLockedLowHyst_f32 "CAL_PcfDia_nMotLockedLowHyst_f32" VALUE 0x801432DC Scalar_FLOAT32_IEEE 0 BSW_A2L_Ident_Float -3.4E+38 3.4E+38 /end CHARACTERISTIC
/begin CHARACTERISTIC CAL_MPC_Rs_f32 "CAL_MPC_Rs_f32" VALUE 0x801421B4 Scalar_FLOAT32_IEEE 0 BSW_A2L_Ident_Float -3.4E+38 3.4E+38 /end CHARACTERISTIC
/begin CHARACTERISTIC CAL_PcfSig_flgPowerOn_b "CAL_PcfSig_flgPowerOn_b" VALUE 0x801431C8 Scalar_BOOLEAN 0 BSW_A2L_Ident_Int 0 1 /end CHARACTERISTIC
/begin CHARACTERISTIC CAL_PcfDia_nMechHiHyst_f32 "CAL_PcfDia_nMechHiHyst_f32" VALUE 0x801432E4 Scalar_FLOAT32_IEEE 0 BSW_A2L_Ident_Float -3.4E+38 3.4E+38 /end CHARACTERISTIC
/begin CHARACTERISTIC CAL_MDF_FwWiIs_f32 "CAL_MDF_FwWiIs_f32" VALUE 0x801416B8 Scalar_FLOAT32_IEEE 0 BSW_A2L_Ident_Float -3.4E+38 3.4E+38 /end CHARACTERISTIC
/begin CHARACTERISTIC CAL_PcfDia_VDD5Debounce_f32 "CAL_PcfDia_VDD5Debounce_f32" VALUE 0x801432FC Scalar_FLOAT32_IEEE 0 BSW_A2L_Ident_Float -3.4E+38 3.4E+38 /end CHARACTERISTIC
/begin CHARACTERISTIC CAL_PcfSig_flgstDoorSwt_b "CAL_PcfSig_flgstDoorSwt_b" VALUE 0x801431C4 Scalar_BOOLEAN 0 BSW_A2L_Ident_Int 0 1 /end CHARACTERISTIC
/begin CHARACTERISTIC CAL_MDF_nAbsThresblockedElMa_f32 "CAL_MDF_nAbsThresblockedElMa_f32" VALUE 0x801414DC Scalar_FLOAT32_IEEE 0 BSW_A2L_Ident_Float -3.4E+38 3.4E+38 /end CHARACTERISTIC
/begin CHARACTERISTIC CAL_RCF_cntMovAveFilFwd_u16 "CAL_RCF_cntMovAveFilFwd_u16" VALUE 0x80143428 Scalar_UWORD 0 BSW_A2L_Ident_Int 0 65535 /end CHARACTERISTIC
/begin CHARACTERISTIC CAL_Scf_cntDisChgEnd_u16 "CAL_Scf_cntDisChgEnd_u16" VALUE 0x801434D4 Scalar_UWORD 0 BSW_A2L_Ident_Int 0 65535 /end CHARACTERISTIC
/begin CHARACTERISTIC CAL_Scf_FFActionArea3_u8 "CAL_Scf_FFActionArea3_u8" VALUE 0x801434E9 Scalar_UBYTE 0 BSW_A2L_Ident_Int 0 255 /end CHARACTERISTIC
/begin CHARACTERISTIC CAL_RCF_nMinSkipAcc_f32 "CAL_RCF_nMinSkipAcc_f32" VALUE 0x801433E0 Scalar_FLOAT32_IEEE 0 BSW_A2L_Ident_Float -3.4E+38 3.4E+38 /end CHARACTERISTIC
/begin CHARACTERISTIC CAL_MDF_IsPhaseFault_f32 "CAL_MDF_IsPhaseFault_f32" VALUE 0x801416A0 Scalar_FLOAT32_IEEE 0 BSW_A2L_Ident_Float -3.4E+38 3.4E+38 /end CHARACTERISTIC
/begin CHARACTERISTIC CAL_Scf_EmgDchabysiglordoubSwt_b "CAL_Scf_EmgDchabysiglordoubSwt_b" VALUE 0x801434EB Scalar_BOOLEAN 0 BSW_A2L_Ident_Int 0 1 /end CHARACTERISTIC
/begin CHARACTERISTIC CAL_PcfCtl_timePrePos_u16 "CAL_PcfCtl_timePrePos_u16" VALUE 0x80143364 Scalar_UWORD 0 BSW_A2L_Ident_Int 0 65535 /end CHARACTERISTIC
/begin CHARACTERISTIC CAL_PcfDia_AimInPRatDown_f32 "CAL_PcfDia_AimInPRatDown_f32" VALUE 0x80143360 Scalar_FLOAT32_IEEE 0 BSW_A2L_Ident_Float -3.4E+38 3.4E+38 /end CHARACTERISTIC
/begin CHARACTERISTIC CAL_RCF_EstToDefault_b "CAL_RCF_EstToDefault_b" VALUE 0x80143450 Scalar_BOOLEAN 0 BSW_A2L_Ident_Int 0 1 /end CHARACTERISTIC
/begin CHARACTERISTIC CAL_MDF_tThd_TempDBCInvSens3Pha_f32 "CAL_MDF_tThd_TempDBCInvSens3Pha_f32" VALUE 0x801414B8 Scalar_FLOAT32_IEEE 0 BSW_A2L_Ident_Float -3.4E+38 3.4E+38 /end CHARACTERISTIC
/begin CHARACTERISTIC CAL_PcfSig_factMosFlt_f32 "CAL_PcfSig_factMosFlt_f32" VALUE 0x801431D8 Scalar_FLOAT32_IEEE 0 BSW_A2L_Ident_Float -3.4E+38 3.4E+38 /end CHARACTERISTIC
/begin CHARACTERISTIC CAL_MCF_UpPowerHeat_f32 "CAL_MCF_UpPowerHeat_f32" VALUE 0x80141068 Scalar_FLOAT32_IEEE 0 BSW_A2L_Ident_Float -3.4E+38 3.4E+38 /end CHARACTERISTIC
/begin CHARACTERISTIC CAL_SCF_flgUseSLCal_b "CAL_SCF_flgUseSLCal_b" VALUE 0x801434EC Scalar_BOOLEAN 0 BSW_A2L_Ident_Int 0 1 /end CHARACTERISTIC
/begin CHARACTERISTIC CAL_MCF_UpLimitPIMotHeat_f32 "CAL_MCF_UpLimitPIMotHeat_f32" VALUE 0x8014106C Scalar_FLOAT32_IEEE 0 BSW_A2L_Ident_Float -3.4E+38 3.4E+38 /end CHARACTERISTIC
/begin CHARACTERISTIC CAL_MDF_DIffAlOfsMax_f32 "CAL_MDF_DIffAlOfsMax_f32" VALUE 0x801416C0 Scalar_FLOAT32_IEEE 0 BSW_A2L_Ident_Float -3.4E+38 3.4E+38 /end CHARACTERISTIC
/begin CHARACTERISTIC CAL_PcfCtl_BCRunDyc_f32 "CAL_PcfCtl_BCRunDyc_f32" VALUE 0x801433A4 Scalar_FLOAT32_IEEE 0 BSW_A2L_Ident_Float -3.4E+38 3.4E+38 /end CHARACTERISTIC
/begin CHARACTERISTIC CAL_PcfDia_Retrytimes_u8 "CAL_PcfDia_Retrytimes_u8" VALUE 0x80143330 Scalar_UBYTE 0 BSW_A2L_Ident_Int 0 255 /end CHARACTERISTIC
/begin CHARACTERISTIC CAL_PcfDia_AimInPRatUp_f32 "CAL_PcfDia_AimInPRatUp_f32" VALUE 0x8014335C Scalar_FLOAT32_IEEE 0 BSW_A2L_Ident_Float -3.4E+38 3.4E+38 /end CHARACTERISTIC
/begin CHARACTERISTIC CAL_MDF_stFrwhlPhd_u8 "CAL_MDF_stFrwhlPhd_u8" VALUE 0x801414C3 Scalar_UBYTE 0 BSW_A2L_Ident_Int 0 255 /end CHARACTERISTIC
/begin CHARACTERISTIC CAL_MDF_tThd_TempDBCInvCoolObsvr_f32 "CAL_MDF_tThd_TempDBCInvCoolObsvr_f32" VALUE 0x801414BC Scalar_FLOAT32_IEEE 0 BSW_A2L_Ident_Float -3.4E+38 3.4E+38 /end CHARACTERISTIC
/begin CHARACTERISTIC CAL_PcfSig_flgNVMSLFnh_b "CAL_PcfSig_flgNVMSLFnh_b" VALUE 0x801431CC Scalar_BOOLEAN 0 BSW_A2L_Ident_Int 0 1 /end CHARACTERISTIC
/begin CHARACTERISTIC CAL_PcfSig_flgPowerOnSwt_b "CAL_PcfSig_flgPowerOnSwt_b" VALUE 0x801431C9 Scalar_BOOLEAN 0 BSW_A2L_Ident_Int 0 1 /end CHARACTERISTIC
/begin CHARACTERISTIC CAL_PcfDia_flgFault_b "CAL_PcfDia_flgFault_b" VALUE 0x801432EC Scalar_BOOLEAN 0 BSW_A2L_Ident_Int 0 1 /end CHARACTERISTIC
/begin CHARACTERISTIC CAL_Scf_flgEpcShutdownSwt_b "CAL_Scf_flgEpcShutdownSwt_b" VALUE 0x801434B9 Scalar_BOOLEAN 0 BSW_A2L_Ident_Int 0 1 /end CHARACTERISTIC
/begin CHARACTERISTIC CAL_MPC_flgUseRs_b "CAL_MPC_flgUseRs_b" VALUE 0x80142110 Scalar_BOOLEAN 0 BSW_A2L_Ident_Int 0 1 /end CHARACTERISTIC
/begin CHARACTERISTIC CAL_MPC_flgUseLdSubLq_b "CAL_MPC_flgUseLdSubLq_b" VALUE 0x80142112 Scalar_BOOLEAN 0 BSW_A2L_Ident_Int 0 1 /end CHARACTERISTIC
/begin CHARACTERISTIC CAL_RCF_tMaxFwlFwd_u16 "CAL_RCF_tMaxFwlFwd_u16" VALUE 0x801433B0 Scalar_UWORD 0 BSW_A2L_Ident_Int 0 65535 /end CHARACTERISTIC
/begin CHARACTERISTIC CAL_MDF_EMBlkWarn_f32 "CAL_MDF_EMBlkWarn_f32" VALUE 0x801416BC Scalar_FLOAT32_IEEE 0 BSW_A2L_Ident_Float -3.4E+38 3.4E+38 /end CHARACTERISTIC
/begin CHARACTERISTIC CAL_MPC_Psi_f32 "CAL_MPC_Psi_f32" VALUE 0x801421BC Scalar_FLOAT32_IEEE 0 BSW_A2L_Ident_Float -3.4E+38 3.4E+38 /end CHARACTERISTIC
/begin CHARACTERISTIC CAL_PcfStm_BCActimeLimt_u16 "CAL_PcfStm_BCActimeLimt_u16" VALUE 0x801430DC Scalar_UWORD 0 BSW_A2L_Ident_Int 0 65535 /end CHARACTERISTIC
/begin CHARACTERISTIC CAL_MPC_uqActCutOffFrq_f32 "CAL_MPC_uqActCutOffFrq_f32" VALUE 0x801416C8 Scalar_FLOAT32_IEEE 0 BSW_A2L_Ident_Float -3.4E+38 3.4E+38 /end CHARACTERISTIC
/begin CHARACTERISTIC CAL_PcfDia_VDD5Lowset_f32 "CAL_PcfDia_VDD5Lowset_f32" VALUE 0x801432F4 Scalar_FLOAT32_IEEE 0 BSW_A2L_Ident_Float -3.4E+38 3.4E+38 /end CHARACTERISTIC
/begin CHARACTERISTIC CAL_PcfDia_tMosNum_u16 "CAL_PcfDia_tMosNum_u16" VALUE 0x801432CA Scalar_UWORD 0 BSW_A2L_Ident_Int 0 65535 /end CHARACTERISTIC
/begin CHARACTERISTIC CAL_Scf_flgOfsClbSwt_b "CAL_Scf_flgOfsClbSwt_b" VALUE 0x801434B5 Scalar_BOOLEAN 0 BSW_A2L_Ident_Int 0 1 /end CHARACTERISTIC
/begin CHARACTERISTIC CAL_MCF_cofFltPowerHeat_f32 "CAL_MCF_cofFltPowerHeat_f32" VALUE 0x80140FFC Scalar_FLOAT32_IEEE 0 BSW_A2L_Ident_Float -3.4E+38 3.4E+38 /end CHARACTERISTIC
/begin CHARACTERISTIC CAL_PcfDia_BCLockedNum_u16 "CAL_PcfDia_BCLockedNum_u16" VALUE 0x80143350 Scalar_UWORD 0 BSW_A2L_Ident_Int 0 65535 /end CHARACTERISTIC
/begin CHARACTERISTIC CAL_MDF_UsErrFlt_f32 "CAL_MDF_UsErrFlt_f32" VALUE 0x80141664 Scalar_FLOAT32_IEEE 0 BSW_A2L_Ident_Float -3.4E+38 3.4E+38 /end CHARACTERISTIC
/begin CHARACTERISTIC CAL_MDF_tThd_TempStr_f32 "CAL_MDF_tThd_TempStr_f32" VALUE 0x801414B4 Scalar_FLOAT32_IEEE 0 BSW_A2L_Ident_Float -3.4E+38 3.4E+38 /end CHARACTERISTIC
/begin CHARACTERISTIC CAL_PcfCtl_InitOutP_f32 "CAL_PcfCtl_InitOutP_f32" VALUE 0x801433A0 Scalar_FLOAT32_IEEE 0 BSW_A2L_Ident_Float -3.4E+38 3.4E+38 /end CHARACTERISTIC
/begin CHARACTERISTIC CAL_MPC_iqActCutOffFrq_f32 "CAL_MPC_iqActCutOffFrq_f32" VALUE 0x80141E6C Scalar_FLOAT32_IEEE 0 BSW_A2L_Ident_Float -3.4E+38 3.4E+38 /end CHARACTERISTIC
/begin CHARACTERISTIC CAL_PcfStm_flgUseRPC_b "CAL_PcfStm_flgUseRPC_b" VALUE 0x801430C1 Scalar_BOOLEAN 0 BSW_A2L_Ident_Int 0 1 /end CHARACTERISTIC
/begin CHARACTERISTIC CAL_PcfStm_flgUseAutoBackP_b "CAL_PcfStm_flgUseAutoBackP_b" VALUE 0x801430C4 Scalar_BOOLEAN 0 BSW_A2L_Ident_Int 0 1 /end CHARACTERISTIC
/begin CHARACTERISTIC CAL_Scf_udcPrechgFish_f32 "CAL_Scf_udcPrechgFish_f32" VALUE 0x8014345C Scalar_FLOAT32_IEEE 0 BSW_A2L_Ident_Float -3.4E+38 3.4E+38 /end CHARACTERISTIC
/begin CHARACTERISTIC CAL_Scf_flgDisChgReqSwt_b "CAL_Scf_flgDisChgReqSwt_b" VALUE 0x801434BC Scalar_BOOLEAN 0 BSW_A2L_Ident_Int 0 1 /end CHARACTERISTIC
/begin CHARACTERISTIC CAL_Scf_uTnetHysToDrv_f32 "CAL_Scf_uTnetHysToDrv_f32" VALUE 0x80143468 Scalar_FLOAT32_IEEE 0 BSW_A2L_Ident_Float -3.4E+38 3.4E+38 /end CHARACTERISTIC
/begin CHARACTERISTIC CAL_RCF_tUbetaSet_u32 "CAL_RCF_tUbetaSet_u32" VALUE 0x801433A8 Scalar_ULONG 0 BSW_A2L_Ident_Int 0 4294967295 /end CHARACTERISTIC
/begin CHARACTERISTIC CAL_Scf_flgActvSubUSwt_b "CAL_Scf_flgActvSubUSwt_b" VALUE 0x801434BF Scalar_BOOLEAN 0 BSW_A2L_Ident_Int 0 1 /end CHARACTERISTIC
/begin CHARACTERISTIC CAL_PcfDia_SpdHiHyst_f32 "CAL_PcfDia_SpdHiHyst_f32" VALUE 0x80143314 Scalar_FLOAT32_IEEE 0 BSW_A2L_Ident_Float -3.4E+38 3.4E+38 /end CHARACTERISTIC
/begin CHARACTERISTIC CAL_MDF_tiEMBlk_f32 "CAL_MDF_tiEMBlk_f32" VALUE 0x801414A8 Scalar_FLOAT32_IEEE 0 BSW_A2L_Ident_Float -3.4E+38 3.4E+38 /end CHARACTERISTIC
/begin CHARACTERISTIC CAL_RCF_nExtClbFrewhlFwd_f32 "CAL_RCF_nExtClbFrewhlFwd_f32" VALUE 0x801433EC Scalar_FLOAT32_IEEE 0 BSW_A2L_Ident_Float -3.4E+38 3.4E+38 /end CHARACTERISTIC
/begin CHARACTERISTIC CAL_RCF_nOfValBwdStp_f32 "CAL_RCF_nOfValBwdStp_f32" VALUE 0x801433D8 Scalar_FLOAT32_IEEE 0 BSW_A2L_Ident_Float -3.4E+38 3.4E+38 /end CHARACTERISTIC
/begin CHARACTERISTIC CAL_PcfCtl_PosKd_f32 "CAL_PcfCtl_PosKd_f32" VALUE 0x80143390 Scalar_FLOAT32_IEEE 0 BSW_A2L_Ident_Float -3.4E+38 3.4E+38 /end CHARACTERISTIC
/begin CHARACTERISTIC CAL_RCF_agReferenceFwd_f32 "CAL_RCF_agReferenceFwd_f32" VALUE 0x80143430 Scalar_FLOAT32_IEEE 0 BSW_A2L_Ident_Float -3.4E+38 3.4E+38 /end CHARACTERISTIC
/begin CHARACTERISTIC CAL_Scf_LowPwrSetUpSud_u8 "CAL_Scf_LowPwrSetUpSud_u8" VALUE 0x801434E1 Scalar_UBYTE 0 BSW_A2L_Ident_Int 0 255 /end CHARACTERISTIC
/begin CHARACTERISTIC CAL_MPC_nTrqMonMin_f32 "CAL_MPC_nTrqMonMin_f32" VALUE 0x801418D0 Scalar_FLOAT32_IEEE 0 BSW_A2L_Ident_Float -3.4E+38 3.4E+38 /end CHARACTERISTIC
/begin CHARACTERISTIC CAL_MDF_UsErrThres_f32 "CAL_MDF_UsErrThres_f32" VALUE 0x80141660 Scalar_FLOAT32_IEEE 0 BSW_A2L_Ident_Float -3.4E+38 3.4E+38 /end CHARACTERISTIC
/begin CHARACTERISTIC CAL_RCF_flgEnOfsClb_b "CAL_RCF_flgEnOfsClb_b" VALUE 0x8014341E Scalar_BOOLEAN 0 BSW_A2L_Ident_Int 0 1 /end CHARACTERISTIC
/begin CHARACTERISTIC CAL_RCF_nCalcSec1_f32 "CAL_RCF_nCalcSec1_f32" VALUE 0x80143414 Scalar_FLOAT32_IEEE 0 BSW_A2L_Ident_Float -3.4E+38 3.4E+38 /end CHARACTERISTIC
/begin CHARACTERISTIC CAL_PcfStm_flgUseSLC_b "CAL_PcfStm_flgUseSLC_b" VALUE 0x801430C0 Scalar_BOOLEAN 0 BSW_A2L_Ident_Int 0 1 /end CHARACTERISTIC
/begin CHARACTERISTIC CAL_RCF_flgUseClbSucNvm_b "CAL_RCF_flgUseClbSucNvm_b" VALUE 0x8014341C Scalar_BOOLEAN 0 BSW_A2L_Ident_Int 0 1 /end CHARACTERISTIC
/begin CHARACTERISTIC CAL_PcfSig_flgAimInPLimtSwt_b "CAL_PcfSig_flgAimInPLimtSwt_b" VALUE 0x801431D3 Scalar_BOOLEAN 0 BSW_A2L_Ident_Int 0 1 /end CHARACTERISTIC
/begin CHARACTERISTIC CAL_PcfDia_SLInPLimt_f32 "CAL_PcfDia_SLInPLimt_f32" VALUE 0x80143328 Scalar_FLOAT32_IEEE 0 BSW_A2L_Ident_Float -3.4E+38 3.4E+38 /end CHARACTERISTIC
/begin CHARACTERISTIC CAL_RCF_tMaxEstAlOfs1_u32 "CAL_RCF_tMaxEstAlOfs1_u32" VALUE 0x801433B8 Scalar_ULONG 0 BSW_A2L_Ident_Int 0 4294967295 /end CHARACTERISTIC
/begin CHARACTERISTIC CAL_MCF_DownLimitPIMotHeat_f32 "CAL_MCF_DownLimitPIMotHeat_f32" VALUE 0x801412E4 Scalar_FLOAT32_IEEE 0 BSW_A2L_Ident_Float -3.4E+38 3.4E+38 /end CHARACTERISTIC
/begin CHARACTERISTIC CAL_Scf_flgEmgDisChgReqSwt_b "CAL_Scf_flgEmgDisChgReqSwt_b" VALUE 0x801434BA Scalar_BOOLEAN 0 BSW_A2L_Ident_Int 0 1 /end CHARACTERISTIC
/begin CHARACTERISTIC CAL_RCF_OffsetAngFiltCoef_f32 "CAL_RCF_OffsetAngFiltCoef_f32" VALUE 0x8014344C Scalar_FLOAT32_IEEE 0 BSW_A2L_Ident_Float -3.4E+38 3.4E+38 /end CHARACTERISTIC
/begin CHARACTERISTIC CAL_PcfSig_IUBPcfFltCoe_f32 "CAL_PcfSig_IUBPcfFltCoe_f32" VALUE 0x801432B8 Scalar_FLOAT32_IEEE 0 BSW_A2L_Ident_Float -3.4E+38 3.4E+38 /end CHARACTERISTIC
/begin CHARACTERISTIC CAL_PcfCtl_intPIDdownlim_f32 "CAL_PcfCtl_intPIDdownlim_f32" VALUE 0x8014336C Scalar_FLOAT32_IEEE 0 BSW_A2L_Ident_Float -3.4E+38 3.4E+38 /end CHARACTERISTIC
/begin CHARACTERISTIC CAL_PcfDia_SLOutPDown_f32 "CAL_PcfDia_SLOutPDown_f32" VALUE 0x80143320 Scalar_FLOAT32_IEEE 0 BSW_A2L_Ident_Float -3.4E+38 3.4E+38 /end CHARACTERISTIC
/begin CHARACTERISTIC CAL_Scf_cntVCUComErrLim_u16 "CAL_Scf_cntVCUComErrLim_u16" VALUE 0x801434CE Scalar_UWORD 0 BSW_A2L_Ident_Int 0 65535 /end CHARACTERISTIC
/begin CHARACTERISTIC CAL_MPC_CofUdc_f32 "CAL_MPC_CofUdc_f32" VALUE 0x801430BC Scalar_FLOAT32_IEEE 0 BSW_A2L_Ident_Float -3.4E+38 3.4E+38 /end CHARACTERISTIC
/begin CHARACTERISTIC CAL_PcfStm_SLAccSpdUp_f32 "CAL_PcfStm_SLAccSpdUp_f32" VALUE 0x801430D8 Scalar_FLOAT32_IEEE 0 BSW_A2L_Ident_Float -3.4E+38 3.4E+38 /end CHARACTERISTIC
/begin CHARACTERISTIC CAL_Scf_uDisChgEnd_f32 "CAL_Scf_uDisChgEnd_f32" VALUE 0x80143478 Scalar_FLOAT32_IEEE 0 BSW_A2L_Ident_Float -3.4E+38 3.4E+38 /end CHARACTERISTIC
/begin CHARACTERISTIC CAL_MCF_UpLimitIMotHeat_f32 "CAL_MCF_UpLimitIMotHeat_f32" VALUE 0x80141070 Scalar_FLOAT32_IEEE 0 BSW_A2L_Ident_Float -3.4E+38 3.4E+38 /end CHARACTERISTIC
/begin CHARACTERISTIC CAL_PcfCtl_SLRunDir_b "CAL_PcfCtl_SLRunDir_b" VALUE 0x80143380 Scalar_BOOLEAN 0 BSW_A2L_Ident_Int 0 1 /end CHARACTERISTIC
/begin CHARACTERISTIC CAL_PcfSig_AimInPLimt_f32 "CAL_PcfSig_AimInPLimt_f32" VALUE 0x801432C4 Scalar_FLOAT32_IEEE 0 BSW_A2L_Ident_Float -3.4E+38 3.4E+38 /end CHARACTERISTIC
/begin CHARACTERISTIC CAL_PcfSig_flgIUBSwt_b "CAL_PcfSig_flgIUBSwt_b" VALUE 0x801431D0 Scalar_BOOLEAN 0 BSW_A2L_Ident_Int 0 1 /end CHARACTERISTIC
/begin CHARACTERISTIC CAL_MPC_nSetTrqMonMin_f32 "CAL_MPC_nSetTrqMonMin_f32" VALUE 0x801418D8 Scalar_FLOAT32_IEEE 0 BSW_A2L_Ident_Float -3.4E+38 3.4E+38 /end CHARACTERISTIC
/begin CHARACTERISTIC CAL_Scf_nSafeLoSpdMinLim_f32 "CAL_Scf_nSafeLoSpdMinLim_f32" VALUE 0x80143498 Scalar_FLOAT32_IEEE 0 BSW_A2L_Ident_Float -3.4E+38 3.4E+38 /end CHARACTERISTIC
/begin CHARACTERISTIC CAL_PcfDia_flgRetry_b "CAL_PcfDia_flgRetry_b" VALUE 0x801432E8 Scalar_BOOLEAN 0 BSW_A2L_Ident_Int 0 1 /end CHARACTERISTIC
/begin CHARACTERISTIC CAL_MDF_UsFrwhlMax_f32 "CAL_MDF_UsFrwhlMax_f32" VALUE 0x8014165C Scalar_FLOAT32_IEEE 0 BSW_A2L_Ident_Float -3.4E+38 3.4E+38 /end CHARACTERISTIC
/begin CHARACTERISTIC CAL_Scf_SenChkSud_u8 "CAL_Scf_SenChkSud_u8" VALUE 0x801434DF Scalar_UBYTE 0 BSW_A2L_Ident_Int 0 255 /end CHARACTERISTIC
/begin CHARACTERISTIC CAL_Scf_flgCanNmSwt_b "CAL_Scf_flgCanNmSwt_b" VALUE 0x801434BD Scalar_BOOLEAN 0 BSW_A2L_Ident_Int 0 1 /end CHARACTERISTIC
/begin CHARACTERISTIC CAL_RCF_nCalcSec5_f32 "CAL_RCF_nCalcSec5_f32" VALUE 0x80143404 Scalar_FLOAT32_IEEE 0 BSW_A2L_Ident_Float -3.4E+38 3.4E+38 /end CHARACTERISTIC
/begin CHARACTERISTIC CAL_Scf_cntDchaSigFit_u8 "CAL_Scf_cntDchaSigFit_u8" VALUE 0x801434D6 Scalar_UBYTE 0 BSW_A2L_Ident_Int 0 255 /end CHARACTERISTIC
/begin CHARACTERISTIC CAL_Scf_udcPrechgFail_f32 "CAL_Scf_udcPrechgFail_f32" VALUE 0x80143460 Scalar_FLOAT32_IEEE 0 BSW_A2L_Ident_Float -3.4E+38 3.4E+38 /end CHARACTERISTIC
/begin CHARACTERISTIC CAL_PcfDia_UdcMotUVSet_f32 "CAL_PcfDia_UdcMotUVSet_f32" VALUE 0x80143300 Scalar_FLOAT32_IEEE 0 BSW_A2L_Ident_Float -3.4E+38 3.4E+38 /end CHARACTERISTIC
/begin CHARACTERISTIC CAL_MPC_Ld_f32 "CAL_MPC_Ld_f32" VALUE 0x801427C0 Scalar_FLOAT32_IEEE 0 BSW_A2L_Ident_Float -3.4E+38 3.4E+38 /end CHARACTERISTIC
/begin CHARACTERISTIC CAL_RCF_tMaxFwlBwd_u16 "CAL_RCF_tMaxFwlBwd_u16" VALUE 0x801433B2 Scalar_UWORD 0 BSW_A2L_Ident_Int 0 65535 /end CHARACTERISTIC
/begin CHARACTERISTIC CAL_MPC_idActCutOffFrq_f32 "CAL_MPC_idActCutOffFrq_f32" VALUE 0x80141E70 Scalar_FLOAT32_IEEE 0 BSW_A2L_Ident_Float -3.4E+38 3.4E+38 /end CHARACTERISTIC
/begin CHARACTERISTIC CAL_PcfCtl_ManualDir_b "CAL_PcfCtl_ManualDir_b" VALUE 0x8014339C Scalar_BOOLEAN 0 BSW_A2L_Ident_Int 0 1 /end CHARACTERISTIC
/begin CHARACTERISTIC CAL_PcfDia_tRetry_u16 "CAL_PcfDia_tRetry_u16" VALUE 0x801432C8 Scalar_UWORD 0 BSW_A2L_Ident_Int 0 65535 /end CHARACTERISTIC
/begin CHARACTERISTIC CAL_Scf_flgActvSubNSwt_b "CAL_Scf_flgActvSubNSwt_b" VALUE 0x801434C0 Scalar_BOOLEAN 0 BSW_A2L_Ident_Int 0 1 /end CHARACTERISTIC
/begin CHARACTERISTIC CAL_MDF_pwrDcDiaMin_f32 "CAL_MDF_pwrDcDiaMin_f32" VALUE 0x801414C4 Scalar_FLOAT32_IEEE 0 BSW_A2L_Ident_Float -3.4E+38 3.4E+38 /end CHARACTERISTIC
/begin CHARACTERISTIC CAL_RCF_nCalcSec6_f32 "CAL_RCF_nCalcSec6_f32" VALUE 0x80143400 Scalar_FLOAT32_IEEE 0 BSW_A2L_Ident_Float -3.4E+38 3.4E+38 /end CHARACTERISTIC
/begin CHARACTERISTIC CAL_MCF_flgMotHeat_b "CAL_MCF_flgMotHeat_b" VALUE 0x80140FED Scalar_BOOLEAN 0 BSW_A2L_Ident_Int 0 1 /end CHARACTERISTIC
/begin CHARACTERISTIC CAL_PcfCtl_flgFnh_b "CAL_PcfCtl_flgFnh_b" VALUE 0x80143371 Scalar_BOOLEAN 0 BSW_A2L_Ident_Int 0 1 /end CHARACTERISTIC
/begin CHARACTERISTIC CAL_PcfDia_SLInPDown_f32 "CAL_PcfDia_SLInPDown_f32" VALUE 0x8014332C Scalar_FLOAT32_IEEE 0 BSW_A2L_Ident_Float -3.4E+38 3.4E+38 /end CHARACTERISTIC
/begin CHARACTERISTIC CAL_cofPowerLimitMotHeat_af32 "" CURVE 0x80140EF0 Lookup1D_FLOAT32_IEEE 0 SWC_MCF_CM_single -3.4E+38 3.4E+38
 /begin AXIS_DESCR COM_AXIS NO_INPUT_QUANTITY SWC_MCF_CM_single 9 -3.4E+38 3.4E+38 AXIS_PTS_REF CAL_tStrrTempFltMotHeat_af32 /end AXIS_DESCR
/end CHARACTERISTIC
/begin CHARACTERISTIC CAL_MCF_TrqOffActiveHeat_af32 "" CURVE 0x8014107C Lookup1D_FLOAT32_IEEE 0 SWC_MCF_CM_single -3.4E+38 3.4E+38
 /begin AXIS_DESCR COM_AXIS NO_INPUT_QUANTITY SWC_MCF_CM_single 9 -3.4E+38 3.4E+38 AXIS_PTS_REF CAL_MCF_SpdActiveHeat_af32 /end AXIS_DESCR
/end CHARACTERISTIC
/begin CHARACTERISTIC CAL_MDF_PwrLoss_Z_af32 "" MAP 0x80141670 Lookup2D_FLOAT32_IEEE 0 SWC_MDF_CM_single -3.4E+38 3.4E+38
 /begin AXIS_DESCR COM_AXIS NO_INPUT_QUANTITY SWC_MDF_CM_single 2 -3.4E+38 3.4E+38 AXIS_PTS_REF CAL_MDF_PwrLoss_Y_af32 /end AXIS_DESCR
 /begin AXIS_DESCR COM_AXIS NO_INPUT_QUANTITY SWC_MDF_CM_single 2 -3.4E+38 3.4E+38 AXIS_PTS_REF CAL_MDF_PwrLoss_X_af32 /end AXIS_DESCR
/end CHARACTERISTIC
/begin CHARACTERISTIC CAL_MDF_cofnAbsPhaseFault_Y_af32 "" CURVE 0x801415A0 Lookup1D_FLOAT32_IEEE 0 SWC_MDF_CM_single -3.4E+38 3.4E+38
 /begin AXIS_DESCR COM_AXIS NO_INPUT_QUANTITY SWC_MDF_CM_single 46 -3.4E+38 3.4E+38 AXIS_PTS_REF CAL_MDF_nAbsPhaseFault_X_af32 /end AXIS_DESCR
/end CHARACTERISTIC
/begin CHARACTERISTIC CAL_MPC_LdSubLqCAzGen_af32 "" MAP 0x80142BFC Lookup2D_FLOAT32_IEEE 0 SWC_MPC_CM_single -3.4E+38 3.4E+38
 /begin AXIS_DESCR COM_AXIS NO_INPUT_QUANTITY SWC_MPC_CM_single 15 -3.4E+38 3.4E+38 AXIS_PTS_REF CAL_MPC_LdSubLqCAy_af32 /end AXIS_DESCR
 /begin AXIS_DESCR COM_AXIS NO_INPUT_QUANTITY SWC_MPC_CM_single 18 -3.4E+38 3.4E+38 AXIS_PTS_REF CAL_MPC_LdSubLqCAx_af32 /end AXIS_DESCR
/end CHARACTERISTIC
/begin CHARACTERISTIC CAL_MPC_LdSubLqCAzMot_af32 "" MAP 0x801427C4 Lookup2D_FLOAT32_IEEE 0 SWC_MPC_CM_single -3.4E+38 3.4E+38
 /begin AXIS_DESCR COM_AXIS NO_INPUT_QUANTITY SWC_MPC_CM_single 15 -3.4E+38 3.4E+38 AXIS_PTS_REF CAL_MPC_LdSubLqCAy_af32 /end AXIS_DESCR
 /begin AXIS_DESCR COM_AXIS NO_INPUT_QUANTITY SWC_MPC_CM_single 18 -3.4E+38 3.4E+38 AXIS_PTS_REF CAL_MPC_LdSubLqCAx_af32 /end AXIS_DESCR
/end CHARACTERISTIC
/begin CHARACTERISTIC CAL_MPC_cofRpwm_Y_af32 "Ëæ»úPWMÆµÂÊÏµÊý²é±íXÖá×ªËÙ" CURVE 0x80142114 Lookup1D_FLOAT32_IEEE 0 SWC_MPC_CM_single -3.4E+38 3.4E+38
 /begin AXIS_DESCR COM_AXIS NO_INPUT_QUANTITY SWC_MPC_CM_single 17 -3.4E+38 3.4E+38 AXIS_PTS_REF CAL_MPC_nCofRpwm_X_af32 /end AXIS_DESCR
/end CHARACTERISTIC
/begin CHARACTERISTIC CAL_MPC_frqPwmVFTableZ_Frq_af32 "±äÔØÆµ²é±íZÖáÔØÆµÆµÂÊ" MAP 0x80141E74 Lookup2D_FLOAT32_IEEE 0 SWC_MPC_CM_single -3.4E+38 3.4E+38
 /begin AXIS_DESCR COM_AXIS NO_INPUT_QUANTITY SWC_MPC_CM_single 11 0.0 1000.0 AXIS_PTS_REF CAL_MPC_frqPwmVFTableX_Is_af32 /end AXIS_DESCR
 /begin AXIS_DESCR COM_AXIS NO_INPUT_QUANTITY SWC_MPC_CM_single 13 0.0 1.15 AXIS_PTS_REF CAL_MPC_frqPwmVFTableY_VoltModuRate_af32 /end AXIS_DESCR
/end CHARACTERISTIC
/begin CHARACTERISTIC CAL_MPC_MtpaTableY_isd_af32 "" CURVE 0x80142744 Lookup1D_FLOAT32_IEEE 0 SWC_MPC_CM_single -3.4E+38 3.4E+38
 /begin AXIS_DESCR COM_AXIS NO_INPUT_QUANTITY SWC_MPC_CM_single 15 -3.4E+38 3.4E+38 AXIS_PTS_REF CAL_MPC_MtpaTableX_Trq_af32 /end AXIS_DESCR
/end CHARACTERISTIC
/begin CHARACTERISTIC CAL_MPC_OmbwTableY_Ombw_af32 "" CURVE 0x801421C0 Lookup1D_FLOAT32_IEEE 0 SWC_MPC_CM_single -3.4E+38 3.4E+38
 /begin AXIS_DESCR COM_AXIS NO_INPUT_QUANTITY SWC_MPC_CM_single 11 -3.4E+38 3.4E+38 AXIS_PTS_REF CAL_MPC_OmbwTableX_Spd_af32 /end AXIS_DESCR
/end CHARACTERISTIC
/begin CHARACTERISTIC CAL_MPC_RvTableY_Rv_af32 "" CURVE 0x8014215C Lookup1D_FLOAT32_IEEE 0 SWC_MPC_CM_single -3.4E+38 3.4E+38
 /begin AXIS_DESCR COM_AXIS NO_INPUT_QUANTITY SWC_MPC_CM_single 11 -3.4E+38 3.4E+38 AXIS_PTS_REF CAL_MPC_RvTableX_Spd_af32 /end AXIS_DESCR
/end CHARACTERISTIC
/begin CHARACTERISTIC CAL_MPC_isdFFTableY_UdcCof_af32 "" CURVE 0x80141DA4 Lookup1D_FLOAT32_IEEE 0 SWC_MPC_CM_single -3.4E+38 3.4E+38
 /begin AXIS_DESCR COM_AXIS NO_INPUT_QUANTITY SWC_MPC_CM_single 8 -3.4E+38 3.4E+38 AXIS_PTS_REF CAL_MPC_isdFFTableX_Udc_af32 /end AXIS_DESCR
/end CHARACTERISTIC
/begin CHARACTERISTIC CAL_MPC_isdFFTableZ_isd_af32 "" MAP 0x80141920 Lookup2D_FLOAT32_IEEE 0 SWC_MPC_CM_single -3.4E+38 3.4E+38
 /begin AXIS_DESCR COM_AXIS NO_INPUT_QUANTITY SWC_MPC_CM_single 17 -3.4E+38 3.4E+38 AXIS_PTS_REF CAL_MPC_isdFFTableY_Trq_af32 /end AXIS_DESCR
 /begin AXIS_DESCR COM_AXIS NO_INPUT_QUANTITY SWC_MPC_CM_single 17 -3.4E+38 3.4E+38 AXIS_PTS_REF CAL_MPC_isdFFTableX_Spd_af32 /end AXIS_DESCR
/end CHARACTERISTIC
/begin CHARACTERISTIC CAL_MPC_MtpvTableZ_idGen_af32 "" MAP 0x80142478 Lookup2D_FLOAT32_IEEE 0 SWC_MPC_CM_single -3.4E+38 3.4E+38
 /begin AXIS_DESCR COM_AXIS NO_INPUT_QUANTITY SWC_MPC_CM_single 19 -3.4E+38 3.4E+38 AXIS_PTS_REF CAL_MPC_MtpvTableY_N_af32 /end AXIS_DESCR
 /begin AXIS_DESCR COM_AXIS NO_INPUT_QUANTITY SWC_MPC_CM_single 8 -3.4E+38 3.4E+38 AXIS_PTS_REF CAL_MPC_MtpvTableX_Udc_af32 /end AXIS_DESCR
/end CHARACTERISTIC
/begin CHARACTERISTIC CAL_MPC_MtpvTableZ_idMot_af32 "" MAP 0x80142218 Lookup2D_FLOAT32_IEEE 0 SWC_MPC_CM_single -3.4E+38 3.4E+38
 /begin AXIS_DESCR COM_AXIS NO_INPUT_QUANTITY SWC_MPC_CM_single 19 -3.4E+38 3.4E+38 AXIS_PTS_REF CAL_MPC_MtpvTableY_N_af32 /end AXIS_DESCR
 /begin AXIS_DESCR COM_AXIS NO_INPUT_QUANTITY SWC_MPC_CM_single 8 -3.4E+38 3.4E+38 AXIS_PTS_REF CAL_MPC_MtpvTableX_Udc_af32 /end AXIS_DESCR
/end CHARACTERISTIC
/begin CHARACTERISTIC CAL_MPC_tCpnBwdGenTableY_tCpn_af32 "ºóÍË·¢µç²é±í¿ª¹ÜÊ±¼ä²¹³¥YÖáÐÞÕýÊ±¼ä" CURVE 0x80141850 Lookup1D_FLOAT32_IEEE 0 SWC_MPC_CM_single -3.4E+38 3.4E+38
 /begin AXIS_DESCR COM_AXIS NO_INPUT_QUANTITY SWC_MPC_CM_single 16 -3.4E+38 3.4E+38 AXIS_PTS_REF CAL_MPC_tCpnBwdGenTableX_n_af32 /end AXIS_DESCR
/end CHARACTERISTIC
/begin CHARACTERISTIC CAL_MPC_tCpnBwdMotTableY_tCpn_af32 "ºóÍËµç¶¯²é±í¿ª¹ÜÊ±¼ä²¹³¥YÖáÐÞÕýÊ±¼ä" CURVE 0x801417D0 Lookup1D_FLOAT32_IEEE 0 SWC_MPC_CM_single -3.4E+38 3.4E+38
 /begin AXIS_DESCR COM_AXIS NO_INPUT_QUANTITY SWC_MPC_CM_single 16 -3.4E+38 3.4E+38 AXIS_PTS_REF CAL_MPC_tCpnBwdMotTableX_n_af32 /end AXIS_DESCR
/end CHARACTERISTIC
/begin CHARACTERISTIC CAL_MPC_tCpnFwdGenTableY_tCpn_af32 "Ç°½ø·¢µç²é±í¿ª¹ÜÊ±¼ä²¹³¥YÖáÐÞÕýÊ±¼ä" CURVE 0x80141750 Lookup1D_FLOAT32_IEEE 0 SWC_MPC_CM_single -3.4E+38 3.4E+38
 /begin AXIS_DESCR COM_AXIS NO_INPUT_QUANTITY SWC_MPC_CM_single 16 -3.4E+38 3.4E+38 AXIS_PTS_REF CAL_MPC_tCpnFwdGenTableX_n_af32 /end AXIS_DESCR
/end CHARACTERISTIC
/begin CHARACTERISTIC CAL_MPC_tCpnFwdMotTableY_tCpn_af32 "Ç°½øµç¶¯²é±í¿ª¹ÜÊ±¼ä²¹³¥YÖáÐÞÕýÊ±¼ä" CURVE 0x801416D0 Lookup1D_FLOAT32_IEEE 0 SWC_MPC_CM_single -3.4E+38 3.4E+38
 /begin AXIS_DESCR COM_AXIS NO_INPUT_QUANTITY SWC_MPC_CM_single 16 -3.4E+38 3.4E+38 AXIS_PTS_REF CAL_MPC_tCpnFwdMotTableX_n_af32 /end AXIS_DESCR
/end CHARACTERISTIC
/begin CHARACTERISTIC CAL_PcfSig_IdcDycX_Idc_af32 "µçÁ÷ÏÞÕ¼¿Õ±È²é±í" CURVE 0x801432A4 Lookup1D_FLOAT32_IEEE 0 SWC_PCF_CM_single -3.4E+38 3.4E+38
 /begin AXIS_DESCR COM_AXIS VAR_PcfSig_IdcPcf_f32 SWC_PCF_CM_single 4 -3.4E+38 3.4E+38 AXIS_PTS_REF CAL_PcfSig_IdcDycY_dyc_af32 /end AXIS_DESCR
/end CHARACTERISTIC
/begin CHARACTERISTIC CAL_PcfSig_UdcDycX_Udc_af32 "UKL30ÏÞÕ¼¿Õ±È²é±í" CURVE 0x80143238 Lookup1D_FLOAT32_IEEE 0 SWC_PCF_CM_single -3.4E+38 3.4E+38
 /begin AXIS_DESCR COM_AXIS VAR_PcfSig_UBRPcf_f32 SWC_PCF_CM_single 20 -3.4E+38 3.4E+38 AXIS_PTS_REF CAL_PcfSig_UdcDycY_dyc_af32 /end AXIS_DESCR
/end CHARACTERISTIC
/begin CHARACTERISTIC CAL_PcfSig_tMosDycX_tMos_af32 "Mos¹ÜÎÂ¶ÈÏÞÕ¼¿Õ±È²é±í" CURVE 0x80143198 Lookup1D_FLOAT32_IEEE 0 SWC_PCF_CM_single -3.4E+38 3.4E+38
 /begin AXIS_DESCR COM_AXIS VAR_PcfSig_nPcfMot_f32 SWC_PCF_CM_single 6 -3.4E+38 3.4E+38 AXIS_PTS_REF CAL_PcfSig_tMosDycY_dyc_af32 /end AXIS_DESCR
/end CHARACTERISTIC
/begin CHARACTERISTIC CAL_PcfSig_tMosiSENcof_tCof_af32 "Mos¹ÜÎÂ¶ÈµçÁ÷²¹³¥ÏµÊý²é±í" CURVE 0x80143158 Lookup1D_FLOAT32_IEEE 0 SWC_PCF_CM_single -3.4E+38 3.4E+38
 /begin AXIS_DESCR COM_AXIS VAR_PcfSig_tMosPcf_f32 SWC_PCF_CM_single 10 -3.4E+38 3.4E+38 AXIS_PTS_REF CAL_PcfSig_tMosiSENcof_tMos_af32 /end AXIS_DESCR
/end CHARACTERISTIC
/begin CHARACTERISTIC CAL_PcfSig_tMosiSENofs_tCof_af32 "" CURVE 0x80143108 Lookup1D_FLOAT32_IEEE 0 SWC_PCF_CM_single -3.4E+38 3.4E+38
 /begin AXIS_DESCR COM_AXIS VAR_PcfSig_tMosPcf_f32 SWC_PCF_CM_single 10 -3.4E+38 3.4E+38 AXIS_PTS_REF CAL_PcfSig_tMosiSENofs_tMos_af32 /end AXIS_DESCR
/end CHARACTERISTIC
/begin AXIS_PTS CAL_tStrrTempFltMotHeat_af32 "" 0x80140ECC NO_INPUT_QUANTITY Lookup1D_X_FLOAT32_IEEE 0 SWC_MCF_CM_single 9 -3.4E+38 3.4E+38 /end AXIS_PTS
/begin AXIS_PTS CAL_MCF_SpdActiveHeat_af32 "" 0x801410B0 NO_INPUT_QUANTITY Lookup1D_X_FLOAT32_IEEE 0 SWC_MCF_CM_single 9 -3.4E+38 3.4E+38 /end AXIS_PTS
/begin AXIS_PTS CAL_MDF_PwrLoss_X_af32 "" 0x80141688 NO_INPUT_QUANTITY Lookup2D_X_FLOAT32_IEEE 0 SWC_MDF_CM_single 2 -3.4E+38 3.4E+38 /end AXIS_PTS
/begin AXIS_PTS CAL_MDF_PwrLoss_Y_af32 "" 0x80141680 NO_INPUT_QUANTITY Lookup2D_X_FLOAT32_IEEE 0 SWC_MDF_CM_single 2 -3.4E+38 3.4E+38 /end AXIS_PTS
/begin AXIS_PTS CAL_MDF_nAbsPhaseFault_X_af32 "" 0x801414E8 NO_INPUT_QUANTITY Lookup1D_X_FLOAT32_IEEE 0 SWC_MDF_CM_single 46 -3.4E+38 3.4E+38 /end AXIS_PTS
/begin AXIS_PTS CAL_MPC_LdSubLqCAx_af32 "" 0x80143070 NO_INPUT_QUANTITY Lookup2D_X_FLOAT32_IEEE 0 SWC_MPC_CM_single 18 -3.4E+38 3.4E+38 /end AXIS_PTS
/begin AXIS_PTS CAL_MPC_LdSubLqCAy_af32 "" 0x80143034 NO_INPUT_QUANTITY Lookup2D_X_FLOAT32_IEEE 0 SWC_MPC_CM_single 15 -3.4E+38 3.4E+38 /end AXIS_PTS
/begin AXIS_PTS CAL_MPC_nCofRpwm_X_af32 "Ëæ»úPWMÆµÂÊÏµÊý²é±íYÖáÆµÂÊÏµÊýÖµ" 0x801418DC NO_INPUT_QUANTITY Lookup1D_X_FLOAT32_IEEE 0 SWC_MPC_CM_single 17 -3.4E+38 3.4E+38 /end AXIS_PTS
/begin AXIS_PTS CAL_MPC_frqPwmVFTableY_VoltModuRate_af32 "±äÔØÆµ²é±íYÖáµçÑ¹µ÷ÖÆ¶È" 0x801420B0 NO_INPUT_QUANTITY Lookup2D_X_FLOAT32_IEEE 0 SWC_MPC_CM_single 13 0.0 1.15 /end AXIS_PTS
/begin AXIS_PTS CAL_MPC_frqPwmVFTableX_Is_af32 "±äÔØÆµ²é±íXÖáÏàµçÁ÷·ùÖµ" 0x801420E4 NO_INPUT_QUANTITY Lookup2D_X_FLOAT32_IEEE 0 SWC_MPC_CM_single 11 0.0 1000.0 /end AXIS_PTS
/begin AXIS_PTS CAL_MPC_MtpaTableX_Trq_af32 "" 0x80142780 NO_INPUT_QUANTITY Lookup1D_X_FLOAT32_IEEE 0 SWC_MPC_CM_single 15 -3.4E+38 3.4E+38 /end AXIS_PTS
/begin AXIS_PTS CAL_MPC_OmbwTableX_Spd_af32 "" 0x801421EC NO_INPUT_QUANTITY Lookup1D_X_FLOAT32_IEEE 0 SWC_MPC_CM_single 11 -3.4E+38 3.4E+38 /end AXIS_PTS
/begin AXIS_PTS CAL_MPC_RvTableX_Spd_af32 "" 0x80142188 NO_INPUT_QUANTITY Lookup1D_X_FLOAT32_IEEE 0 SWC_MPC_CM_single 11 -3.4E+38 3.4E+38 /end AXIS_PTS
/begin AXIS_PTS CAL_MPC_isdFFTableX_Udc_af32 "" 0x80141E08 NO_INPUT_QUANTITY Lookup1D_X_FLOAT32_IEEE 0 SWC_MPC_CM_single 8 -3.4E+38 3.4E+38 /end AXIS_PTS
/begin AXIS_PTS CAL_MPC_isdFFTableX_Spd_af32 "" 0x80141E28 NO_INPUT_QUANTITY Lookup2D_X_FLOAT32_IEEE 0 SWC_MPC_CM_single 17 -3.4E+38 3.4E+38 /end AXIS_PTS
/begin AXIS_PTS CAL_MPC_isdFFTableY_Trq_af32 "" 0x80141DC4 NO_INPUT_QUANTITY Lookup2D_X_FLOAT32_IEEE 0 SWC_MPC_CM_single 17 -3.4E+38 3.4E+38 /end AXIS_PTS
/begin AXIS_PTS CAL_MPC_MtpvTableX_Udc_af32 "" 0x80142724 NO_INPUT_QUANTITY Lookup2D_X_FLOAT32_IEEE 0 SWC_MPC_CM_single 8 -3.4E+38 3.4E+38 /end AXIS_PTS
/begin AXIS_PTS CAL_MPC_MtpvTableY_N_af32 "" 0x801426D8 NO_INPUT_QUANTITY Lookup2D_X_FLOAT32_IEEE 0 SWC_MPC_CM_single 19 -3.4E+38 3.4E+38 /end AXIS_PTS
/begin AXIS_PTS CAL_MPC_tCpnBwdGenTableX_n_af32 "ºóÍË·¢µç²é±í¿ª¹ÜÊ±¼ä²¹³¥XÖáËÙ¶È" 0x80141890 NO_INPUT_QUANTITY Lookup1D_X_FLOAT32_IEEE 0 SWC_MPC_CM_single 16 -3.4E+38 3.4E+38 /end AXIS_PTS
/begin AXIS_PTS CAL_MPC_tCpnBwdMotTableX_n_af32 "ºóÍËµç¶¯²é±í¿ª¹ÜÊ±¼ä²¹³¥XÖáËÙ¶È" 0x80141810 NO_INPUT_QUANTITY Lookup1D_X_FLOAT32_IEEE 0 SWC_MPC_CM_single 16 -3.4E+38 3.4E+38 /end AXIS_PTS
/begin AXIS_PTS CAL_MPC_tCpnFwdGenTableX_n_af32 "Ç°½ø·¢µç²é±í¿ª¹ÜÊ±¼ä²¹³¥XÖáËÙ¶È" 0x80141790 NO_INPUT_QUANTITY Lookup1D_X_FLOAT32_IEEE 0 SWC_MPC_CM_single 16 -3.4E+38 3.4E+38 /end AXIS_PTS
/begin AXIS_PTS CAL_MPC_tCpnFwdMotTableX_n_af32 "Ç°½øµç¶¯²é±í¿ª¹ÜÊ±¼ä²¹³¥XÖáËÙ¶È" 0x80141710 NO_INPUT_QUANTITY Lookup1D_X_FLOAT32_IEEE 0 SWC_MPC_CM_single 16 -3.4E+38 3.4E+38 /end AXIS_PTS
/begin AXIS_PTS CAL_PcfSig_IdcDycY_dyc_af32 "µçÁ÷ÏÞÕ¼¿Õ±ÈãÐÖµ" 0x80143294 VAR_PcfSig_IdcPcf_f32 Lookup1D_X_FLOAT32_IEEE 0 SWC_PCF_CM_single 4 -3.4E+38 3.4E+38 /end AXIS_PTS
/begin AXIS_PTS CAL_PcfSig_UdcDycY_dyc_af32 "UKL30ÏÞÕ¼¿Õ±ÈãÐÖµ" 0x801431E8 VAR_PcfSig_UBRPcf_f32 Lookup1D_X_FLOAT32_IEEE 0 SWC_PCF_CM_single 20 -3.4E+38 3.4E+38 /end AXIS_PTS
/begin AXIS_PTS CAL_PcfSig_tMosDycY_dyc_af32 "Mos¹ÜÎÂ¶ÈÏÞÕ¼¿Õ±ÈãÐÖµ" 0x80143180 VAR_PcfSig_nPcfMot_f32 Lookup1D_X_FLOAT32_IEEE 0 SWC_PCF_CM_single 6 -3.4E+38 3.4E+38 /end AXIS_PTS
/begin AXIS_PTS CAL_PcfSig_tMosiSENcof_tMos_af32 "Mos¹ÜÎÂ¶ÈµçÁ÷²¹³¥ÏµÊýãÐÖµ" 0x80143130 VAR_PcfSig_tMosPcf_f32 Lookup1D_X_FLOAT32_IEEE 0 SWC_PCF_CM_single 10 -3.4E+38 3.4E+38 /end AXIS_PTS
/begin AXIS_PTS CAL_PcfSig_tMosiSENofs_tMos_af32 "EPC¹¤×÷µçÁ÷ADÆ«ÒÆÏµÊý" 0x801430E0 VAR_PcfSig_tMosPcf_f32 Lookup1D_X_FLOAT32_IEEE 0 SWC_PCF_CM_single 10 -3.4E+38 3.4E+38 /end AXIS_PTS
/begin GROUP S38_First_LowPass "SWC_MCF/RE_SWC_MCF_100us_sys/Subsystem/McFwc/McFwc/idqDes/FluxWeakeningLoop/GetisdDesFw/Subsystem1/Subsystem/First_LowPass" /begin REF_CHARACTERISTIC CAL_MCF_cofFltPowerHeat_f32 /end REF_CHARACTERISTIC /end GROUP
/begin GROUP S39_Subsystem1 "SWC_MCF/RE_SWC_MCF_100us_sys/Subsystem/McFwc/McFwc/idqDes/FluxWeakeningLoop/GetisdDesFw/Subsystem1/Subsystem4/Subsystem1"
 /begin REF_CHARACTERISTIC CAL_MCF_UpPowerHeat_f32 CAL_PowerMotHeat_f32 CAL_cofPowerLimitMotHeat_af32 /end REF_CHARACTERISTIC
 /begin REF_MEASUREMENT VAR_MCF_PCUHeaterPower_f32 VAR_MCF_PowerDcLnk_f32 VAR_MCF_PowerMech_f32 VAR_MCF_PowerMotHeat_f32 /end REF_MEASUREMENT
/end GROUP
/begin GROUP S39_Subsystem2 "SWC_MCF/RE_SWC_MCF_100us_sys/Subsystem/McFwc/McFwc/idqDes/FluxWeakeningLoop/GetisdDesFw/Subsystem1/Subsystem4/Subsystem2"
 /begin REF_CHARACTERISTIC CAL_MCF_DownLimitIMotHeat_f32 CAL_MCF_DownLimitPIMotHeat_f32 CAL_MCF_KiMotHeat_f32 CAL_MCF_KpMotHeat_f32 CAL_MCF_UpLimitIMotHeat_f32 CAL_MCF_UpLimitPIMotHeat_f32 /end REF_CHARACTERISTIC
/end GROUP
/begin GROUP S40_Subsystem "SWC_MCF/RE_SWC_MCF_100us_sys/Subsystem/McFwc/McFwc/idqDes/FluxWeakeningLoop/GetisdDesFw/Subsystem1/Subsystem5/Subsystem" /begin REF_CHARACTERISTIC CAL_MCF_flgMotHeat_b /end REF_CHARACTERISTIC /begin REF_MEASUREMENT VAR_MCF_flgMotHeat_b /end REF_MEASUREMENT /end GROUP
/begin GROUP S40_Subsystem4 "SWC_MCF/RE_SWC_MCF_100us_sys/Subsystem/McFwc/McFwc/idqDes/FluxWeakeningLoop/GetisdDesFw/Subsystem1/Subsystem5/Subsystem4" /begin REF_CHARACTERISTIC CAL_MCF_SpdOffActiveHeat_f32 CAL_MCF_TrqOffActiveHeat_af32 /end REF_CHARACTERISTIC /end GROUP
/begin GROUP SWC_MDF "SWC_MDF" ROOT /begin SUB_GROUP Root_RE_SWC_MDF_10ms_sys /end SUB_GROUP /end GROUP
/begin GROUP Root_RE_SWC_MDF_10ms_sys "SWC_MDF/RE_SWC_MDF_10ms_sys"
 /begin REF_MEASUREMENT VAR_MDF_AlOfsNoPlausState_u8 VAR_MDF_DiashCirNoPsblState_u8 VAR_MDF_EmacBlkdState_u8 VAR_MDF_ICtlRatState_u8 VAR_MDF_OpenCirNoPsblState_u8 VAR_MDF_OperOutdRngState_u8 VAR_MDF_PhaseFaultState_u8 VAR_MDF_PrfElDrvState_u8 /end REF_MEASUREMENT
 /begin SUB_GROUP S1_Subsystem /end SUB_GROUP
/end GROUP
/begin GROUP S3_MDF_Fuc "SWC_MDF/RE_SWC_MDF_10ms_sys/Subsystem/MDF_Fuc"
 /begin SUB_GROUP S4_DiaAlOfsNoPlaus S4_DiaEMBlk S4_DiaICtlRat S4_DiaIsMax S4_DiaOpenCirNoPsbl S4_DiaOperOutdRng S4_DiaPhaseFault S4_DiaPrfElDrv S4_DiaShCirNoPsbl /end SUB_GROUP
/end GROUP
/begin GROUP S3_MDF_ParaCalc "SWC_MDF/RE_SWC_MDF_10ms_sys/Subsystem/MDF_ParaCalc" /begin SUB_GROUP S5_FreewheelCalc S5_mdf_DiaElDrvCalc S5_pwrlossCalc /end SUB_GROUP /end GROUP
/begin GROUP S4_DiaAlOfsNoPlaus "SWC_MDF/RE_SWC_MDF_10ms_sys/Subsystem/MDF_Fuc/DiaAlOfsNoPlaus" /begin SUB_GROUP S6_DFCFlag S6_OfsNoPlausFaultCalc S6_mdf_tanDelta_Calc /end SUB_GROUP /end GROUP
/begin GROUP S4_DiaEMBlk "SWC_MDF/RE_SWC_MDF_10ms_sys/Subsystem/MDF_Fuc/DiaEMBlk" /begin SUB_GROUP S7_DFCFlag S7_EMBlk /end SUB_GROUP /end GROUP
/begin GROUP S4_DiaICtlRat "SWC_MDF/RE_SWC_MDF_10ms_sys/Subsystem/MDF_Fuc/DiaICtlRat" /begin SUB_GROUP S8_DFCFlag S8_iCtlJudge /end SUB_GROUP /end GROUP
/begin GROUP S4_DiaIsMax "SWC_MDF/RE_SWC_MDF_10ms_sys/Subsystem/MDF_Fuc/DiaIsMax" /begin SUB_GROUP S9_Subsystem /end SUB_GROUP /end GROUP
/begin GROUP S4_DiaOpenCirNoPsbl "SWC_MDF/RE_SWC_MDF_10ms_sys/Subsystem/MDF_Fuc/DiaOpenCirNoPsbl" /begin SUB_GROUP S10_DFCFlag S10_OpenCirNoPsblCalc /end SUB_GROUP /end GROUP
/begin GROUP S4_DiaOperOutdRng "SWC_MDF/RE_SWC_MDF_10ms_sys/Subsystem/MDF_Fuc/DiaOperOutdRng" /begin SUB_GROUP S11_DFCFlag S11_OperOutdRngFltCalc /end SUB_GROUP /end GROUP
/begin GROUP S4_DiaPhaseFault "SWC_MDF/RE_SWC_MDF_10ms_sys/Subsystem/MDF_Fuc/DiaPhaseFault" /begin SUB_GROUP S12_DFCFlag S12_PhaseFaultCalc /end SUB_GROUP /end GROUP
/begin GROUP S4_DiaPrfElDrv "SWC_MDF/RE_SWC_MDF_10ms_sys/Subsystem/MDF_Fuc/DiaPrfElDrv" /begin SUB_GROUP S13_DFCFlag S13_Pwr3PhaCmp /end SUB_GROUP /end GROUP
/begin GROUP S4_DiaShCirNoPsbl "SWC_MDF/RE_SWC_MDF_10ms_sys/Subsystem/MDF_Fuc/DiaShCirNoPsbl" /begin SUB_GROUP S14_DFCCalc S14_DFCFlag /end SUB_GROUP /end GROUP
/begin GROUP S5_FreewheelCalc "SWC_MDF/RE_SWC_MDF_10ms_sys/Subsystem/MDF_ParaCalc/FreewheelCalc"
 /begin REF_CHARACTERISTIC CAL_MDF_UdcFwMin_f32 CAL_MDF_UsFrwhlMax_f32 CAL_MDF_stFrwhlPhd_u8 CAL_MDF_stFrwhlWiIs_u8 CAL_MDF_stFrwhlWoIs_u8 /end REF_CHARACTERISTIC
/end GROUP
/begin GROUP S5_mdf_DiaElDrvCalc "SWC_MDF/RE_SWC_MDF_10ms_sys/Subsystem/MDF_ParaCalc/mdf_DiaElDrvCalc"
 /begin SUB_GROUP S65_mdf_IsErrCalc S65_mdf_Pwr3PhaFlt S65_mdf_UsErrCalc S65_mdf_pwr3PhaMdlFildCalc /end SUB_GROUP
/end GROUP
/begin GROUP S5_pwrlossCalc "SWC_MDF/RE_SWC_MDF_10ms_sys/Subsystem/MDF_ParaCalc/pwrlossCalc" /begin REF_CHARACTERISTIC CAL_MDF_PwrLoss_Z_af32 /end REF_CHARACTERISTIC /end GROUP
/begin GROUP S6_DFCFlag "SWC_MDF/RE_SWC_MDF_10ms_sys/Subsystem/MDF_Fuc/DiaAlOfsNoPlaus/DFCFlag"
 /begin REF_CHARACTERISTIC CAL_MDF_nThresAlOfsNoPlauseFaultMax_f32 CAL_MDF_nThresAlOfsNoPlauseFaultMin_f32 CAL_MDF_trqOfsNoPlausFault_f32 /end REF_CHARACTERISTIC
 /begin SUB_GROUP S15_On_Delay /end SUB_GROUP
/end GROUP
/begin GROUP S6_OfsNoPlausFaultCalc "SWC_MDF/RE_SWC_MDF_10ms_sys/Subsystem/MDF_Fuc/DiaAlOfsNoPlaus/OfsNoPlausFaultCalc" /begin SUB_GROUP S17_On_Delay S17_mdf_offsetJudge /end SUB_GROUP /end GROUP
/begin GROUP S6_mdf_tanDelta_Calc "SWC_MDF/RE_SWC_MDF_10ms_sys/Subsystem/MDF_Fuc/DiaAlOfsNoPlaus/mdf_tanDelta_Calc" /begin REF_CHARACTERISTIC CAL_MDF_tiAgComp_f32 /end REF_CHARACTERISTIC
 /begin REF_MEASUREMENT VAR_MDF_OffSetSiteAObs_f32 VAR_MDF_OffSetSiteBObs_f32 VAR_MDF_offsetDeltaObs_f32 /end REF_MEASUREMENT
/end GROUP
/begin GROUP S7_DFCFlag "SWC_MDF/RE_SWC_MDF_10ms_sys/Subsystem/MDF_Fuc/DiaEMBlk/DFCFlag" /begin REF_MEASUREMENT VAR_MDF_bEMBlkChk_b /end REF_MEASUREMENT /end GROUP
/begin GROUP S7_EMBlk "SWC_MDF/RE_SWC_MDF_10ms_sys/Subsystem/MDF_Fuc/DiaEMBlk/EMBlk" /begin SUB_GROUP S31_EMBlkErrLock S31_EMBlkWarnJud S31_On_Delay /end SUB_GROUP /end GROUP
/begin GROUP S8_DFCFlag "SWC_MDF/RE_SWC_MDF_10ms_sys/Subsystem/MDF_Fuc/DiaICtlRat/DFCFlag" /begin REF_MEASUREMENT VAR_MDF_bICtlRatChk_b /end REF_MEASUREMENT /end GROUP
/begin GROUP S8_iCtlJudge "SWC_MDF/RE_SWC_MDF_10ms_sys/Subsystem/MDF_Fuc/DiaICtlRat/iCtlJudge" /begin REF_CHARACTERISTIC CAL_MDF_IsErrThres_f32 CAL_MDF_UsErrThres_f32 /end REF_CHARACTERISTIC /begin REF_MEASUREMENT VAR_MDF_bFaultICtlChk_b /end REF_MEASUREMENT /end GROUP
/begin GROUP S9_Subsystem "SWC_MDF/RE_SWC_MDF_10ms_sys/Subsystem/MDF_Fuc/DiaIsMax/Subsystem" /begin REF_CHARACTERISTIC CAL_MDF_IsMaxSet_f32 /end REF_CHARACTERISTIC /begin REF_MEASUREMENT VAR_MDF_bIsOvHiFault_b /end REF_MEASUREMENT /end GROUP
/begin GROUP S10_DFCFlag "SWC_MDF/RE_SWC_MDF_10ms_sys/Subsystem/MDF_Fuc/DiaOpenCirNoPsbl/DFCFlag" /begin REF_CHARACTERISTIC CAL_MDF_nAbsThresOpenCirNoPsbl_f32 /end REF_CHARACTERISTIC /begin REF_MEASUREMENT VAR_MDF_bstGateDrvOpenCir_b /end REF_MEASUREMENT /end GROUP
/begin GROUP S10_OpenCirNoPsblCalc "SWC_MDF/RE_SWC_MDF_10ms_sys/Subsystem/MDF_Fuc/DiaOpenCirNoPsbl/OpenCirNoPsblCalc"
 /begin REF_CHARACTERISTIC CAL_MDF_FwWiIs_f32 CAL_MDF_FwWoIs_f32 CAL_MDF_stFrwhlWiIs_u8 CAL_MDF_stFrwhlWoIs_u8 /end REF_CHARACTERISTIC
 /begin REF_MEASUREMENT VAR_MDF_bOpenCirNoPsblFault_b /end REF_MEASUREMENT
/end GROUP
/begin GROUP S11_DFCFlag "SWC_MDF/RE_SWC_MDF_10ms_sys/Subsystem/MDF_Fuc/DiaOperOutdRng/DFCFlag" /begin REF_CHARACTERISTIC CAL_MDF_Inactive_u8 CAL_MDF_tOperOutdRngSelState_b /end REF_CHARACTERISTIC /begin REF_MEASUREMENT VAR_MDF_flagOperOutdRngChk_b /end REF_MEASUREMENT /end GROUP
/begin GROUP S11_OperOutdRngFltCalc "SWC_MDF/RE_SWC_MDF_10ms_sys/Subsystem/MDF_Fuc/DiaOperOutdRng/OperOutdRngFltCalc"
 /begin REF_CHARACTERISTIC CAL_MDF_tThd_TempDBCInvCoolObsvr_f32 CAL_MDF_tThd_TempDBCInvSens3Pha_f32 CAL_MDF_tThd_TempStr_f32 /end REF_CHARACTERISTIC
 /begin REF_MEASUREMENT VAR_MDF_flagOperOutdRngFault_b /end REF_MEASUREMENT
/end GROUP
/begin GROUP S12_DFCFlag "SWC_MDF/RE_SWC_MDF_10ms_sys/Subsystem/MDF_Fuc/DiaPhaseFault/DFCFlag"
 /begin REF_CHARACTERISTIC CAL_MDF_IsPhaseFault_f32 CAL_MDF_cofnAbsPhaseFault_Y_af32 CAL_MDF_nAbsPhaseFault_f32 /end REF_CHARACTERISTIC
 /begin REF_MEASUREMENT VAR_MDF_PhaseFaultChk_b /end REF_MEASUREMENT
/end GROUP
/begin GROUP S12_PhaseFaultCalc "SWC_MDF/RE_SWC_MDF_10ms_sys/Subsystem/MDF_Fuc/DiaPhaseFault/PhaseFaultCalc" /begin SUB_GROUP S48_On_Delay S48_UnbalanceDegCompare /end SUB_GROUP /end GROUP
/begin GROUP S13_DFCFlag "SWC_MDF/RE_SWC_MDF_10ms_sys/Subsystem/MDF_Fuc/DiaPrfElDrv/DFCFlag"
 /begin REF_CHARACTERISTIC CAL_MDF_nDidMax_f32 CAL_MDF_nDidMin_f32 CAL_MDF_pwrDcDiaMin_f32 /end REF_CHARACTERISTIC
 /begin REF_MEASUREMENT VAR_MDF_bPwrCmpDFCCalc_b /end REF_MEASUREMENT
/end GROUP
/begin GROUP S13_Pwr3PhaCmp "SWC_MDF/RE_SWC_MDF_10ms_sys/Subsystem/MDF_Fuc/DiaPrfElDrv/Pwr3PhaCmp" /begin REF_CHARACTERISTIC CAL_MDF_cErrPwrDcEstMax_f32 /end REF_CHARACTERISTIC /begin REF_MEASUREMENT VAR_MDF_bFaultPwrCmp_b /end REF_MEASUREMENT /end GROUP
/begin GROUP S14_DFCCalc "SWC_MDF/RE_SWC_MDF_10ms_sys/Subsystem/MDF_Fuc/DiaShCirNoPsbl/DFCCalc"
 /begin REF_CHARACTERISTIC CAL_MDF_IsThreshCirNoPsbl_f32 CAL_MDF_UdcThreshCirNoPsbl_f32 /end REF_CHARACTERISTIC
 /begin REF_MEASUREMENT VAR_MDF_bshCirNoPsblFaul_b /end REF_MEASUREMENT
/end GROUP
/begin GROUP S14_DFCFlag "SWC_MDF/RE_SWC_MDF_10ms_sys/Subsystem/MDF_Fuc/DiaShCirNoPsbl/DFCFlag" /begin REF_CHARACTERISTIC CAL_MDF_nAbsThreshCirNoPsbl_f32 /end REF_CHARACTERISTIC /begin REF_MEASUREMENT VAR_MDF_bstGateDrvShCir_b /end REF_MEASUREMENT /end GROUP
/begin GROUP S65_mdf_IsErrCalc "SWC_MDF/RE_SWC_MDF_10ms_sys/Subsystem/MDF_ParaCalc/mdf_DiaElDrvCalc/mdf_IsErrCalc" /begin REF_CHARACTERISTIC CAL_MDF_IsErrFlt_f32 /end REF_CHARACTERISTIC /end GROUP
/begin GROUP S65_mdf_Pwr3PhaFlt "SWC_MDF/RE_SWC_MDF_10ms_sys/Subsystem/MDF_ParaCalc/mdf_DiaElDrvCalc/mdf_Pwr3PhaFlt" /begin REF_CHARACTERISTIC CAL_MDF_Pwr3PhaFlt_f32 /end REF_CHARACTERISTIC /end GROUP
/begin GROUP S65_mdf_UsErrCalc "SWC_MDF/RE_SWC_MDF_10ms_sys/Subsystem/MDF_ParaCalc/mdf_DiaElDrvCalc/mdf_UsErrCalc" /begin REF_CHARACTERISTIC CAL_MDF_UsErrFlt_f32 /end REF_CHARACTERISTIC /end GROUP
/begin GROUP S65_mdf_pwr3PhaMdlFildCalc "SWC_MDF/RE_SWC_MDF_10ms_sys/Subsystem/MDF_ParaCalc/mdf_DiaElDrvCalc/mdf_pwr3PhaMdlFildCalc" /begin REF_CHARACTERISTIC CAL_MDF_PwrDcLinkEstFlt_f32 /end REF_CHARACTERISTIC /end GROUP
/begin GROUP S15_On_Delay "SWC_MDF/RE_SWC_MDF_10ms_sys/Subsystem/MDF_Fuc/DiaAlOfsNoPlaus/DFCFlag/On_Delay" /begin REF_CHARACTERISTIC CAL_MDF_tiOffsetSteady_f32 /end REF_CHARACTERISTIC /begin REF_MEASUREMENT VAR_MDF_bAlOfsChk_b /end REF_MEASUREMENT /end GROUP
/begin GROUP S17_On_Delay "SWC_MDF/RE_SWC_MDF_10ms_sys/Subsystem/MDF_Fuc/DiaAlOfsNoPlaus/OfsNoPlausFaultCalc/On_Delay" /begin REF_CHARACTERISTIC CAL_MDF_tiAlfOfsNoPlauseFault_f32 /end REF_CHARACTERISTIC /begin REF_MEASUREMENT VAR_MDF_bAlfOfsNoPlauseFault_b /end REF_MEASUREMENT /end GROUP
/begin GROUP S17_mdf_offsetJudge "SWC_MDF/RE_SWC_MDF_10ms_sys/Subsystem/MDF_Fuc/DiaAlOfsNoPlaus/OfsNoPlausFaultCalc/mdf_offsetJudge" /begin REF_CHARACTERISTIC CAL_MDF_DIffAlOfsMax_f32 CAL_MDF_OfsDeltaAgFltFrq_f32 /end REF_CHARACTERISTIC /begin REF_MEASUREMENT VAR_MDF_offsetDeltaFlt_f32 /end REF_MEASUREMENT /end GROUP
/begin GROUP S31_EMBlkErrLock "SWC_MDF/RE_SWC_MDF_10ms_sys/Subsystem/MDF_Fuc/DiaEMBlk/EMBlk/EMBlkErrLock" /begin REF_CHARACTERISTIC CAL_MDF_tiQuitEMBlk_f32 /end REF_CHARACTERISTIC /begin REF_MEASUREMENT VAR_MDF_bFaultEMBlkErr_b /end REF_MEASUREMENT /end GROUP
/begin GROUP S31_EMBlkWarnJud "SWC_MDF/RE_SWC_MDF_10ms_sys/Subsystem/MDF_Fuc/DiaEMBlk/EMBlk/EMBlkWarnJud" /begin REF_CHARACTERISTIC CAL_MDF_EMBlkWarn_f32 CAL_MDF_nAbsThresblockedElMa_f32 /end REF_CHARACTERISTIC /begin REF_MEASUREMENT VAR_MDF_bFaultEMBlkWarn_b /end REF_MEASUREMENT /end GROUP
/begin GROUP S31_On_Delay "SWC_MDF/RE_SWC_MDF_10ms_sys/Subsystem/MDF_Fuc/DiaEMBlk/EMBlk/On_Delay" /begin REF_CHARACTERISTIC CAL_MDF_tiEMBlk_f32 /end REF_CHARACTERISTIC /end GROUP
/begin GROUP S48_On_Delay "SWC_MDF/RE_SWC_MDF_10ms_sys/Subsystem/MDF_Fuc/DiaPhaseFault/PhaseFaultCalc/On_Delay" /begin REF_CHARACTERISTIC CAL_MDF_tiPhaFaultDelay_f32 /end REF_CHARACTERISTIC /begin REF_MEASUREMENT VAR_MDF_bPhaseFault_b /end REF_MEASUREMENT /end GROUP
/begin GROUP S48_UnbalanceDegCompare "SWC_MDF/RE_SWC_MDF_10ms_sys/Subsystem/MDF_Fuc/DiaPhaseFault/PhaseFaultCalc/UnbalanceDegCompare" /begin REF_CHARACTERISTIC CAL_MDF_3PhaUnbalance_f32 /end REF_CHARACTERISTIC /begin REF_MEASUREMENT VAR_MDF_3PhaUnbalanceObs_f32 /end REF_MEASUREMENT /end GROUP
/begin GROUP SWC_MPC "SWC_MPC" ROOT /begin SUB_GROUP Root_RE_SWC_MPC_2ms_sys /end SUB_GROUP /end GROUP
/begin GROUP Root_RE_SWC_MPC_2ms_sys "SWC_MPC/RE_SWC_MPC_2ms_sys" /begin SUB_GROUP S1_Subsystem1 /end SUB_GROUP /end GROUP
/begin GROUP S1_Subsystem1 "SWC_MPC/RE_SWC_MPC_2ms_sys/Subsystem1" /begin SUB_GROUP S3_MCF_PMSM S3_MPC_Sig /end SUB_GROUP /end GROUP
/begin GROUP S3_MCF_PMSM "SWC_MPC/RE_SWC_MPC_2ms_sys/Subsystem1/MCF_PMSM" /begin SUB_GROUP S4_LdqCalc S4_PsiCalc S4_RsCalc S4_TrqCalc1 /end SUB_GROUP /end GROUP
/begin GROUP S3_MPC_Sig "SWC_MPC/RE_SWC_MPC_2ms_sys/Subsystem1/MPC_Sig"
 /begin SUB_GROUP S5_MPC_CofRpwm S5_MPC_Flt S5_MPC_Sig S5_MPC_TrqMon S5_MPC_VF S5_MPC_isd /end SUB_GROUP
/end GROUP
/begin GROUP S4_LdqCalc "SWC_MPC/RE_SWC_MPC_2ms_sys/Subsystem1/MCF_PMSM/LdqCalc"
 /begin REF_CHARACTERISTIC CAL_MPC_LdSubLqCAzGen_af32 CAL_MPC_LdSubLqCAzMot_af32 CAL_MPC_Ld_f32 CAL_MPC_Lq_f32 CAL_MPC_flgDesOrAct_b CAL_MPC_flgUseLdSubLq_b CAL_MPC_flgUseLdq_b /end REF_CHARACTERISTIC
/end GROUP
/begin GROUP S4_PsiCalc "SWC_MPC/RE_SWC_MPC_2ms_sys/Subsystem1/MCF_PMSM/PsiCalc" /begin REF_CHARACTERISTIC CAL_MPC_Psi_f32 /end REF_CHARACTERISTIC /end GROUP
/begin GROUP S4_RsCalc "SWC_MPC/RE_SWC_MPC_2ms_sys/Subsystem1/MCF_PMSM/RsCalc" /begin REF_CHARACTERISTIC CAL_MPC_Rs_f32 CAL_MPC_flgUseRs_b /end REF_CHARACTERISTIC /end GROUP
/begin GROUP S4_TrqCalc1 "SWC_MPC/RE_SWC_MPC_2ms_sys/Subsystem1/MCF_PMSM/TrqCalc1" /begin REF_CHARACTERISTIC CAL_MPC_TrqMechCutOffFrq_f32 /end REF_CHARACTERISTIC /end GROUP
/begin GROUP S5_MPC_CofRpwm "SWC_MPC/RE_SWC_MPC_2ms_sys/Subsystem1/MPC_Sig/MPC_CofRpwm" /begin REF_CHARACTERISTIC CAL_MPC_cofRpwm_Y_af32 /end REF_CHARACTERISTIC /begin REF_MEASUREMENT VAR_MPC_CofRandomPwm_f32 /end REF_MEASUREMENT /end GROUP
/begin GROUP S5_MPC_Flt "SWC_MPC/RE_SWC_MPC_2ms_sys/Subsystem1/MPC_Sig/MPC_Flt"
 /begin REF_CHARACTERISTIC CAL_MPC_IsCutOffFrq_f32 CAL_MPC_idActCutOffFrq_f32 CAL_MPC_iqActCutOffFrq_f32 CAL_MPC_udActCutOffFrq_f32 CAL_MPC_uqActCutOffFrq_f32 /end REF_CHARACTERISTIC
/end GROUP
/begin GROUP S5_MPC_Sig "SWC_MPC/RE_SWC_MPC_2ms_sys/Subsystem1/MPC_Sig/MPC_Sig" /begin SUB_GROUP S16_BwdGen_2 S16_BwdMot_3 S16_FwdGen_4 S16_FwdMot_1 /end SUB_GROUP /end GROUP
/begin GROUP S5_MPC_TrqMon "SWC_MPC/RE_SWC_MPC_2ms_sys/Subsystem1/MPC_Sig/MPC_TrqMon" /begin REF_CHARACTERISTIC CAL_MPC_CofUdc_f32 CAL_MPC_Rcmp_f32 /end REF_CHARACTERISTIC /begin REF_MEASUREMENT VAR_MPC_TrqMon_f32 /end REF_MEASUREMENT /begin SUB_GROUP S17_SpdSwitch /end SUB_GROUP /end GROUP
/begin GROUP S5_MPC_VF "SWC_MPC/RE_SWC_MPC_2ms_sys/Subsystem1/MPC_Sig/MPC_VF" /begin REF_CHARACTERISTIC CAL_MPC_frqPwmVFTableZ_Frq_af32 /end REF_CHARACTERISTIC /begin REF_MEASUREMENT VAR_MPC_frqPwmVF_f32 /end REF_MEASUREMENT /end GROUP
/begin GROUP S5_MPC_isd "SWC_MPC/RE_SWC_MPC_2ms_sys/Subsystem1/MPC_Sig/MPC_isd"
 /begin REF_CHARACTERISTIC CAL_MPC_MtpaTableY_isd_af32 CAL_MPC_MtpvTableZ_idGen_af32 CAL_MPC_MtpvTableZ_idMot_af32 CAL_MPC_OmbwTableY_Ombw_af32 CAL_MPC_RvTableY_Rv_af32 CAL_MPC_isdFFTableY_UdcCof_af32 CAL_MPC_isdFFTableZ_isd_af32 /end REF_CHARACTERISTIC
/end GROUP
/begin GROUP S16_BwdGen_2 "SWC_MPC/RE_SWC_MPC_2ms_sys/Subsystem1/MPC_Sig/MPC_Sig/BwdGen_2" /begin REF_CHARACTERISTIC CAL_MPC_tCpnBwdGenTableY_tCpn_af32 /end REF_CHARACTERISTIC /end GROUP
/begin GROUP S16_BwdMot_3 "SWC_MPC/RE_SWC_MPC_2ms_sys/Subsystem1/MPC_Sig/MPC_Sig/BwdMot_3" /begin REF_CHARACTERISTIC CAL_MPC_tCpnBwdMotTableY_tCpn_af32 /end REF_CHARACTERISTIC /end GROUP
/begin GROUP S16_FwdGen_4 "SWC_MPC/RE_SWC_MPC_2ms_sys/Subsystem1/MPC_Sig/MPC_Sig/FwdGen_4" /begin REF_CHARACTERISTIC CAL_MPC_tCpnFwdGenTableY_tCpn_af32 /end REF_CHARACTERISTIC /end GROUP
/begin GROUP S16_FwdMot_1 "SWC_MPC/RE_SWC_MPC_2ms_sys/Subsystem1/MPC_Sig/MPC_Sig/FwdMot_1" /begin REF_CHARACTERISTIC CAL_MPC_tCpnFwdMotTableY_tCpn_af32 /end REF_CHARACTERISTIC /end GROUP
/begin GROUP S17_SpdSwitch "SWC_MPC/RE_SWC_MPC_2ms_sys/Subsystem1/MPC_Sig/MPC_TrqMon/SpdSwitch"
 /begin REF_CHARACTERISTIC CAL_MPC_nSetTrqMonMin_f32 CAL_MPC_nTrqMonMax_f32 CAL_MPC_nTrqMonMin_f32 /end REF_CHARACTERISTIC
/end GROUP
/begin GROUP SWC_PCF "SWC_PCF" ROOT /begin SUB_GROUP Root_RE_SWC_PCF_10ms_sys /end SUB_GROUP /end GROUP
/begin GROUP Root_RE_SWC_PCF_10ms_sys "SWC_PCF/RE_SWC_PCF_10ms_sys"
 /begin REF_MEASUREMENT VAR_PcfSig_UBRPcf_f32 VAR_PcfSig_VDD5Pcf_f32 VAR_PcfSig_flgIoc_b /end REF_MEASUREMENT
 /begin SUB_GROUP S1_PCF_10ms /end SUB_GROUP
/end GROUP
/begin GROUP S1_PCF_10ms "SWC_PCF/RE_SWC_PCF_10ms_sys/PCF_10ms"
 /begin SUB_GROUP S3_PCF_Diagnosis S3_PCF_PWMControl S3_PCF_SignalProcess S3_PCF_StateManagement /end SUB_GROUP
/end GROUP
/begin GROUP S3_PCF_Diagnosis "SWC_PCF/RE_SWC_PCF_10ms_sys/PCF_10ms/PCF_Diagnosis" /begin SUB_GROUP S4_PCF_Diag /end SUB_GROUP /end GROUP
/begin GROUP S3_PCF_PWMControl "SWC_PCF/RE_SWC_PCF_10ms_sys/PCF_10ms/PCF_PWMControl" /begin SUB_GROUP S5_PcfCtl_MotorControl /end SUB_GROUP /end GROUP
/begin GROUP S3_PCF_SignalProcess "SWC_PCF/RE_SWC_PCF_10ms_sys/PCF_10ms/PCF_SignalProcess" /begin SUB_GROUP S6_PCF_Sig /end SUB_GROUP /end GROUP
/begin GROUP S3_PCF_StateManagement "SWC_PCF/RE_SWC_PCF_10ms_sys/PCF_10ms/PCF_StateManagement" /begin SUB_GROUP S7_Pcf_Stm /end SUB_GROUP /end GROUP
/begin GROUP S4_PCF_Diag "SWC_PCF/RE_SWC_PCF_10ms_sys/PCF_10ms/PCF_Diagnosis/PCF_Diag" /begin SUB_GROUP S9_Basic_Diagnosis S9_Compound_Diagnosis /end SUB_GROUP /end GROUP
/begin GROUP S5_PcfCtl_MotorControl "SWC_PCF/RE_SWC_PCF_10ms_sys/PCF_10ms/PCF_PWMControl/PcfCtl_MotorControl" /begin SUB_GROUP S68_PcfCtl_Ctl S68_PcfCtl_Swt /end SUB_GROUP /end GROUP
/begin GROUP S6_PCF_Sig "SWC_PCF/RE_SWC_PCF_10ms_sys/PCF_10ms/PCF_SignalProcess/PCF_Sig" /begin SUB_GROUP S85_PcfSig_001 S85_PcfSig_002 S85_PcfSig_003 /end SUB_GROUP /end GROUP
/begin GROUP S7_Pcf_Stm "SWC_PCF/RE_SWC_PCF_10ms_sys/PCF_10ms/PCF_StateManagement/Pcf_Stm"
 /begin REF_MEASUREMENT VAR_PcfStm_Actime_u16 VAR_PcfStm_BCMotDir_b VAR_PcfStm_BCenMos_b VAR_PcfStm_BCflgModeReq_b VAR_PcfStm_BCstDiag_u8 VAR_PcfStm_MotDir_b VAR_PcfStm_SLActDir_b VAR_PcfStm_SLEnMotorAcc_b VAR_PcfStm_SLPosReg_f32 VAR_PcfStm_SLenMos_b VAR_PcfStm_SLflgPosNvm_b VAR_PcfStm_SLstDiag_u8 VAR_PcfStm_SLstModeReq_u8 VAR_PcfStm_SLtrqDes_f32 VAR_PcfStm_enMos_b VAR_PcfStm_flgAutoP_b VAR_PcfStm_flgRetryFnh_b VAR_PcfStm_stParkCtl_u8 VAR_PcfStm_stPark_u8 /end REF_MEASUREMENT
 /begin SUB_GROUP S118_PcfStm_Judgment /end SUB_GROUP
/end GROUP
/begin GROUP S9_Basic_Diagnosis "SWC_PCF/RE_SWC_PCF_10ms_sys/PCF_10ms/PCF_Diagnosis/PCF_Diag/Basic_Diagnosis"
 /begin SUB_GROUP S10_ActorPosDiag S10_BlindCtlStallDiag S10_IocDiag S10_NormalStallDiag S10_SenDemDiag S10_Subsystem S10_UdcDiag S10_VDD5VDiag S10_flgCritSpdDiag S10_flgNPCActPosDiag S10_stSLActPosDiag S10_tActDiag S10_tMosDiag /end SUB_GROUP
/end GROUP
/begin GROUP S9_Compound_Diagnosis "SWC_PCF/RE_SWC_PCF_10ms_sys/PCF_10ms/PCF_Diagnosis/PCF_Diag/Compound_Diagnosis"
 /begin SUB_GROUP S11_AllowPwmRunDiag S11_CheckSelfDiag S11_DwnReqDiag S11_FaultDiag S11_PosErrDiag S11_RetryDiag S11_StallRetry /end SUB_GROUP
/end GROUP
/begin GROUP S68_PcfCtl_Ctl "SWC_PCF/RE_SWC_PCF_10ms_sys/PCF_10ms/PCF_PWMControl/PcfCtl_MotorControl/PcfCtl_Ctl"
 /begin SUB_GROUP S69_Act_Fin S69_DycProcess S69_PID_Enable S69_PcfCtl_enMosandAimPos S69_Ref S69_Swt S69_posititional_PID /end SUB_GROUP
/end GROUP
/begin GROUP S68_PcfCtl_Swt "SWC_PCF/RE_SWC_PCF_10ms_sys/PCF_10ms/PCF_PWMControl/PcfCtl_MotorControl/PcfCtl_Swt" /begin REF_CHARACTERISTIC CAL_PcfCtl_flgManual_b /end REF_CHARACTERISTIC /begin REF_MEASUREMENT VAR_PcfCtl_enMos_b /end REF_MEASUREMENT
 /begin SUB_GROUP S70_If_Action_Subsystem S70_If_Action_Subsystem1 S70_If_Action_Subsystem4 /end SUB_GROUP
/end GROUP
/begin GROUP S85_PcfSig_001 "SWC_PCF/RE_SWC_PCF_10ms_sys/PCF_10ms/PCF_SignalProcess/PCF_Sig/PcfSig_001" /begin SUB_GROUP S86_Pending_signal S86_VCU_signal /end SUB_GROUP /end GROUP
/begin GROUP S85_PcfSig_002 "SWC_PCF/RE_SWC_PCF_10ms_sys/PCF_10ms/PCF_SignalProcess/PCF_Sig/PcfSig_002" /begin REF_CHARACTERISTIC CAL_PcfSig_flgUseISENorIUB_b /end REF_CHARACTERISTIC /begin REF_MEASUREMENT VAR_PcfSig_IdcPcf_f32 /end REF_MEASUREMENT
 /begin SUB_GROUP S87_EpcPos1 S87_EpcPos2 S87_IUBEpc S87_flgKL15 S87_flgPowerOn S87_iEpc S87_tEpc /end SUB_GROUP
/end GROUP
/begin GROUP S85_PcfSig_003 "SWC_PCF/RE_SWC_PCF_10ms_sys/PCF_10ms/PCF_SignalProcess/PCF_Sig/PcfSig_003" /begin SUB_GROUP S88_DycLim S88_NVMAimOutP S88_NVMSLFnh S88_nMotCalc /end SUB_GROUP /end GROUP
/begin GROUP S118_PcfStm_Judgment "SWC_PCF/RE_SWC_PCF_10ms_sys/PCF_10ms/PCF_StateManagement/Pcf_Stm/PcfStm_Judgment"
 /begin REF_CHARACTERISTIC CAL_PcfStm_BCActimeLimt_u16 CAL_PcfStm_SLAccSpdUp_f32 CAL_PcfStm_SLAccTrqDes_f32 CAL_PcfStm_SLActRunSpdUp_f32 CAL_PcfStm_SLActimeLimt_u16 CAL_PcfStm_SLMotorAcctimeLimt_u16 CAL_PcfStm_SLRetryTimesLimt_u8 CAL_PcfStm_SLRunTimesLimt_u8 CAL_PcfStm_SLWaitimeLimt_u16 CAL_PcfStm_cntSLWaitRunLimt_u16 CAL_PcfStm_flgUseAutoBackP_b CAL_PcfStm_flgUseBlindCtl_b CAL_PcfStm_flgUseFaultRec_b CAL_PcfStm_flgUseRPC_b CAL_PcfStm_flgUseSLC_b /end REF_CHARACTERISTIC
 /begin SUB_GROUP S119_ActJudgeToSLRun S119_FaultToBPC S119_NPCToRPC S119_PCInPorOutPToRun S119_PCInitToInPorOutP S119_ParkToFault S119_SLAccToWait S119_StndbyToSLCorNPC /end SUB_GROUP
/end GROUP
/begin GROUP S10_ActorPosDiag "SWC_PCF/RE_SWC_PCF_10ms_sys/PCF_10ms/PCF_Diagnosis/PCF_Diag/Basic_Diagnosis/ActorPosDiag" /begin REF_CHARACTERISTIC CAL_PcfDia_AimInPRdd_f32 CAL_PcfDia_AimOutPRdd_f32 /end REF_CHARACTERISTIC /begin REF_MEASUREMENT VAR_PcfDia_stActPos_u8 /end REF_MEASUREMENT /end GROUP
/begin GROUP S10_BlindCtlStallDiag "SWC_PCF/RE_SWC_PCF_10ms_sys/PCF_10ms/PCF_Diagnosis/PCF_Diag/Basic_Diagnosis/BlindCtlStallDiag"
 /begin REF_CHARACTERISTIC CAL_PcfDia_BCLockedNum_u16 CAL_PcfDia_IdcLockedHiHyst_f32 CAL_PcfDia_IdcLockedHi_f32 CAL_PcfDia_flgBCLockedSwt_b CAL_PcfDia_flgBCLocked_b /end REF_CHARACTERISTIC
 /begin REF_MEASUREMENT VAR_PcfDia_flgBCLocked_b /end REF_MEASUREMENT
/end GROUP
/begin GROUP S10_IocDiag "SWC_PCF/RE_SWC_PCF_10ms_sys/PCF_10ms/PCF_Diagnosis/PCF_Diag/Basic_Diagnosis/IocDiag" /begin REF_MEASUREMENT VAR_PcfDia_flgHwIdcOv_b /end REF_MEASUREMENT /end GROUP
/begin GROUP S10_NormalStallDiag "SWC_PCF/RE_SWC_PCF_10ms_sys/PCF_10ms/PCF_Diagnosis/PCF_Diag/Basic_Diagnosis/NormalStallDiag"
 /begin REF_CHARACTERISTIC CAL_PcfDia_IdcLockedHiHyst_f32 CAL_PcfDia_IdcLockedHi_f32 CAL_PcfDia_LockedNum_u16 CAL_PcfDia_flgLocked_b CAL_PcfDia_flgLockedlSwt_b CAL_PcfDia_nMotLockedLowHyst_f32 CAL_PcfDia_nMotLockedLow_f32 /end REF_CHARACTERISTIC
 /begin REF_MEASUREMENT VAR_PcfDia_flgLocked_b /end REF_MEASUREMENT
/end GROUP
/begin GROUP S10_SenDemDiag "SWC_PCF/RE_SWC_PCF_10ms_sys/PCF_10ms/PCF_Diagnosis/PCF_Diag/Basic_Diagnosis/SenDemDiag"
 /begin SUB_GROUP S16_Debounce1 S16_Debounce2 S16_PosDiag S16_latch1 S16_latch2 /end SUB_GROUP
/end GROUP
/begin GROUP S10_Subsystem "SWC_PCF/RE_SWC_PCF_10ms_sys/PCF_10ms/PCF_Diagnosis/PCF_Diag/Basic_Diagnosis/Subsystem" /begin REF_CHARACTERISTIC CAL_PcfDia_AimInPRatDown_f32 CAL_PcfDia_AimInPRatUp_f32 /end REF_CHARACTERISTIC /begin REF_MEASUREMENT VAR_PcfDia_flgAimInPRat_b /end REF_MEASUREMENT /end GROUP
/begin GROUP S10_UdcDiag "SWC_PCF/RE_SWC_PCF_10ms_sys/PCF_10ms/PCF_Diagnosis/PCF_Diag/Basic_Diagnosis/UdcDiag"
 /begin REF_CHARACTERISTIC CAL_PcfDia_UdcCANLowSet_f32 CAL_PcfDia_UdcMotLowSet_f32 CAL_PcfDia_UdcMotManSet_f32 CAL_PcfDia_UdcMotUVSet_f32 /end REF_CHARACTERISTIC
 /begin REF_MEASUREMENT VAR_PcfDia_flgUdcLoErr_b VAR_PcfDia_stUdc_u8 /end REF_MEASUREMENT
/end GROUP
/begin GROUP S10_VDD5VDiag "SWC_PCF/RE_SWC_PCF_10ms_sys/PCF_10ms/PCF_Diagnosis/PCF_Diag/Basic_Diagnosis/VDD5VDiag" /begin REF_CHARACTERISTIC CAL_PcfDia_VDD5Highset_f32 CAL_PcfDia_VDD5Lowset_f32 /end REF_CHARACTERISTIC /begin SUB_GROUP S19_Debounce2 S19_latch1 /end SUB_GROUP /end GROUP
/begin GROUP S10_flgCritSpdDiag "SWC_PCF/RE_SWC_PCF_10ms_sys/PCF_10ms/PCF_Diagnosis/PCF_Diag/Basic_Diagnosis/flgCritSpdDiag"
 /begin REF_CHARACTERISTIC CAL_PcfDia_SpdHiHyst_f32 CAL_PcfDia_SpdHi_f32 CAL_PcfDia_nMechHiHyst_f32 CAL_PcfDia_nMechHi_f32 /end REF_CHARACTERISTIC
 /begin REF_MEASUREMENT VAR_PcfDia_flgCritSpd_b /end REF_MEASUREMENT
/end GROUP
/begin GROUP S10_flgNPCActPosDiag "SWC_PCF/RE_SWC_PCF_10ms_sys/PCF_10ms/PCF_Diagnosis/PCF_Diag/Basic_Diagnosis/flgNPCActPosDiag" /begin REF_CHARACTERISTIC CAL_PcfDia_MinPosOutP_f32 /end REF_CHARACTERISTIC /begin REF_MEASUREMENT VAR_PcfDia_flgNPCActPos_b /end REF_MEASUREMENT /end GROUP
/begin GROUP S10_stSLActPosDiag "SWC_PCF/RE_SWC_PCF_10ms_sys/PCF_10ms/PCF_Diagnosis/PCF_Diag/Basic_Diagnosis/stSLActPosDiag"
 /begin REF_CHARACTERISTIC CAL_PcfDia_SLInPDown_f32 CAL_PcfDia_SLInPLimt_f32 CAL_PcfDia_SLInPUp_f32 CAL_PcfDia_SLOutPDown_f32 CAL_PcfDia_SLOutPInit_f32 CAL_PcfDia_SLOutPUp_f32 /end REF_CHARACTERISTIC
 /begin REF_MEASUREMENT VAR_PcfDia_stSLActPos_u8 /end REF_MEASUREMENT
/end GROUP
/begin GROUP S10_tActDiag "SWC_PCF/RE_SWC_PCF_10ms_sys/PCF_10ms/PCF_Diagnosis/PCF_Diag/Basic_Diagnosis/tActDiag" /begin REF_CHARACTERISTIC CAL_PcfDia_cntNorAct_u16 CAL_PcfDia_cntOverAct_u16 /end REF_CHARACTERISTIC /begin REF_MEASUREMENT VAR_PcfDia_flgRunTiOv_b VAR_PcfDia_stRunTi_u8 /end REF_MEASUREMENT /end GROUP
/begin GROUP S10_tMosDiag "SWC_PCF/RE_SWC_PCF_10ms_sys/PCF_10ms/PCF_Diagnosis/PCF_Diag/Basic_Diagnosis/tMosDiag"
 /begin REF_CHARACTERISTIC CAL_PcfDia_tMosHighSet_f32 CAL_PcfDia_tMosLowSet_f32 CAL_PcfDia_tMosNum_u16 /end REF_CHARACTERISTIC
 /begin REF_MEASUREMENT VAR_PcfDia_flgtMosOv_b /end REF_MEASUREMENT
/end GROUP
/begin GROUP S11_AllowPwmRunDiag "SWC_PCF/RE_SWC_PCF_10ms_sys/PCF_10ms/PCF_Diagnosis/PCF_Diag/Compound_Diagnosis/AllowPwmRunDiag" /begin REF_MEASUREMENT VAR_PcfDia_flgAllowPwmRun_b /end REF_MEASUREMENT /end GROUP
/begin GROUP S11_CheckSelfDiag "SWC_PCF/RE_SWC_PCF_10ms_sys/PCF_10ms/PCF_Diagnosis/PCF_Diag/Compound_Diagnosis/CheckSelfDiag" /begin REF_MEASUREMENT VAR_PcfDiag_flgselfCkErr_b VAR_PcfDiag_flgselfCkFnh_b /end REF_MEASUREMENT /end GROUP
/begin GROUP S11_DwnReqDiag "SWC_PCF/RE_SWC_PCF_10ms_sys/PCF_10ms/PCF_Diagnosis/PCF_Diag/Compound_Diagnosis/DwnReqDiag" /begin REF_MEASUREMENT VAR_PcfDia_flgShtDwnReq_b /end REF_MEASUREMENT /end GROUP
/begin GROUP S11_FaultDiag "SWC_PCF/RE_SWC_PCF_10ms_sys/PCF_10ms/PCF_Diagnosis/PCF_Diag/Compound_Diagnosis/FaultDiag" /begin REF_CHARACTERISTIC CAL_PcfDia_flgFaultSwt_b CAL_PcfDia_flgFault_b /end REF_CHARACTERISTIC /begin REF_MEASUREMENT VAR_PcfDia_flgFault_b /end REF_MEASUREMENT /end GROUP
/begin GROUP S11_PosErrDiag "SWC_PCF/RE_SWC_PCF_10ms_sys/PCF_10ms/PCF_Diagnosis/PCF_Diag/Compound_Diagnosis/PosErrDiag" /begin REF_MEASUREMENT VAR_PcfDia_flgUnexPosWarn_b /end REF_MEASUREMENT /end GROUP
/begin GROUP S11_RetryDiag "SWC_PCF/RE_SWC_PCF_10ms_sys/PCF_10ms/PCF_Diagnosis/PCF_Diag/Compound_Diagnosis/RetryDiag" /begin SUB_GROUP S63_Swt /end SUB_GROUP /end GROUP
/begin GROUP S11_StallRetry "SWC_PCF/RE_SWC_PCF_10ms_sys/PCF_10ms/PCF_Diagnosis/PCF_Diag/Compound_Diagnosis/StallRetry" /begin REF_CHARACTERISTIC CAL_PcfDia_Retrytimes_u8 CAL_PcfDia_tRetry_u16 /end REF_CHARACTERISTIC /begin REF_MEASUREMENT VAR_PcfDia_flgStallFault_b VAR_PcfDia_flgstallPause_b /end REF_MEASUREMENT /end GROUP
/begin GROUP S69_Act_Fin "SWC_PCF/RE_SWC_PCF_10ms_sys/PCF_10ms/PCF_PWMControl/PcfCtl_MotorControl/PcfCtl_Ctl/Act_Fin" /begin REF_CHARACTERISTIC CAL_PcfCtl_PrePos_f32 CAL_PcfCtl_timePrePos_u16 /end REF_CHARACTERISTIC /end GROUP
/begin GROUP S69_DycProcess "SWC_PCF/RE_SWC_PCF_10ms_sys/PCF_10ms/PCF_PWMControl/PcfCtl_MotorControl/PcfCtl_Ctl/DycProcess" /begin REF_CHARACTERISTIC CAL_PcfCtl_SoftDyc_f32 /end REF_CHARACTERISTIC
 /begin REF_MEASUREMENT VAR_PcfCtl_DirOutPID_b VAR_PcfCtl_DycOutPID_f32 VAR_PcfCtl_SoftDycPID_f32 /end REF_MEASUREMENT
/end GROUP
/begin GROUP S69_PID_Enable "SWC_PCF/RE_SWC_PCF_10ms_sys/PCF_10ms/PCF_PWMControl/PcfCtl_MotorControl/PcfCtl_Ctl/PID_Enable" /begin REF_MEASUREMENT VAR_PcfCtl_enMosOutPID_b /end REF_MEASUREMENT /end GROUP
/begin GROUP S69_PcfCtl_enMosandAimPos "SWC_PCF/RE_SWC_PCF_10ms_sys/PCF_10ms/PCF_PWMControl/PcfCtl_MotorControl/PcfCtl_Ctl/PcfCtl_enMosandAimPos" /begin REF_MEASUREMENT VAR_PcfCtl_AimPosPID_f32 VAR_PcfCtl_enMosPID_b /end REF_MEASUREMENT /begin SUB_GROUP S74_If_Action_Subsystem S74_If_Action_Subsystem1 /end SUB_GROUP /end GROUP
/begin GROUP S69_Ref "SWC_PCF/RE_SWC_PCF_10ms_sys/PCF_10ms/PCF_PWMControl/PcfCtl_MotorControl/PcfCtl_Ctl/Ref" /begin REF_MEASUREMENT VAR_PcfCtl_PosDif_f32 /end REF_MEASUREMENT /end GROUP
/begin GROUP S69_Swt "SWC_PCF/RE_SWC_PCF_10ms_sys/PCF_10ms/PCF_PWMControl/PcfCtl_MotorControl/PcfCtl_Ctl/Swt" /begin REF_CHARACTERISTIC CAL_PcfCtl_flgFnhSwt_b CAL_PcfCtl_flgFnh_b /end REF_CHARACTERISTIC /begin REF_MEASUREMENT VAR_PcfCtl_ActFnh_b /end REF_MEASUREMENT /end GROUP
/begin GROUP S69_posititional_PID "SWC_PCF/RE_SWC_PCF_10ms_sys/PCF_10ms/PCF_PWMControl/PcfCtl_MotorControl/PcfCtl_Ctl/posititional_PID"
 /begin REF_CHARACTERISTIC CAL_PcfCtl_PosKd_f32 CAL_PcfCtl_PosKi_f32 CAL_PcfCtl_PosKp_f32 CAL_PcfCtl_intPIDdownlim_f32 CAL_PcfCtl_intPIDuplim_f32 /end REF_CHARACTERISTIC
 /begin REF_MEASUREMENT VAR_PcfCtl_PosKd_f32 VAR_PcfCtl_PosKi_f32 VAR_PcfCtl_PosKp_f32 VAR_PcfCtl_PosPIDOut_f32 /end REF_MEASUREMENT
/end GROUP
/begin GROUP S70_If_Action_Subsystem "SWC_PCF/RE_SWC_PCF_10ms_sys/PCF_10ms/PCF_PWMControl/PcfCtl_MotorControl/PcfCtl_Swt/If Action Subsystem" /begin REF_CHARACTERISTIC CAL_PcfCtl_BCRunDyc_f32 /end REF_CHARACTERISTIC /end GROUP
/begin GROUP S70_If_Action_Subsystem1 "SWC_PCF/RE_SWC_PCF_10ms_sys/PCF_10ms/PCF_PWMControl/PcfCtl_MotorControl/PcfCtl_Swt/If Action Subsystem1" /begin REF_CHARACTERISTIC CAL_PcfCtl_SLRunDir_b CAL_PcfCtl_SLRunDyc_f32 /end REF_CHARACTERISTIC /end GROUP
/begin GROUP S70_If_Action_Subsystem4 "SWC_PCF/RE_SWC_PCF_10ms_sys/PCF_10ms/PCF_PWMControl/PcfCtl_MotorControl/PcfCtl_Swt/If Action Subsystem4"
 /begin REF_CHARACTERISTIC CAL_PcfCtl_ManualDir_b CAL_PcfCtl_ManualDty_f32 CAL_PcfCtl_ManualEn_b /end REF_CHARACTERISTIC
/end GROUP
/begin GROUP S86_Pending_signal "SWC_PCF/RE_SWC_PCF_10ms_sys/PCF_10ms/PCF_SignalProcess/PCF_Sig/PcfSig_001/Pending_signal" /begin REF_CHARACTERISTIC CAL_PcfSig_VehSpd_f32 CAL_PcfSig_flgACC_b /end REF_CHARACTERISTIC /begin REF_MEASUREMENT VAR_PcfSig_VehSpd_f32 VAR_PcfSig_flgACC_b /end REF_MEASUREMENT /end GROUP
/begin GROUP S86_VCU_signal "SWC_PCF/RE_SWC_PCF_10ms_sys/PCF_10ms/PCF_SignalProcess/PCF_Sig/PcfSig_001/VCU_signal" /begin SUB_GROUP S90_flgBrake S90_flgP S90_flgP_In S90_stBelt S90_stDoor /end SUB_GROUP /end GROUP
/begin GROUP S87_EpcPos1 "SWC_PCF/RE_SWC_PCF_10ms_sys/PCF_10ms/PCF_SignalProcess/PCF_Sig/PcfSig_002/EpcPos1" /begin REF_CHARACTERISTIC CAL_PcfSig_PosCnvFac_f32 CAL_PcfSig_PosOffset_f32 /end REF_CHARACTERISTIC /begin REF_MEASUREMENT VAR_PcfSig_Pos1_f32 /end REF_MEASUREMENT /end GROUP
/begin GROUP S87_EpcPos2 "SWC_PCF/RE_SWC_PCF_10ms_sys/PCF_10ms/PCF_SignalProcess/PCF_Sig/PcfSig_002/EpcPos2" /begin REF_CHARACTERISTIC CAL_PcfSig_PosCnvFac_f32 CAL_PcfSig_PosOffset_f32 /end REF_CHARACTERISTIC /begin REF_MEASUREMENT VAR_PcfSig_Pos2_f32 /end REF_MEASUREMENT /end GROUP
/begin GROUP S87_IUBEpc "SWC_PCF/RE_SWC_PCF_10ms_sys/PCF_10ms/PCF_SignalProcess/PCF_Sig/PcfSig_002/IUBEpc" /begin REF_CHARACTERISTIC CAL_PcfSig_IUBSet_f32 CAL_PcfSig_flgIUBSwt_b /end REF_CHARACTERISTIC /begin SUB_GROUP S101_flt1 /end SUB_GROUP /end GROUP
/begin GROUP S87_flgKL15 "SWC_PCF/RE_SWC_PCF_10ms_sys/PCF_10ms/PCF_SignalProcess/PCF_Sig/PcfSig_002/flgKL15" /begin REF_CHARACTERISTIC CAL_PcfSig_flgKL15Swt_b CAL_PcfSig_flgKL15_b /end REF_CHARACTERISTIC /begin REF_MEASUREMENT VAR_PcfSig_flgKL15_b /end REF_MEASUREMENT /end GROUP
/begin GROUP S87_flgPowerOn "SWC_PCF/RE_SWC_PCF_10ms_sys/PCF_10ms/PCF_SignalProcess/PCF_Sig/PcfSig_002/flgPowerOn" /begin REF_CHARACTERISTIC CAL_PcfSig_flgPowerOnSwt_b CAL_PcfSig_flgPowerOn_b /end REF_CHARACTERISTIC /begin REF_MEASUREMENT VAR_PcfSig_flgPowerOn_b /end REF_MEASUREMENT /end GROUP
/begin GROUP S87_iEpc "SWC_PCF/RE_SWC_PCF_10ms_sys/PCF_10ms/PCF_SignalProcess/PCF_Sig/PcfSig_002/iEpc" /begin REF_CHARACTERISTIC CAL_PcfSig_iSENCnvFac_f32 /end REF_CHARACTERISTIC /begin REF_MEASUREMENT VAR_PcfSig_IsenPcf_f32 /end REF_MEASUREMENT /begin SUB_GROUP S106_Subsystem S106_Subsystem1 /end SUB_GROUP /end GROUP
/begin GROUP S87_tEpc "SWC_PCF/RE_SWC_PCF_10ms_sys/PCF_10ms/PCF_SignalProcess/PCF_Sig/PcfSig_002/tEpc" /begin REF_CHARACTERISTIC CAL_PcfSig_factMosFlt_f32 /end REF_CHARACTERISTIC /begin SUB_GROUP S107_flt /end SUB_GROUP /end GROUP
/begin GROUP S88_DycLim "SWC_PCF/RE_SWC_PCF_10ms_sys/PCF_10ms/PCF_SignalProcess/PCF_Sig/PcfSig_003/DycLim"
 /begin REF_CHARACTERISTIC CAL_PcfSig_IdcDycX_Idc_af32 CAL_PcfSig_UdcDycX_Udc_af32 CAL_PcfSig_tMosDycX_tMos_af32 /end REF_CHARACTERISTIC
 /begin REF_MEASUREMENT VAR_PcfSig_DycLim_f32 /end REF_MEASUREMENT
/end GROUP
/begin GROUP S88_NVMAimOutP "SWC_PCF/RE_SWC_PCF_10ms_sys/PCF_10ms/PCF_SignalProcess/PCF_Sig/PcfSig_003/NVMAimOutP"
 /begin REF_CHARACTERISTIC CAL_PcfSig_AimInPLimt_f32 CAL_PcfSig_deltaAimInP_f32 CAL_PcfSig_deltaAimOutP_f32 CAL_PcfSig_flgAimInPLimtSwt_b /end REF_CHARACTERISTIC
 /begin REF_MEASUREMENT VAR_PcfSig_PosAimInP_f32 VAR_PcfSig_PosAimOutP_f32 /end REF_MEASUREMENT
/end GROUP
/begin GROUP S88_NVMSLFnh "SWC_PCF/RE_SWC_PCF_10ms_sys/PCF_10ms/PCF_SignalProcess/PCF_Sig/PcfSig_003/NVMSLFnh" /begin REF_CHARACTERISTIC CAL_PcfSig_flgNVMSLFnhSwt_b CAL_PcfSig_flgNVMSLFnh_b /end REF_CHARACTERISTIC /begin REF_MEASUREMENT VAR_PcfSig_NVMSLFnh_b /end REF_MEASUREMENT /end GROUP
/begin GROUP S88_nMotCalc "SWC_PCF/RE_SWC_PCF_10ms_sys/PCF_10ms/PCF_SignalProcess/PCF_Sig/PcfSig_003/nMotCalc" /begin REF_CHARACTERISTIC CAL_PcfSig_AngMotPos_f32 CAL_PcfSig_GernMot_f32 /end REF_CHARACTERISTIC /begin SUB_GROUP S116_flt1 /end SUB_GROUP /end GROUP
/begin GROUP S119_ActJudgeToSLRun "SWC_PCF/RE_SWC_PCF_10ms_sys/PCF_10ms/PCF_StateManagement/Pcf_Stm/PcfStm_Judgment/ActJudgeToSLRun" /begin REF_MEASUREMENT VAR_PcfStm_flgActJudgeToSLRun_b /end REF_MEASUREMENT /end GROUP
/begin GROUP S119_FaultToBPC "SWC_PCF/RE_SWC_PCF_10ms_sys/PCF_10ms/PCF_StateManagement/Pcf_Stm/PcfStm_Judgment/FaultToBPC" /begin REF_MEASUREMENT VAR_PcfStm_flgBPCToFault_b VAR_PcfStm_flgFaultToBPC_b /end REF_MEASUREMENT /end GROUP
/begin GROUP S119_NPCToRPC "SWC_PCF/RE_SWC_PCF_10ms_sys/PCF_10ms/PCF_StateManagement/Pcf_Stm/PcfStm_Judgment/NPCToRPC" /begin REF_MEASUREMENT VAR_PcfStm_flgNPCToRPC_b /end REF_MEASUREMENT /end GROUP
/begin GROUP S119_PCInPorOutPToRun "SWC_PCF/RE_SWC_PCF_10ms_sys/PCF_10ms/PCF_StateManagement/Pcf_Stm/PcfStm_Judgment/PCInPorOutPToRun" /begin SUB_GROUP S124_DiaAutoP S124_EnAutoInP S124_EnAutoOutP S124_InPtoRun /end SUB_GROUP /end GROUP
/begin GROUP S119_PCInitToInPorOutP "SWC_PCF/RE_SWC_PCF_10ms_sys/PCF_10ms/PCF_StateManagement/Pcf_Stm/PcfStm_Judgment/PCInitToInPorOutP" /begin REF_MEASUREMENT VAR_PcfStm_flgPCInitToInP_b VAR_PcfStm_flgPCInitToOutP_b /end REF_MEASUREMENT /end GROUP
/begin GROUP S119_ParkToFault "SWC_PCF/RE_SWC_PCF_10ms_sys/PCF_10ms/PCF_StateManagement/Pcf_Stm/PcfStm_Judgment/ParkToFault" /begin REF_MEASUREMENT VAR_PcfStm_flgFaultToParkCtl_b /end REF_MEASUREMENT /end GROUP
/begin GROUP S119_SLAccToWait "SWC_PCF/RE_SWC_PCF_10ms_sys/PCF_10ms/PCF_StateManagement/Pcf_Stm/PcfStm_Judgment/SLAccToWait" /begin REF_MEASUREMENT VAR_PcfStm_flgSLAccToWait_b /end REF_MEASUREMENT /end GROUP
/begin GROUP S119_StndbyToSLCorNPC "SWC_PCF/RE_SWC_PCF_10ms_sys/PCF_10ms/PCF_StateManagement/Pcf_Stm/PcfStm_Judgment/StndbyToSLCorNPC"
 /begin REF_MEASUREMENT VAR_PcfStm_flgNPCToStandby_b VAR_PcfStm_flgSLCToStandby_b VAR_PcfStm_flgStandbyToNPC_b VAR_PcfStm_flgStandbyToSLC_b /end REF_MEASUREMENT
/end GROUP
/begin GROUP S16_Debounce1 "SWC_PCF/RE_SWC_PCF_10ms_sys/PCF_10ms/PCF_Diagnosis/PCF_Diag/Basic_Diagnosis/SenDemDiag/Debounce1" /begin REF_CHARACTERISTIC CAL_PcfDia_PosDebounce_f32 /end REF_CHARACTERISTIC /end GROUP
/begin GROUP S16_Debounce2 "SWC_PCF/RE_SWC_PCF_10ms_sys/PCF_10ms/PCF_Diagnosis/PCF_Diag/Basic_Diagnosis/SenDemDiag/Debounce2" /begin REF_CHARACTERISTIC CAL_PcfDia_PosDebounce_f32 /end REF_CHARACTERISTIC /end GROUP
/begin GROUP S16_PosDiag "SWC_PCF/RE_SWC_PCF_10ms_sys/PCF_10ms/PCF_Diagnosis/PCF_Diag/Basic_Diagnosis/SenDemDiag/PosDiag"
 /begin REF_CHARACTERISTIC CAL_PcfDia_PosHighset_f32 CAL_PcfDia_PosLowset_f32 CAL_PcfDia_posSenHiRngSet_f32 /end REF_CHARACTERISTIC
/end GROUP
/begin GROUP S16_latch1 "SWC_PCF/RE_SWC_PCF_10ms_sys/PCF_10ms/PCF_Diagnosis/PCF_Diag/Basic_Diagnosis/SenDemDiag/latch1" /begin REF_MEASUREMENT VAR_PcfDia_flgSenVerFail_b /end REF_MEASUREMENT /end GROUP
/begin GROUP S16_latch2 "SWC_PCF/RE_SWC_PCF_10ms_sys/PCF_10ms/PCF_Diagnosis/PCF_Diag/Basic_Diagnosis/SenDemDiag/latch2" /begin REF_MEASUREMENT VAR_PcfDia_flgSenOv_b /end REF_MEASUREMENT /end GROUP
/begin GROUP S19_Debounce2 "SWC_PCF/RE_SWC_PCF_10ms_sys/PCF_10ms/PCF_Diagnosis/PCF_Diag/Basic_Diagnosis/VDD5VDiag/Debounce2" /begin REF_CHARACTERISTIC CAL_PcfDia_VDD5Debounce_f32 /end REF_CHARACTERISTIC /end GROUP
/begin GROUP S19_latch1 "SWC_PCF/RE_SWC_PCF_10ms_sys/PCF_10ms/PCF_Diagnosis/PCF_Diag/Basic_Diagnosis/VDD5VDiag/latch1" /begin REF_MEASUREMENT VAR_PcfDia_VDD5PcfErr_b /end REF_MEASUREMENT /end GROUP
/begin GROUP S63_Swt "SWC_PCF/RE_SWC_PCF_10ms_sys/PCF_10ms/PCF_Diagnosis/PCF_Diag/Compound_Diagnosis/RetryDiag/Swt" /begin REF_CHARACTERISTIC CAL_PcfDia_flgRetrySwt_b CAL_PcfDia_flgRetry_b /end REF_CHARACTERISTIC /begin REF_MEASUREMENT VAR_PcfDia_flgRetryShield_b VAR_PcfDia_flgRetry_b /end REF_MEASUREMENT /end GROUP
/begin GROUP S74_If_Action_Subsystem "SWC_PCF/RE_SWC_PCF_10ms_sys/PCF_10ms/PCF_PWMControl/PcfCtl_MotorControl/PcfCtl_Ctl/PcfCtl_enMosandAimPos/If Action Subsystem" /begin REF_CHARACTERISTIC CAL_PcfCtl_SLdeltaAimOutP_f32 /end REF_CHARACTERISTIC /end GROUP
/begin GROUP S74_If_Action_Subsystem1 "SWC_PCF/RE_SWC_PCF_10ms_sys/PCF_10ms/PCF_PWMControl/PcfCtl_MotorControl/PcfCtl_Ctl/PcfCtl_enMosandAimPos/If Action Subsystem1" /begin REF_CHARACTERISTIC CAL_PcfCtl_InitOutP_f32 /end REF_CHARACTERISTIC /end GROUP
/begin GROUP S90_flgBrake "SWC_PCF/RE_SWC_PCF_10ms_sys/PCF_10ms/PCF_SignalProcess/PCF_Sig/PcfSig_001/VCU_signal/flgBrake" /begin REF_CHARACTERISTIC CAL_PcfSig_flgBrakeSwt_b CAL_PcfSig_flgBrake_u8 /end REF_CHARACTERISTIC /begin REF_MEASUREMENT VAR_PcfSig_flgBrake_b /end REF_MEASUREMENT /end GROUP
/begin GROUP S90_flgP "SWC_PCF/RE_SWC_PCF_10ms_sys/PCF_10ms/PCF_SignalProcess/PCF_Sig/PcfSig_001/VCU_signal/flgP" /begin REF_CHARACTERISTIC CAL_PcfSig_flgPSwt_b CAL_PcfSig_flgP_b /end REF_CHARACTERISTIC /begin REF_MEASUREMENT VAR_PcfSig_flgP_b /end REF_MEASUREMENT /end GROUP
/begin GROUP S90_flgP_In "SWC_PCF/RE_SWC_PCF_10ms_sys/PCF_10ms/PCF_SignalProcess/PCF_Sig/PcfSig_001/VCU_signal/flgP_In"
 /begin REF_CHARACTERISTIC CAL_PcfSig_TimesTestP_u16 CAL_PcfSig_flgTestPSwt_b CAL_PcfSig_tDelayTestP_f32 /end REF_CHARACTERISTIC
 /begin SUB_GROUP S93_TimesCalc /end SUB_GROUP
/end GROUP
/begin GROUP S90_stBelt "SWC_PCF/RE_SWC_PCF_10ms_sys/PCF_10ms/PCF_SignalProcess/PCF_Sig/PcfSig_001/VCU_signal/stBelt" /begin REF_CHARACTERISTIC CAL_PcfSig_flgstBeltSwt_b CAL_PcfSig_stBelt_u8 /end REF_CHARACTERISTIC /begin REF_MEASUREMENT VAR_PcfSig_flgBelt_b VAR_PcfSig_stParkCtlReq_u8 /end REF_MEASUREMENT /end GROUP
/begin GROUP S90_stDoor "SWC_PCF/RE_SWC_PCF_10ms_sys/PCF_10ms/PCF_SignalProcess/PCF_Sig/PcfSig_001/VCU_signal/stDoor" /begin REF_CHARACTERISTIC CAL_PcfSig_flgstDoorSwt_b CAL_PcfSig_stDoor_u8 /end REF_CHARACTERISTIC /begin REF_MEASUREMENT VAR_PcfSig_stDoor_b /end REF_MEASUREMENT /end GROUP
/begin GROUP S101_flt1 "SWC_PCF/RE_SWC_PCF_10ms_sys/PCF_10ms/PCF_SignalProcess/PCF_Sig/PcfSig_002/IUBEpc/flt1" /begin REF_CHARACTERISTIC CAL_PcfSig_IUBPcfFltCoe_f32 /end REF_CHARACTERISTIC /begin REF_MEASUREMENT VAR_PcfSig_IUBPcf_f32 /end REF_MEASUREMENT /end GROUP
/begin GROUP S106_Subsystem "SWC_PCF/RE_SWC_PCF_10ms_sys/PCF_10ms/PCF_SignalProcess/PCF_Sig/PcfSig_002/iEpc/Subsystem" /begin SUB_GROUP S109_flt1 /end SUB_GROUP /end GROUP
/begin GROUP S106_Subsystem1 "SWC_PCF/RE_SWC_PCF_10ms_sys/PCF_10ms/PCF_SignalProcess/PCF_Sig/PcfSig_002/iEpc/Subsystem1"
 /begin REF_CHARACTERISTIC CAL_PcfSig_tMosiSENcof_tCof_af32 CAL_PcfSig_tMosiSENofs_tCof_af32 /end REF_CHARACTERISTIC
/end GROUP
/begin GROUP S107_flt "SWC_PCF/RE_SWC_PCF_10ms_sys/PCF_10ms/PCF_SignalProcess/PCF_Sig/PcfSig_002/tEpc/flt" /begin REF_MEASUREMENT VAR_PcfSig_tMosPcf_f32 /end REF_MEASUREMENT /end GROUP
/begin GROUP S116_flt1 "SWC_PCF/RE_SWC_PCF_10ms_sys/PCF_10ms/PCF_SignalProcess/PCF_Sig/PcfSig_003/nMotCalc/flt1" /begin REF_CHARACTERISTIC CAL_PcfSig_nMotFltCoe_f32 /end REF_CHARACTERISTIC /begin REF_MEASUREMENT VAR_PcfSig_nPcfMot_f32 /end REF_MEASUREMENT /end GROUP
/begin GROUP S124_DiaAutoP "SWC_PCF/RE_SWC_PCF_10ms_sys/PCF_10ms/PCF_StateManagement/Pcf_Stm/PcfStm_Judgment/PCInPorOutPToRun/DiaAutoP" /begin REF_MEASUREMENT VAR_PcfStm_flgDiaAutoP_b /end REF_MEASUREMENT /end GROUP
/begin GROUP S124_EnAutoInP "SWC_PCF/RE_SWC_PCF_10ms_sys/PCF_10ms/PCF_StateManagement/Pcf_Stm/PcfStm_Judgment/PCInPorOutPToRun/EnAutoInP" /begin REF_MEASUREMENT VAR_PcfStm_flgEnAutoInP_b /end REF_MEASUREMENT /end GROUP
/begin GROUP S124_EnAutoOutP "SWC_PCF/RE_SWC_PCF_10ms_sys/PCF_10ms/PCF_StateManagement/Pcf_Stm/PcfStm_Judgment/PCInPorOutPToRun/EnAutoOutP" /begin REF_CHARACTERISTIC CAL_PcfStm_flgTestPSwt_b /end REF_CHARACTERISTIC /begin REF_MEASUREMENT VAR_PcfStm_flgEnAutoOutP_b /end REF_MEASUREMENT /end GROUP
/begin GROUP S124_InPtoRun "SWC_PCF/RE_SWC_PCF_10ms_sys/PCF_10ms/PCF_StateManagement/Pcf_Stm/PcfStm_Judgment/PCInPorOutPToRun/InPtoRun" /begin REF_MEASUREMENT VAR_PcfStm_flgPCInPtoRun_b /end REF_MEASUREMENT /end GROUP
/begin GROUP S93_TimesCalc "SWC_PCF/RE_SWC_PCF_10ms_sys/PCF_10ms/PCF_SignalProcess/PCF_Sig/PcfSig_001/VCU_signal/flgP_In/TimesCalc" /begin REF_MEASUREMENT VAR_PcfSig_TestTimes_u16 /end REF_MEASUREMENT /end GROUP
/begin GROUP S109_flt1 "SWC_PCF/RE_SWC_PCF_10ms_sys/PCF_10ms/PCF_SignalProcess/PCF_Sig/PcfSig_002/iEpc/Subsystem/flt1" /begin REF_CHARACTERISTIC CAL_PcfSig_iSENFltCoe_f32 /end REF_CHARACTERISTIC /begin REF_MEASUREMENT VAR_PcfSig_IsentMosPcf_f32 /end REF_MEASUREMENT /end GROUP
/begin GROUP SWC_RCF "SWC_RCF" ROOT /begin SUB_GROUP Root_RE_SWC_RCF_100us_sys Root_RE_SWC_RCF_10ms_sys /end SUB_GROUP /end GROUP
/begin GROUP Root_RE_SWC_RCF_100us_sys "SWC_RCF/RE_SWC_RCF_100us_sys" /begin SUB_GROUP S1_RCF_100us /end SUB_GROUP /end GROUP
/begin GROUP Root_RE_SWC_RCF_10ms_sys "SWC_RCF/RE_SWC_RCF_10ms_sys" /begin SUB_GROUP S2_RCF_10ms /end SUB_GROUP /end GROUP
/begin GROUP S1_RCF_100us "SWC_RCF/RE_SWC_RCF_100us_sys/RCF_100us" /begin REF_CHARACTERISTIC CAL_RCF_flgEnOfsClb_b /end REF_CHARACTERISTIC /begin SUB_GROUP S4_Subsystem /end SUB_GROUP /end GROUP
/begin GROUP S2_RCF_10ms "SWC_RCF/RE_SWC_RCF_10ms_sys/RCF_10ms"
 /begin REF_CHARACTERISTIC CAL_RCF_TrqDesAcc_f32 CAL_RCF_cTrqSlopAcc_f32 CAL_RCF_tMaxAcc_u16 CAL_RCF_tMaxFwlBwd_u16 CAL_RCF_tMaxFwlFwd_u16 /end REF_CHARACTERISTIC
 /begin REF_MEASUREMENT VAR_RCF_TrqEmDesOfsClb_f32 VAR_RCF_cTrqSlpOfsClb_f32 VAR_RCF_flgEnblEstAlRtrOfs_b VAR_RCF_flgEnblOfsClbFrwhlBwd_b VAR_RCF_flgEnblOfsClbFrwhlFwd_b VAR_RCF_flgEnblOfsClbFrwhl_b VAR_RCF_stAgRtrOfsCal_u8 VAR_RCF_stDiagOfsClb_u8 /end REF_MEASUREMENT
 /begin SUB_GROUP S53_RCF_DEM S53_RCF_flgState /end SUB_GROUP
/end GROUP
/begin GROUP S4_Subsystem "SWC_RCF/RE_SWC_RCF_100us_sys/RCF_100us/Subsystem"
 /begin REF_CHARACTERISTIC CAL_RCF_UsAlfaScalSet_f32 CAL_RCF_UsBetaScalSet_f32 CAL_RCF_cntOfValBwd_u32 CAL_RCF_cntOfValFwd_u32 CAL_RCF_nOfValBwdStp_f32 CAL_RCF_nOfValFwdStp_f32 CAL_RCF_tHiEstAlOfs_u32 CAL_RCF_tMaxEstAlOfs1_u32 CAL_RCF_tMaxEstAlOfs_u32 CAL_RCF_tUAlfaSet_u32 CAL_RCF_tUbetaSet_u32 /end REF_CHARACTERISTIC
 /begin REF_MEASUREMENT VAR_RCF_AutoClbOffset_f32 VAR_RCF_UsAlfaScalSet_f32 VAR_RCF_UsBetaScalSet_f32 VAR_RCF_flgUseUsSet_b VAR_RCF_stEstAlRtrOfs_u8 VAR_RCF_stOfsClbFrwhl_u8 VAR_RCF_stOfsFrwhlBwd_u8 VAR_RCF_stOfsFrwhlFwd_u8 /end REF_MEASUREMENT
 /begin SUB_GROUP S5_RCF_AlRtrOfsClbFrwhl S5_RCF_InitAlRtrOfsEst S5_Subsystem1 S5_secflgstClb S5_secflgstEst /end SUB_GROUP
/end GROUP
/begin GROUP S53_RCF_DEM "SWC_RCF/RE_SWC_RCF_10ms_sys/RCF_10ms/RCF_DEM" /begin REF_CHARACTERISTIC CAL_RCF_flgReAutoClbSuc_b CAL_RCF_flgUseClbSucNvm_b /end REF_CHARACTERISTIC /end GROUP
/begin GROUP S53_RCF_flgState "SWC_RCF/RE_SWC_RCF_10ms_sys/RCF_10ms/RCF_flgState"
 /begin REF_CHARACTERISTIC CAL_RCF_WithoutStatorCurrent_u8 CAL_RCF_nAlRtrDesAcc_f32 CAL_RCF_nMaxStartAcc_f32 CAL_RCF_nMinSkipAcc_f32 /end REF_CHARACTERISTIC
 /begin SUB_GROUP S56_RCF_flgAccToClbFreBwd S56_RCF_flgAccToClbFreFwd S56_RCF_flgAccToDefault S56_RCF_flgAccToSucd S56_RCF_flgClbFreFwdToAcc S56_RCF_flgClbToFail S56_RCF_flgDefaultToClbFreFwd S56_RCF_flgDefaultToFrewhlBwd S56_RCF_flgDefaultToWait S56_RCF_flgFailToDefault S56_RCF_flgFwdorBwdToDefault S56_RCF_flgPsiToFail S56_RCF_flgSucdToDefault S56_RCF_flgWaitToAcc S56_RCF_flgWaitToFail S56_SmgOfs_flgBwClbSucdToAcc /end SUB_GROUP
/end GROUP
/begin GROUP S5_Subsystem1 "SWC_RCF/RE_SWC_RCF_100us_sys/RCF_100us/Subsystem/Subsystem1" /begin REF_MEASUREMENT VAR_RCF_agRtrOffsEstimd_f32 /end REF_MEASUREMENT /end GROUP
/begin GROUP S5_secflgstClb "SWC_RCF/RE_SWC_RCF_100us_sys/RCF_100us/Subsystem/secflgstClb"
 /begin SUB_GROUP S11_RCF_flgBwdClbToCalc S11_RCF_flgClbReset S11_RCF_flgClbToInact S11_RCF_flgFwdClbToWait S11_RCF_flgInactToBwdClb S11_RCF_flgInactToFwdClb S11_RCF_flgWaitToBwdClb /end SUB_GROUP
/end GROUP
/begin GROUP S5_secflgstEst "SWC_RCF/RE_SWC_RCF_100us_sys/RCF_100us/Subsystem/secflgstEst" /begin REF_CHARACTERISTIC CAL_RCF_EstToDefault_b CAL_RCF_nEstAlOfsStop_f32 /end REF_CHARACTERISTIC
 /begin SUB_GROUP S12_RCF_flgFailorFnhToDefault S12_RCF_flgstDefTostEst S12_RCF_flgstEstToFail S12_RCF_flgstEstToWait S12_RCF_flgstEstTostDef /end SUB_GROUP
/end GROUP
/begin GROUP S5_RCF_AlRtrOfsClbFrwhl "SWC_RCF/RE_SWC_RCF_100us_sys/RCF_100us/Subsystem/RCF_AlRtrOfsClbFrwhl" /begin SUB_GROUP S7_simfcnBwd S7_simfcnFwd S7_simfcnSt /end SUB_GROUP /end GROUP
/begin GROUP S5_RCF_InitAlRtrOfsEst "SWC_RCF/RE_SWC_RCF_100us_sys/RCF_100us/Subsystem/RCF_InitAlRtrOfsEst" /begin SUB_GROUP S8_simFcnUaUb /end SUB_GROUP /end GROUP
/begin GROUP S56_RCF_flgAccToClbFreBwd "SWC_RCF/RE_SWC_RCF_10ms_sys/RCF_10ms/RCF_flgState/RCF_flgAccToClbFreBwd" /begin REF_MEASUREMENT VAR_RCF_flgAccToClbFreBwd_b /end REF_MEASUREMENT /end GROUP
/begin GROUP S56_RCF_flgAccToClbFreFwd "SWC_RCF/RE_SWC_RCF_10ms_sys/RCF_10ms/RCF_flgState/RCF_flgAccToClbFreFwd" /begin REF_MEASUREMENT VAR_RCF_flgAccToClbFreFwd_b /end REF_MEASUREMENT /end GROUP
/begin GROUP S56_RCF_flgAccToDefault "SWC_RCF/RE_SWC_RCF_10ms_sys/RCF_10ms/RCF_flgState/RCF_flgAccToDefault" /begin REF_MEASUREMENT VAR_RCF_flgAccToDefault_b /end REF_MEASUREMENT /end GROUP
/begin GROUP S56_RCF_flgAccToSucd "SWC_RCF/RE_SWC_RCF_10ms_sys/RCF_10ms/RCF_flgState/RCF_flgAccToSucd" /begin REF_CHARACTERISTIC CAL_RCF_nMinSuccessStp_f32 /end REF_CHARACTERISTIC /begin REF_MEASUREMENT VAR_RCF_flgAccToSucd_b /end REF_MEASUREMENT /end GROUP
/begin GROUP S56_RCF_flgClbFreFwdToAcc "SWC_RCF/RE_SWC_RCF_10ms_sys/RCF_10ms/RCF_flgState/RCF_flgClbFreFwdToAcc" /begin REF_CHARACTERISTIC CAL_RCF_nExtClbFrewhlFwd_f32 /end REF_CHARACTERISTIC /begin REF_MEASUREMENT VAR_RCF_flgClbFreFwdToAcc_b /end REF_MEASUREMENT /end GROUP
/begin GROUP S56_RCF_flgClbToFail "SWC_RCF/RE_SWC_RCF_10ms_sys/RCF_10ms/RCF_flgState/RCF_flgClbToFail" /begin REF_MEASUREMENT VAR_RCF_flgClbToFail_b /end REF_MEASUREMENT /end GROUP
/begin GROUP S56_RCF_flgDefaultToClbFreFwd "SWC_RCF/RE_SWC_RCF_10ms_sys/RCF_10ms/RCF_flgState/RCF_flgDefaultToClbFreFwd" /begin REF_MEASUREMENT VAR_RCF_flgDefaultToClbFreFwd_b /end REF_MEASUREMENT /end GROUP
/begin GROUP S56_RCF_flgDefaultToFrewhlBwd "SWC_RCF/RE_SWC_RCF_10ms_sys/RCF_10ms/RCF_flgState/RCF_flgDefaultToFrewhlBwd" /begin REF_MEASUREMENT VAR_RCF_flgDefaultToFrewhlBwd_b /end REF_MEASUREMENT /end GROUP
/begin GROUP S56_RCF_flgDefaultToWait "SWC_RCF/RE_SWC_RCF_10ms_sys/RCF_10ms/RCF_flgState/RCF_flgDefaultToWait" /begin REF_MEASUREMENT VAR_RCF_flgDefaultToWait_b /end REF_MEASUREMENT /end GROUP
/begin GROUP S56_RCF_flgFailToDefault "SWC_RCF/RE_SWC_RCF_10ms_sys/RCF_10ms/RCF_flgState/RCF_flgFailToDefault" /begin REF_MEASUREMENT VAR_RCF_flgFailToDefault_b /end REF_MEASUREMENT /end GROUP
/begin GROUP S56_RCF_flgFwdorBwdToDefault "SWC_RCF/RE_SWC_RCF_10ms_sys/RCF_10ms/RCF_flgState/RCF_flgFwdorBwdToDefault" /begin REF_MEASUREMENT VAR_RCF_flgFwdorBwdToDefault_b /end REF_MEASUREMENT /end GROUP
/begin GROUP S56_RCF_flgPsiToFail "SWC_RCF/RE_SWC_RCF_10ms_sys/RCF_10ms/RCF_flgState/RCF_flgPsiToFail" /begin REF_MEASUREMENT VAR_RCF_flgPsiToFail_b /end REF_MEASUREMENT /end GROUP
/begin GROUP S56_RCF_flgSucdToDefault "SWC_RCF/RE_SWC_RCF_10ms_sys/RCF_10ms/RCF_flgState/RCF_flgSucdToDefault" /begin REF_CHARACTERISTIC CAL_RCF_SuccdToDefault_b CAL_RCF_nLimitSucToDef_f32 /end REF_CHARACTERISTIC /begin REF_MEASUREMENT VAR_RCF_flgSucdToDefault_b /end REF_MEASUREMENT /end GROUP
/begin GROUP S56_RCF_flgWaitToAcc "SWC_RCF/RE_SWC_RCF_10ms_sys/RCF_10ms/RCF_flgState/RCF_flgWaitToAcc" /begin REF_MEASUREMENT VAR_RCF_flgWaitToAcc_b /end REF_MEASUREMENT /end GROUP
/begin GROUP S56_RCF_flgWaitToFail "SWC_RCF/RE_SWC_RCF_10ms_sys/RCF_10ms/RCF_flgState/RCF_flgWaitToFail" /begin REF_MEASUREMENT VAR_RCF_flgWaitToFail_b /end REF_MEASUREMENT /end GROUP
/begin GROUP S56_SmgOfs_flgBwClbSucdToAcc "SWC_RCF/RE_SWC_RCF_10ms_sys/RCF_10ms/RCF_flgState/SmgOfs_flgBwClbSucdToAcc" /begin REF_CHARACTERISTIC CAL_RCF_nExtClbFrewhlBwd_f32 /end REF_CHARACTERISTIC /begin REF_MEASUREMENT VAR_RCF_flgBwClbSucdToAcc_b /end REF_MEASUREMENT /end GROUP
/begin GROUP S11_RCF_flgBwdClbToCalc "SWC_RCF/RE_SWC_RCF_100us_sys/RCF_100us/Subsystem/secflgstClb/RCF_flgBwdClbToCalc" /begin REF_CHARACTERISTIC CAL_RCF_nOfValBwdStp_f32 /end REF_CHARACTERISTIC /begin REF_MEASUREMENT VAR_RCF_flgBwdClbToCalc_b /end REF_MEASUREMENT /end GROUP
/begin GROUP S11_RCF_flgClbReset "SWC_RCF/RE_SWC_RCF_100us_sys/RCF_100us/Subsystem/secflgstClb/RCF_flgClbReset" /begin REF_MEASUREMENT VAR_RCF_flgClbReset_b /end REF_MEASUREMENT /end GROUP
/begin GROUP S11_RCF_flgClbToInact "SWC_RCF/RE_SWC_RCF_100us_sys/RCF_100us/Subsystem/secflgstClb/RCF_flgClbToInact" /begin REF_MEASUREMENT VAR_RCF_flgClbToInact_b /end REF_MEASUREMENT /end GROUP
/begin GROUP S11_RCF_flgFwdClbToWait "SWC_RCF/RE_SWC_RCF_100us_sys/RCF_100us/Subsystem/secflgstClb/RCF_flgFwdClbToWait" /begin REF_CHARACTERISTIC CAL_RCF_nOfValFwdStp_f32 /end REF_CHARACTERISTIC /begin REF_MEASUREMENT VAR_RCF_flgFwdClbToWait_b /end REF_MEASUREMENT /end GROUP
/begin GROUP S11_RCF_flgInactToBwdClb "SWC_RCF/RE_SWC_RCF_100us_sys/RCF_100us/Subsystem/secflgstClb/RCF_flgInactToBwdClb" /begin REF_MEASUREMENT VAR_RCF_flgInactToBwdClb_b /end REF_MEASUREMENT /end GROUP
/begin GROUP S11_RCF_flgInactToFwdClb "SWC_RCF/RE_SWC_RCF_100us_sys/RCF_100us/Subsystem/secflgstClb/RCF_flgInactToFwdClb" /begin REF_MEASUREMENT VAR_RCF_flgInactToFwdClb_b /end REF_MEASUREMENT /end GROUP
/begin GROUP S11_RCF_flgWaitToBwdClb "SWC_RCF/RE_SWC_RCF_100us_sys/RCF_100us/Subsystem/secflgstClb/RCF_flgWaitToBwdClb" /begin REF_MEASUREMENT VAR_RCF_flgWaitToBwdClb_b /end REF_MEASUREMENT /end GROUP
/begin GROUP S12_RCF_flgFailorFnhToDefault "SWC_RCF/RE_SWC_RCF_100us_sys/RCF_100us/Subsystem/secflgstEst/RCF_flgFailorFnhToDefault" /begin REF_MEASUREMENT VAR_RCF_flgFailorFnhToDefault_b /end REF_MEASUREMENT /end GROUP
/begin GROUP S12_RCF_flgstDefTostEst "SWC_RCF/RE_SWC_RCF_100us_sys/RCF_100us/Subsystem/secflgstEst/RCF_flgstDefTostEst" /begin REF_MEASUREMENT VAR_RCF_flgstDefTostEst_b /end REF_MEASUREMENT /end GROUP
/begin GROUP S12_RCF_flgstEstToFail "SWC_RCF/RE_SWC_RCF_100us_sys/RCF_100us/Subsystem/secflgstEst/RCF_flgstEstToFail" /begin REF_MEASUREMENT VAR_RCF_flgstEstToFail_b /end REF_MEASUREMENT /end GROUP
/begin GROUP S12_RCF_flgstEstToWait "SWC_RCF/RE_SWC_RCF_100us_sys/RCF_100us/Subsystem/secflgstEst/RCF_flgstEstToWait" /begin REF_MEASUREMENT VAR_RCF_flgstEstToWait_b /end REF_MEASUREMENT /end GROUP
/begin GROUP S12_RCF_flgstEstTostDef "SWC_RCF/RE_SWC_RCF_100us_sys/RCF_100us/Subsystem/secflgstEst/RCF_flgstEstTostDef" /begin REF_MEASUREMENT VAR_RCF_flgstEstTostDef_b /end REF_MEASUREMENT /end GROUP
/begin GROUP S7_simfcnBwd "SWC_RCF/RE_SWC_RCF_100us_sys/RCF_100us/Subsystem/RCF_AlRtrOfsClbFrwhl/simfcnBwd"
 /begin REF_CHARACTERISTIC CAL_RCF_agReferenceBwd_f32 CAL_RCF_nOfsClbMaxBwd_f32 CAL_RCF_nOfsClbMinBwd_f32 /end REF_CHARACTERISTIC
 /begin REF_MEASUREMENT VAR_RCF_OfsClbAngBwd_f32 /end REF_MEASUREMENT
 /begin SUB_GROUP S13_Enabled_Subsystem1 S13_Subsystem S13_Subsystem3 /end SUB_GROUP
/end GROUP
/begin GROUP S7_simfcnFwd "SWC_RCF/RE_SWC_RCF_100us_sys/RCF_100us/Subsystem/RCF_AlRtrOfsClbFrwhl/simfcnFwd"
 /begin REF_CHARACTERISTIC CAL_RCF_agReferenceFwd_f32 CAL_RCF_nOfsClbMaxFwd_f32 CAL_RCF_nOfsClbMinFwd_f32 /end REF_CHARACTERISTIC
 /begin REF_MEASUREMENT VAR_RCF_OfsClbAngFwd_f32 /end REF_MEASUREMENT
 /begin SUB_GROUP S14_Enabled_Subsystem1 S14_Subsystem S14_Subsystem3 /end SUB_GROUP
/end GROUP
/begin GROUP S7_simfcnSt "SWC_RCF/RE_SWC_RCF_100us_sys/RCF_100us/Subsystem/RCF_AlRtrOfsClbFrwhl/simfcnSt" /begin REF_CHARACTERISTIC CAL_RCF_AlRtrOfsDvtMax_f32 /end REF_CHARACTERISTIC /end GROUP
/begin GROUP S8_simFcnUaUb "SWC_RCF/RE_SWC_RCF_100us_sys/RCF_100us/Subsystem/RCF_InitAlRtrOfsEst/simFcnUaUb"
 /begin REF_CHARACTERISTIC CAL_RCF_UsAlfaScalSet_f32 CAL_RCF_UsBetaScalSet_f32 CAL_RCF_tUAlfaSet_u32 CAL_RCF_tUbetaSet_u32 /end REF_CHARACTERISTIC
/end GROUP
/begin GROUP S13_Enabled_Subsystem1 "SWC_RCF/RE_SWC_RCF_100us_sys/RCF_100us/Subsystem/RCF_AlRtrOfsClbFrwhl/simfcnBwd/Enabled Subsystem1" /begin REF_CHARACTERISTIC CAL_RCF_cntMovAveFilBwd_u16 /end REF_CHARACTERISTIC /end GROUP
/begin GROUP S13_Subsystem "SWC_RCF/RE_SWC_RCF_100us_sys/RCF_100us/Subsystem/RCF_AlRtrOfsClbFrwhl/simfcnBwd/Subsystem"
 /begin REF_CHARACTERISTIC CAL_RCF_nCalcSec1_f32 CAL_RCF_nCalcSec2_f32 CAL_RCF_nCalcSec3_f32 CAL_RCF_nCalcSec4_f32 CAL_RCF_nCalcSec5_f32 CAL_RCF_nCalcSec6_f32 CAL_RCF_nCalcSec7_f32 CAL_RCF_nCalcSec8_f32 /end REF_CHARACTERISTIC
 /begin SUB_GROUP S17_If_Action_Subsystem10 S17_If_Action_Subsystem11 S17_If_Action_Subsystem12 S17_If_Action_Subsystem13 S17_If_Action_Subsystem6 S17_If_Action_Subsystem7 S17_If_Action_Subsystem9 /end SUB_GROUP
/end GROUP
/begin GROUP S13_Subsystem3 "SWC_RCF/RE_SWC_RCF_100us_sys/RCF_100us/Subsystem/RCF_AlRtrOfsClbFrwhl/simfcnBwd/Subsystem3" /begin REF_CHARACTERISTIC CAL_RCF_360EdgeRag_f32 /end REF_CHARACTERISTIC /end GROUP
/begin GROUP S14_Enabled_Subsystem1 "SWC_RCF/RE_SWC_RCF_100us_sys/RCF_100us/Subsystem/RCF_AlRtrOfsClbFrwhl/simfcnFwd/Enabled Subsystem1" /begin REF_CHARACTERISTIC CAL_RCF_cntMovAveFilFwd_u16 /end REF_CHARACTERISTIC /end GROUP
/begin GROUP S14_Subsystem "SWC_RCF/RE_SWC_RCF_100us_sys/RCF_100us/Subsystem/RCF_AlRtrOfsClbFrwhl/simfcnFwd/Subsystem"
 /begin REF_CHARACTERISTIC CAL_RCF_nCalcSec1_f32 CAL_RCF_nCalcSec2_f32 CAL_RCF_nCalcSec3_f32 CAL_RCF_nCalcSec4_f32 CAL_RCF_nCalcSec5_f32 CAL_RCF_nCalcSec6_f32 CAL_RCF_nCalcSec7_f32 CAL_RCF_nCalcSec8_f32 /end REF_CHARACTERISTIC
 /begin SUB_GROUP S29_If_Action_Subsystem1 S29_If_Action_Subsystem2 S29_If_Action_Subsystem3 S29_If_Action_Subsystem4 S29_If_Action_Subsystem5 S29_If_Action_Subsystem6 S29_If_Action_Subsystem8 /end SUB_GROUP
/end GROUP
/begin GROUP S17_If_Action_Subsystem10 "SWC_RCF/RE_SWC_RCF_100us_sys/RCF_100us/Subsystem/RCF_AlRtrOfsClbFrwhl/simfcnBwd/Subsystem/If Action Subsystem10" /begin REF_CHARACTERISTIC CAL_RCF_OffsetAngFiltCoef_f32 /end REF_CHARACTERISTIC /begin REF_MEASUREMENT VAR_RCF_OfsFlt4400Bwd_f32 /end REF_MEASUREMENT /end GROUP
/begin GROUP S17_If_Action_Subsystem11 "SWC_RCF/RE_SWC_RCF_100us_sys/RCF_100us/Subsystem/RCF_AlRtrOfsClbFrwhl/simfcnBwd/Subsystem/If Action Subsystem11" /begin REF_CHARACTERISTIC CAL_RCF_OffsetAngFiltCoef_f32 /end REF_CHARACTERISTIC /begin REF_MEASUREMENT VAR_RCF_OfsFlt4600Bwd_f32 /end REF_MEASUREMENT /end GROUP
/begin GROUP S17_If_Action_Subsystem12 "SWC_RCF/RE_SWC_RCF_100us_sys/RCF_100us/Subsystem/RCF_AlRtrOfsClbFrwhl/simfcnBwd/Subsystem/If Action Subsystem12" /begin REF_CHARACTERISTIC CAL_RCF_OffsetAngFiltCoef_f32 /end REF_CHARACTERISTIC /begin REF_MEASUREMENT VAR_RCF_OfsFlt4800Bwd_f32 /end REF_MEASUREMENT /end GROUP
/begin GROUP S17_If_Action_Subsystem13 "SWC_RCF/RE_SWC_RCF_100us_sys/RCF_100us/Subsystem/RCF_AlRtrOfsClbFrwhl/simfcnBwd/Subsystem/If Action Subsystem13" /begin REF_CHARACTERISTIC CAL_RCF_OffsetAngFiltCoef_f32 /end REF_CHARACTERISTIC /begin REF_MEASUREMENT VAR_RCF_OfsFlt3600Bwd_f32 /end REF_MEASUREMENT /end GROUP
/begin GROUP S17_If_Action_Subsystem6 "SWC_RCF/RE_SWC_RCF_100us_sys/RCF_100us/Subsystem/RCF_AlRtrOfsClbFrwhl/simfcnBwd/Subsystem/If Action Subsystem6" /begin REF_CHARACTERISTIC CAL_RCF_OffsetAngFiltCoef_f32 /end REF_CHARACTERISTIC /begin REF_MEASUREMENT VAR_RCF_OfsFlt3800Bwd_f32 /end REF_MEASUREMENT /end GROUP
/begin GROUP S17_If_Action_Subsystem7 "SWC_RCF/RE_SWC_RCF_100us_sys/RCF_100us/Subsystem/RCF_AlRtrOfsClbFrwhl/simfcnBwd/Subsystem/If Action Subsystem7" /begin REF_CHARACTERISTIC CAL_RCF_OffsetAngFiltCoef_f32 /end REF_CHARACTERISTIC /begin REF_MEASUREMENT VAR_RCF_OfsFlt4000Bwd_f32 /end REF_MEASUREMENT /end GROUP
/begin GROUP S17_If_Action_Subsystem9 "SWC_RCF/RE_SWC_RCF_100us_sys/RCF_100us/Subsystem/RCF_AlRtrOfsClbFrwhl/simfcnBwd/Subsystem/If Action Subsystem9" /begin REF_CHARACTERISTIC CAL_RCF_OffsetAngFiltCoef_f32 /end REF_CHARACTERISTIC /begin REF_MEASUREMENT VAR_RCF_OfsFlt4200Bwd_f32 /end REF_MEASUREMENT /end GROUP
/begin GROUP S29_If_Action_Subsystem1 "SWC_RCF/RE_SWC_RCF_100us_sys/RCF_100us/Subsystem/RCF_AlRtrOfsClbFrwhl/simfcnFwd/Subsystem/If Action Subsystem1" /begin REF_CHARACTERISTIC CAL_RCF_OffsetAngFiltCoef_f32 /end REF_CHARACTERISTIC /begin REF_MEASUREMENT VAR_RCF_OfsFlt3800Fwd_f32 /end REF_MEASUREMENT /end GROUP
/begin GROUP S29_If_Action_Subsystem2 "SWC_RCF/RE_SWC_RCF_100us_sys/RCF_100us/Subsystem/RCF_AlRtrOfsClbFrwhl/simfcnFwd/Subsystem/If Action Subsystem2" /begin REF_CHARACTERISTIC CAL_RCF_OffsetAngFiltCoef_f32 /end REF_CHARACTERISTIC /begin REF_MEASUREMENT VAR_RCF_OfsFlt4000Fwd_f32 /end REF_MEASUREMENT /end GROUP
/begin GROUP S29_If_Action_Subsystem3 "SWC_RCF/RE_SWC_RCF_100us_sys/RCF_100us/Subsystem/RCF_AlRtrOfsClbFrwhl/simfcnFwd/Subsystem/If Action Subsystem3" /begin REF_CHARACTERISTIC CAL_RCF_OffsetAngFiltCoef_f32 /end REF_CHARACTERISTIC /begin REF_MEASUREMENT VAR_RCF_OfsFlt4200Fwd_f32 /end REF_MEASUREMENT /end GROUP
/begin GROUP S29_If_Action_Subsystem4 "SWC_RCF/RE_SWC_RCF_100us_sys/RCF_100us/Subsystem/RCF_AlRtrOfsClbFrwhl/simfcnFwd/Subsystem/If Action Subsystem4" /begin REF_CHARACTERISTIC CAL_RCF_OffsetAngFiltCoef_f32 /end REF_CHARACTERISTIC /begin REF_MEASUREMENT VAR_RCF_OfsFlt4400Fwd_f32 /end REF_MEASUREMENT /end GROUP
/begin GROUP S29_If_Action_Subsystem5 "SWC_RCF/RE_SWC_RCF_100us_sys/RCF_100us/Subsystem/RCF_AlRtrOfsClbFrwhl/simfcnFwd/Subsystem/If Action Subsystem5" /begin REF_CHARACTERISTIC CAL_RCF_OffsetAngFiltCoef_f32 /end REF_CHARACTERISTIC /begin REF_MEASUREMENT VAR_RCF_OfsFlt4600Fwd_f32 /end REF_MEASUREMENT /end GROUP
/begin GROUP S29_If_Action_Subsystem6 "SWC_RCF/RE_SWC_RCF_100us_sys/RCF_100us/Subsystem/RCF_AlRtrOfsClbFrwhl/simfcnFwd/Subsystem/If Action Subsystem6" /begin REF_CHARACTERISTIC CAL_RCF_OffsetAngFiltCoef_f32 /end REF_CHARACTERISTIC /begin REF_MEASUREMENT VAR_RCF_OfsFlt4800Fwd_f32 /end REF_MEASUREMENT /end GROUP
/begin GROUP S29_If_Action_Subsystem8 "SWC_RCF/RE_SWC_RCF_100us_sys/RCF_100us/Subsystem/RCF_AlRtrOfsClbFrwhl/simfcnFwd/Subsystem/If Action Subsystem8" /begin REF_CHARACTERISTIC CAL_RCF_OffsetAngFiltCoef_f32 /end REF_CHARACTERISTIC /begin REF_MEASUREMENT VAR_RCF_OfsFlt3600Fwd_f32 /end REF_MEASUREMENT /end GROUP
/begin GROUP SWC_SCF "SWC_SCF" ROOT /begin SUB_GROUP Root_RE_SWC_SCF_10ms_sys /end SUB_GROUP /end GROUP
/begin GROUP Root_RE_SWC_SCF_10ms_sys "SWC_SCF/RE_SWC_SCF_10ms_sys"
 /begin REF_MEASUREMENT VAR_Scf_flgFimDchaFailr_b VAR_Scf_flgFimFaultLvFive_b VAR_Scf_flgFimFaultLvFour_b VAR_Scf_flgFimReqFailr_b VAR_Scf_flgFimVCUComErr_b VAR_Scf_flgFimforFR_b /end REF_MEASUREMENT
 /begin SUB_GROUP S1_SCF_Ctl /end SUB_GROUP
/end GROUP
/begin GROUP S1_SCF_Ctl "SWC_SCF/RE_SWC_SCF_10ms_sys/SCF_Ctl"
 /begin REF_CHARACTERISTIC CAL_Scf_cntDisChgEnd_u16 CAL_Scf_cntDisChgOvTi_u16 CAL_Scf_nSafeLoSpdMaxLim_f32 CAL_Scf_nSafeLoSpdMinLim_f32 CAL_Scf_nSafeMaxLim_f32 CAL_Scf_nSafeMinLim_f32 CAL_Scf_nSafeTestMaxLim_f32 CAL_Scf_nSafeTestMinLim_f32 CAL_Scf_uDisChgEnd_f32 CAL_Scf_uDisChgOutTim_f32 /end REF_CHARACTERISTIC
 /begin REF_MEASUREMENT Var_Scf_flgDisChgFail_b /end REF_MEASUREMENT
 /begin SUB_GROUP S3_SCF_SigInp_10ms S3_SigMap /end SUB_GROUP
/end GROUP
/begin GROUP S3_SCF_SigInp_10ms "SWC_SCF/RE_SWC_SCF_10ms_sys/SCF_Ctl/SCF_SigInp_10ms"
 /begin SUB_GROUP S4_SCF_DchaCtl_10ms S4_SCF_DrvTrans S4_SCF_PreDrvTrans S4_SCF_SysTrans S4_SCF_VCUComErrSwt /end SUB_GROUP
/end GROUP
/begin GROUP S3_SigMap "SWC_SCF/RE_SWC_SCF_10ms_sys/SCF_Ctl/SigMap" /begin SUB_GROUP S6_FRActionLogic /end SUB_GROUP /end GROUP
/begin GROUP S4_SCF_DchaCtl_10ms "SWC_SCF/RE_SWC_SCF_10ms_sys/SCF_Ctl/SCF_SigInp_10ms/SCF_DchaCtl_10ms" /begin SUB_GROUP S7_CmftDchaCtl S7_DchagFunCoord S7_EmDchaCtl /end SUB_GROUP /end GROUP
/begin GROUP S4_SCF_DrvTrans "SWC_SCF/RE_SWC_SCF_10ms_sys/SCF_Ctl/SCF_SigInp_10ms/SCF_DrvTrans"
 /begin SUB_GROUP S8_HvStateJudg S8_TranDchaToNormal S8_TranIdleToStb S8_TranNormalToDcha S8_TranOfstCalToStb S8_TranRunToStb S8_TranStbToEPP S8_TranStbToIdle S8_TranStbToOfstCal S8_TranStbToRun /end SUB_GROUP
/end GROUP
/begin GROUP S4_SCF_PreDrvTrans "SWC_SCF/RE_SWC_SCF_10ms_sys/SCF_Ctl/SCF_SigInp_10ms/SCF_PreDrvTrans"
 /begin SUB_GROUP S9_TranDiagToSenCal S9_TranLoPowSetToDiag S9_TranPreDrvRunToFish S9_TranSenCalToiMMO /end SUB_GROUP
/end GROUP
/begin GROUP S4_SCF_SysTrans "SWC_SCF/RE_SWC_SCF_10ms_sys/SCF_Ctl/SCF_SigInp_10ms/SCF_SysTrans"
 /begin REF_CHARACTERISTIC CAL_Scf_curSenChgToDrv_f32 CAL_Scf_curSenChgToPostDrv_f32 CAL_Scf_nPsmThresToDrv_f32 CAL_Scf_nPsmThresToPostDrv_f32 CAL_Scf_uTnetHysToDrv_f32 CAL_Scf_uTnetHysToPostDrv_f32 /end REF_CHARACTERISTIC
 /begin SUB_GROUP S10_ShutDownOverTime_TranPostDrvToShutDown S10_TranDrvToFail_TranFaultToDcha S10_TranDrvToPostDrv S10_TranFaultToPostDrv S10_TranPostDrvToPreDrive_TranPreDrvToFail S10_uDc_n_Is_Limit /end SUB_GROUP
/end GROUP
/begin GROUP S4_SCF_VCUComErrSwt "SWC_SCF/RE_SWC_SCF_10ms_sys/SCF_Ctl/SCF_SigInp_10ms/SCF_VCUComErrSwt" /begin REF_CHARACTERISTIC CAL_Scf_flgIntVcuComErr_b CAL_Scf_flgIntVcuComSwt_b /end REF_CHARACTERISTIC /begin REF_MEASUREMENT VAR_Scf_VCUComErr_b /end REF_MEASUREMENT /end GROUP
/begin GROUP S6_FRActionLogic "SWC_SCF/RE_SWC_SCF_10ms_sys/SCF_Ctl/SigMap/FRActionLogic"
 /begin REF_CHARACTERISTIC CAL_Scf_FFActionArea2_u8 CAL_Scf_FFActionArea3_u8 CAL_Scf_FFActionDisab_u8 /end REF_CHARACTERISTIC
/end GROUP
/begin GROUP S7_CmftDchaCtl "SWC_SCF/RE_SWC_SCF_10ms_sys/SCF_Ctl/SCF_SigInp_10ms/SCF_DchaCtl_10ms/CmftDchaCtl" /begin SUB_GROUP S12_DchaMcuReqWiRelay S12_DchaReqByVCU S12_VCUComErrDelay /end SUB_GROUP /end GROUP
/begin GROUP S7_DchagFunCoord "SWC_SCF/RE_SWC_SCF_10ms_sys/SCF_Ctl/SCF_SigInp_10ms/SCF_DchaCtl_10ms/DchagFunCoord" /begin REF_CHARACTERISTIC CAL_Scf_flgDisChgReqSwt_b CAL_Scf_flgEmgDisChgReqSwt_b /end REF_CHARACTERISTIC
 /begin REF_MEASUREMENT VAR_Scf_DisChaDetec_b VAR_Scf_flgEmgReqInvDcha_b VAR_Scf_flgReqInvDcha_b /end REF_MEASUREMENT
/end GROUP
/begin GROUP S7_EmDchaCtl "SWC_SCF/RE_SWC_SCF_10ms_sys/SCF_Ctl/SCF_SigInp_10ms/SCF_DchaCtl_10ms/EmDchaCtl" /begin SUB_GROUP S14_EI09_EmDisChaFunction /end SUB_GROUP /end GROUP
/begin GROUP S8_HvStateJudg "SWC_SCF/RE_SWC_SCF_10ms_sys/SCF_Ctl/SCF_SigInp_10ms/SCF_DrvTrans/HvStateJudg" /begin REF_CHARACTERISTIC CAL_Scf_udcPrechgFail_f32 CAL_Scf_udcPrechgFish_f32 /end REF_CHARACTERISTIC /end GROUP
/begin GROUP S8_TranDchaToNormal "SWC_SCF/RE_SWC_SCF_10ms_sys/SCF_Ctl/SCF_SigInp_10ms/SCF_DrvTrans/TranDchaToNormal" /begin REF_CHARACTERISTIC CAL_Scf_uSafeVolt_f32 /end REF_CHARACTERISTIC /begin REF_MEASUREMENT VAR_Scf_flgTranDchaToNormal_b /end REF_MEASUREMENT /end GROUP
/begin GROUP S8_TranIdleToStb "SWC_SCF/RE_SWC_SCF_10ms_sys/SCF_Ctl/SCF_SigInp_10ms/SCF_DrvTrans/TranIdleToStb" /begin REF_MEASUREMENT VAR_Scf_flgTranIdleToStb_b /end REF_MEASUREMENT /end GROUP
/begin GROUP S8_TranNormalToDcha "SWC_SCF/RE_SWC_SCF_10ms_sys/SCF_Ctl/SCF_SigInp_10ms/SCF_DrvTrans/TranNormalToDcha" /begin REF_MEASUREMENT VAR_Scf_flgTranNormalToDcha_b /end REF_MEASUREMENT /end GROUP
/begin GROUP S8_TranOfstCalToStb "SWC_SCF/RE_SWC_SCF_10ms_sys/SCF_Ctl/SCF_SigInp_10ms/SCF_DrvTrans/TranOfstCalToStb" /begin REF_MEASUREMENT VAR_Scf_flgTranOfstCalToStb_b /end REF_MEASUREMENT /end GROUP
/begin GROUP S8_TranRunToStb "SWC_SCF/RE_SWC_SCF_10ms_sys/SCF_Ctl/SCF_SigInp_10ms/SCF_DrvTrans/TranRunToStb" /begin REF_CHARACTERISTIC CAL_Scf_flgJumpRunBy15Swt_b CAL_Scf_nRunTostb_f32 /end REF_CHARACTERISTIC /begin REF_MEASUREMENT VAR_Scf_flgTranRunToStb_b /end REF_MEASUREMENT /end GROUP
/begin GROUP S8_TranStbToEPP "SWC_SCF/RE_SWC_SCF_10ms_sys/SCF_Ctl/SCF_SigInp_10ms/SCF_DrvTrans/TranStbToEPP" /begin REF_CHARACTERISTIC CAL_SCF_flgUseSLCal_b /end REF_CHARACTERISTIC
 /begin REF_MEASUREMENT VAR_Scf_flgTranSLCalToStb_b VAR_Scf_flgTranSLInitToSLAcc_b VAR_Scf_flgTranSLInitToSLFw_b VAR_Scf_flgTranStbToSLCal_b /end REF_MEASUREMENT
/end GROUP
/begin GROUP S8_TranStbToIdle "SWC_SCF/RE_SWC_SCF_10ms_sys/SCF_Ctl/SCF_SigInp_10ms/SCF_DrvTrans/TranStbToIdle" /begin REF_MEASUREMENT VAR_Scf_flgTranStbToIdle_b /end REF_MEASUREMENT /end GROUP
/begin GROUP S8_TranStbToOfstCal "SWC_SCF/RE_SWC_SCF_10ms_sys/SCF_Ctl/SCF_SigInp_10ms/SCF_DrvTrans/TranStbToOfstCal" /begin REF_MEASUREMENT VAR_Scf_flgTranStbToOfstCal_b /end REF_MEASUREMENT /end GROUP
/begin GROUP S8_TranStbToRun "SWC_SCF/RE_SWC_SCF_10ms_sys/SCF_Ctl/SCF_SigInp_10ms/SCF_DrvTrans/TranStbToRun" /begin REF_CHARACTERISTIC CAL_Scf_flgOfsClbSwt_b CAL_Scf_flgPcfAllowPwmRunSwt_b /end REF_CHARACTERISTIC /begin REF_MEASUREMENT VAR_Scf_flgTranStbToRun_b /end REF_MEASUREMENT /end GROUP
/begin GROUP S9_TranDiagToSenCal "SWC_SCF/RE_SWC_SCF_10ms_sys/SCF_Ctl/SCF_SigInp_10ms/SCF_PreDrvTrans/TranDiagToSenCal"
 /begin REF_CHARACTERISTIC CAL_Scf_FLOATZERO_f32 CAL_Scf_WithoutStatorCurrent_u8 CAL_Scf_nSnsrClbFw_f32 /end REF_CHARACTERISTIC
 /begin REF_MEASUREMENT VAR_Scf_flgTranDiagToSenCal_b /end REF_MEASUREMENT
/end GROUP
/begin GROUP S9_TranLoPowSetToDiag "SWC_SCF/RE_SWC_SCF_10ms_sys/SCF_Ctl/SCF_SigInp_10ms/SCF_PreDrvTrans/TranLoPowSetToDiag"
 /begin REF_CHARACTERISTIC CAL_Scf_FLOATZERO_f32 CAL_Scf_LowPwrSetUpSud_u8 CAL_Scf_nSnsrClbFw_f32 /end REF_CHARACTERISTIC
 /begin REF_MEASUREMENT VAR_Scf_flgTranLoPowSetToDia_b /end REF_MEASUREMENT
/end GROUP
/begin GROUP S9_TranPreDrvRunToFish "SWC_SCF/RE_SWC_SCF_10ms_sys/SCF_Ctl/SCF_SigInp_10ms/SCF_PreDrvTrans/TranPreDrvRunToFish" /begin REF_CHARACTERISTIC CAL_Scf_SenChkSud_u8 /end REF_CHARACTERISTIC /begin REF_MEASUREMENT VAR_Scf_flgTranPreDrvRunToFish_b /end REF_MEASUREMENT /end GROUP
/begin GROUP S9_TranSenCalToiMMO "SWC_SCF/RE_SWC_SCF_10ms_sys/SCF_Ctl/SCF_SigInp_10ms/SCF_PreDrvTrans/TranSenCalToiMMO" /begin REF_CHARACTERISTIC CAL_Scf_SenChkSud_u8 /end REF_CHARACTERISTIC /begin REF_MEASUREMENT VAR_Scf_flgTranSenCalToiMMO_b /end REF_MEASUREMENT /end GROUP
/begin GROUP S10_ShutDownOverTime_TranPostDrvToShutDown "SWC_SCF/RE_SWC_SCF_10ms_sys/SCF_Ctl/SCF_SigInp_10ms/SCF_SysTrans/ShutDownOverTime&TranPostDrvToShutDown"
 /begin SUB_GROUP S37_ShutDownOverTime S37_TranPostDrvToShutDown S37_TranPreDrvToDrv S37_TranPreDrvToPostDrv /end SUB_GROUP
/end GROUP
/begin GROUP S10_TranDrvToFail_TranFaultToDcha "SWC_SCF/RE_SWC_SCF_10ms_sys/SCF_Ctl/SCF_SigInp_10ms/SCF_SysTrans/TranDrvToFail&TranFaultToDcha" /begin SUB_GROUP S38_TranDrvToFail S38_TranFaultToDcha /end SUB_GROUP /end GROUP
/begin GROUP S10_TranDrvToPostDrv "SWC_SCF/RE_SWC_SCF_10ms_sys/SCF_Ctl/SCF_SigInp_10ms/SCF_SysTrans/TranDrvToPostDrv"
 /begin SUB_GROUP S39_DrvToPostDrvReqCoord S39_PostDrvReqWiDcha S39_PostDrvReqWoDcha /end SUB_GROUP
/end GROUP
/begin GROUP S10_TranFaultToPostDrv "SWC_SCF/RE_SWC_SCF_10ms_sys/SCF_Ctl/SCF_SigInp_10ms/SCF_SysTrans/TranFaultToPostDrv" /begin SUB_GROUP S40_FaultToPostDrvReqCoord S40_PostDrvReqWiDcha /end SUB_GROUP /end GROUP
/begin GROUP S10_TranPostDrvToPreDrive_TranPreDrvToFail "SWC_SCF/RE_SWC_SCF_10ms_sys/SCF_Ctl/SCF_SigInp_10ms/SCF_SysTrans/TranPostDrvToPreDrive&TranPreDrvToFail" /begin SUB_GROUP S41_TranPostDrvToPreDrive S41_TranPreDrvToFail /end SUB_GROUP /end GROUP
/begin GROUP S10_uDc_n_Is_Limit "SWC_SCF/RE_SWC_SCF_10ms_sys/SCF_Ctl/SCF_SigInp_10ms/SCF_SysTrans/uDc_n_Is_Limit"
 /begin REF_CHARACTERISTIC CAL_Scf_flgActvSubNSwt_b CAL_Scf_flgActvSubUSwt_b CAL_Scf_flgActvSubisSwt_b CAL_Scf_iSubSttrisVal_f32 CAL_Scf_nSubPsmSpdVal_f32 CAL_Scf_uSubHiVoltVal_f32 /end REF_CHARACTERISTIC
/end GROUP
/begin GROUP S12_DchaMcuReqWiRelay "SWC_SCF/RE_SWC_SCF_10ms_sys/SCF_Ctl/SCF_SigInp_10ms/SCF_DchaCtl_10ms/CmftDchaCtl/DchaMcuReqWiRelay" /begin REF_CHARACTERISTIC CAL_Scf_nAllwPwrDcha_f32 CAL_Scf_uAllwPwrDcha_f32 /end REF_CHARACTERISTIC /begin REF_MEASUREMENT VAR_Scf_nDchaAllw_b /end REF_MEASUREMENT /begin SUB_GROUP S15_FaultCheck8 S15_RunToDisChaErr /end SUB_GROUP /end GROUP
/begin GROUP S12_DchaReqByVCU "SWC_SCF/RE_SWC_SCF_10ms_sys/SCF_Ctl/SCF_SigInp_10ms/SCF_DchaCtl_10ms/CmftDchaCtl/DchaReqByVCU" /begin REF_CHARACTERISTIC CAL_Scf_nAllwPwrDcha_f32 CAL_Scf_uAllwPwrDcha_f32 /end REF_CHARACTERISTIC /begin REF_MEASUREMENT VAR_Scf_flgDchaVcuReq_b /end REF_MEASUREMENT /end GROUP
/begin GROUP S12_VCUComErrDelay "SWC_SCF/RE_SWC_SCF_10ms_sys/SCF_Ctl/SCF_SigInp_10ms/SCF_DchaCtl_10ms/CmftDchaCtl/VCUComErrDelay" /begin REF_CHARACTERISTIC CAL_Scf_cntVCUComErrLim_u16 /end REF_CHARACTERISTIC /begin REF_MEASUREMENT VAR_Scf_flgVCUComErrDelay_b /end REF_MEASUREMENT /end GROUP
/begin GROUP S14_EI09_EmDisChaFunction "SWC_SCF/RE_SWC_SCF_10ms_sys/SCF_Ctl/SCF_SigInp_10ms/SCF_DchaCtl_10ms/EmDchaCtl/EI09_EmDisChaFunction" /begin REF_CHARACTERISTIC CAL_Scf_EmgDchabysiglordoubSwt_b /end REF_CHARACTERISTIC /begin SUB_GROUP S21_FaultCheck8 /end SUB_GROUP /end GROUP
/begin GROUP S37_ShutDownOverTime "SWC_SCF/RE_SWC_SCF_10ms_sys/SCF_Ctl/SCF_SigInp_10ms/SCF_SysTrans/ShutDownOverTime&TranPostDrvToShutDown/ShutDownOverTime"
 /begin REF_MEASUREMENT VAR_Scf_flgPostDrvDone_b VAR_Scf_flgWakeLoss_b VAR_Scf_flgWakeNormal_b /end REF_MEASUREMENT
 /begin SUB_GROUP S44_CntShutDownTime S44_Enabled_Subsystem S44_Subsystem S44_WakeLost /end SUB_GROUP
/end GROUP
/begin GROUP S37_TranPostDrvToShutDown "SWC_SCF/RE_SWC_SCF_10ms_sys/SCF_Ctl/SCF_SigInp_10ms/SCF_SysTrans/ShutDownOverTime&TranPostDrvToShutDown/TranPostDrvToShutDown" /begin REF_CHARACTERISTIC CAL_Scf_flgCanNmSwt_b CAL_Scf_flgEpcShutdownSwt_b /end REF_CHARACTERISTIC /begin REF_MEASUREMENT VAR_Scf_flgTranPostDrvToSutDwn_b /end REF_MEASUREMENT /end GROUP
/begin GROUP S37_TranPreDrvToDrv "SWC_SCF/RE_SWC_SCF_10ms_sys/SCF_Ctl/SCF_SigInp_10ms/SCF_SysTrans/ShutDownOverTime&TranPostDrvToShutDown/TranPreDrvToDrv" /begin REF_CHARACTERISTIC CAL_Scf_ShtDwnReqByVcuSwt_b /end REF_CHARACTERISTIC /begin REF_MEASUREMENT VAR_Scf_flgTranPreDrvToDrv_b /end REF_MEASUREMENT /end GROUP
/begin GROUP S37_TranPreDrvToPostDrv "SWC_SCF/RE_SWC_SCF_10ms_sys/SCF_Ctl/SCF_SigInp_10ms/SCF_SysTrans/ShutDownOverTime&TranPostDrvToShutDown/TranPreDrvToPostDrv" /begin REF_MEASUREMENT VAR_Scf_flgTranPreDrvToPostDrv_b /end REF_MEASUREMENT /end GROUP
/begin GROUP S38_TranDrvToFail "SWC_SCF/RE_SWC_SCF_10ms_sys/SCF_Ctl/SCF_SigInp_10ms/SCF_SysTrans/TranDrvToFail&TranFaultToDcha/TranDrvToFail" /begin REF_MEASUREMENT VAR_Scf_flgTranDrvToFault_b /end REF_MEASUREMENT /end GROUP
/begin GROUP S38_TranFaultToDcha "SWC_SCF/RE_SWC_SCF_10ms_sys/SCF_Ctl/SCF_SigInp_10ms/SCF_SysTrans/TranDrvToFail&TranFaultToDcha/TranFaultToDcha" /begin REF_MEASUREMENT VAR_Scf_flgTranFaultToDcha_b /end REF_MEASUREMENT /end GROUP
/begin GROUP S39_DrvToPostDrvReqCoord "SWC_SCF/RE_SWC_SCF_10ms_sys/SCF_Ctl/SCF_SigInp_10ms/SCF_SysTrans/TranDrvToPostDrv/DrvToPostDrvReqCoord" /begin REF_CHARACTERISTIC CAL_Scf_IntDchaSwt_b CAL_Scf_ShtDwnReqByVcuSwt_b /end REF_CHARACTERISTIC
 /begin REF_MEASUREMENT VAR_Scf_flgPostDrvReqWiDcha_b VAR_Scf_flgShtDwnByVcu_b VAR_Scf_flgTranDrvToPostDrv_b /end REF_MEASUREMENT
 /begin SUB_GROUP S55_VcuComErr_Delay /end SUB_GROUP
/end GROUP
/begin GROUP S39_PostDrvReqWiDcha "SWC_SCF/RE_SWC_SCF_10ms_sys/SCF_Ctl/SCF_SigInp_10ms/SCF_SysTrans/TranDrvToPostDrv/PostDrvReqWiDcha" /begin REF_CHARACTERISTIC CAL_Scf_flgDrvToPostWihDisSwt_b /end REF_CHARACTERISTIC /begin REF_MEASUREMENT VAR_Scf_flgShtDwnByMcu_b /end REF_MEASUREMENT /end GROUP
/begin GROUP S39_PostDrvReqWoDcha "SWC_SCF/RE_SWC_SCF_10ms_sys/SCF_Ctl/SCF_SigInp_10ms/SCF_SysTrans/TranDrvToPostDrv/PostDrvReqWoDcha" /begin REF_MEASUREMENT VAR_Scf_flgPostDrvReqWoDcha_b /end REF_MEASUREMENT /end GROUP
/begin GROUP S40_FaultToPostDrvReqCoord "SWC_SCF/RE_SWC_SCF_10ms_sys/SCF_Ctl/SCF_SigInp_10ms/SCF_SysTrans/TranFaultToPostDrv/FaultToPostDrvReqCoord" /begin REF_CHARACTERISTIC CAL_Scf_IntDchaSwt_b CAL_Scf_ShtDwnReqByVcuSwt_b /end REF_CHARACTERISTIC /begin REF_MEASUREMENT VAR_Scf_flgTranFaultToPostDrv_b /end REF_MEASUREMENT /begin SUB_GROUP S59_VcuComErr_Delay1 /end SUB_GROUP /end GROUP
/begin GROUP S40_PostDrvReqWiDcha "SWC_SCF/RE_SWC_SCF_10ms_sys/SCF_Ctl/SCF_SigInp_10ms/SCF_SysTrans/TranFaultToPostDrv/PostDrvReqWiDcha" /begin REF_CHARACTERISTIC CAL_Scf_flgDrvToPostWihDisSwt_b /end REF_CHARACTERISTIC /end GROUP
/begin GROUP S41_TranPostDrvToPreDrive "SWC_SCF/RE_SWC_SCF_10ms_sys/SCF_Ctl/SCF_SigInp_10ms/SCF_SysTrans/TranPostDrvToPreDrive&TranPreDrvToFail/TranPostDrvToPreDrive" /begin REF_CHARACTERISTIC CAL_Scf_StandbyVcuReq_u8 /end REF_CHARACTERISTIC /begin REF_MEASUREMENT VAR_Scf_flgTranPostDrvToPreDrv_b /end REF_MEASUREMENT /end GROUP
/begin GROUP S41_TranPreDrvToFail "SWC_SCF/RE_SWC_SCF_10ms_sys/SCF_Ctl/SCF_SigInp_10ms/SCF_SysTrans/TranPostDrvToPreDrive&TranPreDrvToFail/TranPreDrvToFail" /begin REF_CHARACTERISTIC CAL_Scf_LowPwrSetUpErr_u8 CAL_Scf_SenChkErr_u8 /end REF_CHARACTERISTIC /begin REF_MEASUREMENT VAR_Scf_flgTranPreDrvToFault_b /end REF_MEASUREMENT /end GROUP
/begin GROUP S15_FaultCheck8 "SWC_SCF/RE_SWC_SCF_10ms_sys/SCF_Ctl/SCF_SigInp_10ms/SCF_DchaCtl_10ms/CmftDchaCtl/DchaMcuReqWiRelay/FaultCheck8" /begin REF_CHARACTERISTIC CAL_Scf_cntDchaSigFit_u8 /end REF_CHARACTERISTIC /begin REF_MEASUREMENT VAR_Scf_cntSigFit_b /end REF_MEASUREMENT /end GROUP
/begin GROUP S15_RunToDisChaErr "SWC_SCF/RE_SWC_SCF_10ms_sys/SCF_Ctl/SCF_SigInp_10ms/SCF_DchaCtl_10ms/CmftDchaCtl/DchaMcuReqWiRelay/RunToDisChaErr" /begin REF_CHARACTERISTIC CAL_Scf_UdcLnkAbsDiffLim_f32 /end REF_CHARACTERISTIC
 /begin REF_MEASUREMENT VAR_Scf_DEMRunToDisChaFail_u8 VAR_Scf_DisChaUdcAfterDebounce_f32 VAR_Scf_DischaBeginUdc_f32 VAR_Scf_uDcLnkDiffUnLo_b /end REF_MEASUREMENT
 /begin SUB_GROUP S19_TimeAdding /end SUB_GROUP
/end GROUP
/begin GROUP S21_FaultCheck8 "SWC_SCF/RE_SWC_SCF_10ms_sys/SCF_Ctl/SCF_SigInp_10ms/SCF_DchaCtl_10ms/EmDchaCtl/EI09_EmDisChaFunction/FaultCheck8" /begin REF_CHARACTERISTIC CAL_Scf_cntDchaSigFit_u8 /end REF_CHARACTERISTIC /end GROUP
/begin GROUP S55_VcuComErr_Delay "SWC_SCF/RE_SWC_SCF_10ms_sys/SCF_Ctl/SCF_SigInp_10ms/SCF_SysTrans/TranDrvToPostDrv/DrvToPostDrvReqCoord/VcuComErr_Delay" /begin REF_CHARACTERISTIC CAL_Scf_cntVCUComErrLim_u16 /end REF_CHARACTERISTIC /end GROUP
/begin GROUP S59_VcuComErr_Delay1 "SWC_SCF/RE_SWC_SCF_10ms_sys/SCF_Ctl/SCF_SigInp_10ms/SCF_SysTrans/TranFaultToPostDrv/FaultToPostDrvReqCoord/VcuComErr_Delay1" /begin REF_CHARACTERISTIC CAL_Scf_cntVCUComErrLim_u16 /end REF_CHARACTERISTIC /end GROUP
/begin MEASUREMENT VAR_MCF_PowerMech_f32 "" FLOAT32_IEEE SWC_MCF_CM_single 0 0 -65535.0 65535.0 ECU_ADDRESS 0x70005274 /end MEASUREMENT
/begin MEASUREMENT VAR_MCF_flgMotHeat_b "" UBYTE SWC_MCF_CM_boolean 0 0 0.0 1.0 ECU_ADDRESS 0x7000526A /end MEASUREMENT
/begin MEASUREMENT VAR_MCF_PowerMotHeat_f32 "" FLOAT32_IEEE SWC_MCF_CM_single 0 0 -65535.0 65535.0 ECU_ADDRESS 0x70005270 /end MEASUREMENT
/begin MEASUREMENT VAR_MCF_PCUHeaterPower_f32 "" FLOAT32_IEEE SWC_MCF_CM_single 0 0 -65535.0 65535.0 ECU_ADDRESS 0x7000527C /end MEASUREMENT
/begin MEASUREMENT VAR_MCF_PowerDcLnk_f32 "" FLOAT32_IEEE SWC_MCF_CM_single 0 0 -65535.0 65535.0 ECU_ADDRESS 0x70005278 /end MEASUREMENT
/begin MEASUREMENT VAR_MDF_EmacBlkdState_u8 "" UBYTE SWC_MDF_CM_uint8 0 0 0.0 1.0 ECU_ADDRESS 0x700053B1 /end MEASUREMENT
/begin MEASUREMENT VAR_MDF_3PhaUnbalanceObs_f32 "" FLOAT32_IEEE SWC_MDF_CM_single 0 0 -65535.0 65535.0 ECU_ADDRESS 0x700053B8 /end MEASUREMENT
/begin MEASUREMENT VAR_MDF_flagOperOutdRngChk_b "" UBYTE SWC_MDF_CM_boolean 0 0 0.0 1.0 ECU_ADDRESS 0x700053A6 /end MEASUREMENT
/begin MEASUREMENT VAR_MDF_bIsOvHiFault_b "" UBYTE SWC_MDF_CM_boolean 0 0 0.0 1.0 ECU_ADDRESS 0x7000539E /end MEASUREMENT
/begin MEASUREMENT VAR_MDF_PrfElDrvState_u8 "" UBYTE SWC_MDF_CM_uint8 0 0 0.0 1.0 ECU_ADDRESS 0x700053AC /end MEASUREMENT
/begin MEASUREMENT VAR_MDF_bEMBlkChk_b "" UBYTE SWC_MDF_CM_boolean 0 0 0.0 1.0 ECU_ADDRESS 0x700053A9 /end MEASUREMENT
/begin MEASUREMENT VAR_MDF_bstGateDrvOpenCir_b "" UBYTE SWC_MDF_CM_boolean 0 0 0.0 1.0 ECU_ADDRESS 0x700053A7 /end MEASUREMENT
/begin MEASUREMENT VAR_MDF_bPwrCmpDFCCalc_b "" UBYTE SWC_MDF_CM_boolean 0 0 0.0 1.0 ECU_ADDRESS 0x700053A4 /end MEASUREMENT
/begin MEASUREMENT VAR_MDF_offsetDeltaObs_f32 "" FLOAT32_IEEE SWC_MDF_CM_single 0 0 -65535.0 65535.0 ECU_ADDRESS 0x700053BC /end MEASUREMENT
/begin MEASUREMENT VAR_MDF_OpenCirNoPsblState_u8 "" UBYTE SWC_MDF_CM_uint8 0 0 0.0 1.0 ECU_ADDRESS 0x700053AF /end MEASUREMENT
/begin MEASUREMENT VAR_MDF_PhaseFaultState_u8 "" UBYTE SWC_MDF_CM_uint8 0 0 0.0 1.0 ECU_ADDRESS 0x700053AD /end MEASUREMENT
/begin MEASUREMENT VAR_MDF_bshCirNoPsblFaul_b "" UBYTE SWC_MDF_CM_boolean 0 0 0.0 1.0 ECU_ADDRESS 0x700053A3 /end MEASUREMENT
/begin MEASUREMENT VAR_MDF_bFaultEMBlkWarn_b "" UBYTE SWC_MDF_CM_boolean 0 0 0.0 1.0 ECU_ADDRESS 0x7000539C /end MEASUREMENT
/begin MEASUREMENT VAR_MDF_bFaultEMBlkErr_b "" UBYTE SWC_MDF_CM_boolean 0 0 0.0 1.0 ECU_ADDRESS 0x7000539B /end MEASUREMENT
/begin MEASUREMENT VAR_MDF_ICtlRatState_u8 "" UBYTE SWC_MDF_CM_uint8 0 0 0.0 1.0 ECU_ADDRESS 0x700053B0 /end MEASUREMENT
/begin MEASUREMENT VAR_MDF_bAlOfsChk_b "" UBYTE SWC_MDF_CM_boolean 0 0 0.0 1.0 ECU_ADDRESS 0x700053AB /end MEASUREMENT
/begin MEASUREMENT VAR_MDF_flagOperOutdRngFault_b "" UBYTE SWC_MDF_CM_boolean 0 0 0.0 1.0 ECU_ADDRESS 0x700053A0 /end MEASUREMENT
/begin MEASUREMENT VAR_MDF_OffSetSiteAObs_f32 "" FLOAT32_IEEE SWC_MDF_CM_single 0 0 -65535.0 65535.0 ECU_ADDRESS 0x700053C4 /end MEASUREMENT
/begin MEASUREMENT VAR_MDF_offsetDeltaFlt_f32 "" FLOAT32_IEEE SWC_MDF_CM_single 0 0 -65535.0 65535.0 ECU_ADDRESS 0x700053B4 /end MEASUREMENT
/begin MEASUREMENT VAR_MDF_bstGateDrvShCir_b "" UBYTE SWC_MDF_CM_boolean 0 0 0.0 1.0 ECU_ADDRESS 0x700053AA /end MEASUREMENT
/begin MEASUREMENT VAR_MDF_bICtlRatChk_b "" UBYTE SWC_MDF_CM_boolean 0 0 0.0 1.0 ECU_ADDRESS 0x700053A8 /end MEASUREMENT
/begin MEASUREMENT VAR_MDF_bPhaseFault_b "" UBYTE SWC_MDF_CM_boolean 0 0 0.0 1.0 ECU_ADDRESS 0x700053A1 /end MEASUREMENT
/begin MEASUREMENT VAR_MDF_PhaseFaultChk_b "" UBYTE SWC_MDF_CM_boolean 0 0 0.0 1.0 ECU_ADDRESS 0x700053A5 /end MEASUREMENT
/begin MEASUREMENT VAR_MDF_bAlfOfsNoPlauseFault_b "" UBYTE SWC_MDF_CM_boolean 0 0 0.0 1.0 ECU_ADDRESS 0x7000539A /end MEASUREMENT
/begin MEASUREMENT VAR_MDF_OperOutdRngState_u8 "" UBYTE SWC_MDF_CM_uint8 0 0 0.0 1.0 ECU_ADDRESS 0x700053AE /end MEASUREMENT
/begin MEASUREMENT VAR_MDF_DiashCirNoPsblState_u8 "" UBYTE SWC_MDF_CM_uint8 0 0 0.0 1.0 ECU_ADDRESS 0x700053B2 /end MEASUREMENT
/begin MEASUREMENT VAR_MDF_OffSetSiteBObs_f32 "" FLOAT32_IEEE SWC_MDF_CM_single 0 0 -65535.0 65535.0 ECU_ADDRESS 0x700053C0 /end MEASUREMENT
/begin MEASUREMENT VAR_MDF_AlOfsNoPlausState_u8 "" UBYTE SWC_MDF_CM_uint8 0 0 0.0 1.0 ECU_ADDRESS 0x700053B3 /end MEASUREMENT
/begin MEASUREMENT VAR_MDF_bFaultPwrCmp_b "" UBYTE SWC_MDF_CM_boolean 0 0 0.0 1.0 ECU_ADDRESS 0x700053A2 /end MEASUREMENT
/begin MEASUREMENT VAR_MDF_bOpenCirNoPsblFault_b "" UBYTE SWC_MDF_CM_boolean 0 0 0.0 1.0 ECU_ADDRESS 0x7000539F /end MEASUREMENT
/begin MEASUREMENT VAR_MDF_bFaultICtlChk_b "" UBYTE SWC_MDF_CM_boolean 0 0 0.0 1.0 ECU_ADDRESS 0x7000539D /end MEASUREMENT
/begin MEASUREMENT VAR_MPC_TrqMon_f32 "" FLOAT32_IEEE SWC_MPC_CM_single 0 0 -65535.0 65535.0 ECU_ADDRESS 0x700053EC /end MEASUREMENT
/begin MEASUREMENT VAR_MPC_frqPwmVF_f32 "" FLOAT32_IEEE SWC_MPC_CM_single 0 0 -65535.0 65535.0 ECU_ADDRESS 0x700053E4 /end MEASUREMENT
/begin MEASUREMENT VAR_MPC_CofRandomPwm_f32 "" FLOAT32_IEEE SWC_MPC_CM_single 0 0 -65535.0 65535.0 ECU_ADDRESS 0x700053E8 /end MEASUREMENT
/begin MEASUREMENT VAR_PcfStm_BCenMos_b "" UBYTE SWC_PCF_CM_boolean 0 0 0 1 ECU_ADDRESS 0x7000548F /end MEASUREMENT
/begin MEASUREMENT VAR_PcfStm_flgPCInitToOutP_b "" UBYTE SWC_PCF_CM_boolean 0 0 0 1 ECU_ADDRESS 0x7000549B /end MEASUREMENT
/begin MEASUREMENT VAR_PcfCtl_PosDif_f32 "" FLOAT32_IEEE SWC_PCF_CM_single 0 0 -3.4E+38 3.4E+38 ECU_ADDRESS 0x700054F8 /end MEASUREMENT
/begin MEASUREMENT VAR_PcfStm_SLEnMotorAcc_b "" UBYTE SWC_PCF_CM_boolean 0 0 0 1 ECU_ADDRESS 0x7000548A /end MEASUREMENT
/begin MEASUREMENT VAR_PcfSig_IsentMosPcf_f32 "" FLOAT32_IEEE SWC_PCF_CM_single 0 0 -3.4E+38 3.4E+38 ECU_ADDRESS 0x70005524 /end MEASUREMENT
/begin MEASUREMENT VAR_PcfDia_flgFault_b "" UBYTE SWC_PCF_CM_boolean 0 0 0 1 ECU_ADDRESS 0x700054AB /end MEASUREMENT
/begin MEASUREMENT VAR_PcfDia_flgtMosOv_b "Mos¹Ü¹ýÎÂ¹ÊÕÏ" UBYTE SWC_PCF_CM_boolean 0 0 0 1 ECU_ADDRESS 0x700054A3 /end MEASUREMENT
/begin MEASUREMENT VAR_PcfCtl_enMos_b "" UBYTE SWC_PCF_CM_boolean 0 0 0 1 ECU_ADDRESS 0x70005497 /end MEASUREMENT
/begin MEASUREMENT VAR_PcfStm_flgActJudgeToSLRun_b "" UBYTE SWC_PCF_CM_boolean 0 0 0 1 ECU_ADDRESS 0x700054C1 /end MEASUREMENT
/begin MEASUREMENT VAR_PcfCtl_DirOutPID_b "" UBYTE SWC_PCF_CM_boolean 0 0 0 1 ECU_ADDRESS 0x70005498 /end MEASUREMENT
/begin MEASUREMENT VAR_PcfSig_IsenPcf_f32 "EPC¹¤×÷µçÁ÷" FLOAT32_IEEE SWC_PCF_CM_single 0 0 -3.4E+38 3.4E+38 ECU_ADDRESS 0x70005528 /end MEASUREMENT
/begin MEASUREMENT VAR_PcfSig_VehSpd_f32 "³µËÙÐÅºÅ" FLOAT32_IEEE SWC_PCF_CM_single 0 0 -3.4E+38 3.4E+38 ECU_ADDRESS 0x70005514 /end MEASUREMENT
/begin MEASUREMENT VAR_PcfStm_flgFaultToParkCtl_b "" UBYTE SWC_PCF_CM_boolean 0 0 0 1 ECU_ADDRESS 0x700054AA /end MEASUREMENT
/begin MEASUREMENT VAR_PcfStm_flgEnAutoOutP_b "" UBYTE SWC_PCF_CM_boolean 0 0 0 1 ECU_ADDRESS 0x700054B2 /end MEASUREMENT
/begin MEASUREMENT VAR_PcfDia_stUdc_u8 "EPC¹¤×÷µçÑ¹µÈ¼¶" UBYTE SWC_PCF_CM_uint8 0 0 0 255 ECU_ADDRESS 0x700054C8 /end MEASUREMENT
/begin MEASUREMENT VAR_PcfSig_DycLim_f32 "Õ¼¿Õ±ÈÏÞÖÆ" FLOAT32_IEEE SWC_PCF_CM_single 0 0 -3.4E+38 3.4E+38 ECU_ADDRESS 0x700054E0 /end MEASUREMENT
/begin MEASUREMENT VAR_PcfDia_flgRetryShield_b "" UBYTE SWC_PCF_CM_boolean 0 0 0 1 ECU_ADDRESS 0x700054AC /end MEASUREMENT
/begin MEASUREMENT VAR_PcfStm_BCstDiag_u8 "" UBYTE SWC_PCF_CM_uint8 0 0 0 255 ECU_ADDRESS 0x700054C5 /end MEASUREMENT
/begin MEASUREMENT VAR_PcfDia_flgNPCActPos_b "" UBYTE SWC_PCF_CM_boolean 0 0 0 1 ECU_ADDRESS 0x7000549D /end MEASUREMENT
/begin MEASUREMENT VAR_PcfSig_tMosPcf_f32 "Mos¹ÜÎÂ¶È" FLOAT32_IEEE SWC_PCF_CM_single 0 0 -3.4E+38 3.4E+38 ECU_ADDRESS 0x7000552C /end MEASUREMENT
/begin MEASUREMENT VAR_PcfStm_flgStandbyToNPC_b "" UBYTE SWC_PCF_CM_boolean 0 0 0 1 ECU_ADDRESS 0x7000549F /end MEASUREMENT
/begin MEASUREMENT VAR_PcfCtl_PosKd_f32 "" FLOAT32_IEEE SWC_PCF_CM_single 0 0 -3.4E+38 3.4E+38 ECU_ADDRESS 0x700054EC /end MEASUREMENT
/begin MEASUREMENT VAR_PcfStm_flgNPCToStandby_b "" UBYTE SWC_PCF_CM_boolean 0 0 0 1 ECU_ADDRESS 0x700054A8 /end MEASUREMENT
/begin MEASUREMENT VAR_PcfDia_flgSenOv_b "" UBYTE SWC_PCF_CM_boolean 0 0 0 1 ECU_ADDRESS 0x700054BD /end MEASUREMENT
/begin MEASUREMENT VAR_PcfCtl_PosKi_f32 "" FLOAT32_IEEE SWC_PCF_CM_single 0 0 -3.4E+38 3.4E+38 ECU_ADDRESS 0x700054F0 /end MEASUREMENT
/begin MEASUREMENT VAR_PcfStm_flgPCInitToInP_b "" UBYTE SWC_PCF_CM_boolean 0 0 0 1 ECU_ADDRESS 0x7000549C /end MEASUREMENT
/begin MEASUREMENT VAR_PcfCtl_enMosOutPID_b "" UBYTE SWC_PCF_CM_boolean 0 0 0 1 ECU_ADDRESS 0x70005499 /end MEASUREMENT
/begin MEASUREMENT VAR_PcfDia_flgRetry_b "" UBYTE SWC_PCF_CM_boolean 0 0 0 1 ECU_ADDRESS 0x700054AE /end MEASUREMENT
/begin MEASUREMENT VAR_PcfCtl_PosKp_f32 "" FLOAT32_IEEE SWC_PCF_CM_single 0 0 -3.4E+38 3.4E+38 ECU_ADDRESS 0x700054F4 /end MEASUREMENT
/begin MEASUREMENT VAR_PcfSig_flgBrake_b "É²³µ×´Ì¬ÐÅºÅ" UBYTE SWC_PCF_CM_boolean 0 0 0 1 ECU_ADDRESS 0x700054B8 /end MEASUREMENT
/begin MEASUREMENT VAR_PcfDia_flgRunTiOv_b "" UBYTE SWC_PCF_CM_boolean 0 0 0 1 ECU_ADDRESS 0x700054B0 /end MEASUREMENT
/begin MEASUREMENT VAR_PcfDiag_flgselfCkFnh_b "" UBYTE SWC_PCF_CM_boolean 0 0 0 1 ECU_ADDRESS 0x700054A2 /end MEASUREMENT
/begin MEASUREMENT VAR_PcfDia_flgStallFault_b "" UBYTE SWC_PCF_CM_boolean 0 0 0 1 ECU_ADDRESS 0x70005485 /end MEASUREMENT
/begin MEASUREMENT VAR_PcfStm_SLPosReg_f32 "" FLOAT32_IEEE SWC_PCF_CM_single 0 0 -3.4E+38 3.4E+38 ECU_ADDRESS 0x700054D8 /end MEASUREMENT
/begin MEASUREMENT VAR_PcfSig_flgPowerOn_b "PowerOnÊ¹ÄÜÐÅºÅ" UBYTE SWC_PCF_CM_boolean 0 0 0 1 ECU_ADDRESS 0x700054B4 /end MEASUREMENT
/begin MEASUREMENT VAR_PcfStm_flgStandbyToSLC_b "" UBYTE SWC_PCF_CM_boolean 0 0 0 1 ECU_ADDRESS 0x7000549E /end MEASUREMENT
/begin MEASUREMENT VAR_PcfDia_VDD5PcfErr_b "" UBYTE SWC_PCF_CM_boolean 0 0 0 1 ECU_ADDRESS 0x700054AD /end MEASUREMENT
/begin MEASUREMENT VAR_PcfDia_flgLocked_b "" UBYTE SWC_PCF_CM_boolean 0 0 0 1 ECU_ADDRESS 0x700054AF /end MEASUREMENT
/begin MEASUREMENT VAR_PcfStm_SLenMos_b "" UBYTE SWC_PCF_CM_boolean 0 0 0 1 ECU_ADDRESS 0x70005489 /end MEASUREMENT
/begin MEASUREMENT VAR_PcfDia_flgCritSpd_b "" UBYTE SWC_PCF_CM_boolean 0 0 0 1 ECU_ADDRESS 0x700054B9 /end MEASUREMENT
/begin MEASUREMENT VAR_PcfStm_flgAutoP_b "" UBYTE SWC_PCF_CM_boolean 0 0 0 1 ECU_ADDRESS 0x70005486 /end MEASUREMENT
/begin MEASUREMENT VAR_PcfSig_flgBelt_b "°²È«´ø×´Ì¬ÐÅºÅ" UBYTE SWC_PCF_CM_boolean 0 0 0 1 ECU_ADDRESS 0x70005491 /end MEASUREMENT
/begin MEASUREMENT VAR_PcfDia_stActPos_u8 "" UBYTE SWC_PCF_CM_uint8 0 0 0 255 ECU_ADDRESS 0x700054CB /end MEASUREMENT
/begin MEASUREMENT VAR_PcfSig_VDD5Pcf_f32 "" FLOAT32_IEEE SWC_PCF_CM_single 0 0 -3.4E+38 3.4E+38 ECU_ADDRESS 0x70005504 /end MEASUREMENT
/begin MEASUREMENT VAR_PcfStm_SLstDiag_u8 "" UBYTE SWC_PCF_CM_uint8 0 0 0 255 ECU_ADDRESS 0x700054C4 /end MEASUREMENT
/begin MEASUREMENT VAR_PcfDia_flgHwIdcOv_b "" UBYTE SWC_PCF_CM_boolean 0 0 0 1 ECU_ADDRESS 0x700054BE /end MEASUREMENT
/begin MEASUREMENT VAR_PcfCtl_enMosPID_b "" UBYTE SWC_PCF_CM_boolean 0 0 0 1 ECU_ADDRESS 0x7000549A /end MEASUREMENT
/begin MEASUREMENT VAR_PcfStm_BCMotDir_b "" UBYTE SWC_PCF_CM_boolean 0 0 0 1 ECU_ADDRESS 0x70005490 /end MEASUREMENT
/begin MEASUREMENT VAR_PcfDia_stRunTi_u8 "" UBYTE SWC_PCF_CM_uint8 0 0 0 255 ECU_ADDRESS 0x700054CA /end MEASUREMENT
/begin MEASUREMENT VAR_PcfCtl_PosPIDOut_f32 "" FLOAT32_IEEE SWC_PCF_CM_single 0 0 -3.4E+38 3.4E+38 ECU_ADDRESS 0x700054E8 /end MEASUREMENT
/begin MEASUREMENT VAR_PcfCtl_SoftDycPID_f32 "" FLOAT32_IEEE SWC_PCF_CM_single 0 0 -3.4E+38 3.4E+38 ECU_ADDRESS 0x700054E4 /end MEASUREMENT
/begin MEASUREMENT VAR_PcfStm_SLActDir_b "" UBYTE SWC_PCF_CM_boolean 0 0 0 1 ECU_ADDRESS 0x7000548B /end MEASUREMENT
/begin MEASUREMENT VAR_PcfDia_flgUnexPosWarn_b "" UBYTE SWC_PCF_CM_boolean 0 0 0 1 ECU_ADDRESS 0x70005493 /end MEASUREMENT
/begin MEASUREMENT VAR_PcfStm_SLtrqDes_f32 "" FLOAT32_IEEE SWC_PCF_CM_single 0 0 -3.4E+38 3.4E+38 ECU_ADDRESS 0x700054D4 /end MEASUREMENT
/begin MEASUREMENT VAR_PcfDia_flgBCLocked_b "" UBYTE SWC_PCF_CM_boolean 0 0 0 1 ECU_ADDRESS 0x700054C0 /end MEASUREMENT
/begin MEASUREMENT VAR_PcfStm_enMos_b "" UBYTE SWC_PCF_CM_boolean 0 0 0 1 ECU_ADDRESS 0x7000548D /end MEASUREMENT
/begin MEASUREMENT VAR_PcfSig_IUBPcf_f32 "" FLOAT32_IEEE SWC_PCF_CM_single 0 0 -3.4E+38 3.4E+38 ECU_ADDRESS 0x70005520 /end MEASUREMENT
/begin MEASUREMENT VAR_PcfSig_TestTimes_u16 "³öÈëP×Ô¶¯²âÊÔ´ÎÊý" UWORD SWC_PCF_CM_uint16 0 0 0 65535 ECU_ADDRESS 0x700054D0 /end MEASUREMENT
/begin MEASUREMENT VAR_PcfSig_flgP_b "µ²¸ËÐÅºÅ" UBYTE SWC_PCF_CM_boolean 0 0 0 1 ECU_ADDRESS 0x700054C2 /end MEASUREMENT
/begin MEASUREMENT VAR_PcfSig_stDoor_b "¼ÝÊ»²àÃÅ×´Ì¬ÐÅºÅ" UBYTE SWC_PCF_CM_boolean 0 0 0 1 ECU_ADDRESS 0x700054B7 /end MEASUREMENT
/begin MEASUREMENT VAR_PcfCtl_ActFnh_b "" UBYTE SWC_PCF_CM_boolean 0 0 0 1 ECU_ADDRESS 0x70005492 /end MEASUREMENT
/begin MEASUREMENT VAR_PcfStm_flgPCInPtoRun_b "" UBYTE SWC_PCF_CM_boolean 0 0 0 1 ECU_ADDRESS 0x700054A9 /end MEASUREMENT
/begin MEASUREMENT VAR_PcfStm_flgSLAccToWait_b "" UBYTE SWC_PCF_CM_boolean 0 0 0 1 ECU_ADDRESS 0x700054A6 /end MEASUREMENT
/begin MEASUREMENT VAR_PcfDia_flgUdcLoErr_b "¹¤×÷µçÑ¹¹ÊÕÏ" UBYTE SWC_PCF_CM_boolean 0 0 0 1 ECU_ADDRESS 0x700054A4 /end MEASUREMENT
/begin MEASUREMENT VAR_PcfSig_UBRPcf_f32 "EPC¹¤×÷µçÑ¹" FLOAT32_IEEE SWC_PCF_CM_single 0 0 -3.4E+38 3.4E+38 ECU_ADDRESS 0x70005500 /end MEASUREMENT
/begin MEASUREMENT VAR_PcfDia_flgAllowPwmRun_b "" UBYTE SWC_PCF_CM_boolean 0 0 0 1 ECU_ADDRESS 0x70005496 /end MEASUREMENT
/begin MEASUREMENT VAR_PcfStm_flgEnAutoInP_b "" UBYTE SWC_PCF_CM_boolean 0 0 0 1 ECU_ADDRESS 0x700054B6 /end MEASUREMENT
/begin MEASUREMENT VAR_PcfSig_flgIoc_b "EPCµçÂ·¹ýÁ÷ÐÅºÅ" UBYTE SWC_PCF_CM_boolean 0 0 0 1 ECU_ADDRESS 0x700054BF /end MEASUREMENT
/begin MEASUREMENT VAR_PcfStm_MotDir_b "" UBYTE SWC_PCF_CM_boolean 0 0 0 1 ECU_ADDRESS 0x7000548E /end MEASUREMENT
/begin MEASUREMENT VAR_PcfSig_PosAimOutP_f32 "³öPÄ¿±êÎ»ÖÃ" FLOAT32_IEEE SWC_PCF_CM_single 0 0 -3.4E+38 3.4E+38 ECU_ADDRESS 0x7000550C /end MEASUREMENT
/begin MEASUREMENT VAR_PcfCtl_AimPosPID_f32 "" FLOAT32_IEEE SWC_PCF_CM_single 0 0 -3.4E+38 3.4E+38 ECU_ADDRESS 0x700054FC /end MEASUREMENT
/begin MEASUREMENT VAR_PcfStm_flgNPCToRPC_b "" UBYTE SWC_PCF_CM_boolean 0 0 0 1 ECU_ADDRESS 0x700054A7 /end MEASUREMENT
/begin MEASUREMENT VAR_PcfStm_flgDiaAutoP_b "" UBYTE SWC_PCF_CM_boolean 0 0 0 1 ECU_ADDRESS 0x700054B3 /end MEASUREMENT
/begin MEASUREMENT VAR_PcfStm_BCflgModeReq_b "" UBYTE SWC_PCF_CM_boolean 0 0 0 1 ECU_ADDRESS 0x70005488 /end MEASUREMENT
/begin MEASUREMENT VAR_PcfCtl_DycOutPID_f32 "" FLOAT32_IEEE SWC_PCF_CM_single 0 0 -3.4E+38 3.4E+38 ECU_ADDRESS 0x700054DC /end MEASUREMENT
/begin MEASUREMENT VAR_PcfSig_IdcPcf_f32 "" FLOAT32_IEEE SWC_PCF_CM_single 0 0 -3.4E+38 3.4E+38 ECU_ADDRESS 0x7000551C /end MEASUREMENT
/begin MEASUREMENT VAR_PcfStm_flgFaultToBPC_b "" UBYTE SWC_PCF_CM_boolean 0 0 0 1 ECU_ADDRESS 0x700054B1 /end MEASUREMENT
/begin MEASUREMENT VAR_PcfStm_SLflgPosNvm_b "" UBYTE SWC_PCF_CM_boolean 0 0 0 1 ECU_ADDRESS 0x70005487 /end MEASUREMENT
/begin MEASUREMENT VAR_PcfStm_stParkCtl_u8 "" UBYTE SWC_PCF_CM_uint8 0 0 0 255 ECU_ADDRESS 0x700054C6 /end MEASUREMENT
/begin MEASUREMENT VAR_PcfDia_flgSenVerFail_b "" UBYTE SWC_PCF_CM_boolean 0 0 0 1 ECU_ADDRESS 0x700054BC /end MEASUREMENT
/begin MEASUREMENT VAR_PcfDiag_flgselfCkErr_b "" UBYTE SWC_PCF_CM_boolean 0 0 0 1 ECU_ADDRESS 0x70005495 /end MEASUREMENT
/begin MEASUREMENT VAR_PcfSig_nPcfMot_f32 "Ö´ÐÐÆ÷×ªËÙ" FLOAT32_IEEE SWC_PCF_CM_single 0 0 -3.4E+38 3.4E+38 ECU_ADDRESS 0x70005508 /end MEASUREMENT
/begin MEASUREMENT VAR_PcfSig_NVMSLFnh_b "×ÔÑ§Ï°Íê³ÉÐÅºÅ" UBYTE SWC_PCF_CM_boolean 0 0 0 1 ECU_ADDRESS 0x700054A1 /end MEASUREMENT
/begin MEASUREMENT VAR_PcfSig_Pos1_f32 "1Â·Î»ÖÃÐÅºÅ" FLOAT32_IEEE SWC_PCF_CM_single 0 0 -3.4E+38 3.4E+38 ECU_ADDRESS 0x70005530 /end MEASUREMENT
/begin MEASUREMENT VAR_PcfSig_Pos2_f32 "2Â·Î»ÖÃÐÅºÅ" FLOAT32_IEEE SWC_PCF_CM_single 0 0 -3.4E+38 3.4E+38 ECU_ADDRESS 0x70005518 /end MEASUREMENT
/begin MEASUREMENT VAR_PcfDia_flgAimInPRat_b "" UBYTE SWC_PCF_CM_boolean 0 0 0 1 ECU_ADDRESS 0x700054A0 /end MEASUREMENT
/begin MEASUREMENT VAR_PcfSig_flgKL15_b "KL15ÐÅºÅ" UBYTE SWC_PCF_CM_boolean 0 0 0 1 ECU_ADDRESS 0x700054BA /end MEASUREMENT
/begin MEASUREMENT VAR_PcfDia_stSLActPos_u8 "" UBYTE SWC_PCF_CM_uint8 0 0 0 255 ECU_ADDRESS 0x700054CC /end MEASUREMENT
/begin MEASUREMENT VAR_PcfDia_flgstallPause_b "" UBYTE SWC_PCF_CM_boolean 0 0 0 1 ECU_ADDRESS 0x70005484 /end MEASUREMENT
/begin MEASUREMENT VAR_PcfDia_flgShtDwnReq_b "" UBYTE SWC_PCF_CM_boolean 0 0 0 1 ECU_ADDRESS 0x70005494 /end MEASUREMENT
/begin MEASUREMENT VAR_PcfStm_flgBPCToFault_b "" UBYTE SWC_PCF_CM_boolean 0 0 0 1 ECU_ADDRESS 0x700054BB /end MEASUREMENT
/begin MEASUREMENT VAR_PcfSig_stParkCtlReq_u8 "" UBYTE SWC_PCF_CM_uint8 0 0 0 255 ECU_ADDRESS 0x700054C9 /end MEASUREMENT
/begin MEASUREMENT VAR_PcfStm_Actime_u16 "" UWORD SWC_PCF_CM_uint16 0 0 0 65535 ECU_ADDRESS 0x700054CE /end MEASUREMENT
/begin MEASUREMENT VAR_PcfSig_flgACC_b "¼ÓËÙÐÅºÅ" UBYTE SWC_PCF_CM_boolean 0 0 0 1 ECU_ADDRESS 0x700054B5 /end MEASUREMENT
/begin MEASUREMENT VAR_PcfStm_flgRetryFnh_b "" UBYTE SWC_PCF_CM_boolean 0 0 0 1 ECU_ADDRESS 0x7000548C /end MEASUREMENT
/begin MEASUREMENT VAR_PcfStm_flgSLCToStandby_b "" UBYTE SWC_PCF_CM_boolean 0 0 0 1 ECU_ADDRESS 0x700054A5 /end MEASUREMENT
/begin MEASUREMENT VAR_PcfSig_PosAimInP_f32 "ÈëPÄ¿±êÎ»ÖÃ" FLOAT32_IEEE SWC_PCF_CM_single 0 0 -3.4E+38 3.4E+38 ECU_ADDRESS 0x70005510 /end MEASUREMENT
/begin MEASUREMENT VAR_PcfStm_stPark_u8 "" UBYTE SWC_PCF_CM_uint8 0 0 0 255 ECU_ADDRESS 0x700054C7 /end MEASUREMENT
/begin MEASUREMENT VAR_PcfStm_SLstModeReq_u8 "" UBYTE SWC_PCF_CM_uint8 0 0 0 255 ECU_ADDRESS 0x700054C3 /end MEASUREMENT
/begin MEASUREMENT VAR_RCF_TrqEmDesOfsClb_f32 "" FLOAT32_IEEE SWC_RCF_CM_single 0 0 -3.4E+38 3.4E+38 ECU_ADDRESS 0x700059C0 /end MEASUREMENT
/begin MEASUREMENT VAR_RCF_OfsFlt3800Bwd_f32 "" FLOAT32_IEEE SWC_RCF_CM_single 0 0 -3.4E+38 3.4E+38 ECU_ADDRESS 0x70005990 /end MEASUREMENT
/begin MEASUREMENT VAR_RCF_flgWaitToFail_b "" UBYTE SWC_RCF_CM_boolean 0 0 0 1 ECU_ADDRESS 0x70005959 /end MEASUREMENT
/begin MEASUREMENT VAR_RCF_OfsFlt3600Bwd_f32 "" FLOAT32_IEEE SWC_RCF_CM_single 0 0 -3.4E+38 3.4E+38 ECU_ADDRESS 0x7000598C /end MEASUREMENT
/begin MEASUREMENT VAR_RCF_UsAlfaScalSet_f32 "" FLOAT32_IEEE SWC_RCF_CM_single 0 0 -3.4E+38 3.4E+38 ECU_ADDRESS 0x700059B4 /end MEASUREMENT
/begin MEASUREMENT VAR_RCF_flgDefaultToClbFreFwd_b "" UBYTE SWC_RCF_CM_boolean 0 0 0 1 ECU_ADDRESS 0x70005964 /end MEASUREMENT
/begin MEASUREMENT VAR_RCF_flgstEstToWait_b "" UBYTE SWC_RCF_CM_boolean 0 0 0 1 ECU_ADDRESS 0x7000594D /end MEASUREMENT
/begin MEASUREMENT VAR_RCF_flgPsiToFail_b "" UBYTE SWC_RCF_CM_boolean 0 0 0 1 ECU_ADDRESS 0x70005958 /end MEASUREMENT
/begin MEASUREMENT VAR_RCF_flgWaitToBwdClb_b "" UBYTE SWC_RCF_CM_boolean 0 0 0 1 ECU_ADDRESS 0x70005948 /end MEASUREMENT
/begin MEASUREMENT VAR_RCF_stOfsFrwhlFwd_u8 "" UBYTE SWC_RCF_CM_uint8 0 0 0 255 ECU_ADDRESS 0x70005968 /end MEASUREMENT
/begin MEASUREMENT VAR_RCF_agRtrOffsEstimd_f32 "" FLOAT32_IEEE SWC_RCF_CM_single 0 0 -3.4E+38 3.4E+38 ECU_ADDRESS 0x700059B8 /end MEASUREMENT
/begin MEASUREMENT VAR_RCF_OfsFlt4400Bwd_f32 "" FLOAT32_IEEE SWC_RCF_CM_single 0 0 -3.4E+38 3.4E+38 ECU_ADDRESS 0x7000599C /end MEASUREMENT
/begin MEASUREMENT VAR_RCF_stAgRtrOfsCal_u8 "" UBYTE SWC_RCF_CM_uint8 0 0 0 255 ECU_ADDRESS 0x7000596B /end MEASUREMENT
/begin MEASUREMENT VAR_RCF_OfsFlt4200Bwd_f32 "" FLOAT32_IEEE SWC_RCF_CM_single 0 0 -3.4E+38 3.4E+38 ECU_ADDRESS 0x70005998 /end MEASUREMENT
/begin MEASUREMENT VAR_RCF_OfsFlt4000Bwd_f32 "" FLOAT32_IEEE SWC_RCF_CM_single 0 0 -3.4E+38 3.4E+38 ECU_ADDRESS 0x70005994 /end MEASUREMENT
/begin MEASUREMENT VAR_RCF_flgBwdClbToCalc_b "" UBYTE SWC_RCF_CM_boolean 0 0 0 1 ECU_ADDRESS 0x70005947 /end MEASUREMENT
/begin MEASUREMENT VAR_RCF_flgWaitToAcc_b "" UBYTE SWC_RCF_CM_boolean 0 0 0 1 ECU_ADDRESS 0x70005962 /end MEASUREMENT
/begin MEASUREMENT VAR_RCF_flgFwdorBwdToDefault_b "" UBYTE SWC_RCF_CM_boolean 0 0 0 1 ECU_ADDRESS 0x7000595C /end MEASUREMENT
/begin MEASUREMENT VAR_RCF_OfsClbAngFwd_f32 "" FLOAT32_IEEE SWC_RCF_CM_single 0 0 -3.4E+38 3.4E+38 ECU_ADDRESS 0x70005988 /end MEASUREMENT
/begin MEASUREMENT VAR_RCF_flgFailToDefault_b "" UBYTE SWC_RCF_CM_boolean 0 0 0 1 ECU_ADDRESS 0x7000595A /end MEASUREMENT
/begin MEASUREMENT VAR_RCF_flgInactToBwdClb_b "" UBYTE SWC_RCF_CM_boolean 0 0 0 1 ECU_ADDRESS 0x70005946 /end MEASUREMENT
/begin MEASUREMENT VAR_RCF_flgAccToDefault_b "" UBYTE SWC_RCF_CM_boolean 0 0 0 1 ECU_ADDRESS 0x7000595B /end MEASUREMENT
/begin MEASUREMENT VAR_RCF_OfsFlt4800Fwd_f32 "" FLOAT32_IEEE SWC_RCF_CM_single 0 0 -3.4E+38 3.4E+38 ECU_ADDRESS 0x70005984 /end MEASUREMENT
/begin MEASUREMENT VAR_RCF_flgEnblOfsClbFrwhlBwd_b "" UBYTE SWC_RCF_CM_boolean 0 0 0 1 ECU_ADDRESS 0x70005953 /end MEASUREMENT
/begin MEASUREMENT VAR_RCF_OfsFlt4600Fwd_f32 "" FLOAT32_IEEE SWC_RCF_CM_single 0 0 -3.4E+38 3.4E+38 ECU_ADDRESS 0x70005980 /end MEASUREMENT
/begin MEASUREMENT VAR_RCF_OfsFlt3800Fwd_f32 "" FLOAT32_IEEE SWC_RCF_CM_single 0 0 -3.4E+38 3.4E+38 ECU_ADDRESS 0x70005970 /end MEASUREMENT
/begin MEASUREMENT VAR_RCF_flgClbFreFwdToAcc_b "" UBYTE SWC_RCF_CM_boolean 0 0 0 1 ECU_ADDRESS 0x70005960 /end MEASUREMENT
/begin MEASUREMENT VAR_RCF_flgAccToClbFreBwd_b "" UBYTE SWC_RCF_CM_boolean 0 0 0 1 ECU_ADDRESS 0x7000595F /end MEASUREMENT
/begin MEASUREMENT VAR_RCF_OfsFlt4400Fwd_f32 "" FLOAT32_IEEE SWC_RCF_CM_single 0 0 -3.4E+38 3.4E+38 ECU_ADDRESS 0x7000597C /end MEASUREMENT
/begin MEASUREMENT VAR_RCF_OfsFlt3600Fwd_f32 "" FLOAT32_IEEE SWC_RCF_CM_single 0 0 -3.4E+38 3.4E+38 ECU_ADDRESS 0x7000596C /end MEASUREMENT
/begin MEASUREMENT VAR_RCF_OfsFlt4200Fwd_f32 "" FLOAT32_IEEE SWC_RCF_CM_single 0 0 -3.4E+38 3.4E+38 ECU_ADDRESS 0x70005978 /end MEASUREMENT
/begin MEASUREMENT VAR_RCF_stOfsClbFrwhl_u8 "" UBYTE SWC_RCF_CM_uint8 0 0 0 255 ECU_ADDRESS 0x70005966 /end MEASUREMENT
/begin MEASUREMENT VAR_RCF_flgFwdClbToWait_b "" UBYTE SWC_RCF_CM_boolean 0 0 0 1 ECU_ADDRESS 0x70005949 /end MEASUREMENT
/begin MEASUREMENT VAR_RCF_flgBwClbSucdToAcc_b "" UBYTE SWC_RCF_CM_boolean 0 0 0 1 ECU_ADDRESS 0x7000595E /end MEASUREMENT
/begin MEASUREMENT VAR_RCF_flgDefaultToWait_b "" UBYTE SWC_RCF_CM_boolean 0 0 0 1 ECU_ADDRESS 0x70005965 /end MEASUREMENT
/begin MEASUREMENT VAR_RCF_flgAccToSucd_b "" UBYTE SWC_RCF_CM_boolean 0 0 0 1 ECU_ADDRESS 0x70005956 /end MEASUREMENT
/begin MEASUREMENT VAR_RCF_flgFailorFnhToDefault_b "" UBYTE SWC_RCF_CM_boolean 0 0 0 1 ECU_ADDRESS 0x70005951 /end MEASUREMENT
/begin MEASUREMENT VAR_RCF_stDiagOfsClb_u8 "×Ô±ê¶¨Õï¶Ï×´Ì¬" UBYTE SWC_RCF_CM_uint8 0 0 0 255 ECU_ADDRESS 0x7000596A /end MEASUREMENT
/begin MEASUREMENT VAR_RCF_flgEnblEstAlRtrOfs_b "" UBYTE SWC_RCF_CM_boolean 0 0 0 1 ECU_ADDRESS 0x70005955 /end MEASUREMENT
/begin MEASUREMENT VAR_RCF_flgstEstTostDef_b "" UBYTE SWC_RCF_CM_boolean 0 0 0 1 ECU_ADDRESS 0x7000594F /end MEASUREMENT
/begin MEASUREMENT VAR_RCF_flgEnblOfsClbFrwhl_b "" UBYTE SWC_RCF_CM_boolean 0 0 0 1 ECU_ADDRESS 0x70005952 /end MEASUREMENT
/begin MEASUREMENT VAR_RCF_AutoClbOffset_f32 "" FLOAT32_IEEE SWC_RCF_CM_single 0 0 -3.4E+38 3.4E+38 ECU_ADDRESS 0x700059AC /end MEASUREMENT
/begin MEASUREMENT VAR_RCF_flgClbToInact_b "" UBYTE SWC_RCF_CM_boolean 0 0 0 1 ECU_ADDRESS 0x7000594B /end MEASUREMENT
/begin MEASUREMENT VAR_RCF_flgUseUsSet_b "" UBYTE SWC_RCF_CM_boolean 0 0 0 1 ECU_ADDRESS 0x70005945 /end MEASUREMENT
/begin MEASUREMENT VAR_RCF_OfsFlt4000Fwd_f32 "" FLOAT32_IEEE SWC_RCF_CM_single 0 0 -3.4E+38 3.4E+38 ECU_ADDRESS 0x70005974 /end MEASUREMENT
/begin MEASUREMENT VAR_RCF_stOfsFrwhlBwd_u8 "" UBYTE SWC_RCF_CM_uint8 0 0 0 255 ECU_ADDRESS 0x70005967 /end MEASUREMENT
/begin MEASUREMENT VAR_RCF_flgClbToFail_b "" UBYTE SWC_RCF_CM_boolean 0 0 0 1 ECU_ADDRESS 0x70005957 /end MEASUREMENT
/begin MEASUREMENT VAR_RCF_flgInactToFwdClb_b "" UBYTE SWC_RCF_CM_boolean 0 0 0 1 ECU_ADDRESS 0x7000594C /end MEASUREMENT
/begin MEASUREMENT VAR_RCF_flgstDefTostEst_b "" UBYTE SWC_RCF_CM_boolean 0 0 0 1 ECU_ADDRESS 0x70005950 /end MEASUREMENT
/begin MEASUREMENT VAR_RCF_flgEnblOfsClbFrwhlFwd_b "" UBYTE SWC_RCF_CM_boolean 0 0 0 1 ECU_ADDRESS 0x70005954 /end MEASUREMENT
/begin MEASUREMENT VAR_RCF_flgSucdToDefault_b "" UBYTE SWC_RCF_CM_boolean 0 0 0 1 ECU_ADDRESS 0x7000595D /end MEASUREMENT
/begin MEASUREMENT VAR_RCF_cTrqSlpOfsClb_f32 "" FLOAT32_IEEE SWC_RCF_CM_single 0 0 -3.4E+38 3.4E+38 ECU_ADDRESS 0x700059BC /end MEASUREMENT
/begin MEASUREMENT VAR_RCF_flgAccToClbFreFwd_b "" UBYTE SWC_RCF_CM_boolean 0 0 0 1 ECU_ADDRESS 0x70005961 /end MEASUREMENT
/begin MEASUREMENT VAR_RCF_OfsClbAngBwd_f32 "" FLOAT32_IEEE SWC_RCF_CM_single 0 0 -3.4E+38 3.4E+38 ECU_ADDRESS 0x700059A8 /end MEASUREMENT
/begin MEASUREMENT VAR_RCF_flgClbReset_b "" UBYTE SWC_RCF_CM_boolean 0 0 0 1 ECU_ADDRESS 0x7000594A /end MEASUREMENT
/begin MEASUREMENT VAR_RCF_UsBetaScalSet_f32 "" FLOAT32_IEEE SWC_RCF_CM_single 0 0 -3.4E+38 3.4E+38 ECU_ADDRESS 0x700059B0 /end MEASUREMENT
/begin MEASUREMENT VAR_RCF_flgstEstToFail_b "" UBYTE SWC_RCF_CM_boolean 0 0 0 1 ECU_ADDRESS 0x7000594E /end MEASUREMENT
/begin MEASUREMENT VAR_RCF_flgDefaultToFrewhlBwd_b "" UBYTE SWC_RCF_CM_boolean 0 0 0 1 ECU_ADDRESS 0x70005963 /end MEASUREMENT
/begin MEASUREMENT VAR_RCF_stEstAlRtrOfs_u8 "" UBYTE SWC_RCF_CM_uint8 0 0 0 255 ECU_ADDRESS 0x70005969 /end MEASUREMENT
/begin MEASUREMENT VAR_RCF_OfsFlt4800Bwd_f32 "" FLOAT32_IEEE SWC_RCF_CM_single 0 0 -3.4E+38 3.4E+38 ECU_ADDRESS 0x700059A4 /end MEASUREMENT
/begin MEASUREMENT VAR_RCF_OfsFlt4600Bwd_f32 "" FLOAT32_IEEE SWC_RCF_CM_single 0 0 -3.4E+38 3.4E+38 ECU_ADDRESS 0x700059A0 /end MEASUREMENT
/begin MEASUREMENT VAR_Scf_flgTranStbToOfstCal_b "Standby×´Ì¬Ìø×ªOfstCal×´Ì¬Ê¹ÄÜ" UBYTE SWC_SCF_CM_boolean 0 0 0.0 1.0 ECU_ADDRESS 0x70005A07 /end MEASUREMENT
/begin MEASUREMENT VAR_Scf_uDcLnkDiffUnLo_b "" UBYTE SWC_SCF_CM_boolean 0 0 0.0 1.0 ECU_ADDRESS 0x700059FF /end MEASUREMENT
/begin MEASUREMENT VAR_Scf_flgTranStbToRun_b "Standby×´Ì¬Ìø×ªRun×´Ì¬Ê¹ÄÜ" UBYTE SWC_SCF_CM_boolean 0 0 0.0 1.0 ECU_ADDRESS 0x70005A09 /end MEASUREMENT
/begin MEASUREMENT VAR_Scf_DischaBeginUdc_f32 "" FLOAT32_IEEE SWC_SCF_CM_single 0 0 -3.4E+38 3.4E+38 ECU_ADDRESS 0x70005A38 /end MEASUREMENT
/begin MEASUREMENT VAR_Scf_flgFimforFR_b "" UBYTE SWC_SCF_CM_boolean 0 0 0.0 1.0 ECU_ADDRESS 0x700059FE /end MEASUREMENT
/begin MEASUREMENT VAR_Scf_flgTranIdleToStb_b "Idle×´Ì¬Ìø×ªStandby×´Ì¬Ê¹ÄÜ" UBYTE SWC_SCF_CM_boolean 0 0 0.0 1.0 ECU_ADDRESS 0x70005A0B /end MEASUREMENT
/begin MEASUREMENT VAR_Scf_flgFimReqFailr_b "" UBYTE SWC_SCF_CM_boolean 0 0 0.0 1.0 ECU_ADDRESS 0x70005A22 /end MEASUREMENT
/begin MEASUREMENT VAR_Scf_flgTranNormalToDcha_b "Normal×´Ì¬Ìø×ªDischage×´Ì¬Ê¹ÄÜ" UBYTE SWC_SCF_CM_boolean 0 0 0.0 1.0 ECU_ADDRESS 0x70005A05 /end MEASUREMENT
/begin MEASUREMENT VAR_Scf_flgPostDrvDone_b "" UBYTE SWC_SCF_CM_boolean 0 0 0.0 1.0 ECU_ADDRESS 0x70005A11 /end MEASUREMENT
/begin MEASUREMENT VAR_Scf_VCUComErr_b "×îÖÕÊ¹ÓÃµÄVCUÍ¨Ñ¶¹ÊÕÏ±êÖ¾" UBYTE SWC_SCF_CM_boolean 0 0 0.0 1.0 ECU_ADDRESS 0x70005A2B /end MEASUREMENT
/begin MEASUREMENT VAR_Scf_flgVCUComErrDelay_b "" UBYTE SWC_SCF_CM_boolean 0 0 0.0 1.0 ECU_ADDRESS 0x70005A1A /end MEASUREMENT
/begin MEASUREMENT VAR_Scf_flgEmgReqInvDcha_b "" UBYTE SWC_SCF_CM_boolean 0 0 0.0 1.0 ECU_ADDRESS 0x70005A1F /end MEASUREMENT
/begin MEASUREMENT VAR_Scf_DisChaUdcAfterDebounce_f32 "" FLOAT32_IEEE SWC_SCF_CM_single 0 0 -3.4E+38 3.4E+38 ECU_ADDRESS 0x70005A34 /end MEASUREMENT
/begin MEASUREMENT VAR_Scf_flgTranStbToSLCal_b "" UBYTE SWC_SCF_CM_boolean 0 0 0.0 1.0 ECU_ADDRESS 0x70005A03 /end MEASUREMENT
/begin MEASUREMENT VAR_Scf_flgShtDwnByVcu_b "" UBYTE SWC_SCF_CM_boolean 0 0 0.0 1.0 ECU_ADDRESS 0x70005A2A /end MEASUREMENT
/begin MEASUREMENT VAR_Scf_flgTranLoPowSetToDia_b "" UBYTE SWC_SCF_CM_boolean 0 0 0.0 1.0 ECU_ADDRESS 0x70005A0F /end MEASUREMENT
/begin MEASUREMENT VAR_Scf_flgTranFaultToDcha_b "FaultÄ£Ê½Ìø×ªDchaÄ£Ê½Ê¹ÄÜ" UBYTE SWC_SCF_CM_boolean 0 0 0.0 1.0 ECU_ADDRESS 0x70005A17 /end MEASUREMENT
/begin MEASUREMENT VAR_Scf_flgTranPreDrvRunToFish_b "" UBYTE SWC_SCF_CM_boolean 0 0 0.0 1.0 ECU_ADDRESS 0x70005A0C /end MEASUREMENT
/begin MEASUREMENT VAR_Scf_flgReqInvDcha_b "" UBYTE SWC_SCF_CM_boolean 0 0 0.0 1.0 ECU_ADDRESS 0x70005A18 /end MEASUREMENT
/begin MEASUREMENT VAR_Scf_flgTranOfstCalToStb_b "OfstCal×´Ì¬Ìø×ªStandby×´Ì¬Ê¹ÄÜ" UBYTE SWC_SCF_CM_boolean 0 0 0.0 1.0 ECU_ADDRESS 0x70005A06 /end MEASUREMENT
/begin MEASUREMENT VAR_Scf_flgTranFaultToPostDrv_b "FaultÄ£Ê½Ìø×ªPostDrvÄ£Ê½Ê¹ÄÜ" UBYTE SWC_SCF_CM_boolean 0 0 0.0 1.0 ECU_ADDRESS 0x70005A16 /end MEASUREMENT
/begin MEASUREMENT VAR_Scf_flgTranPostDrvToSutDwn_b "PostDrvÄ£Ê½Ìø×ªShutDownÄ£Ê½Ê¹ÄÜ" UBYTE SWC_SCF_CM_boolean 0 0 0.0 1.0 ECU_ADDRESS 0x70005A10 /end MEASUREMENT
/begin MEASUREMENT VAR_Scf_flgPostDrvReqWiDcha_b "ÓÐÖ÷¶¯·ÅµçÊ±Drv½øÈëPostDrvÊ¹ÄÜ" UBYTE SWC_SCF_CM_boolean 0 0 0.0 1.0 ECU_ADDRESS 0x70005A29 /end MEASUREMENT
/begin MEASUREMENT VAR_Scf_flgDchaVcuReq_b "" UBYTE SWC_SCF_CM_boolean 0 0 0.0 1.0 ECU_ADDRESS 0x70005A1D /end MEASUREMENT
/begin MEASUREMENT VAR_Scf_flgTranRunToStb_b "Run×´Ì¬Ìø×ªStandby×´Ì¬Ê¹ÄÜ" UBYTE SWC_SCF_CM_boolean 0 0 0.0 1.0 ECU_ADDRESS 0x70005A08 /end MEASUREMENT
/begin MEASUREMENT VAR_Scf_flgTranPreDrvToPostDrv_b "PreDrvÄ£Ê½Ìø×ªPostDrvÄ£Ê½Ê¹ÄÜ" UBYTE SWC_SCF_CM_boolean 0 0 0.0 1.0 ECU_ADDRESS 0x70005A26 /end MEASUREMENT
/begin MEASUREMENT VAR_Scf_flgTranStbToIdle_b "Standby×´Ì¬Ìø×ªIdle×´Ì¬Ê¹ÄÜ" UBYTE SWC_SCF_CM_boolean 0 0 0.0 1.0 ECU_ADDRESS 0x70005A0A /end MEASUREMENT
/begin MEASUREMENT VAR_Scf_flgFimVCUComErr_b "" UBYTE SWC_SCF_CM_boolean 0 0 0.0 1.0 ECU_ADDRESS 0x70005A2D /end MEASUREMENT
/begin MEASUREMENT VAR_Scf_flgWakeNormal_b "" UBYTE SWC_SCF_CM_boolean 0 0 0.0 1.0 ECU_ADDRESS 0x70005A14 /end MEASUREMENT
/begin MEASUREMENT VAR_Scf_flgTranPostDrvToPreDrv_b "PostDrvÄ£Ê½Ìø×ªPreDrvÄ£Ê½Ê¹ÄÜ" UBYTE SWC_SCF_CM_boolean 0 0 0.0 1.0 ECU_ADDRESS 0x70005A23 /end MEASUREMENT
/begin MEASUREMENT VAR_Scf_flgTranSLInitToSLFw_b "" UBYTE SWC_SCF_CM_boolean 0 0 0.0 1.0 ECU_ADDRESS 0x70005A00 /end MEASUREMENT
/begin MEASUREMENT VAR_Scf_flgWakeLoss_b "" UBYTE SWC_SCF_CM_boolean 0 0 0.0 1.0 ECU_ADDRESS 0x70005A12 /end MEASUREMENT
/begin MEASUREMENT VAR_Scf_DEMRunToDisChaFail_u8 "" UBYTE SWC_SCF_CM_uint8 0 0 0.0 255.0 ECU_ADDRESS 0x70005A2F /end MEASUREMENT
/begin MEASUREMENT VAR_Scf_cntSigFit_b "" UBYTE SWC_SCF_CM_boolean 0 0 0.0 1.0 ECU_ADDRESS 0x70005A1B /end MEASUREMENT
/begin MEASUREMENT VAR_Scf_flgFimDchaFailr_b "" UBYTE SWC_SCF_CM_boolean 0 0 0.0 1.0 ECU_ADDRESS 0x70005A20 /end MEASUREMENT
/begin MEASUREMENT VAR_Scf_flgTranPreDrvToFault_b "PreDrvÄ£Ê½Ìø×ªFaultÄ£Ê½Ê¹ÄÜ" UBYTE SWC_SCF_CM_boolean 0 0 0.0 1.0 ECU_ADDRESS 0x70005A21 /end MEASUREMENT
/begin MEASUREMENT VAR_Scf_flgFimFaultLvFour_b "" UBYTE SWC_SCF_CM_boolean 0 0 0.0 1.0 ECU_ADDRESS 0x70005A25 /end MEASUREMENT
/begin MEASUREMENT VAR_Scf_flgTranPreDrvToDrv_b "PreDriveÄ£Ê½Ìø×ªDrvÄ£Ê½Ê¹ÄÜ" UBYTE SWC_SCF_CM_boolean 0 0 0.0 1.0 ECU_ADDRESS 0x70005A2E /end MEASUREMENT
/begin MEASUREMENT VAR_Scf_nDchaAllw_b "" UBYTE SWC_SCF_CM_boolean 0 0 0.0 1.0 ECU_ADDRESS 0x70005A1C /end MEASUREMENT
/begin MEASUREMENT VAR_Scf_flgTranDiagToSenCal_b "" UBYTE SWC_SCF_CM_boolean 0 0 0.0 1.0 ECU_ADDRESS 0x70005A0E /end MEASUREMENT
/begin MEASUREMENT VAR_Scf_flgTranDrvToPostDrv_b "DrvÄ£Ê½Ìø×ªPostDrvÄ£Ê½Ê¹ÄÜ" UBYTE SWC_SCF_CM_boolean 0 0 0.0 1.0 ECU_ADDRESS 0x70005A27 /end MEASUREMENT
/begin MEASUREMENT VAR_Scf_flgFimFaultLvFive_b "" UBYTE SWC_SCF_CM_boolean 0 0 0.0 1.0 ECU_ADDRESS 0x70005A24 /end MEASUREMENT
/begin MEASUREMENT VAR_Scf_flgTranDrvToFault_b "DrvÄ£Ê½Ìø×ªFaultÄ£Ê½Ê¹ÄÜ" UBYTE SWC_SCF_CM_boolean 0 0 0.0 1.0 ECU_ADDRESS 0x70005A1E /end MEASUREMENT
/begin MEASUREMENT VAR_Scf_DisChaDetec_b "" UBYTE SWC_SCF_CM_boolean 0 0 0.0 1.0 ECU_ADDRESS 0x70005A19 /end MEASUREMENT
/begin MEASUREMENT VAR_Scf_flgTranSenCalToiMMO_b "" UBYTE SWC_SCF_CM_boolean 0 0 0.0 1.0 ECU_ADDRESS 0x70005A0D /end MEASUREMENT
/begin MEASUREMENT VAR_Scf_flgTranDchaToNormal_b "Dischage×´Ì¬Ìø×ªNormal×´Ì¬Ê¹ÄÜ" UBYTE SWC_SCF_CM_boolean 0 0 0.0 1.0 ECU_ADDRESS 0x70005A04 /end MEASUREMENT
/begin MEASUREMENT VAR_Scf_flgTranSLInitToSLAcc_b "" UBYTE SWC_SCF_CM_boolean 0 0 0.0 1.0 ECU_ADDRESS 0x70005A01 /end MEASUREMENT
/begin MEASUREMENT VAR_Scf_flgPostDrvReqWoDcha_b "ÎÞÖ÷¶¯·ÅµçÊ±Drv½øÈëPostDrvÊ¹ÄÜ" UBYTE SWC_SCF_CM_boolean 0 0 0.0 1.0 ECU_ADDRESS 0x70005A28 /end MEASUREMENT
/begin MEASUREMENT VAR_Scf_flgShtDwnByMcu_b "" UBYTE SWC_SCF_CM_boolean 0 0 0.0 1.0 ECU_ADDRESS 0x70005A2C /end MEASUREMENT
/begin MEASUREMENT VAR_Scf_flgTranSLCalToStb_b "" UBYTE SWC_SCF_CM_boolean 0 0 0.0 1.0 ECU_ADDRESS 0x70005A02 /end MEASUREMENT
/begin MEASUREMENT Var_Scf_flgDisChgFail_b "" UBYTE SWC_SCF_CM_boolean 0 0 0.0 1.0 ECU_ADDRESS 0x700059FD /end MEASUREMENT
/end MODULE
/end PROJECT
