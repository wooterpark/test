ASAP2_VERSION 1 60
/begin PROJECT ETAS_AUTOSAR "XCP on CAN"
/begin HEADER "" VERSION "1.0.0.0" PROJECT_NO ETAS_AUTOSAR /end HEADER
/begin MODULE ETAS_AUTOSAR ""
/begin MOD_COMMON "" DEPOSIT ABSOLUTE BYTE_ORDER MSB_LAST /end MOD_COMMON
/begin MOD_PAR "" VERSION "XCP_1.0.0" CUSTOMER_NO "" USER "" PHONE_NO "" ECU "ETAS AUTOSAR" CPU_TYPE "Tc275"
 /begin MEMORY_SEGMENT Pst80040000 "" CODE FLASH INTERN 0x80040000 0x100000 -1 -1 -1 -1 -1 /end MEMORY_SEGMENT
 /begin MEMORY_SEGMENT Dst80140000 "" DATA FLASH INTERN 0x80140000 0x8000 -1 -1 -1 -1 -1
  /begin IF_DATA XCPplus 0x0102
   /begin SEGMENT 3 0x02 0x00 0x00 0x00
    /begin CHECKSUM XCP_ADD_14 /* checksum: add bytes to 16bit result */ MAX_BLOCK_SIZE 0x400 /end CHECKSUM
    /begin PAGE 0x00 /* page number */ ECU_ACCESS_DONT_CARE XCP_READ_ACCESS_DONT_CARE XCP_WRITE_ACCESS_NOT_ALLOWED /end PAGE
    /begin PAGE 0x01 /* page number */ ECU_ACCESS_DONT_CARE XCP_READ_ACCESS_DONT_CARE XCP_WRITE_ACCESS_WITH_ECU_ONLY /end PAGE
   /end SEGMENT
  /end IF_DATA
 /end MEMORY_SEGMENT
 /begin MEMORY_SEGMENT Pst80148000 "" CODE FLASH INTERN 0x80148000 0xB6000 -1 -1 -1 -1 -1 /end MEMORY_SEGMENT
 /begin MEMORY_SEGMENT RamB0000000 "" VARIABLES RAM INTERN 0xB0000000 0x8000 -1 -1 -1 -1 -1
  /begin IF_DATA XCPplus 0x0102
   /begin SEGMENT 4 0x00 0x00 0x00 0x00 /end SEGMENT
  /end IF_DATA
 /end MEMORY_SEGMENT
 /begin MEMORY_SEGMENT Ram70000000 "" VARIABLES RAM INTERN 0x70000000 0x1C000 -1 -1 -1 -1 -1
  /begin IF_DATA XCPplus 0x0102
   /begin SEGMENT 5 0x00 0x00 0x00 0x00 /end SEGMENT
  /end IF_DATA
 /end MEMORY_SEGMENT
 /begin MEMORY_SEGMENT Ram60000000 "" VARIABLES RAM INTERN 0x60000000 0x1E000 -1 -1 -1 -1 -1
  /begin IF_DATA XCPplus 0x0102
   /begin SEGMENT 6 0x00 0x00 0x00 0x00 /end SEGMENT
  /end IF_DATA
 /end MEMORY_SEGMENT
 /begin MEMORY_SEGMENT Ram50000000 "" VARIABLES RAM INTERN 0x50000000 0x1E000 -1 -1 -1 -1 -1
  /begin IF_DATA XCPplus 0x0102
   /begin SEGMENT 7 0x00 0x00 0x00 0x00 /end SEGMENT
  /end IF_DATA
 /end MEMORY_SEGMENT
 /begin CALIBRATION_METHOD /* name calibration methode */ "DataSetId" /* version calibration metode */ 256 /begin CALIBRATION_HANDLE /* adr data set id characteristic,dummy */ 0x80145000 /end CALIBRATION_HANDLE /end CALIBRATION_METHOD
/end MOD_PAR
/begin IF_DATA XCPplus 0x0102
 /begin PAG 4 /end PAG
 /begin XCP_ON_CAN 0x0102 CAN_ID_MASTER 0x220 CAN_ID_SLAVE 0x300 BAUDRATE 500000 SAMPLE_POINT 100 BTL_CYCLES 11 SJW 0 /begin EVENT_CAN_ID_LIST 0 FIXED 0x310 /end EVENT_CAN_ID_LIST /begin EVENT_CAN_ID_LIST 1 FIXED 0x311 /end EVENT_CAN_ID_LIST /begin EVENT_CAN_ID_LIST 2 FIXED 0x312 /end EVENT_CAN_ID_LIST MAX_BUS_LOAD 100
  /begin PROTOCOL_LAYER 0x0102 2000 2000 0 0 0 0 2000 8 8 BYTE_ORDER_MSB_LAST ADDRESS_GRANULARITY_BYTE OPTIONAL_CMD GET_SEED OPTIONAL_CMD UNLOCK OPTIONAL_CMD SET_MTA OPTIONAL_CMD UPLOAD OPTIONAL_CMD SHORT_UPLOAD OPTIONAL_CMD BUILD_CHECKSUM OPTIONAL_CMD DOWNLOAD OPTIONAL_CMD DOWNLOAD_NEXT OPTIONAL_CMD DOWNLOAD_MAX OPTIONAL_CMD MODIFY_BITS OPTIONAL_CMD SET_CAL_PAGE OPTIONAL_CMD GET_CAL_PAGE OPTIONAL_CMD GET_PAG_PROCESSOR_INFO OPTIONAL_CMD GET_SEGMENT_INFO OPTIONAL_CMD GET_PAGE_INFO OPTIONAL_CMD COPY_CAL_PAGE OPTIONAL_CMD CLEAR_DAQ_LIST OPTIONAL_CMD SET_DAQ_PTR OPTIONAL_CMD WRITE_DAQ OPTIONAL_CMD SET_DAQ_LIST_MODE OPTIONAL_CMD START_STOP_DAQ_LIST OPTIONAL_CMD START_STOP_SYNCH OPTIONAL_CMD GET_DAQ_CLOCK OPTIONAL_CMD READ_DAQ OPTIONAL_CMD GET_DAQ_PROCESSOR_INFO OPTIONAL_CMD GET_DAQ_RESOLUTION_INFO OPTIONAL_CMD GET_DAQ_EVENT_INFO OPTIONAL_CMD FREE_DAQ OPTIONAL_CMD ALLOC_DAQ OPTIONAL_CMD ALLOC_ODT OPTIONAL_CMD ALLOC_ODT_ENTRY COMMUNICATION_MODE_SUPPORTED BLOCK SLAVE MASTER 255 50 SEED_AND_KEY_EXTERNAL_FUNCTION "XcpSeedNKey.dll" /end PROTOCOL_LAYER
  /begin DAQ DYNAMIC 65535 3 0 OPTIMISATION_TYPE_DEFAULT ADDRESS_EXTENSION_FREE IDENTIFICATION_FIELD_TYPE_ABSOLUTE GRANULARITY_ODT_ENTRY_SIZE_DAQ_BYTE 255 NO_OVERLOAD_INDICATION PRESCALER_SUPPORTED /begin TIMESTAMP_SUPPORTED 1 SIZE_WORD UNIT_1MS /end TIMESTAMP_SUPPORTED /begin DAQ_MEMORY_CONSUMPTION 4091 46 6 5 2 0 /end DAQ_MEMORY_CONSUMPTION /begin EVENT "XcpEvent_2ms_Raster" "2msRstr" 0 DAQ 1 2 6 3 /end EVENT /begin EVENT "XcpEvent_10ms_Raster" "10msRstr" 1 DAQ 1 10 6 2 /end EVENT /begin EVENT "XcpEvent_100ms_Raster" "100msRstr" 2 DAQ 1 10 7 1 /end EVENT /end DAQ
  TRANSPORT_LAYER_INSTANCE "XCP_TPL" /end XCP_ON_CAN
/end IF_DATA
/begin FUNCTION __DDS_EXPA2_DEFAULT_FUNC__ "__DDS_EXPA2_DEFAULT_FUNC__" /end FUNCTION
/begin COMPU_METHOD BSW_A2L_Ident_Float "Q = V" RAT_FUNC "%8.6" "" COEFFS 0 1 0 0 0 1 /end COMPU_METHOD
/begin COMPU_METHOD BSW_A2L_Ident_Int "Q = V" RAT_FUNC "%8.0" "" COEFFS 0 1 0 0 0 1 /end COMPU_METHOD
/begin COMPU_METHOD SWC_ADM_CM_single "Q = V" RAT_FUNC "%8.6" "" COEFFS 0 1 0 0 0 1 /end COMPU_METHOD
/begin COMPU_METHOD SWC_ADM_CM_int16 "Q = V" RAT_FUNC "%5.0" "" COEFFS 0 1 0 0 0 1 /end COMPU_METHOD
/begin COMPU_METHOD SWC_ADM_CM_boolean "Q = V" RAT_FUNC "%1.0" "" COEFFS 0 1 0 0 0 1 /end COMPU_METHOD
/begin COMPU_METHOD SWC_ADM_CM_uint8 "Q = V" RAT_FUNC "%3.0" "" COEFFS 0 1 0 0 0 1 /end COMPU_METHOD
/begin COMPU_METHOD SWC_BCC_CM_single "Q = V" RAT_FUNC "%8.6" "" COEFFS 0 1 0 0 0 1 /end COMPU_METHOD
/begin COMPU_METHOD SWC_BCC_CM_boolean "Q = V" RAT_FUNC "%1.0" "" COEFFS 0 1 0 0 0 1 /end COMPU_METHOD
/begin COMPU_METHOD SWC_BCC_CM_uint8 "Q = V" RAT_FUNC "%3.0" "" COEFFS 0 1 0 0 0 1 /end COMPU_METHOD
/begin COMPU_METHOD SWC_CSPF_CM_single "Q = V" RAT_FUNC "%8.6" "" COEFFS 0 1 0 0 0 1 /end COMPU_METHOD
/begin COMPU_METHOD SWC_CSPF_CM_uint16 "Q = V" RAT_FUNC "%5.0" "" COEFFS 0 1 0 0 0 1 /end COMPU_METHOD
/begin COMPU_METHOD SWC_CSPF_CM_boolean "Q = V" RAT_FUNC "%1.0" "" COEFFS 0 1 0 0 0 1 /end COMPU_METHOD
/begin COMPU_METHOD SWC_CSPF_CM_uint8 "Q = V" RAT_FUNC "%3.0" "" COEFFS 0 1 0 0 0 1 /end COMPU_METHOD
/begin COMPU_METHOD SWC_FRP_CM_boolean "Q = V" RAT_FUNC "%1.0" "" COEFFS 0 1 0 0 0 1 /end COMPU_METHOD
/begin COMPU_METHOD SWC_FRP_CM_uint32 "Q = V" RAT_FUNC "%10.0" "" COEFFS 0 1 0 0 0 1 /end COMPU_METHOD
/begin COMPU_METHOD SWC_HSPF_CM_single "Q = V" RAT_FUNC "%8.6" "" COEFFS 0 1 0 0 0 1 /end COMPU_METHOD
/begin COMPU_METHOD SWC_HSPF_CM_uint16 "Q = V" RAT_FUNC "%5.0" "" COEFFS 0 1 0 0 0 1 /end COMPU_METHOD
/begin COMPU_METHOD SWC_HSPF_CM_int8 "Q = V" RAT_FUNC "%3.0" "" COEFFS 0 1 0 0 0 1 /end COMPU_METHOD
/begin COMPU_METHOD SWC_HSPF_CM_uint8 "Q = V" RAT_FUNC "%3.0" "" COEFFS 0 1 0 0 0 1 /end COMPU_METHOD
/begin COMPU_METHOD SWC_HSPF_CM_int16 "Q = V" RAT_FUNC "%5.0" "" COEFFS 0 1 0 0 0 1 /end COMPU_METHOD
/begin COMPU_METHOD SWC_HSPF_CM_boolean "Q = V" RAT_FUNC "%1.0" "" COEFFS 0 1 0 0 0 1 /end COMPU_METHOD
/begin COMPU_METHOD SWC_MCF_CM_single "Q = V" RAT_FUNC "%8.6" "" COEFFS 0 1 0 0 0 1 /end COMPU_METHOD
/begin COMPU_METHOD SWC_MCF_CM_boolean "Q = V" RAT_FUNC "%1.0" "" COEFFS 0 1 0 0 0 1 /end COMPU_METHOD
/begin COMPU_METHOD SWC_MCF_CM_uint8 "Q = V" RAT_FUNC "%3.0" "" COEFFS 0 1 0 0 0 1 /end COMPU_METHOD
/begin COMPU_METHOD SWC_MPC_CM_boolean "Q = V" RAT_FUNC "%1.0" "" COEFFS 0 1 0 0 0 1 /end COMPU_METHOD
/begin COMPU_METHOD SWC_RCF_CM_uint32 "Q = V" RAT_FUNC "%10.0" "" COEFFS 0 1 0 0 0 1 /end COMPU_METHOD
/begin COMPU_METHOD SWC_RCF_CM_uint16 "Q = V" RAT_FUNC "%5.0" "" COEFFS 0 1 0 0 0 1 /end COMPU_METHOD
/begin COMPU_METHOD SWC_SCF_CM_uint16 "Q = V" RAT_FUNC "%5.0" "" COEFFS 0 1 0 0 0 1 /end COMPU_METHOD
/begin COMPU_METHOD SWC_STM_CM_single "Q = V" RAT_FUNC "%8.6" "" COEFFS 0 1 0 0 0 1 /end COMPU_METHOD
/begin COMPU_METHOD SWC_STM_CM_int16 "Q = V" RAT_FUNC "%5.0" "" COEFFS 0 1 0 0 0 1 /end COMPU_METHOD
/begin COMPU_METHOD SWC_STM_CM_uint8 "Q = V" RAT_FUNC "%3.0" "" COEFFS 0 1 0 0 0 1 /end COMPU_METHOD
/begin RECORD_LAYOUT Scalar_BOOLEAN FNC_VALUES 1 UBYTE COLUMN_DIR DIRECT /end RECORD_LAYOUT
/begin RECORD_LAYOUT Scalar_UBYTE FNC_VALUES 1 UBYTE COLUMN_DIR DIRECT /end RECORD_LAYOUT
/begin RECORD_LAYOUT Scalar_BYTE FNC_VALUES 1 SBYTE COLUMN_DIR DIRECT /end RECORD_LAYOUT
/begin RECORD_LAYOUT Scalar_UWORD FNC_VALUES 1 UWORD COLUMN_DIR DIRECT /end RECORD_LAYOUT
/begin RECORD_LAYOUT Scalar_SWORD FNC_VALUES 1 SWORD COLUMN_DIR DIRECT /end RECORD_LAYOUT
/begin RECORD_LAYOUT Scalar_FLOAT32_IEEE FNC_VALUES 1 FLOAT32_IEEE COLUMN_DIR DIRECT /end RECORD_LAYOUT
/begin RECORD_LAYOUT Lookup1D_FLOAT32_IEEE FNC_VALUES 1 FLOAT32_IEEE COLUMN_DIR DIRECT /end RECORD_LAYOUT
/begin RECORD_LAYOUT Lookup1D_X_FLOAT32_IEEE AXIS_PTS_X 1 FLOAT32_IEEE INDEX_INCR DIRECT /end RECORD_LAYOUT
/begin RECORD_LAYOUT Lookup2D_FLOAT32_IEEE FNC_VALUES 1 FLOAT32_IEEE COLUMN_DIR DIRECT /end RECORD_LAYOUT
/begin RECORD_LAYOUT Lookup2D_X_FLOAT32_IEEE AXIS_PTS_X 1 FLOAT32_IEEE INDEX_INCR DIRECT /end RECORD_LAYOUT
/begin CHARACTERISTIC CAL_Cspf_UdcMin_f32 "CAL_Cspf_UdcMin_f32" VALUE 0x8014028C Scalar_FLOAT32_IEEE 0 BSW_A2L_Ident_Float -3.4E+38 3.4E+38 /end CHARACTERISTIC
/begin CHARACTERISTIC CAL_MCF_uDclnkSet_f32 "CAL_MCF_uDclnkSet_f32" VALUE 0x80140F3C Scalar_FLOAT32_IEEE 0 BSW_A2L_Ident_Float -3.4E+38 3.4E+38 /end CHARACTERISTIC
/begin CHARACTERISTIC CAL_MCF_DeltaPower_f32 "CAL_MCF_DeltaPower_f32" VALUE 0x801412F8 Scalar_FLOAT32_IEEE 0 BSW_A2L_Ident_Float -3.4E+38 3.4E+38 /end CHARACTERISTIC
/begin CHARACTERISTIC CAL_Cspf_flgtDBCTempWFltSwt_b "CAL_Cspf_flgtDBCTempWFltSwt_b" VALUE 0x80140230 Scalar_BOOLEAN 0 BSW_A2L_Ident_Int 0 1 /end CHARACTERISTIC
/begin CHARACTERISTIC CAL_Cspf_flgTrqMaxNCtLSwt_b "CAL_Cspf_flgTrqMaxNCtLSwt_b" VALUE 0x80140257 Scalar_BOOLEAN 0 BSW_A2L_Ident_Int 0 1 /end CHARACTERISTIC
/begin CHARACTERISTIC CAL_Hspf_MototOpenChkSubCnt_s8 "CAL_Hspf_MototOpenChkSubCnt_s8" VALUE 0x80140429 Scalar_BYTE 0 BSW_A2L_Ident_Int -128 127 /end CHARACTERISTIC
/begin CHARACTERISTIC CAL_Cspf_FailCode8_u8 "CAL_Cspf_FailCode8_u8" VALUE 0x801402E7 Scalar_UBYTE 0 BSW_A2L_Ident_Int 0 255 /end CHARACTERISTIC
/begin CHARACTERISTIC CAL_MCF_FrqRmp_f32 "CAL_MCF_FrqRmp_f32" VALUE 0x801412C8 Scalar_FLOAT32_IEEE 0 BSW_A2L_Ident_Float -3.4E+38 3.4E+38 /end CHARACTERISTIC
/begin CHARACTERISTIC CAL_TjLv2Act_f32 "CAL_TjLv2Act_f32" VALUE 0x801401A4 Scalar_FLOAT32_IEEE 0 BSW_A2L_Ident_Float -3.4E+38 3.4E+38 /end CHARACTERISTIC
/begin CHARACTERISTIC CAL_Cspf_flgUdcMaxSwt_b "CAL_Cspf_flgUdcMaxSwt_b" VALUE 0x80140251 Scalar_BOOLEAN 0 BSW_A2L_Ident_Int 0 1 /end CHARACTERISTIC
/begin CHARACTERISTIC CAL_ADM_L2Com_HiPrecVolt_b "CAL_ADM_L2Com_HiPrecVolt_b" VALUE 0x801400DC Scalar_BOOLEAN 0 BSW_A2L_Ident_Int 0 1 /end CHARACTERISTIC
/begin CHARACTERISTIC CAL_FRP_TrqCalcErrOutCtl_b "CAL_FRP_TrqCalcErrOutCtl_b" VALUE 0x801402FC Scalar_BOOLEAN 0 BSW_A2L_Ident_Int 0 1 /end CHARACTERISTIC
/begin CHARACTERISTIC CAL_Cspf_flgbDernOvrIdcSwt_b "CAL_Cspf_flgbDernOvrIdcSwt_b" VALUE 0x80140246 Scalar_BOOLEAN 0 BSW_A2L_Ident_Int 0 1 /end CHARACTERISTIC
/begin CHARACTERISTIC CAL_MCF_flgVF_b "CAL_MCF_flgVF_b" VALUE 0x80140FE0 Scalar_BOOLEAN 0 BSW_A2L_Ident_Int 0 1 /end CHARACTERISTIC
/begin CHARACTERISTIC CAL_FRP_RslvExciRngErrOutCtl_b "CAL_FRP_RslvExciRngErrOutCtl_b" VALUE 0x80140300 Scalar_BOOLEAN 0 BSW_A2L_Ident_Int 0 1 /end CHARACTERISTIC
/begin CHARACTERISTIC CAL_FRP_CurrSumErrOutCtl_b "CAL_FRP_CurrSumErrOutCtl_b" VALUE 0x80140305 Scalar_BOOLEAN 0 BSW_A2L_Ident_Int 0 1 /end CHARACTERISTIC
/begin CHARACTERISTIC CAL_Cspf_flgUdcMinSwt_b "CAL_Cspf_flgUdcMinSwt_b" VALUE 0x80140250 Scalar_BOOLEAN 0 BSW_A2L_Ident_Int 0 1 /end CHARACTERISTIC
/begin CHARACTERISTIC CAL_MCF_nDpwmOff_f32 "CAL_MCF_nDpwmOff_f32" VALUE 0x80140FB0 Scalar_FLOAT32_IEEE 0 BSW_A2L_Ident_Float -3.4E+38 3.4E+38 /end CHARACTERISTIC
/begin CHARACTERISTIC CAL_ADM_flgCrashSwt_b "CAL_ADM_flgCrashSwt_b" VALUE 0x801400C9 Scalar_BOOLEAN 0 BSW_A2L_Ident_Int 0 1 /end CHARACTERISTIC
/begin CHARACTERISTIC CAL_TjrthLv4dlih_f32 "CAL_TjrthLv4dlih_f32" VALUE 0x80140134 Scalar_FLOAT32_IEEE 0 BSW_A2L_Ident_Float -3.4E+38 3.4E+38 /end CHARACTERISTIC
/begin CHARACTERISTIC CAL_TjrthLv4dhdh_f32 "CAL_TjrthLv4dhdh_f32" VALUE 0x8014014C Scalar_FLOAT32_IEEE 0 BSW_A2L_Ident_Float -3.4E+38 3.4E+38 /end CHARACTERISTIC
/begin CHARACTERISTIC CAL_BCC_AgGenCoe_f32 "CAL_BCC_AgGenCoe_f32" VALUE 0x801401EC Scalar_FLOAT32_IEEE 0 BSW_A2L_Ident_Float -3.4E+38 3.4E+38 /end CHARACTERISTIC
/begin CHARACTERISTIC CAL_Cspf_flgKpHighNCtLSwt_b "CAL_Cspf_flgKpHighNCtLSwt_b" VALUE 0x80140262 Scalar_BOOLEAN 0 BSW_A2L_Ident_Int 0 1 /end CHARACTERISTIC
/begin CHARACTERISTIC CAL_FRP_RslvRngErrOutCtl_b "CAL_FRP_RslvRngErrOutCtl_b" VALUE 0x801402FF Scalar_BOOLEAN 0 BSW_A2L_Ident_Int 0 1 /end CHARACTERISTIC
/begin CHARACTERISTIC CAL_MCF_stPwmMode_u8 "CAL_MCF_stPwmMode_u8" VALUE 0x80140F9C Scalar_UBYTE 0 BSW_A2L_Ident_Int 0 255 /end CHARACTERISTIC
/begin CHARACTERISTIC CAL_Hspf_iPhaHighSet_u16 "CAL_Hspf_iPhaHighSet_u16" VALUE 0x80140336 Scalar_UWORD 0 BSW_A2L_Ident_Int 0 65535 /end CHARACTERISTIC
/begin CHARACTERISTIC CAL_BCC_flgEnableTj_b "CAL_BCC_flgEnableTj_b" VALUE 0x801401E0 Scalar_BOOLEAN 0 BSW_A2L_Ident_Int 0 1 /end CHARACTERISTIC
/begin CHARACTERISTIC CAL_Hspf_MotorOpenChkCntLoLim_s8 "CAL_Hspf_MotorOpenChkCntLoLim_s8" VALUE 0x8014042A Scalar_BYTE 0 BSW_A2L_Ident_Int -128 127 /end CHARACTERISTIC
/begin CHARACTERISTIC CAL_Cspf_flgbDernCANSwt_b "CAL_Cspf_flgbDernCANSwt_b" VALUE 0x8014024D Scalar_BOOLEAN 0 BSW_A2L_Ident_Int 0 1 /end CHARACTERISTIC
/begin CHARACTERISTIC CAL_ADM_DchgMode_u8 "CAL_ADM_DchgMode_u8" VALUE 0x801400F5 Scalar_UBYTE 0 BSW_A2L_Ident_Int 0 255 /end CHARACTERISTIC
/begin CHARACTERISTIC CAL_Hspf_DBCTempROCLimChkCnt_u8 "CAL_Hspf_DBCTempROCLimChkCnt_u8" VALUE 0x80140CBC Scalar_UBYTE 0 BSW_A2L_Ident_Int 0 255 /end CHARACTERISTIC
/begin CHARACTERISTIC CAL_MCF_uDUpLimEOL_f32 "CAL_MCF_uDUpLimEOL_f32" VALUE 0x80140F40 Scalar_FLOAT32_IEEE 0 BSW_A2L_Ident_Float -3.4E+38 3.4E+38 /end CHARACTERISTIC
/begin CHARACTERISTIC CAL_Cspf_flgFailCode4Swt_b "CAL_Cspf_flgFailCode4Swt_b" VALUE 0x8014026C Scalar_BOOLEAN 0 BSW_A2L_Ident_Int 0 1 /end CHARACTERISTIC
/begin CHARACTERISTIC CAL_Cspf_flgtCoolantTempFltSwt_b "CAL_Cspf_flgtCoolantTempFltSwt_b" VALUE 0x80140233 Scalar_BOOLEAN 0 BSW_A2L_Ident_Int 0 1 /end CHARACTERISTIC
/begin CHARACTERISTIC CAL_MCF_flgDpwm_b "CAL_MCF_flgDpwm_b" VALUE 0x80140FF1 Scalar_BOOLEAN 0 BSW_A2L_Ident_Int 0 1 /end CHARACTERISTIC
/begin CHARACTERISTIC CAL_Hspf_VerMatchUncheck_u8 "CAL_Hspf_VerMatchUncheck_u8" VALUE 0x80140344 Scalar_UBYTE 0 BSW_A2L_Ident_Int 0 255 /end CHARACTERISTIC
/begin CHARACTERISTIC CAL_MCF_trqDpwmOff_f32 "CAL_MCF_trqDpwmOff_f32" VALUE 0x80140F98 Scalar_FLOAT32_IEEE 0 BSW_A2L_Ident_Float -3.4E+38 3.4E+38 /end CHARACTERISTIC
/begin CHARACTERISTIC CAL_Cspf_flgstTrqEmMaxSwt_b "CAL_Cspf_flgstTrqEmMaxSwt_b" VALUE 0x80140235 Scalar_BOOLEAN 0 BSW_A2L_Ident_Int 0 1 /end CHARACTERISTIC
/begin CHARACTERISTIC CAL_Cspf_TrqDmpLim_f32 "CAL_Cspf_TrqDmpLim_f32" VALUE 0x801402B4 Scalar_FLOAT32_IEEE 0 BSW_A2L_Ident_Float -3.4E+38 3.4E+38 /end CHARACTERISTIC
/begin CHARACTERISTIC CAL_Cspf_flgstTrqEmMinSwt_b "CAL_Cspf_flgstTrqEmMinSwt_b" VALUE 0x80140234 Scalar_BOOLEAN 0 BSW_A2L_Ident_Int 0 1 /end CHARACTERISTIC
/begin CHARACTERISTIC CAL_MCF_isSet_f32 "CAL_MCF_isSet_f32" VALUE 0x80140FCC Scalar_FLOAT32_IEEE 0 BSW_A2L_Ident_Float -3.4E+38 3.4E+38 /end CHARACTERISTIC
/begin CHARACTERISTIC CAL_MCF_TrqOffDeadCpn_f32 "CAL_MCF_TrqOffDeadCpn_f32" VALUE 0x80141078 Scalar_FLOAT32_IEEE 0 BSW_A2L_Ident_Float -3.4E+38 3.4E+38 /end CHARACTERISTIC
/begin CHARACTERISTIC CAL_Cspf_bDernStrTemp_u8 "CAL_Cspf_bDernStrTemp_u8" VALUE 0x80140277 Scalar_UBYTE 0 BSW_A2L_Ident_Int 0 255 /end CHARACTERISTIC
/begin CHARACTERISTIC CAL_Cspf_agRtrEe_f32 "CAL_Cspf_agRtrEe_f32" VALUE 0x80140284 Scalar_FLOAT32_IEEE 0 BSW_A2L_Ident_Float -3.4E+38 3.4E+38 /end CHARACTERISTIC
/begin CHARACTERISTIC CAL_MCF_udOverGain_f32 "CAL_MCF_udOverGain_f32" VALUE 0x80140F30 Scalar_FLOAT32_IEEE 0 BSW_A2L_Ident_Float -3.4E+38 3.4E+38 /end CHARACTERISTIC
/begin CHARACTERISTIC CAL_Hspf_tStrrTmp1FltFrq_f32 "CAL_Hspf_tStrrTmp1FltFrq_f32" VALUE 0x80140320 Scalar_FLOAT32_IEEE 0 BSW_A2L_Ident_Float -3.4E+38 3.4E+38 /end CHARACTERISTIC
/begin CHARACTERISTIC CAL_Hspf_iDcLnkEstFltFrq_f32 "CAL_Hspf_iDcLnkEstFltFrq_f32" VALUE 0x80140338 Scalar_FLOAT32_IEEE 0 BSW_A2L_Ident_Float -3.4E+38 3.4E+38 /end CHARACTERISTIC
/begin CHARACTERISTIC CAL_Cspf_CodeVer_u16 "CAL_Cspf_CodeVer_u16" VALUE 0x801402F4 Scalar_UWORD 0 BSW_A2L_Ident_Int 0 65535 /end CHARACTERISTIC
/begin CHARACTERISTIC CAL_MCF_flgUseZeroCtl_b "CAL_MCF_flgUseZeroCtl_b" VALUE 0x80140FE3 Scalar_BOOLEAN 0 BSW_A2L_Ident_Int 0 1 /end CHARACTERISTIC
/begin CHARACTERISTIC CAL_Cspf_tCoolantTempFlt_f32 "CAL_Cspf_tCoolantTempFlt_f32" VALUE 0x8014020C Scalar_FLOAT32_IEEE 0 BSW_A2L_Ident_Float -3.4E+38 3.4E+38 /end CHARACTERISTIC
/begin CHARACTERISTIC CAL_Cspf_flgIdcMinSwt_b "CAL_Cspf_flgIdcMinSwt_b" VALUE 0x80140264 Scalar_BOOLEAN 0 BSW_A2L_Ident_Int 0 1 /end CHARACTERISTIC
/begin CHARACTERISTIC CAL_ADM_flgstModeReqSwt_b "CAL_ADM_flgstModeReqSwt_b" VALUE 0x801400C5 Scalar_BOOLEAN 0 BSW_A2L_Ident_Int 0 1 /end CHARACTERISTIC
/begin CHARACTERISTIC CAL_TjrthLv4ilil_f32 "CAL_TjrthLv4ilil_f32" VALUE 0x80140110 Scalar_FLOAT32_IEEE 0 BSW_A2L_Ident_Float -3.4E+38 3.4E+38 /end CHARACTERISTIC
/begin CHARACTERISTIC CAL_Cspf_nSlowFlt_f32 "CAL_Cspf_nSlowFlt_f32" VALUE 0x80140218 Scalar_FLOAT32_IEEE 0 BSW_A2L_Ident_Float -3.4E+38 3.4E+38 /end CHARACTERISTIC
/begin CHARACTERISTIC CAL_TjrthLv4ilih_f32 "CAL_TjrthLv4ilih_f32" VALUE 0x80140114 Scalar_FLOAT32_IEEE 0 BSW_A2L_Ident_Float -3.4E+38 3.4E+38 /end CHARACTERISTIC
/begin CHARACTERISTIC CAL_FRP_TrqSetPRngErrOutCtl_b "CAL_FRP_TrqSetPRngErrOutCtl_b" VALUE 0x801402FB Scalar_BOOLEAN 0 BSW_A2L_Ident_Int 0 1 /end CHARACTERISTIC
/begin CHARACTERISTIC CAL_Hspf_CrashChkCntHiLim_u8 "CAL_Hspf_CrashChkCntHiLim_u8" VALUE 0x80140CBF Scalar_UBYTE 0 BSW_A2L_Ident_Int 0 255 /end CHARACTERISTIC
/begin CHARACTERISTIC CAL_Hspf_TmpUFltFrq_f32 "CAL_Hspf_TmpUFltFrq_f32" VALUE 0x80140354 Scalar_FLOAT32_IEEE 0 BSW_A2L_Ident_Float -3.4E+38 3.4E+38 /end CHARACTERISTIC
/begin CHARACTERISTIC CAL_Hspf_VerMatchTimeOutErr_u8 "CAL_Hspf_VerMatchTimeOutErr_u8" VALUE 0x80140345 Scalar_UBYTE 0 BSW_A2L_Ident_Int 0 255 /end CHARACTERISTIC
/begin CHARACTERISTIC CAL_Cspf_flgOfsClbSucSwt_b "CAL_Cspf_flgOfsClbSucSwt_b" VALUE 0x8014025E Scalar_BOOLEAN 0 BSW_A2L_Ident_Int 0 1 /end CHARACTERISTIC
/begin CHARACTERISTIC CAL_Cspf_flgFailCode5Swt_b "CAL_Cspf_flgFailCode5Swt_b" VALUE 0x8014026B Scalar_BOOLEAN 0 BSW_A2L_Ident_Int 0 1 /end CHARACTERISTIC
/begin CHARACTERISTIC CAL_ADM_VoltCmpChkErrCntThr_s16 "CAL_ADM_VoltCmpChkErrCntThr_s16" VALUE 0x801400CE Scalar_SWORD 0 BSW_A2L_Ident_Int -32768 32767 /end CHARACTERISTIC
/begin CHARACTERISTIC CAL_BCC_dycLowLimt_f32 "CAL_BCC_dycLowLimt_f32" VALUE 0x801401E8 Scalar_FLOAT32_IEEE 0 BSW_A2L_Ident_Float -3.4E+38 3.4E+38 /end CHARACTERISTIC
/begin CHARACTERISTIC CAL_Cspf_flgiDcLnkEstFltSwt_b "CAL_Cspf_flgiDcLnkEstFltSwt_b" VALUE 0x8014023F Scalar_BOOLEAN 0 BSW_A2L_Ident_Int 0 1 /end CHARACTERISTIC
/begin CHARACTERISTIC CAL_Cspf_flgHvMcuVerSwt_b "CAL_Cspf_flgHvMcuVerSwt_b" VALUE 0x80140267 Scalar_BOOLEAN 0 BSW_A2L_Ident_Int 0 1 /end CHARACTERISTIC
/begin CHARACTERISTIC CAL_Cspf_TrqMax_f32 "CAL_Cspf_TrqMax_f32" VALUE 0x801402A8 Scalar_FLOAT32_IEEE 0 BSW_A2L_Ident_Float -3.4E+38 3.4E+38 /end CHARACTERISTIC
/begin CHARACTERISTIC CAL_MCF_FlgUseDeadCpn_b "CAL_MCF_FlgUseDeadCpn_b" VALUE 0x801412D0 Scalar_BOOLEAN 0 BSW_A2L_Ident_Int 0 1 /end CHARACTERISTIC
/begin CHARACTERISTIC CAL_Cspf_IdcMin_f32 "CAL_Cspf_IdcMin_f32" VALUE 0x801402DC Scalar_FLOAT32_IEEE 0 BSW_A2L_Ident_Float -3.4E+38 3.4E+38 /end CHARACTERISTIC
/begin CHARACTERISTIC CAL_Cspf_TrqMin_f32 "CAL_Cspf_TrqMin_f32" VALUE 0x8014029C Scalar_FLOAT32_IEEE 0 BSW_A2L_Ident_Float -3.4E+38 3.4E+38 /end CHARACTERISTIC
/begin CHARACTERISTIC CAL_BCC_iThetaOffset_f32 "CAL_BCC_iThetaOffset_f32" VALUE 0x801401D4 Scalar_FLOAT32_IEEE 0 BSW_A2L_Ident_Float -3.4E+38 3.4E+38 /end CHARACTERISTIC
/begin CHARACTERISTIC CAL_MCF_DeadTimeCpn_f32 "CAL_MCF_DeadTimeCpn_f32" VALUE 0x80141374 Scalar_FLOAT32_IEEE 0 BSW_A2L_Ident_Float -3.4E+38 3.4E+38 /end CHARACTERISTIC
/begin CHARACTERISTIC CAL_MCF_uqDecoupki_f32 "CAL_MCF_uqDecoupki_f32" VALUE 0x80140F24 Scalar_FLOAT32_IEEE 0 BSW_A2L_Ident_Float -3.4E+38 3.4E+38 /end CHARACTERISTIC
/begin CHARACTERISTIC CAL_FRP_RslvSensVolRngErrOutCtl_b "CAL_FRP_RslvSensVolRngErrOutCtl_b" VALUE 0x801402FE Scalar_BOOLEAN 0 BSW_A2L_Ident_Int 0 1 /end CHARACTERISTIC
/begin CHARACTERISTIC CAL_TjrthLv4dldl_f32 "CAL_TjrthLv4dldl_f32" VALUE 0x80140138 Scalar_FLOAT32_IEEE 0 BSW_A2L_Ident_Float -3.4E+38 3.4E+38 /end CHARACTERISTIC
/begin CHARACTERISTIC CAL_Hspf_stPreDrvCtl_u8 "CAL_Hspf_stPreDrvCtl_u8" VALUE 0x8014032C Scalar_UBYTE 0 BSW_A2L_Ident_Int 0 255 /end CHARACTERISTIC
/begin CHARACTERISTIC CAL_Cspf_agOffset_f32 "CAL_Cspf_agOffset_f32" VALUE 0x80140288 Scalar_FLOAT32_IEEE 0 BSW_A2L_Ident_Float -3.4E+38 3.4E+38 /end CHARACTERISTIC
/begin CHARACTERISTIC CAL_MCF_flgUseFF_b "CAL_MCF_flgUseFF_b" VALUE 0x80140FE6 Scalar_BOOLEAN 0 BSW_A2L_Ident_Int 0 1 /end CHARACTERISTIC
/begin CHARACTERISTIC CAL_MCF_isdSet_f32 "CAL_MCF_isdSet_f32" VALUE 0x80140FC4 Scalar_FLOAT32_IEEE 0 BSW_A2L_Ident_Float -3.4E+38 3.4E+38 /end CHARACTERISTIC
/begin CHARACTERISTIC CAL_MCF_ActiveHeatNormal_u8 "CAL_MCF_ActiveHeatNormal_u8" VALUE 0x80141494 Scalar_UBYTE 0 BSW_A2L_Ident_Int 0 255 /end CHARACTERISTIC
/begin CHARACTERISTIC CAL_Cspf_bDernOvrIdc_u8 "CAL_Cspf_bDernOvrIdc_u8" VALUE 0x80140279 Scalar_UBYTE 0 BSW_A2L_Ident_Int 0 255 /end CHARACTERISTIC
/begin CHARACTERISTIC CAL_TjLv3Act_f32 "CAL_TjLv3Act_f32" VALUE 0x801401A0 Scalar_FLOAT32_IEEE 0 BSW_A2L_Ident_Float -3.4E+38 3.4E+38 /end CHARACTERISTIC
/begin CHARACTERISTIC CAL_Hspf_tSwtTempSttrLoLim_f32 "CAL_Hspf_tSwtTempSttrLoLim_f32" VALUE 0x80140314 Scalar_FLOAT32_IEEE 0 BSW_A2L_Ident_Float -3.4E+38 3.4E+38 /end CHARACTERISTIC
/begin CHARACTERISTIC CAL_Cspf_HwVer_u16 "CAL_Cspf_HwVer_u16" VALUE 0x801402E4 Scalar_UWORD 0 BSW_A2L_Ident_Int 0 65535 /end CHARACTERISTIC
/begin CHARACTERISTIC CAL_Cspf_FailCode5_u8 "CAL_Cspf_FailCode5_u8" VALUE 0x801402EA Scalar_UBYTE 0 BSW_A2L_Ident_Int 0 255 /end CHARACTERISTIC
/begin CHARACTERISTIC CAL_Cspf_tStrrTemp2Flt_f32 "CAL_Cspf_tStrrTemp2Flt_f32" VALUE 0x801401F8 Scalar_FLOAT32_IEEE 0 BSW_A2L_Ident_Float -3.4E+38 3.4E+38 /end CHARACTERISTIC
/begin CHARACTERISTIC CAL_MCF_isThetaSet_f32 "CAL_MCF_isThetaSet_f32" VALUE 0x80140FC8 Scalar_FLOAT32_IEEE 0 BSW_A2L_Ident_Float -3.4E+38 3.4E+38 /end CHARACTERISTIC
/begin CHARACTERISTIC CAL_Cspf_flgFailCode3Swt_b "CAL_Cspf_flgFailCode3Swt_b" VALUE 0x8014026D Scalar_BOOLEAN 0 BSW_A2L_Ident_Int 0 1 /end CHARACTERISTIC
/begin CHARACTERISTIC CAL_MCF_CoefuDCLimtEOL_f32 "CAL_MCF_CoefuDCLimtEOL_f32" VALUE 0x80141378 Scalar_FLOAT32_IEEE 0 BSW_A2L_Ident_Float -3.4E+38 3.4E+38 /end CHARACTERISTIC
/begin CHARACTERISTIC CAL_Cspf_flgstMainReLaySwt_b "CAL_Cspf_flgstMainReLaySwt_b" VALUE 0x80140238 Scalar_BOOLEAN 0 BSW_A2L_Ident_Int 0 1 /end CHARACTERISTIC
/begin CHARACTERISTIC CAL_ADM_flgCrash_b "CAL_ADM_flgCrash_b" VALUE 0x801400C8 Scalar_BOOLEAN 0 BSW_A2L_Ident_Int 0 1 /end CHARACTERISTIC
/begin CHARACTERISTIC CAL_MCF_FlgUseClose_b "CAL_MCF_FlgUseClose_b" VALUE 0x801412D1 Scalar_BOOLEAN 0 BSW_A2L_Ident_Int 0 1 /end CHARACTERISTIC
/begin CHARACTERISTIC CAL_Hspf_tDBCtempOffset_u8 "CAL_Hspf_tDBCtempOffset_u8" VALUE 0x80140324 Scalar_UBYTE 0 BSW_A2L_Ident_Int 0 255 /end CHARACTERISTIC
/begin CHARACTERISTIC CAL_Cspf_MainReLay_u8 "CAL_Cspf_MainReLay_u8" VALUE 0x801402CC Scalar_UBYTE 0 BSW_A2L_Ident_Int 0 255 /end CHARACTERISTIC
/begin CHARACTERISTIC CAL_Cspf_flgCpldVerSwt_b "CAL_Cspf_flgCpldVerSwt_b" VALUE 0x80140274 Scalar_BOOLEAN 0 BSW_A2L_Ident_Int 0 1 /end CHARACTERISTIC
/begin CHARACTERISTIC CAL_Hspf_INVOpenChkCntLoLim_s8 "CAL_Hspf_INVOpenChkCntLoLim_s8" VALUE 0x80140C39 Scalar_BYTE 0 BSW_A2L_Ident_Int -128 127 /end CHARACTERISTIC
/begin CHARACTERISTIC CAL_MCF_ratLo_f32 "CAL_MCF_ratLo_f32" VALUE 0x80140FA8 Scalar_FLOAT32_IEEE 0 BSW_A2L_Ident_Float -3.4E+38 3.4E+38 /end CHARACTERISTIC
/begin CHARACTERISTIC CAL_BCC_dycUpLimt_f32 "CAL_BCC_dycUpLimt_f32" VALUE 0x801401E4 Scalar_FLOAT32_IEEE 0 BSW_A2L_Ident_Float -3.4E+38 3.4E+38 /end CHARACTERISTIC
/begin CHARACTERISTIC CAL_MCF_nDpwmOffDelay_f32 "CAL_MCF_nDpwmOffDelay_f32" VALUE 0x80140FB4 Scalar_FLOAT32_IEEE 0 BSW_A2L_Ident_Float -3.4E+38 3.4E+38 /end CHARACTERISTIC
/begin CHARACTERISTIC CAL_Hspf_uKl30FltFrq_f32 "CAL_Hspf_uKl30FltFrq_f32" VALUE 0x8014030C Scalar_FLOAT32_IEEE 0 BSW_A2L_Ident_Float -3.4E+38 3.4E+38 /end CHARACTERISTIC
/begin CHARACTERISTIC CAL_MCF_uDDownLimEOL_f32 "CAL_MCF_uDDownLimEOL_f32" VALUE 0x80140F44 Scalar_FLOAT32_IEEE 0 BSW_A2L_Ident_Float -3.4E+38 3.4E+38 /end CHARACTERISTIC
/begin CHARACTERISTIC CAL_Cspf_flgbDernOvrUdcSwt_b "CAL_Cspf_flgbDernOvrUdcSwt_b" VALUE 0x80140245 Scalar_BOOLEAN 0 BSW_A2L_Ident_Int 0 1 /end CHARACTERISTIC
/begin CHARACTERISTIC CAL_Cspf_bDernCoolantTemp_u8 "CAL_Cspf_bDernCoolantTemp_u8" VALUE 0x80140281 Scalar_UBYTE 0 BSW_A2L_Ident_Int 0 255 /end CHARACTERISTIC
/begin CHARACTERISTIC CAL_MCF_Part_ActiveHeat_u8 "CAL_MCF_Part_ActiveHeat_u8" VALUE 0x801410D8 Scalar_UBYTE 0 BSW_A2L_Ident_Int 0 255 /end CHARACTERISTIC
/begin CHARACTERISTIC CAL_MCF_flgCalibOffset_b "CAL_MCF_flgCalibOffset_b" VALUE 0x80140FF2 Scalar_BOOLEAN 0 BSW_A2L_Ident_Int 0 1 /end CHARACTERISTIC
/begin CHARACTERISTIC CAL_Cspf_UdcMax_f32 "CAL_Cspf_UdcMax_f32" VALUE 0x80140290 Scalar_FLOAT32_IEEE 0 BSW_A2L_Ident_Float -3.4E+38 3.4E+38 /end CHARACTERISTIC
/begin CHARACTERISTIC CAL_ADM_VoltChgThr_f32 "CAL_ADM_VoltChgThr_f32" VALUE 0x801400D0 Scalar_FLOAT32_IEEE 0 BSW_A2L_Ident_Float -3.4E+38 3.4E+38 /end CHARACTERISTIC
/begin CHARACTERISTIC CAL_MCF_flgRpwmFrqRandom_b "CAL_MCF_flgRpwmFrqRandom_b" VALUE 0x80140FE9 Scalar_BOOLEAN 0 BSW_A2L_Ident_Int 0 1 /end CHARACTERISTIC
/begin CHARACTERISTIC CAL_Cspf_flgTrqDmpMaxSwt_b "CAL_Cspf_flgTrqDmpMaxSwt_b" VALUE 0x80140259 Scalar_BOOLEAN 0 BSW_A2L_Ident_Int 0 1 /end CHARACTERISTIC
/begin CHARACTERISTIC CAL_ADM_flgDchgReqSwt_b "CAL_ADM_flgDchgReqSwt_b" VALUE 0x801400C7 Scalar_BOOLEAN 0 BSW_A2L_Ident_Int 0 1 /end CHARACTERISTIC
/begin CHARACTERISTIC CAL_MCF_IsThetaSet11ZR_f32 "CAL_MCF_IsThetaSet11ZR_f32" VALUE 0x80141158 Scalar_FLOAT32_IEEE 0 BSW_A2L_Ident_Float -3.4E+38 3.4E+38 /end CHARACTERISTIC
/begin CHARACTERISTIC CAL_MCF_flgOverModu_b "CAL_MCF_flgOverModu_b" VALUE 0x80140FEA Scalar_BOOLEAN 0 BSW_A2L_Ident_Int 0 1 /end CHARACTERISTIC
/begin CHARACTERISTIC CAL_Cspf_stDisChg_u8 "CAL_Cspf_stDisChg_u8" VALUE 0x80140216 Scalar_UBYTE 0 BSW_A2L_Ident_Int 0 255 /end CHARACTERISTIC
/begin CHARACTERISTIC CAL_Cspf_flgbReadyHVSwt_b "CAL_Cspf_flgbReadyHVSwt_b" VALUE 0x80140242 Scalar_BOOLEAN 0 BSW_A2L_Ident_Int 0 1 /end CHARACTERISTIC
/begin CHARACTERISTIC CAL_MCF_KpBetaZeroCtl_f32 "CAL_MCF_KpBetaZeroCtl_f32" VALUE 0x8014113C Scalar_FLOAT32_IEEE 0 BSW_A2L_Ident_Float -3.4E+38 3.4E+38 /end CHARACTERISTIC
/begin CHARACTERISTIC CAL_MCF_cofOverModu_f32 "CAL_MCF_cofOverModu_f32" VALUE 0x80140FF4 Scalar_FLOAT32_IEEE 0 BSW_A2L_Ident_Float -3.4E+38 3.4E+38 /end CHARACTERISTIC
/begin CHARACTERISTIC CAL_FRP_1V8CPLDVoltRngErrOutCtl_b "CAL_FRP_1V8CPLDVoltRngErrOutCtl_b" VALUE 0x80140309 Scalar_BOOLEAN 0 BSW_A2L_Ident_Int 0 1 /end CHARACTERISTIC
/begin CHARACTERISTIC CAL_MCF_KpAlphaZeroCtl_f32 "CAL_MCF_KpAlphaZeroCtl_f32" VALUE 0x80141140 Scalar_FLOAT32_IEEE 0 BSW_A2L_Ident_Float -3.4E+38 3.4E+38 /end CHARACTERISTIC
/begin CHARACTERISTIC CAL_Cspf_flgTrqMinNCtlSwt_b "CAL_Cspf_flgTrqMinNCtlSwt_b" VALUE 0x80140254 Scalar_BOOLEAN 0 BSW_A2L_Ident_Int 0 1 /end CHARACTERISTIC
/begin CHARACTERISTIC CAL_MCF_flgInternalOffset_b "CAL_MCF_flgInternalOffset_b" VALUE 0x80140FEF Scalar_BOOLEAN 0 BSW_A2L_Ident_Int 0 1 /end CHARACTERISTIC
/begin CHARACTERISTIC CAL_Hspf_TmpWFltFrq_f32 "CAL_Hspf_TmpWFltFrq_f32" VALUE 0x8014034C Scalar_FLOAT32_IEEE 0 BSW_A2L_Ident_Float -3.4E+38 3.4E+38 /end CHARACTERISTIC
/begin CHARACTERISTIC CAL_FRP_UintndSpdErrOutCtl_b "CAL_FRP_UintndSpdErrOutCtl_b" VALUE 0x801402F9 Scalar_BOOLEAN 0 BSW_A2L_Ident_Int 0 1 /end CHARACTERISTIC
/begin CHARACTERISTIC CAL_Cspf_TraTrqMin_f32 "CAL_Cspf_TraTrqMin_f32" VALUE 0x801402BC Scalar_FLOAT32_IEEE 0 BSW_A2L_Ident_Float -3.4E+38 3.4E+38 /end CHARACTERISTIC
/begin CHARACTERISTIC CAL_MCF_SampleTime_f32 "CAL_MCF_SampleTime_f32" VALUE 0x801410D4 Scalar_FLOAT32_IEEE 0 BSW_A2L_Ident_Float -3.4E+38 3.4E+38 /end CHARACTERISTIC
/begin CHARACTERISTIC CAL_Hspf_iPhaLowSet_u16 "CAL_Hspf_iPhaLowSet_u16" VALUE 0x80140334 Scalar_UWORD 0 BSW_A2L_Ident_Int 0 65535 /end CHARACTERISTIC
/begin CHARACTERISTIC CAL_MCF_isdfwKi_f32 "CAL_MCF_isdfwKi_f32" VALUE 0x80140FC0 Scalar_FLOAT32_IEEE 0 BSW_A2L_Ident_Float -3.4E+38 3.4E+38 /end CHARACTERISTIC
/begin CHARACTERISTIC CAL_TjrthLv4dldh_f32 "CAL_TjrthLv4dldh_f32" VALUE 0x8014013C Scalar_FLOAT32_IEEE 0 BSW_A2L_Ident_Float -3.4E+38 3.4E+38 /end CHARACTERISTIC
/begin CHARACTERISTIC CAL_MCF_DycVSet_f32 "CAL_MCF_DycVSet_f32" VALUE 0x801412DC Scalar_FLOAT32_IEEE 0 BSW_A2L_Ident_Float -3.4E+38 3.4E+38 /end CHARACTERISTIC
/begin CHARACTERISTIC CAL_Cspf_flgbDernStrTempSwt_b "CAL_Cspf_flgbDernStrTempSwt_b" VALUE 0x80140244 Scalar_BOOLEAN 0 BSW_A2L_Ident_Int 0 1 /end CHARACTERISTIC
/begin CHARACTERISTIC CAL_TjrthLv4dhil_f32 "CAL_TjrthLv4dhil_f32" VALUE 0x80140144 Scalar_FLOAT32_IEEE 0 BSW_A2L_Ident_Float -3.4E+38 3.4E+38 /end CHARACTERISTIC
/begin CHARACTERISTIC CAL_Cspf_flgDchaReqSwt_b "CAL_Cspf_flgDchaReqSwt_b" VALUE 0x80140271 Scalar_BOOLEAN 0 BSW_A2L_Ident_Int 0 1 /end CHARACTERISTIC
/begin CHARACTERISTIC CAL_Hspf_MotorOpenChkAddCnt_u8 "CAL_Hspf_MotorOpenChkAddCnt_u8" VALUE 0x8014042C Scalar_UBYTE 0 BSW_A2L_Ident_Int 0 255 /end CHARACTERISTIC
/begin CHARACTERISTIC CAL_Cspf_flgDchaReq_b "CAL_Cspf_flgDchaReq_b" VALUE 0x80140270 Scalar_BOOLEAN 0 BSW_A2L_Ident_Int 0 1 /end CHARACTERISTIC
/begin CHARACTERISTIC CAL_Cspf_bDernOvrUdc_u8 "CAL_Cspf_bDernOvrUdc_u8" VALUE 0x80140278 Scalar_UBYTE 0 BSW_A2L_Ident_Int 0 255 /end CHARACTERISTIC
/begin CHARACTERISTIC CAL_MCF_flgLowOrHvudcLnk_b "CAL_MCF_flgLowOrHvudcLnk_b" VALUE 0x80140FEE Scalar_BOOLEAN 0 BSW_A2L_Ident_Int 0 1 /end CHARACTERISTIC
/begin CHARACTERISTIC CAL_ADM_stModeReq_u8 "CAL_ADM_stModeReq_u8" VALUE 0x801400C4 Scalar_UBYTE 0 BSW_A2L_Ident_Int 0 255 /end CHARACTERISTIC
/begin CHARACTERISTIC CAL_Cspf_flgHwVerSwt_b "CAL_Cspf_flgHwVerSwt_b" VALUE 0x80140266 Scalar_BOOLEAN 0 BSW_A2L_Ident_Int 0 1 /end CHARACTERISTIC
/begin CHARACTERISTIC CAL_Cspf_bDernDbcTemp_u8 "CAL_Cspf_bDernDbcTemp_u8" VALUE 0x80140280 Scalar_UBYTE 0 BSW_A2L_Ident_Int 0 255 /end CHARACTERISTIC
/begin CHARACTERISTIC CAL_MCF_FlgUseOpen_b "CAL_MCF_FlgUseOpen_b" VALUE 0x801412CE Scalar_BOOLEAN 0 BSW_A2L_Ident_Int 0 1 /end CHARACTERISTIC
/begin CHARACTERISTIC CAL_Hspf_TmpVFltFrq_f32 "CAL_Hspf_TmpVFltFrq_f32" VALUE 0x80140350 Scalar_FLOAT32_IEEE 0 BSW_A2L_Ident_Float -3.4E+38 3.4E+38 /end CHARACTERISTIC
/begin CHARACTERISTIC CAL_Hspf_CrashChkSubCnt_s8 "CAL_Hspf_CrashChkSubCnt_s8" VALUE 0x80140CBD Scalar_BYTE 0 BSW_A2L_Ident_Int -128 127 /end CHARACTERISTIC
/begin CHARACTERISTIC CAL_MCF_flgUseisTheta_b "CAL_MCF_flgUseisTheta_b" VALUE 0x80140FE2 Scalar_BOOLEAN 0 BSW_A2L_Ident_Int 0 1 /end CHARACTERISTIC
/begin CHARACTERISTIC CAL_Cspf_flgFailCode1Swt_b "CAL_Cspf_flgFailCode1Swt_b" VALUE 0x8014026F Scalar_BOOLEAN 0 BSW_A2L_Ident_Int 0 1 /end CHARACTERISTIC
/begin CHARACTERISTIC CAL_Cspf_flgstDmpCtLReqSwt_b "CAL_Cspf_flgstDmpCtLReqSwt_b" VALUE 0x8014023A Scalar_BOOLEAN 0 BSW_A2L_Ident_Int 0 1 /end CHARACTERISTIC
/begin CHARACTERISTIC CAL_MCF_CoefFltZero_C_f32 "CAL_MCF_CoefFltZero_C_f32" VALUE 0x80141444 Scalar_FLOAT32_IEEE 0 BSW_A2L_Ident_Float -3.4E+38 3.4E+38 /end CHARACTERISTIC
/begin CHARACTERISTIC CAL_MCF_isMax_f32 "CAL_MCF_isMax_f32" VALUE 0x80140FD0 Scalar_FLOAT32_IEEE 0 BSW_A2L_Ident_Float -3.4E+38 3.4E+38 /end CHARACTERISTIC
/begin CHARACTERISTIC CAL_Cspf_bDernUndrUdc_u8 "CAL_Cspf_bDernUndrUdc_u8" VALUE 0x80140276 Scalar_UBYTE 0 BSW_A2L_Ident_Int 0 255 /end CHARACTERISTIC
/begin CHARACTERISTIC CAL_FRP_FaultReactCtl_b "CAL_FRP_FaultReactCtl_b" VALUE 0x80140304 Scalar_BOOLEAN 0 BSW_A2L_Ident_Int 0 1 /end CHARACTERISTIC
/begin CHARACTERISTIC CAL_ADM_VoltCmpChkErrst_b "CAL_ADM_VoltCmpChkErrst_b" VALUE 0x801400CA Scalar_BOOLEAN 0 BSW_A2L_Ident_Int 0 1 /end CHARACTERISTIC
/begin CHARACTERISTIC CAL_TjrthLv4dlntc_f32 "CAL_TjrthLv4dlntc_f32" VALUE 0x8014012C Scalar_FLOAT32_IEEE 0 BSW_A2L_Ident_Float -3.4E+38 3.4E+38 /end CHARACTERISTIC
/begin CHARACTERISTIC CAL_Hspf_bt15ChkCntHiLim_u8 "CAL_Hspf_bt15ChkCntHiLim_u8" VALUE 0x80140342 Scalar_UBYTE 0 BSW_A2L_Ident_Int 0 255 /end CHARACTERISTIC
/begin CHARACTERISTIC CAL_MCF_FixFreq_f32 "CAL_MCF_FixFreq_f32" VALUE 0x801412D4 Scalar_FLOAT32_IEEE 0 BSW_A2L_Ident_Float -3.4E+38 3.4E+38 /end CHARACTERISTIC
/begin CHARACTERISTIC CAL_MCF_stDpwm_u8 "CAL_MCF_stDpwm_u8" VALUE 0x80140F9D Scalar_UBYTE 0 BSW_A2L_Ident_Int 0 255 /end CHARACTERISTIC
/begin CHARACTERISTIC CAL_Cspf_flgTrqMechFltSwt_b "CAL_Cspf_flgTrqMechFltSwt_b" VALUE 0x80140255 Scalar_BOOLEAN 0 BSW_A2L_Ident_Int 0 1 /end CHARACTERISTIC
/begin CHARACTERISTIC CAL_Cspf_flgTrqCurrWoDmpCSwt_b "CAL_Cspf_flgTrqCurrWoDmpCSwt_b" VALUE 0x8014025A Scalar_BOOLEAN 0 BSW_A2L_Ident_Int 0 1 /end CHARACTERISTIC
/begin CHARACTERISTIC CAL_Cspf_tDBCTempUFlt_f32 "CAL_Cspf_tDBCTempUFlt_f32" VALUE 0x80140208 Scalar_FLOAT32_IEEE 0 BSW_A2L_Ident_Float -3.4E+38 3.4E+38 /end CHARACTERISTIC
/begin CHARACTERISTIC CAL_MCF_KiUdEOL_f32 "CAL_MCF_KiUdEOL_f32" VALUE 0x80141144 Scalar_FLOAT32_IEEE 0 BSW_A2L_Ident_Float -3.4E+38 3.4E+38 /end CHARACTERISTIC
/begin CHARACTERISTIC CAL_Hspf_uDcLnkFltFrq_f32 "CAL_Hspf_uDcLnkFltFrq_f32" VALUE 0x80140310 Scalar_FLOAT32_IEEE 0 BSW_A2L_Ident_Float -3.4E+38 3.4E+38 /end CHARACTERISTIC
/begin CHARACTERISTIC CAL_MCF_perCpnAg_f32 "CAL_MCF_perCpnAg_f32" VALUE 0x80140FAC Scalar_FLOAT32_IEEE 0 BSW_A2L_Ident_Float -3.4E+38 3.4E+38 /end CHARACTERISTIC
/begin CHARACTERISTIC CAL_Cspf_flgbDernDrvBoardTempSwt_b "CAL_Cspf_flgbDernDrvBoardTempSwt_b" VALUE 0x8014024A Scalar_BOOLEAN 0 BSW_A2L_Ident_Int 0 1 /end CHARACTERISTIC
/begin CHARACTERISTIC CAL_ADM_BMSVoltRngErrDebThr_s16 "CAL_ADM_BMSVoltRngErrDebThr_s16" VALUE 0x801400F8 Scalar_SWORD 0 BSW_A2L_Ident_Int -32768 32767 /end CHARACTERISTIC
/begin CHARACTERISTIC CAL_MCF_BetaRefZeroCtl_f32 "CAL_MCF_BetaRefZeroCtl_f32" VALUE 0x80141450 Scalar_FLOAT32_IEEE 0 BSW_A2L_Ident_Float -3.4E+38 3.4E+38 /end CHARACTERISTIC
/begin CHARACTERISTIC CAL_Cspf_flgFailCode7Swt_b "CAL_Cspf_flgFailCode7Swt_b" VALUE 0x80140269 Scalar_BOOLEAN 0 BSW_A2L_Ident_Int 0 1 /end CHARACTERISTIC
/begin CHARACTERISTIC CAL_MCF_iVCnvFac_f32 "CAL_MCF_iVCnvFac_f32" VALUE 0x80140FD8 Scalar_FLOAT32_IEEE 0 BSW_A2L_Ident_Float -3.4E+38 3.4E+38 /end CHARACTERISTIC
/begin CHARACTERISTIC CAL_Cspf_FailCode2_u8 "CAL_Cspf_FailCode2_u8" VALUE 0x801402ED Scalar_UBYTE 0 BSW_A2L_Ident_Int 0 255 /end CHARACTERISTIC
/begin CHARACTERISTIC CAL_Hspf_tSwtTempSttrHiLim_f32 "CAL_Hspf_tSwtTempSttrHiLim_f32" VALUE 0x80140318 Scalar_FLOAT32_IEEE 0 BSW_A2L_Ident_Float -3.4E+38 3.4E+38 /end CHARACTERISTIC
/begin CHARACTERISTIC CAL_Cspf_uDcLnkSlowFlt_f32 "CAL_Cspf_uDcLnkSlowFlt_f32" VALUE 0x801401F4 Scalar_FLOAT32_IEEE 0 BSW_A2L_Ident_Float -3.4E+38 3.4E+38 /end CHARACTERISTIC
/begin CHARACTERISTIC CAL_Cspf_flgtDBCTempUFltSwt_b "CAL_Cspf_flgtDBCTempUFltSwt_b" VALUE 0x80140232 Scalar_BOOLEAN 0 BSW_A2L_Ident_Int 0 1 /end CHARACTERISTIC
/begin CHARACTERISTIC CAL_Hspf_Multiple_u8 "CAL_Hspf_Multiple_u8" VALUE 0x80140428 Scalar_UBYTE 0 BSW_A2L_Ident_Int 0 255 /end CHARACTERISTIC
/begin CHARACTERISTIC CAL_Cspf_flgFailCode6Swt_b "CAL_Cspf_flgFailCode6Swt_b" VALUE 0x8014026A Scalar_BOOLEAN 0 BSW_A2L_Ident_Int 0 1 /end CHARACTERISTIC
/begin CHARACTERISTIC CAL_Cspf_DataVer_u16 "CAL_Cspf_DataVer_u16" VALUE 0x801402F0 Scalar_UWORD 0 BSW_A2L_Ident_Int 0 65535 /end CHARACTERISTIC
/begin CHARACTERISTIC CAL_Hspf_TmpCoolanTjFltFrq_f32 "CAL_Hspf_TmpCoolanTjFltFrq_f32" VALUE 0x80140358 Scalar_FLOAT32_IEEE 0 BSW_A2L_Ident_Float -3.4E+38 3.4E+38 /end CHARACTERISTIC
/begin CHARACTERISTIC CAL_MCF_flgTabZeroCtl_b "CAL_MCF_flgTabZeroCtl_b" VALUE 0x80140FE8 Scalar_BOOLEAN 0 BSW_A2L_Ident_Int 0 1 /end CHARACTERISTIC
/begin CHARACTERISTIC CAL_MCF_HalfFreq_f32 "CAL_MCF_HalfFreq_f32" VALUE 0x801412C4 Scalar_FLOAT32_IEEE 0 BSW_A2L_Ident_Float -3.4E+38 3.4E+38 /end CHARACTERISTIC
/begin CHARACTERISTIC CAL_MCF_uqki_f32 "CAL_MCF_uqki_f32" VALUE 0x80140F1C Scalar_FLOAT32_IEEE 0 BSW_A2L_Ident_Float -3.4E+38 3.4E+38 /end CHARACTERISTIC
/begin CHARACTERISTIC CAL_FRP_NSetPRngErrOutCtl_b "CAL_FRP_NSetPRngErrOutCtl_b" VALUE 0x80140302 Scalar_BOOLEAN 0 BSW_A2L_Ident_Int 0 1 /end CHARACTERISTIC
/begin CHARACTERISTIC CAL_Cspf_TrqMaxNCtL_f32 "CAL_Cspf_TrqMaxNCtL_f32" VALUE 0x801402AC Scalar_FLOAT32_IEEE 0 BSW_A2L_Ident_Float -3.4E+38 3.4E+38 /end CHARACTERISTIC
/begin CHARACTERISTIC CAL_Cspf_uKl30Flt_f32 "CAL_Cspf_uKl30Flt_f32" VALUE 0x801401F0 Scalar_FLOAT32_IEEE 0 BSW_A2L_Ident_Float -3.4E+38 3.4E+38 /end CHARACTERISTIC
/begin CHARACTERISTIC CAL_BCC_iThetaOffsetGen_f32 "CAL_BCC_iThetaOffsetGen_f32" VALUE 0x801401D8 Scalar_FLOAT32_IEEE 0 BSW_A2L_Ident_Float -3.4E+38 3.4E+38 /end CHARACTERISTIC
/begin CHARACTERISTIC CAL_TjLv1Act_f32 "CAL_TjLv1Act_f32" VALUE 0x801401A8 Scalar_FLOAT32_IEEE 0 BSW_A2L_Ident_Float -3.4E+38 3.4E+38 /end CHARACTERISTIC
/begin CHARACTERISTIC CAL_Hspf_VerMatchSucceed_u8 "CAL_Hspf_VerMatchSucceed_u8" VALUE 0x80140346 Scalar_UBYTE 0 BSW_A2L_Ident_Int 0 255 /end CHARACTERISTIC
/begin CHARACTERISTIC CAL_MCF_uqkp_f32 "CAL_MCF_uqkp_f32" VALUE 0x80140F18 Scalar_FLOAT32_IEEE 0 BSW_A2L_Ident_Float -3.4E+38 3.4E+38 /end CHARACTERISTIC
/begin CHARACTERISTIC CAL_Cspf_KpHighNCtL_f32 "CAL_Cspf_KpHighNCtL_f32" VALUE 0x801402D4 Scalar_FLOAT32_IEEE 0 BSW_A2L_Ident_Float -3.4E+38 3.4E+38 /end CHARACTERISTIC
/begin CHARACTERISTIC CAL_Cspf_FailCode1_u8 "CAL_Cspf_FailCode1_u8" VALUE 0x801402EE Scalar_UBYTE 0 BSW_A2L_Ident_Int 0 255 /end CHARACTERISTIC
/begin CHARACTERISTIC CAL_Cspf_tStrrTemp1Flt_f32 "CAL_Cspf_tStrrTemp1Flt_f32" VALUE 0x801401FC Scalar_FLOAT32_IEEE 0 BSW_A2L_Ident_Float -3.4E+38 3.4E+38 /end CHARACTERISTIC
/begin CHARACTERISTIC CAL_MCF_cofFltWe_f32 "CAL_MCF_cofFltWe_f32" VALUE 0x80140FF8 Scalar_FLOAT32_IEEE 0 BSW_A2L_Ident_Float -3.4E+38 3.4E+38 /end CHARACTERISTIC
/begin CHARACTERISTIC CAL_MCF_FlgUseSatuEOL_b "CAL_MCF_FlgUseSatuEOL_b" VALUE 0x801412CD Scalar_BOOLEAN 0 BSW_A2L_Ident_Int 0 1 /end CHARACTERISTIC
/begin CHARACTERISTIC CAL_FRP_BMSVoltRngErrOutCtl_b "CAL_FRP_BMSVoltRngErrOutCtl_b" VALUE 0x80140307 Scalar_BOOLEAN 0 BSW_A2L_Ident_Int 0 1 /end CHARACTERISTIC
/begin CHARACTERISTIC CAL_MCF_DisChaisqDes_f32 "CAL_MCF_DisChaisqDes_f32" VALUE 0x801412F0 Scalar_FLOAT32_IEEE 0 BSW_A2L_Ident_Float -3.4E+38 3.4E+38 /end CHARACTERISTIC
/begin CHARACTERISTIC CAL_Cspf_TrqDmpMax_f32 "CAL_Cspf_TrqDmpMax_f32" VALUE 0x801402B0 Scalar_FLOAT32_IEEE 0 BSW_A2L_Ident_Float -3.4E+38 3.4E+38 /end CHARACTERISTIC
/begin CHARACTERISTIC CAL_TjrthLv4ildl_f32 "CAL_TjrthLv4ildl_f32" VALUE 0x80140118 Scalar_FLOAT32_IEEE 0 BSW_A2L_Ident_Float -3.4E+38 3.4E+38 /end CHARACTERISTIC
/begin CHARACTERISTIC CAL_Cspf_flgNSetPSwt_b "CAL_Cspf_flgNSetPSwt_b" VALUE 0x8014025F Scalar_BOOLEAN 0 BSW_A2L_Ident_Int 0 1 /end CHARACTERISTIC
/begin CHARACTERISTIC CAL_Hspf_INVOpenChkSubCnt_s8 "CAL_Hspf_INVOpenChkSubCnt_s8" VALUE 0x80140C38 Scalar_BYTE 0 BSW_A2L_Ident_Int -128 127 /end CHARACTERISTIC
/begin CHARACTERISTIC CAL_BCC_iDcEstflt_f32 "CAL_BCC_iDcEstflt_f32" VALUE 0x801401DC Scalar_FLOAT32_IEEE 0 BSW_A2L_Ident_Float -3.4E+38 3.4E+38 /end CHARACTERISTIC
/begin CHARACTERISTIC CAL_MCF_udDecoupki_f32 "CAL_MCF_udDecoupki_f32" VALUE 0x80140F34 Scalar_FLOAT32_IEEE 0 BSW_A2L_Ident_Float -3.4E+38 3.4E+38 /end CHARACTERISTIC
/begin CHARACTERISTIC CAL_ADM_BMSLowerThr_f32 "CAL_ADM_BMSLowerThr_f32" VALUE 0x80140100 Scalar_FLOAT32_IEEE 0 BSW_A2L_Ident_Float -3.4E+38 3.4E+38 /end CHARACTERISTIC
/begin CHARACTERISTIC CAL_MCF_flgHarmInIsThetaTab11ZR_b "CAL_MCF_flgHarmInIsThetaTab11ZR_b" VALUE 0x80140FF0 Scalar_BOOLEAN 0 BSW_A2L_Ident_Int 0 1 /end CHARACTERISTIC
/begin CHARACTERISTIC CAL_Cspf_TrqSetP_f32 "CAL_Cspf_TrqSetP_f32" VALUE 0x80140294 Scalar_FLOAT32_IEEE 0 BSW_A2L_Ident_Float -3.4E+38 3.4E+38 /end CHARACTERISTIC
/begin CHARACTERISTIC CAL_FRP_OffsetRngErrrOutCtl_b "CAL_FRP_OffsetRngErrrOutCtl_b" VALUE 0x80140301 Scalar_BOOLEAN 0 BSW_A2L_Ident_Int 0 1 /end CHARACTERISTIC
/begin CHARACTERISTIC CAL_MCF_DycUSet_f32 "CAL_MCF_DycUSet_f32" VALUE 0x801412E0 Scalar_FLOAT32_IEEE 0 BSW_A2L_Ident_Float -3.4E+38 3.4E+38 /end CHARACTERISTIC
/begin CHARACTERISTIC CAL_ADM_flgDchgReq_b "CAL_ADM_flgDchgReq_b" VALUE 0x801400C6 Scalar_BOOLEAN 0 BSW_A2L_Ident_Int 0 1 /end CHARACTERISTIC
/begin CHARACTERISTIC CAL_TjrthLv4dhdl_f32 "CAL_TjrthLv4dhdl_f32" VALUE 0x80140148 Scalar_FLOAT32_IEEE 0 BSW_A2L_Ident_Float -3.4E+38 3.4E+38 /end CHARACTERISTIC
/begin CHARACTERISTIC CAL_Cspf_flguDcLnkSlowFltSwt_b "CAL_Cspf_flguDcLnkSlowFltSwt_b" VALUE 0x8014022D Scalar_BOOLEAN 0 BSW_A2L_Ident_Int 0 1 /end CHARACTERISTIC
/begin CHARACTERISTIC CAL_Cspf_FailCode4_u8 "CAL_Cspf_FailCode4_u8" VALUE 0x801402EB Scalar_UBYTE 0 BSW_A2L_Ident_Int 0 255 /end CHARACTERISTIC
/begin CHARACTERISTIC CAL_MCF_KpUdEOL_f32 "CAL_MCF_KpUdEOL_f32" VALUE 0x80141134 Scalar_FLOAT32_IEEE 0 BSW_A2L_Ident_Float -3.4E+38 3.4E+38 /end CHARACTERISTIC
/begin CHARACTERISTIC CAL_TjrthLv4dlil_f32 "CAL_TjrthLv4dlil_f32" VALUE 0x80140130 Scalar_FLOAT32_IEEE 0 BSW_A2L_Ident_Float -3.4E+38 3.4E+38 /end CHARACTERISTIC
/begin CHARACTERISTIC CAL_Cspf_iDActSlowFlt_f32 "CAL_Cspf_iDActSlowFlt_f32" VALUE 0x80140228 Scalar_FLOAT32_IEEE 0 BSW_A2L_Ident_Float -3.4E+38 3.4E+38 /end CHARACTERISTIC
/begin CHARACTERISTIC CAL_MCF_isdfwKp_f32 "CAL_MCF_isdfwKp_f32" VALUE 0x80140FBC Scalar_FLOAT32_IEEE 0 BSW_A2L_Ident_Float -3.4E+38 3.4E+38 /end CHARACTERISTIC
/begin CHARACTERISTIC CAL_Cspf_stGateDrv_u8 "CAL_Cspf_stGateDrv_u8" VALUE 0x80140214 Scalar_UBYTE 0 BSW_A2L_Ident_Int 0 255 /end CHARACTERISTIC
/begin CHARACTERISTIC CAL_MCF_TrqInvMax_f32 "CAL_MCF_TrqInvMax_f32" VALUE 0x801410A0 Scalar_FLOAT32_IEEE 0 BSW_A2L_Ident_Float -3.4E+38 3.4E+38 /end CHARACTERISTIC
/begin CHARACTERISTIC CAL_MCF_KiBetaZeroCtl_f32 "CAL_MCF_KiBetaZeroCtl_f32" VALUE 0x8014114C Scalar_FLOAT32_IEEE 0 BSW_A2L_Ident_Float -3.4E+38 3.4E+38 /end CHARACTERISTIC
/begin CHARACTERISTIC CAL_MCF_flgNWS_b "CAL_MCF_flgNWS_b" VALUE 0x80140FEC Scalar_BOOLEAN 0 BSW_A2L_Ident_Int 0 1 /end CHARACTERISTIC
/begin CHARACTERISTIC CAL_Cspf_flgbDernDbcTempSwt_b "CAL_Cspf_flgbDernDbcTempSwt_b" VALUE 0x8014024B Scalar_BOOLEAN 0 BSW_A2L_Ident_Int 0 1 /end CHARACTERISTIC
/begin CHARACTERISTIC CAL_MCF_iWCnvFac_f32 "CAL_MCF_iWCnvFac_f32" VALUE 0x80140FD4 Scalar_FLOAT32_IEEE 0 BSW_A2L_Ident_Float -3.4E+38 3.4E+38 /end CHARACTERISTIC
/begin CHARACTERISTIC CAL_TjLv3Pas_f32 "CAL_TjLv3Pas_f32" VALUE 0x8014019C Scalar_FLOAT32_IEEE 0 BSW_A2L_Ident_Float -3.4E+38 3.4E+38 /end CHARACTERISTIC
/begin CHARACTERISTIC CAL_Cspf_flgcTrqSLopeSwt_b "CAL_Cspf_flgcTrqSLopeSwt_b" VALUE 0x80140241 Scalar_BOOLEAN 0 BSW_A2L_Ident_Int 0 1 /end CHARACTERISTIC
/begin CHARACTERISTIC CAL_Cspf_flgFailCode2Swt_b "CAL_Cspf_flgFailCode2Swt_b" VALUE 0x8014026E Scalar_BOOLEAN 0 BSW_A2L_Ident_Int 0 1 /end CHARACTERISTIC
/begin CHARACTERISTIC CAL_Cspf_FailCode6_u8 "CAL_Cspf_FailCode6_u8" VALUE 0x801402E9 Scalar_UBYTE 0 BSW_A2L_Ident_Int 0 255 /end CHARACTERISTIC
/begin CHARACTERISTIC CAL_Cspf_bDernDrvBoardTemp_u16 "CAL_Cspf_bDernDrvBoardTemp_u16" VALUE 0x8014027E Scalar_UWORD 0 BSW_A2L_Ident_Int 0 65535 /end CHARACTERISTIC
/begin CHARACTERISTIC CAL_Cspf_flgbDernExcMaxSwt_b "CAL_Cspf_flgbDernExcMaxSwt_b" VALUE 0x80140249 Scalar_BOOLEAN 0 BSW_A2L_Ident_Int 0 1 /end CHARACTERISTIC
/begin CHARACTERISTIC CAL_Hspf_MotorOpenChkCntHiLim_u8 "CAL_Hspf_MotorOpenChkCntHiLim_u8" VALUE 0x8014042B Scalar_UBYTE 0 BSW_A2L_Ident_Int 0 255 /end CHARACTERISTIC
/begin CHARACTERISTIC CAL_Cspf_IdcMax_f32 "CAL_Cspf_IdcMax_f32" VALUE 0x801402E0 Scalar_FLOAT32_IEEE 0 BSW_A2L_Ident_Float -3.4E+38 3.4E+38 /end CHARACTERISTIC
/begin CHARACTERISTIC CAL_MCF_OffsetInternal_f32 "CAL_MCF_OffsetInternal_f32" VALUE 0x8014112C Scalar_FLOAT32_IEEE 0 BSW_A2L_Ident_Float -3.4E+38 3.4E+38 /end CHARACTERISTIC
/begin CHARACTERISTIC CAL_Cspf_NDiffMax_f32 "CAL_Cspf_NDiffMax_f32" VALUE 0x801402C8 Scalar_FLOAT32_IEEE 0 BSW_A2L_Ident_Float -3.4E+38 3.4E+38 /end CHARACTERISTIC
/begin CHARACTERISTIC CAL_TjrthLv4ilntc_f32 "CAL_TjrthLv4ilntc_f32" VALUE 0x8014010C Scalar_FLOAT32_IEEE 0 BSW_A2L_Ident_Float -3.4E+38 3.4E+38 /end CHARACTERISTIC
/begin CHARACTERISTIC CAL_Cspf_NSetP_f32 "CAL_Cspf_NSetP_f32" VALUE 0x801402C4 Scalar_FLOAT32_IEEE 0 BSW_A2L_Ident_Float -3.4E+38 3.4E+38 /end CHARACTERISTIC
/begin CHARACTERISTIC CAL_MCF_KiAlphaZeroCtl_f32 "CAL_MCF_KiAlphaZeroCtl_f32" VALUE 0x80141150 Scalar_FLOAT32_IEEE 0 BSW_A2L_Ident_Float -3.4E+38 3.4E+38 /end CHARACTERISTIC
/begin CHARACTERISTIC CAL_MCF_flgUse1113ZR_b "CAL_MCF_flgUse1113ZR_b" VALUE 0x80140FE7 Scalar_BOOLEAN 0 BSW_A2L_Ident_Int 0 1 /end CHARACTERISTIC
/begin CHARACTERISTIC CAL_MCF_ratNarrWave_f32 "CAL_MCF_ratNarrWave_f32" VALUE 0x80140FA4 Scalar_FLOAT32_IEEE 0 BSW_A2L_Ident_Float -3.4E+38 3.4E+38 /end CHARACTERISTIC
/begin CHARACTERISTIC CAL_ADM_VoltAbsDiffThr_f32 "CAL_ADM_VoltAbsDiffThr_f32" VALUE 0x801400D4 Scalar_FLOAT32_IEEE 0 BSW_A2L_Ident_Float -3.4E+38 3.4E+38 /end CHARACTERISTIC
/begin CHARACTERISTIC CAL_TjrthLv4ihil_f32 "CAL_TjrthLv4ihil_f32" VALUE 0x80140120 Scalar_FLOAT32_IEEE 0 BSW_A2L_Ident_Float -3.4E+38 3.4E+38 /end CHARACTERISTIC
/begin CHARACTERISTIC CAL_Cspf_flgIsFltSwt_b "CAL_Cspf_flgIsFltSwt_b" VALUE 0x80140263 Scalar_BOOLEAN 0 BSW_A2L_Ident_Int 0 1 /end CHARACTERISTIC
/begin CHARACTERISTIC CAL_MCF_stChangePha_u8 "CAL_MCF_stChangePha_u8" VALUE 0x80140F9E Scalar_UBYTE 0 BSW_A2L_Ident_Int 0 255 /end CHARACTERISTIC
/begin CHARACTERISTIC CAL_MCF_UpLimPIZeroCtl_f32 "CAL_MCF_UpLimPIZeroCtl_f32" VALUE 0x80141074 Scalar_FLOAT32_IEEE 0 BSW_A2L_Ident_Float -3.4E+38 3.4E+38 /end CHARACTERISTIC
/begin CHARACTERISTIC CAL_Cspf_IsFlt_f32 "CAL_Cspf_IsFlt_f32" VALUE 0x801402D8 Scalar_FLOAT32_IEEE 0 BSW_A2L_Ident_Float -3.4E+38 3.4E+38 /end CHARACTERISTIC
/begin CHARACTERISTIC CAL_Hspf_CltInletTempFltFrq_f32 "CAL_Hspf_CltInletTempFltFrq_f32" VALUE 0x80140EB0 Scalar_FLOAT32_IEEE 0 BSW_A2L_Ident_Float -3.4E+38 3.4E+38 /end CHARACTERISTIC
/begin CHARACTERISTIC CAL_Cspf_FailCode3_u8 "CAL_Cspf_FailCode3_u8" VALUE 0x801402EC Scalar_UBYTE 0 BSW_A2L_Ident_Int 0 255 /end CHARACTERISTIC
/begin CHARACTERISTIC CAL_MCF_uQDesEOL_f32 "CAL_MCF_uQDesEOL_f32" VALUE 0x80140F38 Scalar_FLOAT32_IEEE 0 BSW_A2L_Ident_Float -3.4E+38 3.4E+38 /end CHARACTERISTIC
/begin CHARACTERISTIC CAL_Cspf_TraTrqMax_f32 "CAL_Cspf_TraTrqMax_f32" VALUE 0x801402C0 Scalar_FLOAT32_IEEE 0 BSW_A2L_Ident_Float -3.4E+38 3.4E+38 /end CHARACTERISTIC
/begin CHARACTERISTIC CAL_Cspf_flgstDisChgSwt_b "CAL_Cspf_flgstDisChgSwt_b" VALUE 0x8014023B Scalar_BOOLEAN 0 BSW_A2L_Ident_Int 0 1 /end CHARACTERISTIC
/begin CHARACTERISTIC CAL_MCF_flgUseisdqSet_b "CAL_MCF_flgUseisdqSet_b" VALUE 0x80140FE1 Scalar_BOOLEAN 0 BSW_A2L_Ident_Int 0 1 /end CHARACTERISTIC
/begin CHARACTERISTIC CAL_MCF_FlgUseSetDyc_b "CAL_MCF_FlgUseSetDyc_b" VALUE 0x801412CC Scalar_BOOLEAN 0 BSW_A2L_Ident_Int 0 1 /end CHARACTERISTIC
/begin CHARACTERISTIC CAL_Cspf_bReadyHV_u8 "CAL_Cspf_bReadyHV_u8" VALUE 0x80140275 Scalar_UBYTE 0 BSW_A2L_Ident_Int 0 255 /end CHARACTERISTIC
/begin CHARACTERISTIC CAL_MCF_udkp_f32 "CAL_MCF_udkp_f32" VALUE 0x80140F28 Scalar_FLOAT32_IEEE 0 BSW_A2L_Ident_Float -3.4E+38 3.4E+38 /end CHARACTERISTIC
/begin CHARACTERISTIC CAL_MCF_DownLimPIZeroCtl_f32 "CAL_MCF_DownLimPIZeroCtl_f32" VALUE 0x801412EC Scalar_FLOAT32_IEEE 0 BSW_A2L_Ident_Float -3.4E+38 3.4E+38 /end CHARACTERISTIC
/begin CHARACTERISTIC CAL_Hspf_cntIPhCalOffTolCnt_u16 "CAL_Hspf_cntIPhCalOffTolCnt_u16" VALUE 0x8014033E Scalar_UWORD 0 BSW_A2L_Ident_Int 0 65535 /end CHARACTERISTIC
/begin CHARACTERISTIC CAL_Hspf_bt15ChkCntLoLim_s8 "CAL_Hspf_bt15ChkCntLoLim_s8" VALUE 0x80140341 Scalar_BYTE 0 BSW_A2L_Ident_Int -128 127 /end CHARACTERISTIC
/begin CHARACTERISTIC CAL_MCF_flgUseUsdqSet_b "CAL_MCF_flgUseUsdqSet_b" VALUE 0x80140FE4 Scalar_BOOLEAN 0 BSW_A2L_Ident_Int 0 1 /end CHARACTERISTIC
/begin CHARACTERISTIC CAL_FRP_UintndTrqErrOutCtl_b "CAL_FRP_UintndTrqErrOutCtl_b" VALUE 0x801402F8 Scalar_BOOLEAN 0 BSW_A2L_Ident_Int 0 1 /end CHARACTERISTIC
/begin CHARACTERISTIC CAL_Cspf_flgbDernCoolantTempSwt_b "CAL_Cspf_flgbDernCoolantTempSwt_b" VALUE 0x8014024C Scalar_BOOLEAN 0 BSW_A2L_Ident_Int 0 1 /end CHARACTERISTIC
/begin CHARACTERISTIC CAL_Cspf_flgCrashSwt_b "CAL_Cspf_flgCrashSwt_b" VALUE 0x80140273 Scalar_BOOLEAN 0 BSW_A2L_Ident_Int 0 1 /end CHARACTERISTIC
/begin CHARACTERISTIC CAL_MCF_flgOfsClbTest_b "CAL_MCF_flgOfsClbTest_b" VALUE 0x80140FEB Scalar_BOOLEAN 0 BSW_A2L_Ident_Int 0 1 /end CHARACTERISTIC
/begin CHARACTERISTIC CAL_Cspf_tDBCTempVFlt_f32 "CAL_Cspf_tDBCTempVFlt_f32" VALUE 0x80140204 Scalar_FLOAT32_IEEE 0 BSW_A2L_Ident_Float -3.4E+38 3.4E+38 /end CHARACTERISTIC
/begin CHARACTERISTIC CAL_BCC_flgEnableIdc_b "CAL_BCC_flgEnableIdc_b" VALUE 0x801401E1 Scalar_BOOLEAN 0 BSW_A2L_Ident_Int 0 1 /end CHARACTERISTIC
/begin CHARACTERISTIC CAL_Cspf_flgnSlowFltSwt_b "CAL_Cspf_flgnSlowFltSwt_b" VALUE 0x8014023C Scalar_BOOLEAN 0 BSW_A2L_Ident_Int 0 1 /end CHARACTERISTIC
/begin CHARACTERISTIC CAL_FRP_CurrRngErrOutCtl_b "CAL_FRP_CurrRngErrOutCtl_b" VALUE 0x80140306 Scalar_BOOLEAN 0 BSW_A2L_Ident_Int 0 1 /end CHARACTERISTIC
/begin CHARACTERISTIC CAL_TjstUVW_u8 "CAL_TjstUVW_u8" VALUE 0x80140108 Scalar_UBYTE 0 BSW_A2L_Ident_Int 0 255 /end CHARACTERISTIC
/begin CHARACTERISTIC CAL_Cspf_flgCrash_b "CAL_Cspf_flgCrash_b" VALUE 0x80140272 Scalar_BOOLEAN 0 BSW_A2L_Ident_Int 0 1 /end CHARACTERISTIC
/begin CHARACTERISTIC CAL_Cspf_flgkDmpSwt_b "CAL_Cspf_flgkDmpSwt_b" VALUE 0x8014023D Scalar_BOOLEAN 0 BSW_A2L_Ident_Int 0 1 /end CHARACTERISTIC
/begin CHARACTERISTIC CAL_MCF_ActiveHeatInit_u8 "CAL_MCF_ActiveHeatInit_u8" VALUE 0x80141495 Scalar_UBYTE 0 BSW_A2L_Ident_Int 0 255 /end CHARACTERISTIC
/begin CHARACTERISTIC CAL_Cspf_bDernExcMin_u8 "CAL_Cspf_bDernExcMin_u8" VALUE 0x8014027B Scalar_UBYTE 0 BSW_A2L_Ident_Int 0 255 /end CHARACTERISTIC
/begin CHARACTERISTIC CAL_FRP_3V3CPLDVoltRngErrOutCtl_b "CAL_FRP_3V3CPLDVoltRngErrOutCtl_b" VALUE 0x80140308 Scalar_BOOLEAN 0 BSW_A2L_Ident_Int 0 1 /end CHARACTERISTIC
/begin CHARACTERISTIC CAL_MCF_Non_ActiveHeat_u8 "CAL_MCF_Non_ActiveHeat_u8" VALUE 0x80141130 Scalar_UBYTE 0 BSW_A2L_Ident_Int 0 255 /end CHARACTERISTIC
/begin CHARACTERISTIC CAL_Tj_cofFltCoolant_f32 "CAL_Tj_cofFltCoolant_f32" VALUE 0x80140198 Scalar_FLOAT32_IEEE 0 BSW_A2L_Ident_Float -3.4E+38 3.4E+38 /end CHARACTERISTIC
/begin CHARACTERISTIC CAL_MCF_UsdScalSet_f32 "CAL_MCF_UsdScalSet_f32" VALUE 0x8014100C Scalar_FLOAT32_IEEE 0 BSW_A2L_Ident_Float -3.4E+38 3.4E+38 /end CHARACTERISTIC
/begin CHARACTERISTIC CAL_Cspf_iDcLnkEstFlt_f32 "CAL_Cspf_iDcLnkEstFlt_f32" VALUE 0x80140224 Scalar_FLOAT32_IEEE 0 BSW_A2L_Ident_Float -3.4E+38 3.4E+38 /end CHARACTERISTIC
/begin CHARACTERISTIC CAL_MCF_isqSet_f32 "CAL_MCF_isqSet_f32" VALUE 0x80140FB8 Scalar_FLOAT32_IEEE 0 BSW_A2L_Ident_Float -3.4E+38 3.4E+38 /end CHARACTERISTIC
/begin CHARACTERISTIC CAL_Cspf_flgtDBCTempVFltSwt_b "CAL_Cspf_flgtDBCTempVFltSwt_b" VALUE 0x80140231 Scalar_BOOLEAN 0 BSW_A2L_Ident_Int 0 1 /end CHARACTERISTIC
/begin CHARACTERISTIC CAL_Cspf_flgTraTrqMinSwt_b "CAL_Cspf_flgTraTrqMinSwt_b" VALUE 0x8014025B Scalar_BOOLEAN 0 BSW_A2L_Ident_Int 0 1 /end CHARACTERISTIC
/begin CHARACTERISTIC CAL_Hspf_VerMatchFailure_u8 "CAL_Hspf_VerMatchFailure_u8" VALUE 0x80140347 Scalar_UBYTE 0 BSW_A2L_Ident_Int 0 255 /end CHARACTERISTIC
/begin CHARACTERISTIC CAL_Cspf_flgFailCode8Swt_b "CAL_Cspf_flgFailCode8Swt_b" VALUE 0x80140268 Scalar_BOOLEAN 0 BSW_A2L_Ident_Int 0 1 /end CHARACTERISTIC
/begin CHARACTERISTIC CAL_MCF_FlgUseEOL_b "CAL_MCF_FlgUseEOL_b" VALUE 0x801412CF Scalar_BOOLEAN 0 BSW_A2L_Ident_Int 0 1 /end CHARACTERISTIC
/begin CHARACTERISTIC CAL_Cspf_stMode_u8 "CAL_Cspf_stMode_u8" VALUE 0x80140212 Scalar_UBYTE 0 BSW_A2L_Ident_Int 0 255 /end CHARACTERISTIC
/begin CHARACTERISTIC CAL_ADM_GlbDchgThrshTime_f32 "CAL_ADM_GlbDchgThrshTime_f32" VALUE 0x801400F0 Scalar_FLOAT32_IEEE 0 BSW_A2L_Ident_Float -3.4E+38 3.4E+38 /end CHARACTERISTIC
/begin CHARACTERISTIC CAL_Hspf_INVOpenChkAddCnt_u8 "CAL_Hspf_INVOpenChkAddCnt_u8" VALUE 0x80140C3B Scalar_UBYTE 0 BSW_A2L_Ident_Int 0 255 /end CHARACTERISTIC
/begin CHARACTERISTIC CAL_Cspf_flgOfsClbSuc_u8 "CAL_Cspf_flgOfsClbSuc_u8" VALUE 0x8014025D Scalar_UBYTE 0 BSW_A2L_Ident_Int 0 255 /end CHARACTERISTIC
/begin CHARACTERISTIC CAL_tiPwmLim_f32 "CAL_tiPwmLim_f32" VALUE 0x80140104 Scalar_FLOAT32_IEEE 0 BSW_A2L_Ident_Float -3.4E+38 3.4E+38 /end CHARACTERISTIC
/begin CHARACTERISTIC CAL_Cspf_FailCode7_u8 "CAL_Cspf_FailCode7_u8" VALUE 0x801402E8 Scalar_UBYTE 0 BSW_A2L_Ident_Int 0 255 /end CHARACTERISTIC
/begin CHARACTERISTIC CAL_FRP_RslvSqrtErrOutCtl_b "CAL_FRP_RslvSqrtErrOutCtl_b" VALUE 0x801402FD Scalar_BOOLEAN 0 BSW_A2L_Ident_Int 0 1 /end CHARACTERISTIC
/begin CHARACTERISTIC CAL_Hspf_nFltFrq_f32 "CAL_Hspf_nFltFrq_f32" VALUE 0x80140330 Scalar_FLOAT32_IEEE 0 BSW_A2L_Ident_Float -3.4E+38 3.4E+38 /end CHARACTERISTIC
/begin CHARACTERISTIC CAL_Hspf_tDBCTempROCLim_u8 "CAL_Hspf_tDBCTempROCLim_u8" VALUE 0x80140325 Scalar_UBYTE 0 BSW_A2L_Ident_Int 0 255 /end CHARACTERISTIC
/begin CHARACTERISTIC CAL_BCC_tiFull_f32 "CAL_BCC_tiFull_f32" VALUE 0x801401D0 Scalar_FLOAT32_IEEE 0 BSW_A2L_Ident_Float -3.4E+38 3.4E+38 /end CHARACTERISTIC
/begin CHARACTERISTIC CAL_Cspf_flgiQActSlowFltSwt_b "CAL_Cspf_flgiQActSlowFltSwt_b" VALUE 0x8014023E Scalar_BOOLEAN 0 BSW_A2L_Ident_Int 0 1 /end CHARACTERISTIC
/begin CHARACTERISTIC CAL_Cspf_stModeReq_u8 "CAL_Cspf_stModeReq_u8" VALUE 0x80140213 Scalar_UBYTE 0 BSW_A2L_Ident_Int 0 255 /end CHARACTERISTIC
/begin CHARACTERISTIC CAL_FRP_VoltCmpChkErrOutCtl_b "CAL_FRP_VoltCmpChkErrOutCtl_b" VALUE 0x801402F7 Scalar_BOOLEAN 0 BSW_A2L_Ident_Int 0 1 /end CHARACTERISTIC
/begin CHARACTERISTIC CAL_Hspf_bt15ChkAddCnt_u8 "CAL_Hspf_bt15ChkAddCnt_u8" VALUE 0x80140343 Scalar_UBYTE 0 BSW_A2L_Ident_Int 0 255 /end CHARACTERISTIC
/begin CHARACTERISTIC CAL_FRP_ModeReqRngErrOutCtl_b "CAL_FRP_ModeReqRngErrOutCtl_b" VALUE 0x80140303 Scalar_BOOLEAN 0 BSW_A2L_Ident_Int 0 1 /end CHARACTERISTIC
/begin CHARACTERISTIC CAL_ADM_VoltCmpChkErrDebThr_s16 "CAL_ADM_VoltCmpChkErrDebThr_s16" VALUE 0x801400CC Scalar_SWORD 0 BSW_A2L_Ident_Int -32768 32767 /end CHARACTERISTIC
/begin CHARACTERISTIC CAL_Cspf_bDernExcMax_u8 "CAL_Cspf_bDernExcMax_u8" VALUE 0x8014027C Scalar_UBYTE 0 BSW_A2L_Ident_Int 0 255 /end CHARACTERISTIC
/begin CHARACTERISTIC CAL_FRP_18VHSVoltRngErrOutCtl_b "CAL_FRP_18VHSVoltRngErrOutCtl_b" VALUE 0x8014030A Scalar_BOOLEAN 0 BSW_A2L_Ident_Int 0 1 /end CHARACTERISTIC
/begin CHARACTERISTIC CAL_TjrthLv4ihdh_f32 "CAL_TjrthLv4ihdh_f32" VALUE 0x80140128 Scalar_FLOAT32_IEEE 0 BSW_A2L_Ident_Float -3.4E+38 3.4E+38 /end CHARACTERISTIC
/begin CHARACTERISTIC CAL_FRP_iPhasSensVolRngErrOutCtl_b "CAL_FRP_iPhasSensVolRngErrOutCtl_b" VALUE 0x801402F6 Scalar_BOOLEAN 0 BSW_A2L_Ident_Int 0 1 /end CHARACTERISTIC
/begin CHARACTERISTIC CAL_Cspf_tDBCTempWFlt_f32 "CAL_Cspf_tDBCTempWFlt_f32" VALUE 0x80140200 Scalar_FLOAT32_IEEE 0 BSW_A2L_Ident_Float -3.4E+38 3.4E+38 /end CHARACTERISTIC
/begin CHARACTERISTIC CAL_MCF_DycWSet_f32 "CAL_MCF_DycWSet_f32" VALUE 0x801412D8 Scalar_FLOAT32_IEEE 0 BSW_A2L_Ident_Float -3.4E+38 3.4E+38 /end CHARACTERISTIC
/begin CHARACTERISTIC CAL_Cspf_flgTraTrqMaxSwt_b "CAL_Cspf_flgTraTrqMaxSwt_b" VALUE 0x8014025C Scalar_BOOLEAN 0 BSW_A2L_Ident_Int 0 1 /end CHARACTERISTIC
/begin CHARACTERISTIC CAL_Cspf_flgTrqSetPSwt_b "CAL_Cspf_flgTrqSetPSwt_b" VALUE 0x80140252 Scalar_BOOLEAN 0 BSW_A2L_Ident_Int 0 1 /end CHARACTERISTIC
/begin CHARACTERISTIC CAL_Cspf_bDernMtrSpd_u8 "CAL_Cspf_bDernMtrSpd_u8" VALUE 0x8014027A Scalar_UBYTE 0 BSW_A2L_Ident_Int 0 255 /end CHARACTERISTIC
/begin CHARACTERISTIC CAL_Cspf_flgbDernExcMinSwt_b "CAL_Cspf_flgbDernExcMinSwt_b" VALUE 0x80140248 Scalar_BOOLEAN 0 BSW_A2L_Ident_Int 0 1 /end CHARACTERISTIC
/begin CHARACTERISTIC CAL_MCF_SpdOffDeadCpn_f32 "CAL_MCF_SpdOffDeadCpn_f32" VALUE 0x801410A8 Scalar_FLOAT32_IEEE 0 BSW_A2L_Ident_Float -3.4E+38 3.4E+38 /end CHARACTERISTIC
/begin CHARACTERISTIC CAL_Hspf_INVOpenChkCntHiLim_u8 "CAL_Hspf_INVOpenChkCntHiLim_u8" VALUE 0x80140C3A Scalar_UBYTE 0 BSW_A2L_Ident_Int 0 255 /end CHARACTERISTIC
/begin CHARACTERISTIC CAL_Hspf_tCoolantFltFrq_f32 "CAL_Hspf_tCoolantFltFrq_f32" VALUE 0x80140328 Scalar_FLOAT32_IEEE 0 BSW_A2L_Ident_Float -3.4E+38 3.4E+38 /end CHARACTERISTIC
/begin CHARACTERISTIC CAL_BCC_flgDelayDyc_b "CAL_BCC_flgDelayDyc_b" VALUE 0x801401E2 Scalar_BOOLEAN 0 BSW_A2L_Ident_Int 0 1 /end CHARACTERISTIC
/begin CHARACTERISTIC CAL_Cspf_TrqCurrWoDmpC_f32 "CAL_Cspf_TrqCurrWoDmpC_f32" VALUE 0x801402B8 Scalar_FLOAT32_IEEE 0 BSW_A2L_Ident_Float -3.4E+38 3.4E+38 /end CHARACTERISTIC
/begin CHARACTERISTIC CAL_Cspf_bDernCAN_u8 "CAL_Cspf_bDernCAN_u8" VALUE 0x80140282 Scalar_UBYTE 0 BSW_A2L_Ident_Int 0 255 /end CHARACTERISTIC
/begin CHARACTERISTIC CAL_MCF_DisChaisdDes_f32 "CAL_MCF_DisChaisdDes_f32" VALUE 0x801412F4 Scalar_FLOAT32_IEEE 0 BSW_A2L_Ident_Float -3.4E+38 3.4E+38 /end CHARACTERISTIC
/begin CHARACTERISTIC CAL_MCF_CoefFltZero_B_f32 "CAL_MCF_CoefFltZero_B_f32" VALUE 0x80141448 Scalar_FLOAT32_IEEE 0 BSW_A2L_Ident_Float -3.4E+38 3.4E+38 /end CHARACTERISTIC
/begin CHARACTERISTIC CAL_Cspf_HvMcuVer_u8 "CAL_Cspf_HvMcuVer_u8" VALUE 0x801402E6 Scalar_UBYTE 0 BSW_A2L_Ident_Int 0 255 /end CHARACTERISTIC
/begin CHARACTERISTIC CAL_Cspf_stTrqEmMin_u8 "CAL_Cspf_stTrqEmMin_u8" VALUE 0x80140210 Scalar_UBYTE 0 BSW_A2L_Ident_Int 0 255 /end CHARACTERISTIC
/begin CHARACTERISTIC CAL_Cspf_stTrqEmMax_u8 "CAL_Cspf_stTrqEmMax_u8" VALUE 0x80140211 Scalar_UBYTE 0 BSW_A2L_Ident_Int 0 255 /end CHARACTERISTIC
/begin CHARACTERISTIC CAL_Cspf_TrqSLope_f32 "CAL_Cspf_TrqSLope_f32" VALUE 0x80140298 Scalar_FLOAT32_IEEE 0 BSW_A2L_Ident_Float -3.4E+38 3.4E+38 /end CHARACTERISTIC
/begin CHARACTERISTIC CAL_MCF_UsqScalSet_f32 "CAL_MCF_UsqScalSet_f32" VALUE 0x80141008 Scalar_FLOAT32_IEEE 0 BSW_A2L_Ident_Float -3.4E+38 3.4E+38 /end CHARACTERISTIC
/begin CHARACTERISTIC CAL_Cspf_kDmp_f32 "CAL_Cspf_kDmp_f32" VALUE 0x8014021C Scalar_FLOAT32_IEEE 0 BSW_A2L_Ident_Float -3.4E+38 3.4E+38 /end CHARACTERISTIC
/begin CHARACTERISTIC CAL_Cspf_iQActSlowFlt_f32 "CAL_Cspf_iQActSlowFlt_f32" VALUE 0x80140220 Scalar_FLOAT32_IEEE 0 BSW_A2L_Ident_Float -3.4E+38 3.4E+38 /end CHARACTERISTIC
/begin CHARACTERISTIC CAL_Cspf_flgbDernUndrUdcSwt_b "CAL_Cspf_flgbDernUndrUdcSwt_b" VALUE 0x80140243 Scalar_BOOLEAN 0 BSW_A2L_Ident_Int 0 1 /end CHARACTERISTIC
/begin CHARACTERISTIC CAL_TjrthLv4ildh_f32 "CAL_TjrthLv4ildh_f32" VALUE 0x8014011C Scalar_FLOAT32_IEEE 0 BSW_A2L_Ident_Float -3.4E+38 3.4E+38 /end CHARACTERISTIC
/begin CHARACTERISTIC CAL_Cspf_stDmpCtLReq_u8 "CAL_Cspf_stDmpCtLReq_u8" VALUE 0x80140215 Scalar_UBYTE 0 BSW_A2L_Ident_Int 0 255 /end CHARACTERISTIC
/begin CHARACTERISTIC CAL_Hspf_tStrrTmp2FltFrq_f32 "CAL_Hspf_tStrrTmp2FltFrq_f32" VALUE 0x8014031C Scalar_FLOAT32_IEEE 0 BSW_A2L_Ident_Float -3.4E+38 3.4E+38 /end CHARACTERISTIC
/begin CHARACTERISTIC CAL_MCF_cofFltN_f32 "CAL_MCF_cofFltN_f32" VALUE 0x80141000 Scalar_FLOAT32_IEEE 0 BSW_A2L_Ident_Float -3.4E+38 3.4E+38 /end CHARACTERISTIC
/begin CHARACTERISTIC CAL_MCF_SpdOnDeadCpn_f32 "CAL_MCF_SpdOnDeadCpn_f32" VALUE 0x801410A4 Scalar_FLOAT32_IEEE 0 BSW_A2L_Ident_Float -3.4E+38 3.4E+38 /end CHARACTERISTIC
/begin CHARACTERISTIC CAL_Hspf_VerChkTime_u16 "CAL_Hspf_VerChkTime_u16" VALUE 0x80140348 Scalar_UWORD 0 BSW_A2L_Ident_Int 0 65535 /end CHARACTERISTIC
/begin CHARACTERISTIC CAL_Hspf_bt15ChkSubCnt_s8 "CAL_Hspf_bt15ChkSubCnt_s8" VALUE 0x80140340 Scalar_BYTE 0 BSW_A2L_Ident_Int -128 127 /end CHARACTERISTIC
/begin CHARACTERISTIC CAL_Cspf_flgiDActSlowFltSwt_b "CAL_Cspf_flgiDActSlowFltSwt_b" VALUE 0x80140240 Scalar_BOOLEAN 0 BSW_A2L_Ident_Int 0 1 /end CHARACTERISTIC
/begin CHARACTERISTIC CAL_Cspf_flgstGateDrvSwt_b "CAL_Cspf_flgstGateDrvSwt_b" VALUE 0x80140239 Scalar_BOOLEAN 0 BSW_A2L_Ident_Int 0 1 /end CHARACTERISTIC
/begin CHARACTERISTIC CAL_Cspf_flgstModeSwt_b "CAL_Cspf_flgstModeSwt_b" VALUE 0x80140236 Scalar_BOOLEAN 0 BSW_A2L_Ident_Int 0 1 /end CHARACTERISTIC
/begin CHARACTERISTIC CAL_FRP_UBRVoltRngErrOutCtl_b "CAL_FRP_UBRVoltRngErrOutCtl_b" VALUE 0x801402FA Scalar_BOOLEAN 0 BSW_A2L_Ident_Int 0 1 /end CHARACTERISTIC
/begin CHARACTERISTIC CAL_Cspf_flgKpLowNCtlSwt_b "CAL_Cspf_flgKpLowNCtlSwt_b" VALUE 0x80140261 Scalar_BOOLEAN 0 BSW_A2L_Ident_Int 0 1 /end CHARACTERISTIC
/begin CHARACTERISTIC CAL_Cspf_flgtStrrTemp2FltSwt_b "CAL_Cspf_flgtStrrTemp2FltSwt_b" VALUE 0x8014022E Scalar_BOOLEAN 0 BSW_A2L_Ident_Int 0 1 /end CHARACTERISTIC
/begin CHARACTERISTIC CAL_Cspf_CpldVer_u8 "CAL_Cspf_CpldVer_u8" VALUE 0x801402F2 Scalar_UBYTE 0 BSW_A2L_Ident_Int 0 255 /end CHARACTERISTIC
/begin CHARACTERISTIC CAL_MCF_iUCnvFac_f32 "CAL_MCF_iUCnvFac_f32" VALUE 0x80140FDC Scalar_FLOAT32_IEEE 0 BSW_A2L_Ident_Float -3.4E+38 3.4E+38 /end CHARACTERISTIC
/begin CHARACTERISTIC CAL_ADM_BMSVoltRngErrCntThr_s16 "CAL_ADM_BMSVoltRngErrCntThr_s16" VALUE 0x801400FA Scalar_SWORD 0 BSW_A2L_Ident_Int -32768 32767 /end CHARACTERISTIC
/begin CHARACTERISTIC CAL_Hspf_CrashChkAddCnt_u8 "CAL_Hspf_CrashChkAddCnt_u8" VALUE 0x80140CC0 Scalar_UBYTE 0 BSW_A2L_Ident_Int 0 255 /end CHARACTERISTIC
/begin CHARACTERISTIC CAL_ADM_GlbDchgThrshVolt_f32 "CAL_ADM_GlbDchgThrshVolt_f32" VALUE 0x801400EC Scalar_FLOAT32_IEEE 0 BSW_A2L_Ident_Float -3.4E+38 3.4E+38 /end CHARACTERISTIC
/begin CHARACTERISTIC CAL_MCF_bUseduDclnkSet_b "CAL_MCF_bUseduDclnkSet_b" VALUE 0x80141004 Scalar_BOOLEAN 0 BSW_A2L_Ident_Int 0 1 /end CHARACTERISTIC
/begin CHARACTERISTIC CAL_MCF_AgDiffCurrSec_f32 "CAL_MCF_AgDiffCurrSec_f32" VALUE 0x80141490 Scalar_FLOAT32_IEEE 0 BSW_A2L_Ident_Float -3.4E+38 3.4E+38 /end CHARACTERISTIC
/begin CHARACTERISTIC CAL_Cspf_flgTrqMaxSwt_b "CAL_Cspf_flgTrqMaxSwt_b" VALUE 0x80140256 Scalar_BOOLEAN 0 BSW_A2L_Ident_Int 0 1 /end CHARACTERISTIC
/begin CHARACTERISTIC CAL_Cspf_flgTrqMinSwt_b "CAL_Cspf_flgTrqMinSwt_b" VALUE 0x80140253 Scalar_BOOLEAN 0 BSW_A2L_Ident_Int 0 1 /end CHARACTERISTIC
/begin CHARACTERISTIC CAL_TjrthLv4dhntc_f32 "CAL_TjrthLv4dhntc_f32" VALUE 0x80140140 Scalar_FLOAT32_IEEE 0 BSW_A2L_Ident_Float -3.4E+38 3.4E+38 /end CHARACTERISTIC
/begin CHARACTERISTIC CAL_Cspf_flguKl30FltSwt_b "CAL_Cspf_flguKl30FltSwt_b" VALUE 0x8014022C Scalar_BOOLEAN 0 BSW_A2L_Ident_Int 0 1 /end CHARACTERISTIC
/begin CHARACTERISTIC CAL_TjDycMax_f32 "CAL_TjDycMax_f32" VALUE 0x801401B0 Scalar_FLOAT32_IEEE 0 BSW_A2L_Ident_Float -3.4E+38 3.4E+38 /end CHARACTERISTIC
/begin CHARACTERISTIC CAL_Cspf_flgtStrrTemp1FltSwt_b "CAL_Cspf_flgtStrrTemp1FltSwt_b" VALUE 0x8014022F Scalar_BOOLEAN 0 BSW_A2L_Ident_Int 0 1 /end CHARACTERISTIC
/begin CHARACTERISTIC CAL_MCF_IsSet11ZR_f32 "CAL_MCF_IsSet11ZR_f32" VALUE 0x8014115C Scalar_FLOAT32_IEEE 0 BSW_A2L_Ident_Float -3.4E+38 3.4E+38 /end CHARACTERISTIC
/begin CHARACTERISTIC CAL_Cspf_TrqMechFlt_f32 "CAL_Cspf_TrqMechFlt_f32" VALUE 0x801402A4 Scalar_FLOAT32_IEEE 0 BSW_A2L_Ident_Float -3.4E+38 3.4E+38 /end CHARACTERISTIC
/begin CHARACTERISTIC CAL_Cspf_flgTrqDmpMinSwt_b "CAL_Cspf_flgTrqDmpMinSwt_b" VALUE 0x80140258 Scalar_BOOLEAN 0 BSW_A2L_Ident_Int 0 1 /end CHARACTERISTIC
/begin CHARACTERISTIC CAL_Cspf_KpLowNCtl_f32 "CAL_Cspf_KpLowNCtl_f32" VALUE 0x801402D0 Scalar_FLOAT32_IEEE 0 BSW_A2L_Ident_Float -3.4E+38 3.4E+38 /end CHARACTERISTIC
/begin CHARACTERISTIC CAL_Cspf_flgstModeReqSwt_b "CAL_Cspf_flgstModeReqSwt_b" VALUE 0x80140237 Scalar_BOOLEAN 0 BSW_A2L_Ident_Int 0 1 /end CHARACTERISTIC
/begin CHARACTERISTIC CAL_MCF_IsrmsDesEOL_f32 "CAL_MCF_IsrmsDesEOL_f32" VALUE 0x80141154 Scalar_FLOAT32_IEEE 0 BSW_A2L_Ident_Float -3.4E+38 3.4E+38 /end CHARACTERISTIC
/begin CHARACTERISTIC CAL_ADM_BMSVoltRngErrRst_b "CAL_ADM_BMSVoltRngErrRst_b" VALUE 0x801400F6 Scalar_BOOLEAN 0 BSW_A2L_Ident_Int 0 1 /end CHARACTERISTIC
/begin CHARACTERISTIC CAL_ADM_BMSUpperThr_f32 "CAL_ADM_BMSUpperThr_f32" VALUE 0x801400FC Scalar_FLOAT32_IEEE 0 BSW_A2L_Ident_Float -3.4E+38 3.4E+38 /end CHARACTERISTIC
/begin CHARACTERISTIC CAL_Cspf_flgIdcMaxSwt_b "CAL_Cspf_flgIdcMaxSwt_b" VALUE 0x80140265 Scalar_BOOLEAN 0 BSW_A2L_Ident_Int 0 1 /end CHARACTERISTIC
/begin CHARACTERISTIC CAL_Hspf_cntIPhCalOffValCnt_u16 "CAL_Hspf_cntIPhCalOffValCnt_u16" VALUE 0x8014033C Scalar_UWORD 0 BSW_A2L_Ident_Int 0 65535 /end CHARACTERISTIC
/begin CHARACTERISTIC CAL_Cspf_TrqMinNCtl_f32 "CAL_Cspf_TrqMinNCtl_f32" VALUE 0x801402A0 Scalar_FLOAT32_IEEE 0 BSW_A2L_Ident_Float -3.4E+38 3.4E+38 /end CHARACTERISTIC
/begin CHARACTERISTIC CAL_Cspf_flgagRtrEeSwt_b "CAL_Cspf_flgagRtrEeSwt_b" VALUE 0x8014024E Scalar_BOOLEAN 0 BSW_A2L_Ident_Int 0 1 /end CHARACTERISTIC
/begin CHARACTERISTIC CAL_ADM_VoltAbsDiffThrPerc_f32 "CAL_ADM_VoltAbsDiffThrPerc_f32" VALUE 0x801400D8 Scalar_FLOAT32_IEEE 0 BSW_A2L_Ident_Float -3.4E+38 3.4E+38 /end CHARACTERISTIC
/begin CHARACTERISTIC CAL_MCF_uqOverGain_f32 "CAL_MCF_uqOverGain_f32" VALUE 0x80140F20 Scalar_FLOAT32_IEEE 0 BSW_A2L_Ident_Float -3.4E+38 3.4E+38 /end CHARACTERISTIC
/begin CHARACTERISTIC CAL_ADM_VoltCmpChkErrRst_b "CAL_ADM_VoltCmpChkErrRst_b" VALUE 0x801400CB Scalar_BOOLEAN 0 BSW_A2L_Ident_Int 0 1 /end CHARACTERISTIC
/begin CHARACTERISTIC CAL_MCF_flgUseUsOver_b "CAL_MCF_flgUseUsOver_b" VALUE 0x80140FE5 Scalar_BOOLEAN 0 BSW_A2L_Ident_Int 0 1 /end CHARACTERISTIC
/begin CHARACTERISTIC CAL_MCF_udki_f32 "CAL_MCF_udki_f32" VALUE 0x80140F2C Scalar_FLOAT32_IEEE 0 BSW_A2L_Ident_Float -3.4E+38 3.4E+38 /end CHARACTERISTIC
/begin CHARACTERISTIC CAL_ADM_L2Com_BMSVolt_b "CAL_ADM_L2Com_BMSVolt_b" VALUE 0x801400E4 Scalar_BOOLEAN 0 BSW_A2L_Ident_Int 0 1 /end CHARACTERISTIC
/begin CHARACTERISTIC CAL_CoolantFlowReq_u8 "CAL_CoolantFlowReq_u8" VALUE 0x801401CC Scalar_UBYTE 0 BSW_A2L_Ident_Int 0 255 /end CHARACTERISTIC
/begin CHARACTERISTIC CAL_MCF_CoefFltZero_A_f32 "CAL_MCF_CoefFltZero_A_f32" VALUE 0x8014144C Scalar_FLOAT32_IEEE 0 BSW_A2L_Ident_Float -3.4E+38 3.4E+38 /end CHARACTERISTIC
/begin CHARACTERISTIC CAL_Hspf_tDBCCmpTime_u16 "CAL_Hspf_tDBCCmpTime_u16" VALUE 0x80140326 Scalar_UWORD 0 BSW_A2L_Ident_Int 0 65535 /end CHARACTERISTIC
/begin CHARACTERISTIC CAL_Cspf_flgagOffsetSwt_b "CAL_Cspf_flgagOffsetSwt_b" VALUE 0x8014024F Scalar_BOOLEAN 0 BSW_A2L_Ident_Int 0 1 /end CHARACTERISTIC
/begin CHARACTERISTIC CAL_ADM_GlbDchgErrRst_b "CAL_ADM_GlbDchgErrRst_b" VALUE 0x801400F4 Scalar_BOOLEAN 0 BSW_A2L_Ident_Int 0 1 /end CHARACTERISTIC
/begin CHARACTERISTIC CAL_Hspf_CrashChkCntLoLim_s8 "CAL_Hspf_CrashChkCntLoLim_s8" VALUE 0x80140CBE Scalar_BYTE 0 BSW_A2L_Ident_Int -128 127 /end CHARACTERISTIC
/begin CHARACTERISTIC CAL_Cspf_flgbDernMtrSpdSwt_b "CAL_Cspf_flgbDernMtrSpdSwt_b" VALUE 0x80140247 Scalar_BOOLEAN 0 BSW_A2L_Ident_Int 0 1 /end CHARACTERISTIC
/begin CHARACTERISTIC CAL_TjrthLv4ihdl_f32 "CAL_TjrthLv4ihdl_f32" VALUE 0x80140124 Scalar_FLOAT32_IEEE 0 BSW_A2L_Ident_Float -3.4E+38 3.4E+38 /end CHARACTERISTIC
/begin CHARACTERISTIC CAL_Cspf_flgNDiffMaxSwt_b "CAL_Cspf_flgNDiffMaxSwt_b" VALUE 0x80140260 Scalar_BOOLEAN 0 BSW_A2L_Ident_Int 0 1 /end CHARACTERISTIC
/begin CHARACTERISTIC CAL_MCF_ratUp_f32 "CAL_MCF_ratUp_f32" VALUE 0x80140FA0 Scalar_FLOAT32_IEEE 0 BSW_A2L_Ident_Float -3.4E+38 3.4E+38 /end CHARACTERISTIC
/begin CHARACTERISTIC CAL_MCF_AplhaRefZeroCtl_f32 "CAL_MCF_AplhaRefZeroCtl_f32" VALUE 0x80141454 Scalar_FLOAT32_IEEE 0 BSW_A2L_Ident_Float -3.4E+38 3.4E+38 /end CHARACTERISTIC
/begin CHARACTERISTIC CAL_MCF_FlgUpdateDyc_b "CAL_MCF_FlgUpdateDyc_b" VALUE 0x801412D2 Scalar_BOOLEAN 0 BSW_A2L_Ident_Int 0 1 /end CHARACTERISTIC
/begin CHARACTERISTIC CAL_TjDycMin_f32 "CAL_TjDycMin_f32" VALUE 0x801401AC Scalar_FLOAT32_IEEE 0 BSW_A2L_Ident_Float -3.4E+38 3.4E+38 /end CHARACTERISTIC
/begin CHARACTERISTIC CAL_ADM_L2Com_BMSVolt "" VALUE 0x801400E8 Scalar_FLOAT32_IEEE 0 SWC_ADM_CM_single 0.0 1000.0 /end CHARACTERISTIC
/begin CHARACTERISTIC CAL_ADM_L2Com_HiPrecVolt "" VALUE 0x801400E0 Scalar_FLOAT32_IEEE 0 SWC_ADM_CM_single 0.0 1000.0 /end CHARACTERISTIC
/begin CHARACTERISTIC CAL_TjrthLv4IhIhTab_af32 "" CURVE 0x80140168 Lookup1D_FLOAT32_IEEE 0 SWC_BCC_CM_single -3.4E+38 3.4E+38
 /begin AXIS_DESCR COM_AXIS NO_INPUT_QUANTITY SWC_BCC_CM_single 6 -3.4E+38 3.4E+38 AXIS_PTS_REF CAL_TjCoolantFlowTab_af32 /end AXIS_DESCR
/end CHARACTERISTIC
/begin CHARACTERISTIC CAL_TjrthLv4IhNtcTab_af32 "" CURVE 0x80140150 Lookup1D_FLOAT32_IEEE 0 SWC_BCC_CM_single -3.4E+38 3.4E+38
 /begin AXIS_DESCR COM_AXIS NO_INPUT_QUANTITY SWC_BCC_CM_single 6 -3.4E+38 3.4E+38 AXIS_PTS_REF CAL_TjCoolantFlowTab_af32 /end AXIS_DESCR
/end CHARACTERISTIC
/begin CHARACTERISTIC CAL_TjrthLv4DhIhTab_af32 "" CURVE 0x80140180 Lookup1D_FLOAT32_IEEE 0 SWC_BCC_CM_single -3.4E+38 3.4E+38
 /begin AXIS_DESCR COM_AXIS NO_INPUT_QUANTITY SWC_BCC_CM_single 6 -3.4E+38 3.4E+38 AXIS_PTS_REF CAL_TjCoolantFlowTab_af32 /end AXIS_DESCR
/end CHARACTERISTIC
/begin CHARACTERISTIC CAL_Hspf_CodeDataMatchTable_af32 "Èí¼þºÍÊý¾ÝÆ¥Åä±í" MAP 0x80140D98 Lookup2D_FLOAT32_IEEE 0 SWC_HSPF_CM_single -3.4E+38 3.4E+38
 /begin AXIS_DESCR COM_AXIS NO_INPUT_QUANTITY SWC_HSPF_CM_single 7 -3.4E+38 3.4E+38 AXIS_PTS_REF CAL_Hspf_CodeTable_af32 /end AXIS_DESCR
 /begin AXIS_DESCR COM_AXIS NO_INPUT_QUANTITY SWC_HSPF_CM_single 6 -3.4E+38 3.4E+38 AXIS_PTS_REF CAL_Hspf_DataTable_af32 /end AXIS_DESCR
/end CHARACTERISTIC
/begin CHARACTERISTIC CAL_Hspf_ProjectNumMatchTable_af32 "ÏîÄ¿Æ¥Åä±í" MAP 0x80140380 Lookup2D_FLOAT32_IEEE 0 SWC_HSPF_CM_single -3.4E+38 3.4E+38
 /begin AXIS_DESCR COM_AXIS NO_INPUT_QUANTITY SWC_HSPF_CM_single 7 -3.4E+38 3.4E+38 AXIS_PTS_REF CAL_Hspf_ProjectNuminSWTable_af32 /end AXIS_DESCR
 /begin AXIS_DESCR COM_AXIS NO_INPUT_QUANTITY SWC_HSPF_CM_single 6 -3.4E+38 3.4E+38 AXIS_PTS_REF CAL_Hspf_CPLDProjectNumTable_af32 /end AXIS_DESCR
/end CHARACTERISTIC
/begin CHARACTERISTIC CAL_Hspf_CodeCpldSwMatchTable_af32 "Èí¼þºÍCPLDÈí¼þ°æ±¾ºÅÆ¥Åä±í" MAP 0x80140E40 Lookup2D_FLOAT32_IEEE 0 SWC_HSPF_CM_single -3.4E+38 3.4E+38
 /begin AXIS_DESCR COM_AXIS NO_INPUT_QUANTITY SWC_HSPF_CM_single 7 -3.4E+38 3.4E+38 AXIS_PTS_REF CAL_Hspf_CodeTable_af32 /end AXIS_DESCR
 /begin AXIS_DESCR COM_AXIS NO_INPUT_QUANTITY SWC_HSPF_CM_single 4 -3.4E+38 3.4E+38 AXIS_PTS_REF CAL_Hspf_CpldSwTable_af32 /end AXIS_DESCR
/end CHARACTERISTIC
/begin CHARACTERISTIC CAL_Hspf_CodeHvMcuMatchTable_af32 "Èí¼þºÍ¸ßÑ¹MCU°æ±¾ºÅÆ¥Åä±í" MAP 0x80140CF0 Lookup2D_FLOAT32_IEEE 0 SWC_HSPF_CM_single -3.4E+38 3.4E+38
 /begin AXIS_DESCR COM_AXIS NO_INPUT_QUANTITY SWC_HSPF_CM_single 7 -3.4E+38 3.4E+38 AXIS_PTS_REF CAL_Hspf_CodeTable_af32 /end AXIS_DESCR
 /begin AXIS_DESCR COM_AXIS NO_INPUT_QUANTITY SWC_HSPF_CM_single 6 -3.4E+38 3.4E+38 AXIS_PTS_REF CAL_Hspf_HvMcuTable_af32 /end AXIS_DESCR
/end CHARACTERISTIC
/begin CHARACTERISTIC CAL_Hspf_HwAnalHwVerMatchTable_af32 "Ó²¼þÆ¥Åä±í" MAP 0x80140C5C Lookup2D_FLOAT32_IEEE 0 SWC_HSPF_CM_single -3.4E+38 3.4E+38
 /begin AXIS_DESCR COM_AXIS VAR_Bsw_Hwver_f32 SWC_HSPF_CM_single 6 -3.4E+38 3.4E+38 AXIS_PTS_REF CAL_Hspf_HwVerTable_af32 /end AXIS_DESCR
 /begin AXIS_DESCR COM_AXIS NO_INPUT_QUANTITY SWC_HSPF_CM_single 2 -3.4E+38 3.4E+38 AXIS_PTS_REF CAL_Hspf_HwAnalTable_af32 /end AXIS_DESCR
/end CHARACTERISTIC
/begin CHARACTERISTIC CAL_Hspf_MotTemLowTable_af32 "" VAL_BLK 0x8014042D Scalar_BYTE 0 SWC_HSPF_CM_int8 -128 127 NUMBER 1024 /end CHARACTERISTIC
/begin CHARACTERISTIC CAL_Hspf_MotTemHigTable_af32 "" VAL_BLK 0x8014082D Scalar_UBYTE 0 SWC_HSPF_CM_uint8 0 255 NUMBER 1024 /end CHARACTERISTIC
/begin CHARACTERISTIC CAL_MCF_DeadTimeTableY_Ti_af32 "ËÀÇøÊ±¼ä²é±íÊä³öËÀÇøÊ±¼ä" CURVE 0x801412FC Lookup1D_FLOAT32_IEEE 0 SWC_MCF_CM_single -3.4E+38 3.4E+38
 /begin AXIS_DESCR COM_AXIS NO_INPUT_QUANTITY SWC_MCF_CM_single 15 -3.4E+38 3.4E+38 AXIS_PTS_REF CAL_MCF_DeadTimeTableX_Frq_af32 /end AXIS_DESCR
/end CHARACTERISTIC
/begin CHARACTERISTIC CAL_MCF_UsUseRateDesTableY_UsRes_af32 "" CURVE 0x80141010 Lookup1D_FLOAT32_IEEE 0 SWC_MCF_CM_single -3.4E+38 3.4E+38
 /begin AXIS_DESCR COM_AXIS NO_INPUT_QUANTITY SWC_MCF_CM_single 11 -3.4E+38 3.4E+38 AXIS_PTS_REF CAL_MCF_UsUseRateDesTableX_Spd_af32 /end AXIS_DESCR
/end CHARACTERISTIC
/begin CHARACTERISTIC CAL_MCF_AgRangeDeadCpnY_Ag_af32 "" CURVE 0x80141458 Lookup1D_FLOAT32_IEEE 0 SWC_MCF_CM_single -65535.0 65535.0
 /begin AXIS_DESCR COM_AXIS NO_INPUT_QUANTITY SWC_MCF_CM_single 7 -65535.0 65535.0 AXIS_PTS_REF CAL_MCF_AgRangeDeadCpnX_Trq_af32 /end AXIS_DESCR
/end CHARACTERISTIC
/begin CHARACTERISTIC CAL_MCF_HarmIn11ZRY_Is_af32 "" CURVE 0x8014120C Lookup1D_FLOAT32_IEEE 0 SWC_MCF_CM_single -3.4E+38 3.4E+38
 /begin AXIS_DESCR COM_AXIS NO_INPUT_QUANTITY SWC_MCF_CM_single 23 -3.4E+38 3.4E+38 AXIS_PTS_REF CAL_MCF_HarmIn1113ZRX_Spd_af32 /end AXIS_DESCR
/end CHARACTERISTIC
/begin CHARACTERISTIC CAL_MCF_HarmIn11ZRY_Thetam_af32 "" CURVE 0x801411B0 Lookup1D_FLOAT32_IEEE 0 SWC_MCF_CM_single -3.4E+38 3.4E+38
 /begin AXIS_DESCR COM_AXIS NO_INPUT_QUANTITY SWC_MCF_CM_single 23 -3.4E+38 3.4E+38 AXIS_PTS_REF CAL_MCF_HarmIn1113ZRX_Spd_af32 /end AXIS_DESCR
/end CHARACTERISTIC
/begin CHARACTERISTIC CAL_MCF_CoefPIAlphaZeroFtlY_Kp_af32 "" CURVE 0x801413F4 Lookup1D_FLOAT32_IEEE 0 SWC_MCF_CM_single -3.4E+38 3.4E+38
 /begin AXIS_DESCR COM_AXIS NO_INPUT_QUANTITY SWC_MCF_CM_single 10 -3.4E+38 3.4E+38 AXIS_PTS_REF CAL_MCF_CoefPIZoreCtlX_N_af32 /end AXIS_DESCR
/end CHARACTERISTIC
/begin CHARACTERISTIC CAL_MCF_CoefPIAlphaZeroCtlY_Ki_af32 "" CURVE 0x8014141C Lookup1D_FLOAT32_IEEE 0 SWC_MCF_CM_single -3.4E+38 3.4E+38
 /begin AXIS_DESCR COM_AXIS NO_INPUT_QUANTITY SWC_MCF_CM_single 10 -3.4E+38 3.4E+38 AXIS_PTS_REF CAL_MCF_CoefPIZoreCtlX_N_af32 /end AXIS_DESCR
/end CHARACTERISTIC
/begin CHARACTERISTIC CAL_MCF_CoefPIBetaZeroCtlY_Kp_af32 "" CURVE 0x801413A4 Lookup1D_FLOAT32_IEEE 0 SWC_MCF_CM_single -3.4E+38 3.4E+38
 /begin AXIS_DESCR COM_AXIS NO_INPUT_QUANTITY SWC_MCF_CM_single 10 -3.4E+38 3.4E+38 AXIS_PTS_REF CAL_MCF_CoefPIZoreCtlX_N_af32 /end AXIS_DESCR
/end CHARACTERISTIC
/begin CHARACTERISTIC CAL_MCF_CoefPIBetaZeroCtlY_Ki_af32 "" CURVE 0x801413CC Lookup1D_FLOAT32_IEEE 0 SWC_MCF_CM_single -3.4E+38 3.4E+38
 /begin AXIS_DESCR COM_AXIS NO_INPUT_QUANTITY SWC_MCF_CM_single 10 -3.4E+38 3.4E+38 AXIS_PTS_REF CAL_MCF_CoefPIZoreCtlX_N_af32 /end AXIS_DESCR
/end CHARACTERISTIC
/begin CHARACTERISTIC CAL_MCF_uDDesEOLY_af32 "" CURVE 0x80140F48 Lookup1D_FLOAT32_IEEE 0 SWC_MCF_CM_single -3.4E+38 3.4E+38
 /begin AXIS_DESCR COM_AXIS NO_INPUT_QUANTITY SWC_MCF_CM_single 20 -3.4E+38 3.4E+38 AXIS_PTS_REF CAL_MCF_IrmsDesEOLX_af32 /end AXIS_DESCR
/end CHARACTERISTIC
/begin CHARACTERISTIC CAL_MCF_OmbwFirstFltY_Ombw_af32 "" CURVE 0x801410DC Lookup1D_FLOAT32_IEEE 0 SWC_MCF_CM_single -3.4E+38 3.4E+38
 /begin AXIS_DESCR COM_AXIS NO_INPUT_QUANTITY SWC_MCF_CM_single 10 -3.4E+38 3.4E+38 AXIS_PTS_REF CAL_MCF_OmbwFirstFltX_N_af32 /end AXIS_DESCR
/end CHARACTERISTIC
/begin AXIS_PTS CAL_TjCoolantFlowTab_af32 "" 0x801401B4 NO_INPUT_QUANTITY Lookup1D_X_FLOAT32_IEEE 0 SWC_BCC_CM_single 6 -3.4E+38 3.4E+38 /end AXIS_PTS
/begin AXIS_PTS CAL_Hspf_DataTable_af32 "Êý¾Ý°æ±¾ºÅ" 0x80140CA4 NO_INPUT_QUANTITY Lookup2D_X_FLOAT32_IEEE 0 SWC_HSPF_CM_single 6 -3.4E+38 3.4E+38 /end AXIS_PTS
/begin AXIS_PTS CAL_Hspf_CodeTable_af32 "Èí¼þ°æ±¾ºÅ" 0x80140CD4 NO_INPUT_QUANTITY Lookup2D_X_FLOAT32_IEEE 0 SWC_HSPF_CM_single 7 -3.4E+38 3.4E+38 /end AXIS_PTS
/begin AXIS_PTS CAL_Hspf_CPLDProjectNumTable_af32 "CPLDÏîÄ¿ºÅ" 0x80140EB4 NO_INPUT_QUANTITY Lookup2D_X_FLOAT32_IEEE 0 SWC_HSPF_CM_single 6 -3.4E+38 3.4E+38 /end AXIS_PTS
/begin AXIS_PTS CAL_Hspf_ProjectNuminSWTable_af32 "½âÎö³öÀ´µÄÏîÄ¿ºÅ" 0x80140364 NO_INPUT_QUANTITY Lookup2D_X_FLOAT32_IEEE 0 SWC_HSPF_CM_single 7 -3.4E+38 3.4E+38 /end AXIS_PTS
/begin AXIS_PTS CAL_Hspf_CpldSwTable_af32 "CPLDÈí¼þ°æ±¾" 0x80140CC4 NO_INPUT_QUANTITY Lookup2D_X_FLOAT32_IEEE 0 SWC_HSPF_CM_single 4 -3.4E+38 3.4E+38 /end AXIS_PTS
/begin AXIS_PTS CAL_Hspf_HvMcuTable_af32 "¸ßÑ¹MCU°æ±¾ºÅ" 0x80140C8C NO_INPUT_QUANTITY Lookup2D_X_FLOAT32_IEEE 0 SWC_HSPF_CM_single 6 -3.4E+38 3.4E+38 /end AXIS_PTS
/begin AXIS_PTS CAL_Hspf_HwAnalTable_af32 "½âÎöÆ¥Åä" 0x80140C54 NO_INPUT_QUANTITY Lookup2D_X_FLOAT32_IEEE 0 SWC_HSPF_CM_single 2 -3.4E+38 3.4E+38 /end AXIS_PTS
/begin AXIS_PTS CAL_Hspf_HwVerTable_af32 "Ó²¼þ°æ±¾ºÅ" 0x80140C3C VAR_Bsw_Hwver_f32 Lookup2D_X_FLOAT32_IEEE 0 SWC_HSPF_CM_single 6 -3.4E+38 3.4E+38 /end AXIS_PTS
/begin AXIS_PTS CAL_MCF_DeadTimeTableX_Frq_af32 "ËÀÇøÊ±¼ä²é±íÊäÈëÔØÆµ" 0x80141338 NO_INPUT_QUANTITY Lookup1D_X_FLOAT32_IEEE 0 SWC_MCF_CM_single 15 -3.4E+38 3.4E+38 /end AXIS_PTS
/begin AXIS_PTS CAL_MCF_UsUseRateDesTableX_Spd_af32 "" 0x8014103C NO_INPUT_QUANTITY Lookup1D_X_FLOAT32_IEEE 0 SWC_MCF_CM_single 11 -3.4E+38 3.4E+38 /end AXIS_PTS
/begin AXIS_PTS CAL_MCF_AgRangeDeadCpnX_Trq_af32 "" 0x80141474 NO_INPUT_QUANTITY Lookup1D_X_FLOAT32_IEEE 0 SWC_MCF_CM_single 7 -65535.0 65535.0 /end AXIS_PTS
/begin AXIS_PTS CAL_MCF_HarmIn1113ZRX_Spd_af32 "" 0x80141268 NO_INPUT_QUANTITY Lookup1D_X_FLOAT32_IEEE 0 SWC_MCF_CM_single 23 -3.4E+38 3.4E+38 /end AXIS_PTS
/begin AXIS_PTS CAL_MCF_CoefPIZoreCtlX_N_af32 "" 0x8014137C NO_INPUT_QUANTITY Lookup1D_X_FLOAT32_IEEE 0 SWC_MCF_CM_single 10 -3.4E+38 3.4E+38 /end AXIS_PTS
/begin AXIS_PTS CAL_MCF_IrmsDesEOLX_af32 "" 0x80141160 NO_INPUT_QUANTITY Lookup1D_X_FLOAT32_IEEE 0 SWC_MCF_CM_single 20 -3.4E+38 3.4E+38 /end AXIS_PTS
/begin AXIS_PTS CAL_MCF_OmbwFirstFltX_N_af32 "" 0x80141104 NO_INPUT_QUANTITY Lookup1D_X_FLOAT32_IEEE 0 SWC_MCF_CM_single 10 -3.4E+38 3.4E+38 /end AXIS_PTS
/begin GROUP SWC_ADM "SWC_ADM" ROOT /begin SUB_GROUP Root_SWC_ADM_1ms_sys /end SUB_GROUP /end GROUP
/begin GROUP Root_SWC_ADM_1ms_sys "SWC_ADM/SWC_ADM_1ms_sys" /begin SUB_GROUP S1_GlbDchgMon S1_SigMng S1_VoltMon /end SUB_GROUP /end GROUP
/begin GROUP S1_GlbDchgMon "SWC_ADM/SWC_ADM_1ms_sys/GlbDchgMon"
 /begin REF_CHARACTERISTIC CAL_ADM_DchgMode_u8 CAL_ADM_GlbDchgErrRst_b CAL_ADM_GlbDchgThrshTime_f32 CAL_ADM_GlbDchgThrshVolt_f32 CAL_ADM_VoltCmpChkErrst_b /end REF_CHARACTERISTIC
 /begin REF_MEASUREMENT VAR_ADM_GlbDchgErr_b /end REF_MEASUREMENT
/end GROUP
/begin GROUP S1_SigMng "SWC_ADM/SWC_ADM_1ms_sys/SigMng"
 /begin SUB_GROUP S4_Subsystem1 S4_Subsystem10 S4_Subsystem2 S4_Subsystem22 S4_Subsystem3 /end SUB_GROUP
/end GROUP
/begin GROUP S1_VoltMon "SWC_ADM/SWC_ADM_1ms_sys/VoltMon" /begin SUB_GROUP S5_BMSVoltRngMon S5_VoltCmpChkMon /end SUB_GROUP /end GROUP
/begin GROUP S4_Subsystem1 "SWC_ADM/SWC_ADM_1ms_sys/SigMng/Subsystem1" /begin REF_CHARACTERISTIC CAL_ADM_flgCrashSwt_b CAL_ADM_flgCrash_b /end REF_CHARACTERISTIC /begin REF_MEASUREMENT VAR_ADM_flgCrash_b /end REF_MEASUREMENT /end GROUP
/begin GROUP S4_Subsystem10 "SWC_ADM/SWC_ADM_1ms_sys/SigMng/Subsystem10" /begin REF_CHARACTERISTIC CAL_ADM_flgstModeReqSwt_b CAL_ADM_stModeReq_u8 /end REF_CHARACTERISTIC /begin REF_MEASUREMENT VAR_ADM_stModeReq_u8 /end REF_MEASUREMENT /end GROUP
/begin GROUP S4_Subsystem2 "SWC_ADM/SWC_ADM_1ms_sys/SigMng/Subsystem2" /begin REF_CHARACTERISTIC CAL_ADM_L2Com_HiPrecVolt CAL_ADM_L2Com_HiPrecVolt_b /end REF_CHARACTERISTIC /begin REF_MEASUREMENT VAR_ADM_L2Com_HiPrecVolt_IN /end REF_MEASUREMENT /end GROUP
/begin GROUP S4_Subsystem22 "SWC_ADM/SWC_ADM_1ms_sys/SigMng/Subsystem22" /begin REF_CHARACTERISTIC CAL_ADM_flgDchgReqSwt_b CAL_ADM_flgDchgReq_b /end REF_CHARACTERISTIC /begin REF_MEASUREMENT VAR_ADM_flgDchgReq_b /end REF_MEASUREMENT /end GROUP
/begin GROUP S4_Subsystem3 "SWC_ADM/SWC_ADM_1ms_sys/SigMng/Subsystem3" /begin REF_CHARACTERISTIC CAL_ADM_L2Com_BMSVolt CAL_ADM_L2Com_BMSVolt_b /end REF_CHARACTERISTIC /begin REF_MEASUREMENT VAR_ADM_L2Com_BMSVolt_IN /end REF_MEASUREMENT /end GROUP
/begin GROUP S5_BMSVoltRngMon "SWC_ADM/SWC_ADM_1ms_sys/VoltMon/BMSVoltRngMon"
 /begin REF_CHARACTERISTIC CAL_ADM_BMSVoltRngErrCntThr_s16 CAL_ADM_BMSVoltRngErrDebThr_s16 CAL_ADM_BMSVoltRngErrRst_b /end REF_CHARACTERISTIC
 /begin REF_MEASUREMENT VAR_ADM_BMSVoltRngErr_b /end REF_MEASUREMENT
 /begin SUB_GROUP S11_BMSVoltRngChk /end SUB_GROUP
/end GROUP
/begin GROUP S5_VoltCmpChkMon "SWC_ADM/SWC_ADM_1ms_sys/VoltMon/VoltCmpChkMon"
 /begin REF_CHARACTERISTIC CAL_ADM_VoltCmpChkErrCntThr_s16 CAL_ADM_VoltCmpChkErrDebThr_s16 CAL_ADM_VoltCmpChkErrRst_b /end REF_CHARACTERISTIC
 /begin REF_MEASUREMENT VAR_ADM_VoltCmpChkErr_b /end REF_MEASUREMENT
 /begin SUB_GROUP S12_VoltCmpChk /end SUB_GROUP
/end GROUP
/begin GROUP S11_BMSVoltRngChk "SWC_ADM/SWC_ADM_1ms_sys/VoltMon/BMSVoltRngMon/BMSVoltRngChk" /begin REF_CHARACTERISTIC CAL_ADM_BMSLowerThr_f32 CAL_ADM_BMSUpperThr_f32 /end REF_CHARACTERISTIC /begin REF_MEASUREMENT VAR_ADM_BMSVolt_f32 VAR_BMSVoltRngErrSt /end REF_MEASUREMENT /end GROUP
/begin GROUP S12_VoltCmpChk "SWC_ADM/SWC_ADM_1ms_sys/VoltMon/VoltCmpChkMon/VoltCmpChk"
 /begin REF_CHARACTERISTIC CAL_ADM_VoltAbsDiffThrPerc_f32 CAL_ADM_VoltAbsDiffThr_f32 CAL_ADM_VoltChgThr_f32 /end REF_CHARACTERISTIC
 /begin REF_MEASUREMENT VAR_ADM_HiPrecVolt_f32 VAR_VoltCmpChkErrSt /end REF_MEASUREMENT
/end GROUP
/begin GROUP SWC_BCC "SWC_BCC" ROOT /begin SUB_GROUP Root_RE_SWC_BCC_100us_sys /end SUB_GROUP /end GROUP
/begin GROUP Root_RE_SWC_BCC_100us_sys "SWC_BCC/RE_SWC_BCC_100us_sys" /begin SUB_GROUP S1_iDcLnkCal /end SUB_GROUP /end GROUP
/begin GROUP S1_iDcLnkCal "SWC_BCC/RE_SWC_BCC_100us_sys/iDcLnkCal" /begin REF_CHARACTERISTIC CAL_BCC_flgEnableIdc_b CAL_BCC_flgEnableTj_b /end REF_CHARACTERISTIC /begin SUB_GROUP S3_Dyc_Calc S3_Idc_Calc S3_Tj S3_iUVW_Calc /end SUB_GROUP /end GROUP
/begin GROUP S3_Dyc_Calc "SWC_BCC/RE_SWC_BCC_100us_sys/iDcLnkCal/Dyc_Calc" /begin REF_CHARACTERISTIC CAL_BCC_flgDelayDyc_b /end REF_CHARACTERISTIC /end GROUP
/begin GROUP S3_Idc_Calc "SWC_BCC/RE_SWC_BCC_100us_sys/iDcLnkCal/Idc_Calc" /begin SUB_GROUP S5_IdcCalc S5_IdcCalcFlt /end SUB_GROUP /end GROUP
/begin GROUP S3_Tj "SWC_BCC/RE_SWC_BCC_100us_sys/iDcLnkCal/Tj"
 /begin REF_CHARACTERISTIC CAL_CoolantFlowReq_u8 CAL_TjrthLv4DhIhTab_af32 CAL_TjrthLv4IhIhTab_af32 CAL_TjrthLv4IhNtcTab_af32 CAL_TjrthLv4dhdh_f32 CAL_TjrthLv4dhdl_f32 CAL_TjrthLv4dhil_f32 CAL_TjrthLv4dhntc_f32 CAL_TjrthLv4dldh_f32 CAL_TjrthLv4dldl_f32 CAL_TjrthLv4dlih_f32 CAL_TjrthLv4dlil_f32 CAL_TjrthLv4dlntc_f32 CAL_TjrthLv4ihdh_f32 CAL_TjrthLv4ihdl_f32 CAL_TjrthLv4ihil_f32 CAL_TjrthLv4ildh_f32 CAL_TjrthLv4ildl_f32 CAL_TjrthLv4ilih_f32 CAL_TjrthLv4ilil_f32 CAL_TjrthLv4ilntc_f32 CAL_tiPwmLim_f32 /end REF_CHARACTERISTIC
 /begin SUB_GROUP S6_uTjCal1 S6_uTjCal2 S6_uTjCal3 /end SUB_GROUP
/end GROUP
/begin GROUP S3_iUVW_Calc "SWC_BCC/RE_SWC_BCC_100us_sys/iDcLnkCal/iUVW_Calc" /begin SUB_GROUP S8_SinCos /end SUB_GROUP /end GROUP
/begin GROUP S5_IdcCalc "SWC_BCC/RE_SWC_BCC_100us_sys/iDcLnkCal/Idc_Calc/IdcCalc" /begin REF_CHARACTERISTIC CAL_BCC_flgDelayDyc_b /end REF_CHARACTERISTIC /begin REF_MEASUREMENT VAR_BCC_iDcLnkEst_f32 /end REF_MEASUREMENT
 /begin SUB_GROUP S16_Case1 S16_Case2 S16_Case3 S16_Case4 S16_Case5 S16_Case6 S16_Subsystem1 /end SUB_GROUP
/end GROUP
/begin GROUP S5_IdcCalcFlt "SWC_BCC/RE_SWC_BCC_100us_sys/iDcLnkCal/Idc_Calc/IdcCalcFlt" /begin REF_CHARACTERISTIC CAL_BCC_iDcEstflt_f32 /end REF_CHARACTERISTIC /begin SUB_GROUP S17_ISC_ILPFilter6 S17_Subsystem /end SUB_GROUP /end GROUP
/begin GROUP S6_uTjCal1 "SWC_BCC/RE_SWC_BCC_100us_sys/iDcLnkCal/Tj/uTjCal1" /begin REF_CHARACTERISTIC CAL_Tj_cofFltCoolant_f32 CAL_TjstUVW_u8 /end REF_CHARACTERISTIC
 /begin REF_MEASUREMENT VAR_UCoolantTj_f32 VAR_UdhTjtIGBT_f32 VAR_UdlTjtIGBT_f32 VAR_UihTjtIGBT_f32 VAR_UilTjtIGBT_f32 /end REF_MEASUREMENT
 /begin SUB_GROUP S59_Subsystem S59_Subsystem12 S59_Subsystem14 S59_Subsystem3 S59_Subsystem4 S59_Subsystem5 S59_Subsystem7 S59_Subsystem8 S59_Subsystem9 /end SUB_GROUP
/end GROUP
/begin GROUP S6_uTjCal2 "SWC_BCC/RE_SWC_BCC_100us_sys/iDcLnkCal/Tj/uTjCal2" /begin REF_CHARACTERISTIC CAL_Tj_cofFltCoolant_f32 CAL_TjstUVW_u8 /end REF_CHARACTERISTIC
 /begin REF_MEASUREMENT VAR_VCoolantTj_f32 VAR_VdhTjtIGBT_f32 VAR_VdlTjtIGBT_f32 VAR_VihTjtIGBT_f32 VAR_VilTjtIGBT_f32 /end REF_MEASUREMENT
 /begin SUB_GROUP S60_Subsystem S60_Subsystem12 S60_Subsystem14 S60_Subsystem3 S60_Subsystem4 S60_Subsystem5 S60_Subsystem7 S60_Subsystem8 S60_Subsystem9 /end SUB_GROUP
/end GROUP
/begin GROUP S6_uTjCal3 "SWC_BCC/RE_SWC_BCC_100us_sys/iDcLnkCal/Tj/uTjCal3" /begin REF_CHARACTERISTIC CAL_Tj_cofFltCoolant_f32 CAL_TjstUVW_u8 /end REF_CHARACTERISTIC /begin REF_MEASUREMENT VAR_WCoolantTj_f32 VAR_WihTjtIGBT_f32 /end REF_MEASUREMENT
 /begin SUB_GROUP S61_Subsystem S61_Subsystem15 S61_Subsystem4 S61_Subsystem5 S61_Subsystem7 S61_Subsystem8 S61_Subsystem9 /end SUB_GROUP
/end GROUP
/begin GROUP S8_SinCos "SWC_BCC/RE_SWC_BCC_100us_sys/iDcLnkCal/iUVW_Calc/SinCos" /begin REF_CHARACTERISTIC CAL_BCC_iThetaOffsetGen_f32 CAL_BCC_iThetaOffset_f32 /end REF_CHARACTERISTIC /end GROUP
/begin GROUP S16_Case1 "SWC_BCC/RE_SWC_BCC_100us_sys/iDcLnkCal/Idc_Calc/IdcCalc/Case1" /begin REF_CHARACTERISTIC CAL_BCC_AgGenCoe_f32 CAL_BCC_tiFull_f32 /end REF_CHARACTERISTIC /end GROUP
/begin GROUP S16_Case2 "SWC_BCC/RE_SWC_BCC_100us_sys/iDcLnkCal/Idc_Calc/IdcCalc/Case2" /begin REF_CHARACTERISTIC CAL_BCC_AgGenCoe_f32 CAL_BCC_tiFull_f32 /end REF_CHARACTERISTIC /end GROUP
/begin GROUP S16_Case3 "SWC_BCC/RE_SWC_BCC_100us_sys/iDcLnkCal/Idc_Calc/IdcCalc/Case3" /begin REF_CHARACTERISTIC CAL_BCC_AgGenCoe_f32 CAL_BCC_tiFull_f32 /end REF_CHARACTERISTIC /end GROUP
/begin GROUP S16_Case4 "SWC_BCC/RE_SWC_BCC_100us_sys/iDcLnkCal/Idc_Calc/IdcCalc/Case4" /begin REF_CHARACTERISTIC CAL_BCC_AgGenCoe_f32 CAL_BCC_tiFull_f32 /end REF_CHARACTERISTIC /end GROUP
/begin GROUP S16_Case5 "SWC_BCC/RE_SWC_BCC_100us_sys/iDcLnkCal/Idc_Calc/IdcCalc/Case5" /begin REF_CHARACTERISTIC CAL_BCC_AgGenCoe_f32 CAL_BCC_tiFull_f32 /end REF_CHARACTERISTIC /end GROUP
/begin GROUP S16_Case6 "SWC_BCC/RE_SWC_BCC_100us_sys/iDcLnkCal/Idc_Calc/IdcCalc/Case6" /begin REF_CHARACTERISTIC CAL_BCC_AgGenCoe_f32 CAL_BCC_tiFull_f32 /end REF_CHARACTERISTIC /end GROUP
/begin GROUP S16_Subsystem1 "SWC_BCC/RE_SWC_BCC_100us_sys/iDcLnkCal/Idc_Calc/IdcCalc/Subsystem1" /begin SUB_GROUP S25_Subsystem /end SUB_GROUP /end GROUP
/begin GROUP S17_ISC_ILPFilter6 "SWC_BCC/RE_SWC_BCC_100us_sys/iDcLnkCal/Idc_Calc/IdcCalcFlt/ISC_ILPFilter6" /begin REF_MEASUREMENT VAR_BCC_iDcLnkEstFlt_f32 /end REF_MEASUREMENT /end GROUP
/begin GROUP S17_Subsystem "SWC_BCC/RE_SWC_BCC_100us_sys/iDcLnkCal/Idc_Calc/IdcCalcFlt/Subsystem" /begin REF_MEASUREMENT VAR_BCC_flgstGateDrv_b /end REF_MEASUREMENT /end GROUP
/begin GROUP S59_Subsystem "SWC_BCC/RE_SWC_BCC_100us_sys/iDcLnkCal/Tj/uTjCal1/Subsystem" /begin REF_CHARACTERISTIC CAL_TjDycMax_f32 CAL_TjDycMin_f32 /end REF_CHARACTERISTIC /end GROUP
/begin GROUP S59_Subsystem12 "SWC_BCC/RE_SWC_BCC_100us_sys/iDcLnkCal/Tj/uTjCal1/Subsystem12"
 /begin REF_CHARACTERISTIC CAL_TjLv1Act_f32 CAL_TjLv2Act_f32 CAL_TjLv3Act_f32 CAL_TjLv3Pas_f32 /end REF_CHARACTERISTIC
/end GROUP
/begin GROUP S59_Subsystem14 "SWC_BCC/RE_SWC_BCC_100us_sys/iDcLnkCal/Tj/uTjCal1/Subsystem14"
 /begin REF_CHARACTERISTIC CAL_TjLv1Act_f32 CAL_TjLv2Act_f32 CAL_TjLv3Act_f32 CAL_TjLv3Pas_f32 /end REF_CHARACTERISTIC
/end GROUP
/begin GROUP S59_Subsystem3 "SWC_BCC/RE_SWC_BCC_100us_sys/iDcLnkCal/Tj/uTjCal1/Subsystem3"
 /begin REF_CHARACTERISTIC CAL_TjLv1Act_f32 CAL_TjLv2Act_f32 CAL_TjLv3Act_f32 CAL_TjLv3Pas_f32 /end REF_CHARACTERISTIC
/end GROUP
/begin GROUP S59_Subsystem4 "SWC_BCC/RE_SWC_BCC_100us_sys/iDcLnkCal/Tj/uTjCal1/Subsystem4"
 /begin REF_CHARACTERISTIC CAL_TjLv1Act_f32 CAL_TjLv2Act_f32 CAL_TjLv3Act_f32 CAL_TjLv3Pas_f32 /end REF_CHARACTERISTIC
/end GROUP
/begin GROUP S59_Subsystem5 "SWC_BCC/RE_SWC_BCC_100us_sys/iDcLnkCal/Tj/uTjCal1/Subsystem5" /begin REF_MEASUREMENT VAR_UTjpwr_f32 /end REF_MEASUREMENT /end GROUP
/begin GROUP S59_Subsystem7 "SWC_BCC/RE_SWC_BCC_100us_sys/iDcLnkCal/Tj/uTjCal1/Subsystem7" /begin REF_CHARACTERISTIC CAL_TjDycMax_f32 CAL_TjDycMin_f32 /end REF_CHARACTERISTIC /end GROUP
/begin GROUP S59_Subsystem8 "SWC_BCC/RE_SWC_BCC_100us_sys/iDcLnkCal/Tj/uTjCal1/Subsystem8" /begin REF_CHARACTERISTIC CAL_TjDycMax_f32 CAL_TjDycMin_f32 /end REF_CHARACTERISTIC /end GROUP
/begin GROUP S59_Subsystem9 "SWC_BCC/RE_SWC_BCC_100us_sys/iDcLnkCal/Tj/uTjCal1/Subsystem9" /begin REF_CHARACTERISTIC CAL_TjDycMax_f32 CAL_TjDycMin_f32 /end REF_CHARACTERISTIC /end GROUP
/begin GROUP S60_Subsystem "SWC_BCC/RE_SWC_BCC_100us_sys/iDcLnkCal/Tj/uTjCal2/Subsystem" /begin REF_CHARACTERISTIC CAL_TjDycMax_f32 CAL_TjDycMin_f32 /end REF_CHARACTERISTIC /end GROUP
/begin GROUP S60_Subsystem12 "SWC_BCC/RE_SWC_BCC_100us_sys/iDcLnkCal/Tj/uTjCal2/Subsystem12"
 /begin REF_CHARACTERISTIC CAL_TjLv1Act_f32 CAL_TjLv2Act_f32 CAL_TjLv3Act_f32 CAL_TjLv3Pas_f32 /end REF_CHARACTERISTIC
/end GROUP
/begin GROUP S60_Subsystem14 "SWC_BCC/RE_SWC_BCC_100us_sys/iDcLnkCal/Tj/uTjCal2/Subsystem14"
 /begin REF_CHARACTERISTIC CAL_TjLv1Act_f32 CAL_TjLv2Act_f32 CAL_TjLv3Act_f32 CAL_TjLv3Pas_f32 /end REF_CHARACTERISTIC
/end GROUP
/begin GROUP S60_Subsystem3 "SWC_BCC/RE_SWC_BCC_100us_sys/iDcLnkCal/Tj/uTjCal2/Subsystem3"
 /begin REF_CHARACTERISTIC CAL_TjLv1Act_f32 CAL_TjLv2Act_f32 CAL_TjLv3Act_f32 CAL_TjLv3Pas_f32 /end REF_CHARACTERISTIC
/end GROUP
/begin GROUP S60_Subsystem4 "SWC_BCC/RE_SWC_BCC_100us_sys/iDcLnkCal/Tj/uTjCal2/Subsystem4"
 /begin REF_CHARACTERISTIC CAL_TjLv1Act_f32 CAL_TjLv2Act_f32 CAL_TjLv3Act_f32 CAL_TjLv3Pas_f32 /end REF_CHARACTERISTIC
/end GROUP
/begin GROUP S60_Subsystem5 "SWC_BCC/RE_SWC_BCC_100us_sys/iDcLnkCal/Tj/uTjCal2/Subsystem5" /begin REF_MEASUREMENT VAR_VTjpwr_f32 /end REF_MEASUREMENT /end GROUP
/begin GROUP S60_Subsystem7 "SWC_BCC/RE_SWC_BCC_100us_sys/iDcLnkCal/Tj/uTjCal2/Subsystem7" /begin REF_CHARACTERISTIC CAL_TjDycMax_f32 CAL_TjDycMin_f32 /end REF_CHARACTERISTIC /end GROUP
/begin GROUP S60_Subsystem8 "SWC_BCC/RE_SWC_BCC_100us_sys/iDcLnkCal/Tj/uTjCal2/Subsystem8" /begin REF_CHARACTERISTIC CAL_TjDycMax_f32 CAL_TjDycMin_f32 /end REF_CHARACTERISTIC /end GROUP
/begin GROUP S60_Subsystem9 "SWC_BCC/RE_SWC_BCC_100us_sys/iDcLnkCal/Tj/uTjCal2/Subsystem9" /begin REF_CHARACTERISTIC CAL_TjDycMax_f32 CAL_TjDycMin_f32 /end REF_CHARACTERISTIC /end GROUP
/begin GROUP S61_Subsystem "SWC_BCC/RE_SWC_BCC_100us_sys/iDcLnkCal/Tj/uTjCal3/Subsystem" /begin REF_CHARACTERISTIC CAL_TjDycMax_f32 CAL_TjDycMin_f32 /end REF_CHARACTERISTIC /end GROUP
/begin GROUP S61_Subsystem15 "SWC_BCC/RE_SWC_BCC_100us_sys/iDcLnkCal/Tj/uTjCal3/Subsystem15" /begin REF_MEASUREMENT VAR_WdhTjtIGBT_f32 VAR_WdlTjtIGBT_f32 VAR_WilTjtIGBT_f32 /end REF_MEASUREMENT /begin SUB_GROUP S132_Subsystem12 S132_Subsystem14 S132_Subsystem3 /end SUB_GROUP /end GROUP
/begin GROUP S61_Subsystem4 "SWC_BCC/RE_SWC_BCC_100us_sys/iDcLnkCal/Tj/uTjCal3/Subsystem4"
 /begin REF_CHARACTERISTIC CAL_TjLv1Act_f32 CAL_TjLv2Act_f32 CAL_TjLv3Act_f32 CAL_TjLv3Pas_f32 /end REF_CHARACTERISTIC
/end GROUP
/begin GROUP S61_Subsystem5 "SWC_BCC/RE_SWC_BCC_100us_sys/iDcLnkCal/Tj/uTjCal3/Subsystem5" /begin REF_MEASUREMENT VAR_WTjpwr_f32 /end REF_MEASUREMENT /end GROUP
/begin GROUP S61_Subsystem7 "SWC_BCC/RE_SWC_BCC_100us_sys/iDcLnkCal/Tj/uTjCal3/Subsystem7" /begin REF_CHARACTERISTIC CAL_TjDycMax_f32 CAL_TjDycMin_f32 /end REF_CHARACTERISTIC /end GROUP
/begin GROUP S61_Subsystem8 "SWC_BCC/RE_SWC_BCC_100us_sys/iDcLnkCal/Tj/uTjCal3/Subsystem8" /begin REF_CHARACTERISTIC CAL_TjDycMax_f32 CAL_TjDycMin_f32 /end REF_CHARACTERISTIC /end GROUP
/begin GROUP S61_Subsystem9 "SWC_BCC/RE_SWC_BCC_100us_sys/iDcLnkCal/Tj/uTjCal3/Subsystem9" /begin REF_CHARACTERISTIC CAL_TjDycMax_f32 CAL_TjDycMin_f32 /end REF_CHARACTERISTIC /end GROUP
/begin GROUP S25_Subsystem "SWC_BCC/RE_SWC_BCC_100us_sys/iDcLnkCal/Idc_Calc/IdcCalc/Subsystem1/Subsystem"
 /begin SUB_GROUP S44_Sec1_Dyc S44_Sec2_Dyc S44_Sec3_Dyc S44_Sec4_Dyc S44_Sec5_Dyc S44_Sec6_Dyc /end SUB_GROUP
/end GROUP
/begin GROUP S132_Subsystem12 "SWC_BCC/RE_SWC_BCC_100us_sys/iDcLnkCal/Tj/uTjCal3/Subsystem15/Subsystem12"
 /begin REF_CHARACTERISTIC CAL_TjLv1Act_f32 CAL_TjLv2Act_f32 CAL_TjLv3Act_f32 CAL_TjLv3Pas_f32 /end REF_CHARACTERISTIC
/end GROUP
/begin GROUP S132_Subsystem14 "SWC_BCC/RE_SWC_BCC_100us_sys/iDcLnkCal/Tj/uTjCal3/Subsystem15/Subsystem14"
 /begin REF_CHARACTERISTIC CAL_TjLv1Act_f32 CAL_TjLv2Act_f32 CAL_TjLv3Act_f32 CAL_TjLv3Pas_f32 /end REF_CHARACTERISTIC
/end GROUP
/begin GROUP S132_Subsystem3 "SWC_BCC/RE_SWC_BCC_100us_sys/iDcLnkCal/Tj/uTjCal3/Subsystem15/Subsystem3"
 /begin REF_CHARACTERISTIC CAL_TjLv1Act_f32 CAL_TjLv2Act_f32 CAL_TjLv3Act_f32 CAL_TjLv3Pas_f32 /end REF_CHARACTERISTIC
/end GROUP
/begin GROUP S44_Sec1_Dyc "SWC_BCC/RE_SWC_BCC_100us_sys/iDcLnkCal/Idc_Calc/IdcCalc/Subsystem1/Subsystem/Sec1_Dyc" /begin REF_CHARACTERISTIC CAL_BCC_dycLowLimt_f32 CAL_BCC_dycUpLimt_f32 /end REF_CHARACTERISTIC /end GROUP
/begin GROUP S44_Sec2_Dyc "SWC_BCC/RE_SWC_BCC_100us_sys/iDcLnkCal/Idc_Calc/IdcCalc/Subsystem1/Subsystem/Sec2_Dyc" /begin REF_CHARACTERISTIC CAL_BCC_dycLowLimt_f32 CAL_BCC_dycUpLimt_f32 /end REF_CHARACTERISTIC /end GROUP
/begin GROUP S44_Sec3_Dyc "SWC_BCC/RE_SWC_BCC_100us_sys/iDcLnkCal/Idc_Calc/IdcCalc/Subsystem1/Subsystem/Sec3_Dyc" /begin REF_CHARACTERISTIC CAL_BCC_dycLowLimt_f32 CAL_BCC_dycUpLimt_f32 /end REF_CHARACTERISTIC /end GROUP
/begin GROUP S44_Sec4_Dyc "SWC_BCC/RE_SWC_BCC_100us_sys/iDcLnkCal/Idc_Calc/IdcCalc/Subsystem1/Subsystem/Sec4_Dyc" /begin REF_CHARACTERISTIC CAL_BCC_dycLowLimt_f32 CAL_BCC_dycUpLimt_f32 /end REF_CHARACTERISTIC /end GROUP
/begin GROUP S44_Sec5_Dyc "SWC_BCC/RE_SWC_BCC_100us_sys/iDcLnkCal/Idc_Calc/IdcCalc/Subsystem1/Subsystem/Sec5_Dyc" /begin REF_CHARACTERISTIC CAL_BCC_dycLowLimt_f32 CAL_BCC_dycUpLimt_f32 /end REF_CHARACTERISTIC /end GROUP
/begin GROUP S44_Sec6_Dyc "SWC_BCC/RE_SWC_BCC_100us_sys/iDcLnkCal/Idc_Calc/IdcCalc/Subsystem1/Subsystem/Sec6_Dyc" /begin REF_CHARACTERISTIC CAL_BCC_dycLowLimt_f32 CAL_BCC_dycUpLimt_f32 /end REF_CHARACTERISTIC /end GROUP
/begin GROUP SWC_CSPF "SWC_CSPF" ROOT /begin SUB_GROUP Root_RE_SWC_CSPF_100ms_sys Root_RE_SWC_CSPF_10ms_sys /end SUB_GROUP /end GROUP
/begin GROUP Root_RE_SWC_CSPF_100ms_sys "SWC_CSPF/RE_SWC_CSPF_100ms_sys" /begin SUB_GROUP S1_CSPF_Rec_100ms S1_CSPF_Tra_100ms /end SUB_GROUP /end GROUP
/begin GROUP Root_RE_SWC_CSPF_10ms_sys "SWC_CSPF/RE_SWC_CSPF_10ms_sys" /begin SUB_GROUP S2_CSPF_Rec_10ms S2_CSPF_Tra_10ms /end SUB_GROUP /end GROUP
/begin GROUP S1_CSPF_Rec_100ms "SWC_CSPF/RE_SWC_CSPF_100ms_sys/CSPF_Rec_100ms" /begin SUB_GROUP S4_VCU01 /end SUB_GROUP /end GROUP
/begin GROUP S1_CSPF_Tra_100ms "SWC_CSPF/RE_SWC_CSPF_100ms_sys/CSPF_Tra_100ms" /begin SUB_GROUP S5_CSDTra_100ms S5_CSDTra_100ms_sub2 /end SUB_GROUP /end GROUP
/begin GROUP S2_CSPF_Rec_10ms "SWC_CSPF/RE_SWC_CSPF_10ms_sys/CSPF_Rec_10ms" /begin SUB_GROUP S45_CanSig_Select /end SUB_GROUP /end GROUP
/begin GROUP S2_CSPF_Tra_10ms "SWC_CSPF/RE_SWC_CSPF_10ms_sys/CSPF_Tra_10ms" /begin SUB_GROUP S46_CSPFTra_10ms /end SUB_GROUP /end GROUP
/begin GROUP S4_VCU01 "SWC_CSPF/RE_SWC_CSPF_100ms_sys/CSPF_Rec_100ms/VCU01" /begin SUB_GROUP S6_Subsystem1 S6_Subsystem2 S6_Subsystem3 S6_Subsystem4 /end SUB_GROUP /end GROUP
/begin GROUP S5_CSDTra_100ms "SWC_CSPF/RE_SWC_CSPF_100ms_sys/CSPF_Tra_100ms/CSDTra_100ms" /begin SUB_GROUP S12_PEB02 /end SUB_GROUP /end GROUP
/begin GROUP S5_CSDTra_100ms_sub2 "SWC_CSPF/RE_SWC_CSPF_100ms_sys/CSPF_Tra_100ms/CSDTra_100ms_sub2" /begin SUB_GROUP S13_PEB05 S13_PEB06 S13_Subsystem11 /end SUB_GROUP /end GROUP
/begin GROUP S45_CanSig_Select "SWC_CSPF/RE_SWC_CSPF_10ms_sys/CSPF_Rec_10ms/CanSig_Select"
 /begin SUB_GROUP S47_BMS01 S47_Subsystem1 S47_Subsystem22 S47_VCU02 S47_VCU03 S47_VCU04 S47_VCU05 /end SUB_GROUP
/end GROUP
/begin GROUP S46_CSPFTra_10ms "SWC_CSPF/RE_SWC_CSPF_10ms_sys/CSPF_Tra_10ms/CSPFTra_10ms" /begin SUB_GROUP S77_PEB01 S77_PEB03 S77_PEB04 S77_PEB08 S77_Subsystem8 /end SUB_GROUP /end GROUP
/begin GROUP S6_Subsystem1 "SWC_CSPF/RE_SWC_CSPF_100ms_sys/CSPF_Rec_100ms/VCU01/Subsystem1" /begin REF_CHARACTERISTIC CAL_Cspf_UdcMin_f32 CAL_Cspf_flgUdcMinSwt_b /end REF_CHARACTERISTIC /end GROUP
/begin GROUP S6_Subsystem2 "SWC_CSPF/RE_SWC_CSPF_100ms_sys/CSPF_Rec_100ms/VCU01/Subsystem2" /begin REF_CHARACTERISTIC CAL_Cspf_UdcMax_f32 CAL_Cspf_flgUdcMaxSwt_b /end REF_CHARACTERISTIC /end GROUP
/begin GROUP S6_Subsystem3 "SWC_CSPF/RE_SWC_CSPF_100ms_sys/CSPF_Rec_100ms/VCU01/Subsystem3" /begin REF_CHARACTERISTIC CAL_Cspf_IdcMin_f32 CAL_Cspf_flgIdcMinSwt_b /end REF_CHARACTERISTIC /end GROUP
/begin GROUP S6_Subsystem4 "SWC_CSPF/RE_SWC_CSPF_100ms_sys/CSPF_Rec_100ms/VCU01/Subsystem4" /begin REF_CHARACTERISTIC CAL_Cspf_IdcMax_f32 CAL_Cspf_flgIdcMaxSwt_b /end REF_CHARACTERISTIC /end GROUP
/begin GROUP S12_PEB02 "SWC_CSPF/RE_SWC_CSPF_100ms_sys/CSPF_Tra_100ms/CSDTra_100ms/PEB02"
 /begin SUB_GROUP S14_Subsystem1 S14_Subsystem10 S14_Subsystem11 S14_Subsystem12 S14_Subsystem13 S14_Subsystem14 S14_Subsystem15 S14_Subsystem16 S14_Subsystem17 S14_Subsystem2 S14_Subsystem3 S14_Subsystem4 S14_Subsystem5 S14_Subsystem6 S14_Subsystem7 S14_Subsystem8 S14_Subsystem9 /end SUB_GROUP
/end GROUP
/begin GROUP S13_PEB05 "SWC_CSPF/RE_SWC_CSPF_100ms_sys/CSPF_Tra_100ms/CSDTra_100ms_sub2/PEB05"
 /begin SUB_GROUP S32_Subsystem18 S32_Subsystem19 S32_Subsystem20 S32_Subsystem21 S32_Subsystem22 S32_Subsystem23 S32_Subsystem24 S32_Subsystem25 /end SUB_GROUP
/end GROUP
/begin GROUP S13_PEB06 "SWC_CSPF/RE_SWC_CSPF_100ms_sys/CSPF_Tra_100ms/CSDTra_100ms_sub2/PEB06" /begin REF_CHARACTERISTIC CAL_Cspf_CodeVer_u16 CAL_Cspf_DataVer_u16 /end REF_CHARACTERISTIC /begin SUB_GROUP S33_Subsystem26 S33_Subsystem27 /end SUB_GROUP /end GROUP
/begin GROUP S13_Subsystem11 "SWC_CSPF/RE_SWC_CSPF_100ms_sys/CSPF_Tra_100ms/CSDTra_100ms_sub2/Subsystem11"
 /begin REF_CHARACTERISTIC CAL_Cspf_bDernDrvBoardTemp_u16 CAL_Cspf_flgbDernDrvBoardTempSwt_b /end REF_CHARACTERISTIC
 /begin REF_MEASUREMENT VAR_Cspf_TrabDernDrvBoardTemp_u16 /end REF_MEASUREMENT
/end GROUP
/begin GROUP S47_BMS01 "SWC_CSPF/RE_SWC_CSPF_10ms_sys/CSPF_Rec_10ms/CanSig_Select/BMS01" /begin SUB_GROUP S48_Subsystem26 /end SUB_GROUP /end GROUP
/begin GROUP S47_Subsystem1 "SWC_CSPF/RE_SWC_CSPF_10ms_sys/CSPF_Rec_10ms/CanSig_Select/Subsystem1" /begin REF_CHARACTERISTIC CAL_Cspf_flgCrashSwt_b CAL_Cspf_flgCrash_b /end REF_CHARACTERISTIC /end GROUP
/begin GROUP S47_Subsystem22 "SWC_CSPF/RE_SWC_CSPF_10ms_sys/CSPF_Rec_10ms/CanSig_Select/Subsystem22" /begin REF_CHARACTERISTIC CAL_Cspf_flgDchaReqSwt_b CAL_Cspf_flgDchaReq_b /end REF_CHARACTERISTIC /end GROUP
/begin GROUP S47_VCU02 "SWC_CSPF/RE_SWC_CSPF_10ms_sys/CSPF_Rec_10ms/CanSig_Select/VCU02"
 /begin SUB_GROUP S51_Subsystem S51_Subsystem1 S51_Subsystem2 S51_Subsystem24 S51_Subsystem3 /end SUB_GROUP
/end GROUP
/begin GROUP S47_VCU03 "SWC_CSPF/RE_SWC_CSPF_10ms_sys/CSPF_Rec_10ms/CanSig_Select/VCU03" /begin SUB_GROUP S52_Subsystem4 S52_Subsystem5 S52_Subsystem6 /end SUB_GROUP /end GROUP
/begin GROUP S47_VCU04 "SWC_CSPF/RE_SWC_CSPF_10ms_sys/CSPF_Rec_10ms/CanSig_Select/VCU04" /begin SUB_GROUP S53_Subsystem10 S53_Subsystem11 S53_Subsystem9 /end SUB_GROUP /end GROUP
/begin GROUP S47_VCU05 "SWC_CSPF/RE_SWC_CSPF_10ms_sys/CSPF_Rec_10ms/CanSig_Select/VCU05"
 /begin SUB_GROUP S54_Subsystem13 S54_Subsystem15 S54_Subsystem16 S54_Subsystem17 /end SUB_GROUP
/end GROUP
/begin GROUP S77_PEB01 "SWC_CSPF/RE_SWC_CSPF_10ms_sys/CSPF_Tra_10ms/CSPFTra_10ms/PEB01"
 /begin SUB_GROUP S78_Subsystem1 S78_Subsystem2 S78_Subsystem3 S78_Subsystem4 S78_stMode /end SUB_GROUP
/end GROUP
/begin GROUP S77_PEB03 "SWC_CSPF/RE_SWC_CSPF_10ms_sys/CSPF_Tra_10ms/CSPFTra_10ms/PEB03"
 /begin SUB_GROUP S79_Subsystem10 S79_Subsystem5 S79_Subsystem6 S79_Subsystem7 S79_Subsystem9 /end SUB_GROUP
/end GROUP
/begin GROUP S77_PEB04 "SWC_CSPF/RE_SWC_CSPF_10ms_sys/CSPF_Tra_10ms/CSPFTra_10ms/PEB04"
 /begin SUB_GROUP S80_Subsystem11 S80_Subsystem12 S80_Subsystem13 S80_Subsystem14 S80_Subsystem15 S80_Subsystem16 S80_stGateDrv /end SUB_GROUP
/end GROUP
/begin GROUP S77_PEB08 "SWC_CSPF/RE_SWC_CSPF_10ms_sys/CSPF_Tra_10ms/CSPFTra_10ms/PEB08" /begin SUB_GROUP S81_Subsystem17 S81_Subsystem18 /end SUB_GROUP /end GROUP
/begin GROUP S77_Subsystem8 "SWC_CSPF/RE_SWC_CSPF_10ms_sys/CSPF_Tra_10ms/CSPFTra_10ms/Subsystem8"
 /begin REF_CHARACTERISTIC CAL_Cspf_flgtCoolantTempFltSwt_b CAL_Cspf_tCoolantTempFlt_f32 /end REF_CHARACTERISTIC
 /begin REF_MEASUREMENT VAR_Cspf_TraTempCurrCooL_f32 /end REF_MEASUREMENT
/end GROUP
/begin GROUP S14_Subsystem1 "SWC_CSPF/RE_SWC_CSPF_100ms_sys/CSPF_Tra_100ms/CSDTra_100ms/PEB02/Subsystem1" /begin REF_CHARACTERISTIC CAL_Cspf_bDernMtrSpd_u8 CAL_Cspf_flgbDernMtrSpdSwt_b /end REF_CHARACTERISTIC /begin REF_MEASUREMENT VAR_Cspf_TrabDernN_u8 /end REF_MEASUREMENT /end GROUP
/begin GROUP S14_Subsystem10 "SWC_CSPF/RE_SWC_CSPF_100ms_sys/CSPF_Tra_100ms/CSDTra_100ms/PEB02/Subsystem10" /begin REF_CHARACTERISTIC CAL_Cspf_bDernCAN_u8 CAL_Cspf_flgbDernCANSwt_b /end REF_CHARACTERISTIC /begin REF_MEASUREMENT VAR_Cspf_TrabDernCAN_u8 /end REF_MEASUREMENT /end GROUP
/begin GROUP S14_Subsystem11 "SWC_CSPF/RE_SWC_CSPF_100ms_sys/CSPF_Tra_100ms/CSDTra_100ms/PEB02/Subsystem11" /begin REF_CHARACTERISTIC CAL_Cspf_bReadyHV_u8 CAL_Cspf_flgbReadyHVSwt_b /end REF_CHARACTERISTIC /begin REF_MEASUREMENT VAR_Cspf_TrabReadyHV_u8 /end REF_MEASUREMENT /end GROUP
/begin GROUP S14_Subsystem12 "SWC_CSPF/RE_SWC_CSPF_100ms_sys/CSPF_Tra_100ms/CSDTra_100ms/PEB02/Subsystem12" /begin REF_CHARACTERISTIC CAL_Cspf_flgiDcLnkEstFltSwt_b CAL_Cspf_iDcLnkEstFlt_f32 /end REF_CHARACTERISTIC /begin REF_MEASUREMENT VAR_Cspf_TraidcCurr_f32 /end REF_MEASUREMENT /end GROUP
/begin GROUP S14_Subsystem13 "SWC_CSPF/RE_SWC_CSPF_100ms_sys/CSPF_Tra_100ms/CSDTra_100ms/PEB02/Subsystem13" /begin REF_CHARACTERISTIC CAL_Cspf_flgstTrqEmMaxSwt_b CAL_Cspf_stTrqEmMax_u8 /end REF_CHARACTERISTIC /begin REF_MEASUREMENT VAR_Cspf_TrastTrqEmMax_u8 /end REF_MEASUREMENT /end GROUP
/begin GROUP S14_Subsystem14 "SWC_CSPF/RE_SWC_CSPF_100ms_sys/CSPF_Tra_100ms/CSDTra_100ms/PEB02/Subsystem14" /begin REF_CHARACTERISTIC CAL_Cspf_flgstTrqEmMinSwt_b CAL_Cspf_stTrqEmMin_u8 /end REF_CHARACTERISTIC /begin REF_MEASUREMENT VAR_Cspf_TrastTrqEmMin_u8 /end REF_MEASUREMENT /end GROUP
/begin GROUP S14_Subsystem15 "SWC_CSPF/RE_SWC_CSPF_100ms_sys/CSPF_Tra_100ms/CSDTra_100ms/PEB02/Subsystem15" /begin REF_CHARACTERISTIC CAL_Cspf_TraTrqMax_f32 CAL_Cspf_flgTraTrqMaxSwt_b /end REF_CHARACTERISTIC /begin REF_MEASUREMENT VAR_Cspf_TraTrqAbsMax_f32 /end REF_MEASUREMENT /end GROUP
/begin GROUP S14_Subsystem16 "SWC_CSPF/RE_SWC_CSPF_100ms_sys/CSPF_Tra_100ms/CSDTra_100ms/PEB02/Subsystem16" /begin REF_CHARACTERISTIC CAL_Cspf_TraTrqMin_f32 CAL_Cspf_flgTraTrqMinSwt_b /end REF_CHARACTERISTIC /begin REF_MEASUREMENT VAR_Cspf_TraTrqAbsMin_f32 /end REF_MEASUREMENT /end GROUP
/begin GROUP S14_Subsystem17 "SWC_CSPF/RE_SWC_CSPF_100ms_sys/CSPF_Tra_100ms/CSDTra_100ms/PEB02/Subsystem17" /begin REF_CHARACTERISTIC CAL_Cspf_flguKl30FltSwt_b CAL_Cspf_uKl30Flt_f32 /end REF_CHARACTERISTIC /begin REF_MEASUREMENT VAR_Cspf_TraUT30Curr_f32 /end REF_MEASUREMENT /end GROUP
/begin GROUP S14_Subsystem2 "SWC_CSPF/RE_SWC_CSPF_100ms_sys/CSPF_Tra_100ms/CSDTra_100ms/PEB02/Subsystem2" /begin REF_CHARACTERISTIC CAL_Cspf_bDernOvrIdc_u8 CAL_Cspf_flgbDernOvrIdcSwt_b /end REF_CHARACTERISTIC /begin REF_MEASUREMENT VAR_Cspf_TrabDernOvridc_u8 /end REF_MEASUREMENT /end GROUP
/begin GROUP S14_Subsystem3 "SWC_CSPF/RE_SWC_CSPF_100ms_sys/CSPF_Tra_100ms/CSDTra_100ms/PEB02/Subsystem3" /begin REF_CHARACTERISTIC CAL_Cspf_bDernOvrUdc_u8 CAL_Cspf_flgbDernOvrUdcSwt_b /end REF_CHARACTERISTIC /begin REF_MEASUREMENT VAR_Cspf_TrabDernOvrUdc_u8 /end REF_MEASUREMENT /end GROUP
/begin GROUP S14_Subsystem4 "SWC_CSPF/RE_SWC_CSPF_100ms_sys/CSPF_Tra_100ms/CSDTra_100ms/PEB02/Subsystem4" /begin REF_CHARACTERISTIC CAL_Cspf_bDernStrTemp_u8 CAL_Cspf_flgbDernStrTempSwt_b /end REF_CHARACTERISTIC /begin REF_MEASUREMENT VAR_Cspf_TrabDernStrTemp_u8 /end REF_MEASUREMENT /end GROUP
/begin GROUP S14_Subsystem5 "SWC_CSPF/RE_SWC_CSPF_100ms_sys/CSPF_Tra_100ms/CSDTra_100ms/PEB02/Subsystem5"
 /begin REF_CHARACTERISTIC CAL_Cspf_bDernCoolantTemp_u8 CAL_Cspf_flgbDernCoolantTempSwt_b /end REF_CHARACTERISTIC
 /begin REF_MEASUREMENT VAR_Cspf_TrabDernTempCooL_u8 /end REF_MEASUREMENT
/end GROUP
/begin GROUP S14_Subsystem6 "SWC_CSPF/RE_SWC_CSPF_100ms_sys/CSPF_Tra_100ms/CSDTra_100ms/PEB02/Subsystem6" /begin REF_CHARACTERISTIC CAL_Cspf_bDernDbcTemp_u8 CAL_Cspf_flgbDernDbcTempSwt_b /end REF_CHARACTERISTIC /begin REF_MEASUREMENT VAR_Cspf_TrabDernTempiGBT_u8 /end REF_MEASUREMENT /end GROUP
/begin GROUP S14_Subsystem7 "SWC_CSPF/RE_SWC_CSPF_100ms_sys/CSPF_Tra_100ms/CSDTra_100ms/PEB02/Subsystem7" /begin REF_CHARACTERISTIC CAL_Cspf_bDernExcMax_u8 CAL_Cspf_flgbDernExcMaxSwt_b /end REF_CHARACTERISTIC /begin REF_MEASUREMENT VAR_Cspf_TrabDernTrqMax_u8 /end REF_MEASUREMENT /end GROUP
/begin GROUP S14_Subsystem8 "SWC_CSPF/RE_SWC_CSPF_100ms_sys/CSPF_Tra_100ms/CSDTra_100ms/PEB02/Subsystem8" /begin REF_CHARACTERISTIC CAL_Cspf_bDernExcMin_u8 CAL_Cspf_flgbDernExcMinSwt_b /end REF_CHARACTERISTIC /begin REF_MEASUREMENT VAR_Cspf_TrabDernTrqMin_u8 /end REF_MEASUREMENT /end GROUP
/begin GROUP S14_Subsystem9 "SWC_CSPF/RE_SWC_CSPF_100ms_sys/CSPF_Tra_100ms/CSDTra_100ms/PEB02/Subsystem9" /begin REF_CHARACTERISTIC CAL_Cspf_bDernUndrUdc_u8 CAL_Cspf_flgbDernUndrUdcSwt_b /end REF_CHARACTERISTIC /begin REF_MEASUREMENT VAR_Cspf_TrabDernUndrUdc_u8 /end REF_MEASUREMENT /end GROUP
/begin GROUP S32_Subsystem18 "SWC_CSPF/RE_SWC_CSPF_100ms_sys/CSPF_Tra_100ms/CSDTra_100ms_sub2/PEB05/Subsystem18" /begin REF_CHARACTERISTIC CAL_Cspf_FailCode1_u8 CAL_Cspf_flgFailCode1Swt_b /end REF_CHARACTERISTIC /begin REF_MEASUREMENT VAR_Cspf_TraFailCode1_u8 /end REF_MEASUREMENT /end GROUP
/begin GROUP S32_Subsystem19 "SWC_CSPF/RE_SWC_CSPF_100ms_sys/CSPF_Tra_100ms/CSDTra_100ms_sub2/PEB05/Subsystem19" /begin REF_CHARACTERISTIC CAL_Cspf_FailCode2_u8 CAL_Cspf_flgFailCode2Swt_b /end REF_CHARACTERISTIC /begin REF_MEASUREMENT VAR_Cspf_TraFailCode2_u8 /end REF_MEASUREMENT /end GROUP
/begin GROUP S32_Subsystem20 "SWC_CSPF/RE_SWC_CSPF_100ms_sys/CSPF_Tra_100ms/CSDTra_100ms_sub2/PEB05/Subsystem20" /begin REF_CHARACTERISTIC CAL_Cspf_FailCode3_u8 CAL_Cspf_flgFailCode3Swt_b /end REF_CHARACTERISTIC /begin REF_MEASUREMENT VAR_Cspf_TraFailCode3_u8 /end REF_MEASUREMENT /end GROUP
/begin GROUP S32_Subsystem21 "SWC_CSPF/RE_SWC_CSPF_100ms_sys/CSPF_Tra_100ms/CSDTra_100ms_sub2/PEB05/Subsystem21" /begin REF_CHARACTERISTIC CAL_Cspf_FailCode4_u8 CAL_Cspf_flgFailCode4Swt_b /end REF_CHARACTERISTIC /begin REF_MEASUREMENT VAR_Cspf_TraFailCode4_u8 /end REF_MEASUREMENT /end GROUP
/begin GROUP S32_Subsystem22 "SWC_CSPF/RE_SWC_CSPF_100ms_sys/CSPF_Tra_100ms/CSDTra_100ms_sub2/PEB05/Subsystem22" /begin REF_CHARACTERISTIC CAL_Cspf_FailCode5_u8 CAL_Cspf_flgFailCode5Swt_b /end REF_CHARACTERISTIC /begin REF_MEASUREMENT VAR_Cspf_TraFailCode5_u8 /end REF_MEASUREMENT /end GROUP
/begin GROUP S32_Subsystem23 "SWC_CSPF/RE_SWC_CSPF_100ms_sys/CSPF_Tra_100ms/CSDTra_100ms_sub2/PEB05/Subsystem23" /begin REF_CHARACTERISTIC CAL_Cspf_FailCode6_u8 CAL_Cspf_flgFailCode6Swt_b /end REF_CHARACTERISTIC /begin REF_MEASUREMENT VAR_Cspf_TraFailCode6_u8 /end REF_MEASUREMENT /end GROUP
/begin GROUP S32_Subsystem24 "SWC_CSPF/RE_SWC_CSPF_100ms_sys/CSPF_Tra_100ms/CSDTra_100ms_sub2/PEB05/Subsystem24" /begin REF_CHARACTERISTIC CAL_Cspf_FailCode7_u8 CAL_Cspf_flgFailCode7Swt_b /end REF_CHARACTERISTIC /begin REF_MEASUREMENT VAR_Cspf_TraFailCode7_u8 /end REF_MEASUREMENT /end GROUP
/begin GROUP S32_Subsystem25 "SWC_CSPF/RE_SWC_CSPF_100ms_sys/CSPF_Tra_100ms/CSDTra_100ms_sub2/PEB05/Subsystem25" /begin REF_CHARACTERISTIC CAL_Cspf_FailCode8_u8 CAL_Cspf_flgFailCode8Swt_b /end REF_CHARACTERISTIC /begin REF_MEASUREMENT VAR_Cspf_TraFailCode8_u8 /end REF_MEASUREMENT /end GROUP
/begin GROUP S33_Subsystem26 "SWC_CSPF/RE_SWC_CSPF_100ms_sys/CSPF_Tra_100ms/CSDTra_100ms_sub2/PEB06/Subsystem26" /begin REF_CHARACTERISTIC CAL_Cspf_CpldVer_u8 CAL_Cspf_flgCpldVerSwt_b /end REF_CHARACTERISTIC /begin REF_MEASUREMENT VAR_Cspf_TraCpldVer_u16 /end REF_MEASUREMENT /end GROUP
/begin GROUP S33_Subsystem27 "SWC_CSPF/RE_SWC_CSPF_100ms_sys/CSPF_Tra_100ms/CSDTra_100ms_sub2/PEB06/Subsystem27" /begin REF_CHARACTERISTIC CAL_Cspf_HvMcuVer_u8 CAL_Cspf_flgHvMcuVerSwt_b /end REF_CHARACTERISTIC /begin REF_MEASUREMENT VAR_Cspf_TraHvMcuVer_u16 /end REF_MEASUREMENT /end GROUP
/begin GROUP S48_Subsystem26 "SWC_CSPF/RE_SWC_CSPF_10ms_sys/CSPF_Rec_10ms/CanSig_Select/BMS01/Subsystem26" /begin REF_CHARACTERISTIC CAL_Cspf_MainReLay_u8 CAL_Cspf_flgstMainReLaySwt_b /end REF_CHARACTERISTIC /end GROUP
/begin GROUP S51_Subsystem "SWC_CSPF/RE_SWC_CSPF_10ms_sys/CSPF_Rec_10ms/CanSig_Select/VCU02/Subsystem" /begin REF_CHARACTERISTIC CAL_Cspf_KpHighNCtL_f32 CAL_Cspf_flgKpHighNCtLSwt_b /end REF_CHARACTERISTIC /end GROUP
/begin GROUP S51_Subsystem1 "SWC_CSPF/RE_SWC_CSPF_10ms_sys/CSPF_Rec_10ms/CanSig_Select/VCU02/Subsystem1" /begin REF_CHARACTERISTIC CAL_Cspf_NDiffMax_f32 CAL_Cspf_flgNDiffMaxSwt_b /end REF_CHARACTERISTIC /end GROUP
/begin GROUP S51_Subsystem2 "SWC_CSPF/RE_SWC_CSPF_10ms_sys/CSPF_Rec_10ms/CanSig_Select/VCU02/Subsystem2" /begin REF_CHARACTERISTIC CAL_Cspf_TrqMaxNCtL_f32 CAL_Cspf_flgTrqMaxNCtLSwt_b /end REF_CHARACTERISTIC /end GROUP
/begin GROUP S51_Subsystem24 "SWC_CSPF/RE_SWC_CSPF_10ms_sys/CSPF_Rec_10ms/CanSig_Select/VCU02/Subsystem24" /begin REF_CHARACTERISTIC CAL_Cspf_KpLowNCtl_f32 CAL_Cspf_flgKpLowNCtlSwt_b /end REF_CHARACTERISTIC /end GROUP
/begin GROUP S51_Subsystem3 "SWC_CSPF/RE_SWC_CSPF_10ms_sys/CSPF_Rec_10ms/CanSig_Select/VCU02/Subsystem3" /begin REF_CHARACTERISTIC CAL_Cspf_TrqMinNCtl_f32 CAL_Cspf_flgTrqMinNCtlSwt_b /end REF_CHARACTERISTIC /end GROUP
/begin GROUP S52_Subsystem4 "SWC_CSPF/RE_SWC_CSPF_10ms_sys/CSPF_Rec_10ms/CanSig_Select/VCU03/Subsystem4" /begin REF_CHARACTERISTIC CAL_Cspf_TrqSLope_f32 CAL_Cspf_flgcTrqSLopeSwt_b /end REF_CHARACTERISTIC /end GROUP
/begin GROUP S52_Subsystem5 "SWC_CSPF/RE_SWC_CSPF_10ms_sys/CSPF_Rec_10ms/CanSig_Select/VCU03/Subsystem5" /begin REF_CHARACTERISTIC CAL_Cspf_TrqMax_f32 CAL_Cspf_flgTrqMaxSwt_b /end REF_CHARACTERISTIC /end GROUP
/begin GROUP S52_Subsystem6 "SWC_CSPF/RE_SWC_CSPF_10ms_sys/CSPF_Rec_10ms/CanSig_Select/VCU03/Subsystem6" /begin REF_CHARACTERISTIC CAL_Cspf_TrqMin_f32 CAL_Cspf_flgTrqMinSwt_b /end REF_CHARACTERISTIC /end GROUP
/begin GROUP S53_Subsystem10 "SWC_CSPF/RE_SWC_CSPF_10ms_sys/CSPF_Rec_10ms/CanSig_Select/VCU04/Subsystem10" /begin REF_CHARACTERISTIC CAL_Cspf_flgstModeReqSwt_b CAL_Cspf_stModeReq_u8 /end REF_CHARACTERISTIC /end GROUP
/begin GROUP S53_Subsystem11 "SWC_CSPF/RE_SWC_CSPF_10ms_sys/CSPF_Rec_10ms/CanSig_Select/VCU04/Subsystem11" /begin REF_CHARACTERISTIC CAL_Cspf_TrqSetP_f32 CAL_Cspf_flgTrqSetPSwt_b /end REF_CHARACTERISTIC /end GROUP
/begin GROUP S53_Subsystem9 "SWC_CSPF/RE_SWC_CSPF_10ms_sys/CSPF_Rec_10ms/CanSig_Select/VCU04/Subsystem9" /begin REF_CHARACTERISTIC CAL_Cspf_NSetP_f32 CAL_Cspf_flgNSetPSwt_b /end REF_CHARACTERISTIC /end GROUP
/begin GROUP S54_Subsystem13 "SWC_CSPF/RE_SWC_CSPF_10ms_sys/CSPF_Rec_10ms/CanSig_Select/VCU05/Subsystem13" /begin REF_CHARACTERISTIC CAL_Cspf_flgkDmpSwt_b CAL_Cspf_kDmp_f32 /end REF_CHARACTERISTIC /end GROUP
/begin GROUP S54_Subsystem15 "SWC_CSPF/RE_SWC_CSPF_10ms_sys/CSPF_Rec_10ms/CanSig_Select/VCU05/Subsystem15" /begin REF_CHARACTERISTIC CAL_Cspf_flgstDmpCtLReqSwt_b CAL_Cspf_stDmpCtLReq_u8 /end REF_CHARACTERISTIC /end GROUP
/begin GROUP S54_Subsystem16 "SWC_CSPF/RE_SWC_CSPF_10ms_sys/CSPF_Rec_10ms/CanSig_Select/VCU05/Subsystem16" /begin REF_CHARACTERISTIC CAL_Cspf_TrqDmpLim_f32 CAL_Cspf_flgTrqDmpMinSwt_b /end REF_CHARACTERISTIC /end GROUP
/begin GROUP S54_Subsystem17 "SWC_CSPF/RE_SWC_CSPF_10ms_sys/CSPF_Rec_10ms/CanSig_Select/VCU05/Subsystem17" /begin REF_CHARACTERISTIC CAL_Cspf_TrqDmpMax_f32 CAL_Cspf_flgTrqDmpMaxSwt_b /end REF_CHARACTERISTIC /end GROUP
/begin GROUP S78_Subsystem1 "SWC_CSPF/RE_SWC_CSPF_10ms_sys/CSPF_Tra_10ms/CSPFTra_10ms/PEB01/Subsystem1" /begin REF_CHARACTERISTIC CAL_Cspf_flgnSlowFltSwt_b CAL_Cspf_nSlowFlt_f32 /end REF_CHARACTERISTIC /begin REF_MEASUREMENT VAR_Cspf_TraNCurr_f32 /end REF_MEASUREMENT /end GROUP
/begin GROUP S78_Subsystem2 "SWC_CSPF/RE_SWC_CSPF_10ms_sys/CSPF_Tra_10ms/CSPFTra_10ms/PEB01/Subsystem2" /begin REF_CHARACTERISTIC CAL_Cspf_TrqMechFlt_f32 CAL_Cspf_flgTrqMechFltSwt_b /end REF_CHARACTERISTIC /begin REF_MEASUREMENT VAR_Cspf_TraTrqCurr_f32 /end REF_MEASUREMENT /end GROUP
/begin GROUP S78_Subsystem3 "SWC_CSPF/RE_SWC_CSPF_10ms_sys/CSPF_Tra_10ms/CSPFTra_10ms/PEB01/Subsystem3" /begin REF_CHARACTERISTIC CAL_Cspf_flguDcLnkSlowFltSwt_b CAL_Cspf_uDcLnkSlowFlt_f32 /end REF_CHARACTERISTIC /begin REF_MEASUREMENT VAR_Cspf_TraUdcCurr_f32 /end REF_MEASUREMENT /end GROUP
/begin GROUP S78_Subsystem4 "SWC_CSPF/RE_SWC_CSPF_10ms_sys/CSPF_Tra_10ms/CSPFTra_10ms/PEB01/Subsystem4" /begin REF_CHARACTERISTIC CAL_Cspf_IsFlt_f32 CAL_Cspf_flgIsFltSwt_b /end REF_CHARACTERISTIC /begin REF_MEASUREMENT VAR_Cspf_TraisCurr_f32 /end REF_MEASUREMENT /end GROUP
/begin GROUP S78_stMode "SWC_CSPF/RE_SWC_CSPF_10ms_sys/CSPF_Tra_10ms/CSPFTra_10ms/PEB01/stMode" /begin SUB_GROUP S87_Subsystem10 /end SUB_GROUP /end GROUP
/begin GROUP S79_Subsystem10 "SWC_CSPF/RE_SWC_CSPF_10ms_sys/CSPF_Tra_10ms/CSPFTra_10ms/PEB03/Subsystem10" /begin REF_CHARACTERISTIC CAL_Cspf_flgtStrrTemp2FltSwt_b CAL_Cspf_tStrrTemp2Flt_f32 /end REF_CHARACTERISTIC /begin REF_MEASUREMENT VAR_Cspf_TraTempCurrStr2_f32 /end REF_MEASUREMENT /end GROUP
/begin GROUP S79_Subsystem5 "SWC_CSPF/RE_SWC_CSPF_10ms_sys/CSPF_Tra_10ms/CSPFTra_10ms/PEB03/Subsystem5" /begin REF_CHARACTERISTIC CAL_Cspf_flgtDBCTempUFltSwt_b CAL_Cspf_tDBCTempUFlt_f32 /end REF_CHARACTERISTIC /begin REF_MEASUREMENT VAR_Cspf_TraiGBTTempU_f32 /end REF_MEASUREMENT /end GROUP
/begin GROUP S79_Subsystem6 "SWC_CSPF/RE_SWC_CSPF_10ms_sys/CSPF_Tra_10ms/CSPFTra_10ms/PEB03/Subsystem6" /begin REF_CHARACTERISTIC CAL_Cspf_flgtDBCTempVFltSwt_b CAL_Cspf_tDBCTempVFlt_f32 /end REF_CHARACTERISTIC /begin REF_MEASUREMENT VAR_Cspf_TraiGBTTempV_f32 /end REF_MEASUREMENT /end GROUP
/begin GROUP S79_Subsystem7 "SWC_CSPF/RE_SWC_CSPF_10ms_sys/CSPF_Tra_10ms/CSPFTra_10ms/PEB03/Subsystem7" /begin REF_CHARACTERISTIC CAL_Cspf_flgtDBCTempWFltSwt_b CAL_Cspf_tDBCTempWFlt_f32 /end REF_CHARACTERISTIC /begin REF_MEASUREMENT VAR_Cspf_TraiGBTTempW_f32 /end REF_MEASUREMENT /end GROUP
/begin GROUP S79_Subsystem9 "SWC_CSPF/RE_SWC_CSPF_10ms_sys/CSPF_Tra_10ms/CSPFTra_10ms/PEB03/Subsystem9" /begin REF_CHARACTERISTIC CAL_Cspf_flgtStrrTemp1FltSwt_b CAL_Cspf_tStrrTemp1Flt_f32 /end REF_CHARACTERISTIC /begin REF_MEASUREMENT VAR_Cspf_TraTempCurrStr1_f32 /end REF_MEASUREMENT /end GROUP
/begin GROUP S80_Subsystem11 "SWC_CSPF/RE_SWC_CSPF_10ms_sys/CSPF_Tra_10ms/CSPFTra_10ms/PEB04/Subsystem11" /begin REF_CHARACTERISTIC CAL_Cspf_agRtrEe_f32 CAL_Cspf_flgagRtrEeSwt_b /end REF_CHARACTERISTIC /begin REF_MEASUREMENT VAR_Cspf_TraagRtrELecSnsr_f32 /end REF_MEASUREMENT /end GROUP
/begin GROUP S80_Subsystem12 "SWC_CSPF/RE_SWC_CSPF_10ms_sys/CSPF_Tra_10ms/CSPFTra_10ms/PEB04/Subsystem12" /begin REF_CHARACTERISTIC CAL_Cspf_flgOfsClbSucSwt_b CAL_Cspf_flgOfsClbSuc_u8 /end REF_CHARACTERISTIC /begin REF_MEASUREMENT VAR_Cspf_TraflgOfsClbSuc_u8 /end REF_MEASUREMENT /end GROUP
/begin GROUP S80_Subsystem13 "SWC_CSPF/RE_SWC_CSPF_10ms_sys/CSPF_Tra_10ms/CSPFTra_10ms/PEB04/Subsystem13" /begin REF_CHARACTERISTIC CAL_Cspf_flgiDActSlowFltSwt_b CAL_Cspf_iDActSlowFlt_f32 /end REF_CHARACTERISTIC /begin REF_MEASUREMENT VAR_Cspf_Traisd_f32 /end REF_MEASUREMENT /end GROUP
/begin GROUP S80_Subsystem14 "SWC_CSPF/RE_SWC_CSPF_10ms_sys/CSPF_Tra_10ms/CSPFTra_10ms/PEB04/Subsystem14" /begin REF_CHARACTERISTIC CAL_Cspf_flgiQActSlowFltSwt_b CAL_Cspf_iQActSlowFlt_f32 /end REF_CHARACTERISTIC /begin REF_MEASUREMENT VAR_Cspf_Traisq_f32 /end REF_MEASUREMENT /end GROUP
/begin GROUP S80_Subsystem15 "SWC_CSPF/RE_SWC_CSPF_10ms_sys/CSPF_Tra_10ms/CSPFTra_10ms/PEB04/Subsystem15" /begin REF_CHARACTERISTIC CAL_Cspf_agOffset_f32 CAL_Cspf_flgagOffsetSwt_b /end REF_CHARACTERISTIC /begin REF_MEASUREMENT VAR_Cspf_TraOfsAL_f32 /end REF_MEASUREMENT /end GROUP
/begin GROUP S80_Subsystem16 "SWC_CSPF/RE_SWC_CSPF_10ms_sys/CSPF_Tra_10ms/CSPFTra_10ms/PEB04/Subsystem16" /begin REF_CHARACTERISTIC CAL_Cspf_TrqCurrWoDmpC_f32 CAL_Cspf_flgTrqCurrWoDmpCSwt_b /end REF_CHARACTERISTIC /begin REF_MEASUREMENT VAR_Cspf_TraTrqCurrWoDmpC_f32 /end REF_MEASUREMENT /end GROUP
/begin GROUP S80_stGateDrv "SWC_CSPF/RE_SWC_CSPF_10ms_sys/CSPF_Tra_10ms/CSPFTra_10ms/PEB04/stGateDrv" /begin SUB_GROUP S100_Subsystem10 /end SUB_GROUP /end GROUP
/begin GROUP S81_Subsystem17 "SWC_CSPF/RE_SWC_CSPF_10ms_sys/CSPF_Tra_10ms/CSPFTra_10ms/PEB08/Subsystem17" /begin REF_CHARACTERISTIC CAL_Cspf_flgstDisChgSwt_b CAL_Cspf_stDisChg_u8 /end REF_CHARACTERISTIC /begin REF_MEASUREMENT VAR_Cspf_TrastDischg_u8 /end REF_MEASUREMENT /end GROUP
/begin GROUP S81_Subsystem18 "SWC_CSPF/RE_SWC_CSPF_10ms_sys/CSPF_Tra_10ms/CSPFTra_10ms/PEB08/Subsystem18" /begin REF_CHARACTERISTIC CAL_Cspf_HwVer_u16 CAL_Cspf_flgHwVerSwt_b /end REF_CHARACTERISTIC /begin REF_MEASUREMENT VAR_Cspf_TraHwVer_u16 /end REF_MEASUREMENT /end GROUP
/begin GROUP S87_Subsystem10 "SWC_CSPF/RE_SWC_CSPF_10ms_sys/CSPF_Tra_10ms/CSPFTra_10ms/PEB01/stMode/Subsystem10" /begin REF_CHARACTERISTIC CAL_Cspf_flgstModeSwt_b CAL_Cspf_stMode_u8 /end REF_CHARACTERISTIC /begin REF_MEASUREMENT VAR_Cspf_TrastMode_u8 /end REF_MEASUREMENT /end GROUP
/begin GROUP S100_Subsystem10 "SWC_CSPF/RE_SWC_CSPF_10ms_sys/CSPF_Tra_10ms/CSPFTra_10ms/PEB04/stGateDrv/Subsystem10" /begin REF_CHARACTERISTIC CAL_Cspf_flgstGateDrvSwt_b CAL_Cspf_stGateDrv_u8 /end REF_CHARACTERISTIC /begin REF_MEASUREMENT VAR_Cspf_TrastGateDrv_u8 /end REF_MEASUREMENT /end GROUP
/begin GROUP SWC_FRP "SWC_FRP" ROOT /begin SUB_GROUP Root_SWC_FRM_1ms_sys /end SUB_GROUP /end GROUP
/begin GROUP Root_SWC_FRM_1ms_sys "SWC_FRP/SWC_FRM_1ms_sys" /begin SUB_GROUP S1_FaultInfoGen S1_FaultReactGen /end SUB_GROUP /end GROUP
/begin GROUP S1_FaultInfoGen "SWC_FRP/SWC_FRM_1ms_sys/FaultInfoGen" /begin REF_MEASUREMENT VAR_FRP_FaultInfo_u32 /end REF_MEASUREMENT /end GROUP
/begin GROUP S1_FaultReactGen "SWC_FRP/SWC_FRM_1ms_sys/FaultReactGen"
 /begin REF_CHARACTERISTIC CAL_FRP_18VHSVoltRngErrOutCtl_b CAL_FRP_1V8CPLDVoltRngErrOutCtl_b CAL_FRP_3V3CPLDVoltRngErrOutCtl_b CAL_FRP_BMSVoltRngErrOutCtl_b CAL_FRP_CurrRngErrOutCtl_b CAL_FRP_CurrSumErrOutCtl_b CAL_FRP_FaultReactCtl_b CAL_FRP_ModeReqRngErrOutCtl_b CAL_FRP_NSetPRngErrOutCtl_b CAL_FRP_OffsetRngErrrOutCtl_b CAL_FRP_RslvExciRngErrOutCtl_b CAL_FRP_RslvRngErrOutCtl_b CAL_FRP_RslvSensVolRngErrOutCtl_b CAL_FRP_RslvSqrtErrOutCtl_b CAL_FRP_TrqCalcErrOutCtl_b CAL_FRP_TrqSetPRngErrOutCtl_b CAL_FRP_UBRVoltRngErrOutCtl_b CAL_FRP_UintndSpdErrOutCtl_b CAL_FRP_UintndTrqErrOutCtl_b CAL_FRP_VoltCmpChkErrOutCtl_b CAL_FRP_iPhasSensVolRngErrOutCtl_b /end REF_CHARACTERISTIC
 /begin REF_MEASUREMENT VAR_FRP_FaultReact_b /end REF_MEASUREMENT
/end GROUP
/begin GROUP SWC_HSPF "SWC_HSPF" ROOT /begin SUB_GROUP Root_RE_SWC_HSPF_10ms_sys /end SUB_GROUP /end GROUP
/begin GROUP Root_RE_SWC_HSPF_10ms_sys "SWC_HSPF/RE_SWC_HSPF_10ms_sys"
 /begin REF_MEASUREMENT VAR_Bsw_Crash_b VAR_Bsw_Hwver_f32 VAR_Bsw_INV_Open_b VAR_Bsw_Motor_Open_b VAR_Bsw_Wake_b VAR_Bsw_bt15_b VAR_Bsw_tCoolantTemp_f32 VAR_Hspf_uKl30_f32 /end REF_MEASUREMENT
 /begin SUB_GROUP S1_Subsystem /end SUB_GROUP
/end GROUP
/begin GROUP S1_Subsystem "SWC_HSPF/RE_SWC_HSPF_10ms_sys/Subsystem"
 /begin SUB_GROUP S3_HSPF_GsDia S3_HSPF_SelfTest S3_HSPF_SigDebounce S3_HSPF_TjProcess S3_HSPF_VerChk S3_SPF_SigFlt /end SUB_GROUP
/end GROUP
/begin GROUP S3_HSPF_GsDia "SWC_HSPF/RE_SWC_HSPF_10ms_sys/Subsystem/HSPF_GsDia" /begin SUB_GROUP S4_HSPF_sttrTempDia S4_HSPF_tDBCTempDia /end SUB_GROUP /end GROUP
/begin GROUP S3_HSPF_SelfTest "SWC_HSPF/RE_SWC_HSPF_10ms_sys/Subsystem/HSPF_SelfTest" /begin SUB_GROUP S5_IPhaSenOffCal1 /end SUB_GROUP /end GROUP
/begin GROUP S3_HSPF_SigDebounce "SWC_HSPF/RE_SWC_HSPF_10ms_sys/Subsystem/HSPF_SigDebounce"
 /begin SUB_GROUP S6_HSPF_CrashDebounce S6_HSPF_INV_OpenDebounce S6_HSPF_Motor_OpenDebounce S6_HSPF_WakeDebounce S6_HSPF_bt15Debounce /end SUB_GROUP
/end GROUP
/begin GROUP S3_HSPF_TjProcess "SWC_HSPF/RE_SWC_HSPF_10ms_sys/Subsystem/HSPF_TjProcess" /begin REF_CHARACTERISTIC CAL_Hspf_TmpCoolanTjFltFrq_f32 /end REF_CHARACTERISTIC /begin SUB_GROUP S7_HSPF_tDBCTempUFilter /end SUB_GROUP /end GROUP
/begin GROUP S3_HSPF_VerChk "SWC_HSPF/RE_SWC_HSPF_10ms_sys/Subsystem/HSPF_VerChk" /begin REF_CHARACTERISTIC CAL_Hspf_VerMatchUncheck_u8 /end REF_CHARACTERISTIC /begin SUB_GROUP S8_HspfVerChk /end SUB_GROUP /end GROUP
/begin GROUP S3_SPF_SigFlt "SWC_HSPF/RE_SWC_HSPF_10ms_sys/Subsystem/SPF_SigFlt"
 /begin REF_CHARACTERISTIC CAL_Hspf_CltInletTempFltFrq_f32 CAL_Hspf_TmpUFltFrq_f32 CAL_Hspf_TmpVFltFrq_f32 CAL_Hspf_TmpWFltFrq_f32 CAL_Hspf_iDcLnkEstFltFrq_f32 CAL_Hspf_nFltFrq_f32 CAL_Hspf_tCoolantFltFrq_f32 CAL_Hspf_tStrrTmp1FltFrq_f32 CAL_Hspf_tStrrTmp2FltFrq_f32 CAL_Hspf_uDcLnkFltFrq_f32 CAL_Hspf_uKl30FltFrq_f32 /end REF_CHARACTERISTIC
 /begin REF_MEASUREMENT VAR_Bsw_tDBCTempU_u16 VAR_Bsw_tDBCTempV_u16 VAR_Bsw_tDBCTempW_u16 VAR_Bsw_tDrvBoardTemp_u16 VAR_Bsw_tStrrTemp1_u16 VAR_Bsw_tStrrTemp2_u16 VAR_Hspf_uDcLnk_f32 /end REF_MEASUREMENT
 /begin SUB_GROUP S9_DrvBoardTemp S9_HSPF_nFilter S9_HSPF_tCoolantFilter S9_HSPF_tCoolantFilter2 S9_HSPF_tCoolantTemp S9_HSPF_tDBCTempUCnv S9_HSPF_tDBCTempUFilter S9_HSPF_tDBCTempVCnv S9_HSPF_tDBCTempVFilter S9_HSPF_tDBCTempWFilter S9_HSPF_tDrvBoardTemp S9_HSPF_tStrrTemp1Filter S9_HSPF_tStrrTemp2Filter S9_HSPF_tSttrTemp2Cnv S9_HSPF_uDcLnkFilter S9_HSPF_uKl30Filter S9_SPF_tDBCTempWCnv S9_SPF_tSttrTemp1Cnv /end SUB_GROUP
/end GROUP
/begin GROUP S4_HSPF_sttrTempDia "SWC_HSPF/RE_SWC_HSPF_10ms_sys/Subsystem/HSPF_GsDia/HSPF_sttrTempDia" /begin REF_MEASUREMENT VAR_Hspf_flgSttr1NoErr_b VAR_Hspf_flgSttr2NoErr_b /end REF_MEASUREMENT /end GROUP
/begin GROUP S4_HSPF_tDBCTempDia "SWC_HSPF/RE_SWC_HSPF_10ms_sys/Subsystem/HSPF_GsDia/HSPF_tDBCTempDia" /begin REF_CHARACTERISTIC CAL_Hspf_tDBCtempOffset_u8 /end REF_CHARACTERISTIC /begin SUB_GROUP S12_ErrDelay /end SUB_GROUP /end GROUP
/begin GROUP S5_IPhaSenOffCal1 "SWC_HSPF/RE_SWC_HSPF_10ms_sys/Subsystem/HSPF_SelfTest/IPhaSenOffCal1"
 /begin REF_CHARACTERISTIC CAL_Hspf_cntIPhCalOffTolCnt_u16 CAL_Hspf_cntIPhCalOffValCnt_u16 CAL_Hspf_iPhaHighSet_u16 CAL_Hspf_iPhaLowSet_u16 CAL_Hspf_stPreDrvCtl_u8 /end REF_CHARACTERISTIC
/end GROUP
/begin GROUP S6_HSPF_CrashDebounce "SWC_HSPF/RE_SWC_HSPF_10ms_sys/Subsystem/HSPF_SigDebounce/HSPF_CrashDebounce"
 /begin REF_CHARACTERISTIC CAL_Hspf_CrashChkAddCnt_u8 CAL_Hspf_CrashChkCntHiLim_u8 CAL_Hspf_CrashChkCntLoLim_s8 CAL_Hspf_CrashChkSubCnt_s8 /end REF_CHARACTERISTIC
/end GROUP
/begin GROUP S6_HSPF_INV_OpenDebounce "SWC_HSPF/RE_SWC_HSPF_10ms_sys/Subsystem/HSPF_SigDebounce/HSPF_INV_OpenDebounce"
 /begin REF_CHARACTERISTIC CAL_Hspf_INVOpenChkAddCnt_u8 CAL_Hspf_INVOpenChkCntHiLim_u8 CAL_Hspf_INVOpenChkCntLoLim_s8 CAL_Hspf_INVOpenChkSubCnt_s8 /end REF_CHARACTERISTIC
/end GROUP
/begin GROUP S6_HSPF_Motor_OpenDebounce "SWC_HSPF/RE_SWC_HSPF_10ms_sys/Subsystem/HSPF_SigDebounce/HSPF_Motor_OpenDebounce"
 /begin REF_CHARACTERISTIC CAL_Hspf_MotorOpenChkAddCnt_u8 CAL_Hspf_MotorOpenChkCntHiLim_u8 CAL_Hspf_MotorOpenChkCntLoLim_s8 CAL_Hspf_MototOpenChkSubCnt_s8 /end REF_CHARACTERISTIC
/end GROUP
/begin GROUP S6_HSPF_WakeDebounce "SWC_HSPF/RE_SWC_HSPF_10ms_sys/Subsystem/HSPF_SigDebounce/HSPF_WakeDebounce"
 /begin REF_CHARACTERISTIC CAL_Hspf_bt15ChkAddCnt_u8 CAL_Hspf_bt15ChkCntHiLim_u8 CAL_Hspf_bt15ChkCntLoLim_s8 CAL_Hspf_bt15ChkSubCnt_s8 /end REF_CHARACTERISTIC
/end GROUP
/begin GROUP S6_HSPF_bt15Debounce "SWC_HSPF/RE_SWC_HSPF_10ms_sys/Subsystem/HSPF_SigDebounce/HSPF_bt15Debounce"
 /begin REF_CHARACTERISTIC CAL_Hspf_bt15ChkAddCnt_u8 CAL_Hspf_bt15ChkCntHiLim_u8 CAL_Hspf_bt15ChkCntLoLim_s8 CAL_Hspf_bt15ChkSubCnt_s8 /end REF_CHARACTERISTIC
/end GROUP
/begin GROUP S7_HSPF_tDBCTempUFilter "SWC_HSPF/RE_SWC_HSPF_10ms_sys/Subsystem/HSPF_TjProcess/HSPF_tDBCTempUFilter" /begin REF_CHARACTERISTIC CAL_Hspf_Multiple_u8 /end REF_CHARACTERISTIC /end GROUP
/begin GROUP S8_HspfVerChk "SWC_HSPF/RE_SWC_HSPF_10ms_sys/Subsystem/HSPF_VerChk/HspfVerChk"
 /begin REF_CHARACTERISTIC CAL_Hspf_CodeCpldSwMatchTable_af32 CAL_Hspf_CodeDataMatchTable_af32 CAL_Hspf_CodeHvMcuMatchTable_af32 CAL_Hspf_HwAnalHwVerMatchTable_af32 CAL_Hspf_ProjectNumMatchTable_af32 CAL_Hspf_VerChkTime_u16 CAL_Hspf_VerMatchFailure_u8 CAL_Hspf_VerMatchSucceed_u8 CAL_Hspf_VerMatchTimeOutErr_u8 CAL_Hspf_VerMatchUncheck_u8 /end REF_CHARACTERISTIC
 /begin REF_MEASUREMENT VAR_Hspf_HWVer_u8 VAR_Hspf_VerMatchFailureErr_u8 VAR_Hspf_stVerChk_u8 /end REF_MEASUREMENT
/end GROUP
/begin GROUP S9_DrvBoardTemp "SWC_HSPF/RE_SWC_HSPF_10ms_sys/Subsystem/SPF_SigFlt/DrvBoardTemp" /begin REF_MEASUREMENT VAR_Hspf_tDrvBoardTemp_f32 /end REF_MEASUREMENT /end GROUP
/begin GROUP S9_HSPF_nFilter "SWC_HSPF/RE_SWC_HSPF_10ms_sys/Subsystem/SPF_SigFlt/HSPF_nFilter" /begin REF_CHARACTERISTIC CAL_Hspf_Multiple_u8 /end REF_CHARACTERISTIC /end GROUP
/begin GROUP S9_HSPF_tCoolantFilter "SWC_HSPF/RE_SWC_HSPF_10ms_sys/Subsystem/SPF_SigFlt/HSPF_tCoolantFilter" /begin REF_CHARACTERISTIC CAL_Hspf_Multiple_u8 /end REF_CHARACTERISTIC /end GROUP
/begin GROUP S9_HSPF_tCoolantFilter2 "SWC_HSPF/RE_SWC_HSPF_10ms_sys/Subsystem/SPF_SigFlt/HSPF_tCoolantFilter2" /begin REF_CHARACTERISTIC CAL_Hspf_Multiple_u8 /end REF_CHARACTERISTIC /end GROUP
/begin GROUP S9_HSPF_tCoolantTemp "SWC_HSPF/RE_SWC_HSPF_10ms_sys/Subsystem/SPF_SigFlt/HSPF_tCoolantTemp" /begin REF_MEASUREMENT VAR_Hspf_tCoolantTemp_f32 /end REF_MEASUREMENT /end GROUP
/begin GROUP S9_HSPF_tDBCTempUCnv "SWC_HSPF/RE_SWC_HSPF_10ms_sys/Subsystem/SPF_SigFlt/HSPF_tDBCTempUCnv" /begin REF_CHARACTERISTIC CAL_Hspf_DBCTempROCLimChkCnt_u8 CAL_Hspf_tDBCTempROCLim_u8 /end REF_CHARACTERISTIC /begin REF_MEASUREMENT VAR_Hspf_tDBCTempU_f32 /end REF_MEASUREMENT /end GROUP
/begin GROUP S9_HSPF_tDBCTempUFilter "SWC_HSPF/RE_SWC_HSPF_10ms_sys/Subsystem/SPF_SigFlt/HSPF_tDBCTempUFilter" /begin REF_CHARACTERISTIC CAL_Hspf_Multiple_u8 /end REF_CHARACTERISTIC /end GROUP
/begin GROUP S9_HSPF_tDBCTempVCnv "SWC_HSPF/RE_SWC_HSPF_10ms_sys/Subsystem/SPF_SigFlt/HSPF_tDBCTempVCnv" /begin REF_CHARACTERISTIC CAL_Hspf_DBCTempROCLimChkCnt_u8 CAL_Hspf_tDBCTempROCLim_u8 /end REF_CHARACTERISTIC /begin REF_MEASUREMENT VAR_Hspf_tDBCTempV_f32 /end REF_MEASUREMENT /end GROUP
/begin GROUP S9_HSPF_tDBCTempVFilter "SWC_HSPF/RE_SWC_HSPF_10ms_sys/Subsystem/SPF_SigFlt/HSPF_tDBCTempVFilter" /begin REF_CHARACTERISTIC CAL_Hspf_Multiple_u8 /end REF_CHARACTERISTIC /end GROUP
/begin GROUP S9_HSPF_tDBCTempWFilter "SWC_HSPF/RE_SWC_HSPF_10ms_sys/Subsystem/SPF_SigFlt/HSPF_tDBCTempWFilter" /begin REF_CHARACTERISTIC CAL_Hspf_Multiple_u8 /end REF_CHARACTERISTIC /end GROUP
/begin GROUP S9_HSPF_tDrvBoardTemp "SWC_HSPF/RE_SWC_HSPF_10ms_sys/Subsystem/SPF_SigFlt/HSPF_tDrvBoardTemp" /begin REF_CHARACTERISTIC CAL_Hspf_Multiple_u8 /end REF_CHARACTERISTIC /end GROUP
/begin GROUP S9_HSPF_tStrrTemp1Filter "SWC_HSPF/RE_SWC_HSPF_10ms_sys/Subsystem/SPF_SigFlt/HSPF_tStrrTemp1Filter" /begin REF_CHARACTERISTIC CAL_Hspf_Multiple_u8 /end REF_CHARACTERISTIC /end GROUP
/begin GROUP S9_HSPF_tStrrTemp2Filter "SWC_HSPF/RE_SWC_HSPF_10ms_sys/Subsystem/SPF_SigFlt/HSPF_tStrrTemp2Filter" /begin REF_CHARACTERISTIC CAL_Hspf_Multiple_u8 /end REF_CHARACTERISTIC /end GROUP
/begin GROUP S9_HSPF_tSttrTemp2Cnv "SWC_HSPF/RE_SWC_HSPF_10ms_sys/Subsystem/SPF_SigFlt/HSPF_tSttrTemp2Cnv"
 /begin REF_CHARACTERISTIC CAL_Hspf_MotTemHigTable_af32 CAL_Hspf_MotTemLowTable_af32 CAL_Hspf_tSwtTempSttrHiLim_f32 CAL_Hspf_tSwtTempSttrLoLim_f32 /end REF_CHARACTERISTIC
 /begin REF_MEASUREMENT VAR_Hspf_bSwtTempSttr2_b VAR_Hspf_tStrrTemp2_s16 /end REF_MEASUREMENT
/end GROUP
/begin GROUP S9_HSPF_uDcLnkFilter "SWC_HSPF/RE_SWC_HSPF_10ms_sys/Subsystem/SPF_SigFlt/HSPF_uDcLnkFilter" /begin REF_CHARACTERISTIC CAL_Hspf_Multiple_u8 /end REF_CHARACTERISTIC /end GROUP
/begin GROUP S9_HSPF_uKl30Filter "SWC_HSPF/RE_SWC_HSPF_10ms_sys/Subsystem/SPF_SigFlt/HSPF_uKl30Filter" /begin REF_CHARACTERISTIC CAL_Hspf_Multiple_u8 /end REF_CHARACTERISTIC /end GROUP
/begin GROUP S9_SPF_tDBCTempWCnv "SWC_HSPF/RE_SWC_HSPF_10ms_sys/Subsystem/SPF_SigFlt/SPF_tDBCTempWCnv" /begin REF_CHARACTERISTIC CAL_Hspf_DBCTempROCLimChkCnt_u8 CAL_Hspf_tDBCTempROCLim_u8 /end REF_CHARACTERISTIC /begin REF_MEASUREMENT VAR_Hspf_tDBCTempW_f32 /end REF_MEASUREMENT /end GROUP
/begin GROUP S9_SPF_tSttrTemp1Cnv "SWC_HSPF/RE_SWC_HSPF_10ms_sys/Subsystem/SPF_SigFlt/SPF_tSttrTemp1Cnv"
 /begin REF_CHARACTERISTIC CAL_Hspf_MotTemHigTable_af32 CAL_Hspf_MotTemLowTable_af32 CAL_Hspf_tSwtTempSttrHiLim_f32 CAL_Hspf_tSwtTempSttrLoLim_f32 /end REF_CHARACTERISTIC
 /begin REF_MEASUREMENT VAR_Hspf_bSwtTempSttr1_b VAR_Hspf_tStrrTemp1_s16 /end REF_MEASUREMENT
/end GROUP
/begin GROUP S12_ErrDelay "SWC_HSPF/RE_SWC_HSPF_10ms_sys/Subsystem/HSPF_GsDia/HSPF_tDBCTempDia/ErrDelay" /begin REF_CHARACTERISTIC CAL_Hspf_tDBCCmpTime_u16 /end REF_CHARACTERISTIC /begin REF_MEASUREMENT VAR_Hspf_tDBCCmpErrDelay_b /end REF_MEASUREMENT /end GROUP
/begin GROUP SWC_MCF "SWC_MCF" ROOT /begin SUB_GROUP Root_RE_SWC_MCF_100us_sys /end SUB_GROUP /end GROUP
/begin GROUP Root_RE_SWC_MCF_100us_sys "SWC_MCF/RE_SWC_MCF_100us_sys" /begin SUB_GROUP S1_Subsystem /end SUB_GROUP /end GROUP
/begin GROUP S3_MCF_Signal "SWC_MCF/RE_SWC_MCF_100us_sys/Subsystem/MCF_Signal" /begin SUB_GROUP S4_MCF_Signal /end SUB_GROUP /end GROUP
/begin GROUP S3_McFwc "SWC_MCF/RE_SWC_MCF_100us_sys/Subsystem/McFwc" /begin SUB_GROUP S5_McFwc /end SUB_GROUP /end GROUP
/begin GROUP S3_McPoc "SWC_MCF/RE_SWC_MCF_100us_sys/Subsystem/McPoc" /begin SUB_GROUP S6_McPoc /end SUB_GROUP /end GROUP
/begin GROUP S3_McSfc "SWC_MCF/RE_SWC_MCF_100us_sys/Subsystem/McSfc" /begin SUB_GROUP S7_McSfc /end SUB_GROUP /end GROUP
/begin GROUP S3_McVmc "SWC_MCF/RE_SWC_MCF_100us_sys/Subsystem/McVmc" /begin SUB_GROUP S8_McVmc /end SUB_GROUP /end GROUP
/begin GROUP S4_MCF_Signal "SWC_MCF/RE_SWC_MCF_100us_sys/Subsystem/MCF_Signal/MCF_Signal" /begin REF_MEASUREMENT VAR_MCF_HSPF_stIphaOffCal_u8 /end REF_MEASUREMENT /begin SUB_GROUP S9_IsCalc S9_OffsetCal S9_SigCnv S9_park /end SUB_GROUP /end GROUP
/begin GROUP S5_McFwc "SWC_MCF/RE_SWC_MCF_100us_sys/Subsystem/McFwc/McFwc" /begin SUB_GROUP S17_Conditional_Judgment_ S17_idqDes S17_udqDes /end SUB_GROUP /end GROUP
/begin GROUP S6_McPoc "SWC_MCF/RE_SWC_MCF_100us_sys/Subsystem/McPoc/McPoc"
 /begin SUB_GROUP S59_Calculat__Dead_Compensation_Voltage S59_Harmonic_Injection_Funcation S59_Zero_Sequence_Control_Function /end SUB_GROUP
/end GROUP
/begin GROUP S7_McSfc "SWC_MCF/RE_SWC_MCF_100us_sys/Subsystem/McSfc/McSfc" /begin SUB_GROUP S105_Calibration_Duty_Cycle S105_EOL_Function /end SUB_GROUP /end GROUP
/begin GROUP S8_McVmc "SWC_MCF/RE_SWC_MCF_100us_sys/Subsystem/McVmc/McVmc"
 /begin SUB_GROUP S115_MCF_DPWM S115_MCF_OverModu S115_MCF_RePark S115_MCF_frqpwmCalc /end SUB_GROUP
/end GROUP
/begin GROUP S9_IsCalc "SWC_MCF/RE_SWC_MCF_100us_sys/Subsystem/MCF_Signal/MCF_Signal/IsCalc" /begin REF_MEASUREMENT VAR_MCF_Is_f32 /end REF_MEASUREMENT /end GROUP
/begin GROUP S9_OffsetCal "SWC_MCF/RE_SWC_MCF_100us_sys/Subsystem/MCF_Signal/MCF_Signal/OffsetCal"
 /begin REF_CHARACTERISTIC CAL_MCF_OffsetInternal_f32 CAL_MCF_flgCalibOffset_b CAL_MCF_flgInternalOffset_b /end REF_CHARACTERISTIC
 /begin REF_MEASUREMENT VAR_MCF_agOffset_f32 /end REF_MEASUREMENT
 /begin SUB_GROUP S12_Rem3 /end SUB_GROUP
/end GROUP
/begin GROUP S9_SigCnv "SWC_MCF/RE_SWC_MCF_100us_sys/Subsystem/MCF_Signal/MCF_Signal/SigCnv"
 /begin REF_CHARACTERISTIC CAL_MCF_bUseduDclnkSet_b CAL_MCF_flgLowOrHvudcLnk_b CAL_MCF_iUCnvFac_f32 CAL_MCF_iVCnvFac_f32 CAL_MCF_iWCnvFac_f32 CAL_MCF_stChangePha_u8 CAL_MCF_uDclnkSet_f32 /end REF_CHARACTERISTIC
 /begin REF_MEASUREMENT VAR_MCF_iU_f32 VAR_MCF_iV_f32 VAR_MCF_iW_f32 VAR_MCF_uDcLnk_f32 /end REF_MEASUREMENT
/end GROUP
/begin GROUP S9_park "SWC_MCF/RE_SWC_MCF_100us_sys/Subsystem/MCF_Signal/MCF_Signal/park" /begin REF_MEASUREMENT VAR_MCF_idAct_f32 VAR_MCF_iqAct_f32 /end REF_MEASUREMENT /end GROUP
/begin GROUP S17_Conditional_Judgment_ "SWC_MCF/RE_SWC_MCF_100us_sys/Subsystem/McFwc/McFwc/Conditional Judgment " /begin SUB_GROUP S18_FwcUsRes /end SUB_GROUP /end GROUP
/begin GROUP S17_idqDes "SWC_MCF/RE_SWC_MCF_100us_sys/Subsystem/McFwc/McFwc/idqDes" /begin SUB_GROUP S19_FluxWeakeningLoop /end SUB_GROUP /end GROUP
/begin GROUP S17_udqDes "SWC_MCF/RE_SWC_MCF_100us_sys/Subsystem/McFwc/McFwc/udqDes" /begin SUB_GROUP S20_CurrentLoop /end SUB_GROUP /end GROUP
/begin GROUP S59_Calculat__Dead_Compensation_Voltage "SWC_MCF/RE_SWC_MCF_100us_sys/Subsystem/McPoc/McPoc/Calculat_ Dead_Compensation_Voltage" /begin REF_MEASUREMENT VAR_MCF_uAlphaDeadCpn_f32 VAR_MCF_uBetaDeadCpn_f32 /end REF_MEASUREMENT
 /begin SUB_GROUP S60_Calculate_dead_compensation_voltage S60_Determines_dead_compensation_is_enabled /end SUB_GROUP
/end GROUP
/begin GROUP S59_Harmonic_Injection_Funcation "SWC_MCF/RE_SWC_MCF_100us_sys/Subsystem/McPoc/McPoc/Harmonic_Injection_Funcation" /begin REF_CHARACTERISTIC CAL_MCF_flgUse1113ZR_b /end REF_CHARACTERISTIC /begin REF_MEASUREMENT VAR_MCF_UdDes11ZR_f32 VAR_MCF_UqDes11ZR_f32 /end REF_MEASUREMENT /begin SUB_GROUP S61_Harmonic_injection_of_11_and_13 /end SUB_GROUP /end GROUP
/begin GROUP S59_Zero_Sequence_Control_Function "SWC_MCF/RE_SWC_MCF_100us_sys/Subsystem/McPoc/McPoc/Zero Sequence Control Function" /begin REF_CHARACTERISTIC CAL_MCF_flgUseZeroCtl_b /end REF_CHARACTERISTIC /begin REF_MEASUREMENT VAR_MCF_uAlphaZero_f32 VAR_MCF_uBetaZero_f32 /end REF_MEASUREMENT /begin SUB_GROUP S62_Calculate_zero_sequence_alpha_and_beta_axis_voltage /end SUB_GROUP /end GROUP
/begin GROUP S105_Calibration_Duty_Cycle "SWC_MCF/RE_SWC_MCF_100us_sys/Subsystem/McSfc/McSfc/Calibration Duty Cycle"
 /begin REF_CHARACTERISTIC CAL_MCF_DycUSet_f32 CAL_MCF_DycVSet_f32 CAL_MCF_DycWSet_f32 CAL_MCF_FlgUpdateDyc_b CAL_MCF_FlgUseSetDyc_b CAL_MCF_stPwmMode_u8 /end REF_CHARACTERISTIC
/end GROUP
/begin GROUP S105_EOL_Function "SWC_MCF/RE_SWC_MCF_100us_sys/Subsystem/McSfc/McSfc/EOL Function" /begin REF_CHARACTERISTIC CAL_MCF_FlgUseEOL_b /end REF_CHARACTERISTIC /begin REF_MEASUREMENT VAR_MCF_uDDesEOL_f32 VAR_MCF_uQDesEOL_f32 /end REF_MEASUREMENT /begin SUB_GROUP S107_Inductancetestfunction /end SUB_GROUP /end GROUP
/begin GROUP S115_MCF_DPWM "SWC_MCF/RE_SWC_MCF_100us_sys/Subsystem/McVmc/McVmc/MCF_DPWM"
 /begin SUB_GROUP S116_MCF_DPWM S116_MCF_DeadTimeCalc S116_MCF_DpwmEn S116_MCF_NarrWaSupr S116_MCF_dycCalc /end SUB_GROUP
/end GROUP
/begin GROUP S115_MCF_OverModu "SWC_MCF/RE_SWC_MCF_100us_sys/Subsystem/McVmc/McVmc/MCF_OverModu" /begin REF_CHARACTERISTIC CAL_MCF_flgOverModu_b /end REF_CHARACTERISTIC /begin SUB_GROUP S117_MCF_OverModuEn /end SUB_GROUP /end GROUP
/begin GROUP S115_MCF_RePark "SWC_MCF/RE_SWC_MCF_100us_sys/Subsystem/McVmc/McVmc/MCF_RePark" /begin SUB_GROUP S118_Mcf_AgTranCalc S118_OSC_AlOfsClbCompen /end SUB_GROUP /end GROUP
/begin GROUP S115_MCF_frqpwmCalc "SWC_MCF/RE_SWC_MCF_100us_sys/Subsystem/McVmc/McVmc/MCF_frqpwmCalc"
 /begin REF_CHARACTERISTIC CAL_MCF_FixFreq_f32 CAL_MCF_HalfFreq_f32 CAL_MCF_flgRpwmFrqRandom_b CAL_MCF_flgVF_b /end REF_CHARACTERISTIC
 /begin SUB_GROUP S119_FrqRamp S119_FrqRamp1 /end SUB_GROUP
/end GROUP
/begin GROUP S12_Rem3 "SWC_MCF/RE_SWC_MCF_100us_sys/Subsystem/MCF_Signal/MCF_Signal/OffsetCal/Rem3" /begin REF_MEASUREMENT VAR_MCF_agRtrEe_f32 /end REF_MEASUREMENT /end GROUP
/begin GROUP S18_FwcUsRes "SWC_MCF/RE_SWC_MCF_100us_sys/Subsystem/McFwc/McFwc/Conditional Judgment /FwcUsRes" /begin SUB_GROUP S21_GetFwFlag S21_GetUsResAct S21_UsdqDesCalc /end SUB_GROUP /end GROUP
/begin GROUP S19_FluxWeakeningLoop "SWC_MCF/RE_SWC_MCF_100us_sys/Subsystem/McFwc/McFwc/idqDes/FluxWeakeningLoop" /begin REF_MEASUREMENT VAR_MCF_MPC_LdSubLq_f32 /end REF_MEASUREMENT /begin SUB_GROUP S27_GetisdDesFw S27_isdDesCoordinate1 S27_isqDesCoordinate /end SUB_GROUP /end GROUP
/begin GROUP S20_CurrentLoop "SWC_MCF/RE_SWC_MCF_100us_sys/Subsystem/McFwc/McFwc/udqDes/CurrentLoop"
 /begin REF_MEASUREMENT VAR_MCF_MPC_Ld_f32 VAR_MCF_MPC_Lq_f32 VAR_MCF_Rdc_nWoFlt_f32 VAR_MCF_SCF_flgInitEn_b /end REF_MEASUREMENT
 /begin SUB_GROUP S55_Subsystem S55_Subsystem1 /end SUB_GROUP
/end GROUP
/begin GROUP S60_Calculate_dead_compensation_voltage "SWC_MCF/RE_SWC_MCF_100us_sys/Subsystem/McPoc/McPoc/Calculat_ Dead_Compensation_Voltage/Calculate dead compensation voltage" /begin SUB_GROUP S63_Calculate_coefficient_alpha_and_beta_axis /end SUB_GROUP /end GROUP
/begin GROUP S60_Determines_dead_compensation_is_enabled "SWC_MCF/RE_SWC_MCF_100us_sys/Subsystem/McPoc/McPoc/Calculat_ Dead_Compensation_Voltage/Determines dead compensation is enabled"
 /begin SUB_GROUP S64_Determines_whether_dead_compensation_is_enabled S64_Flag_of_dead_compensation_according_to_speed S64__Flag_of_dead_compensation_according_to_torque /end SUB_GROUP
/end GROUP
/begin GROUP S61_Harmonic_injection_of_11_and_13 "SWC_MCF/RE_SWC_MCF_100us_sys/Subsystem/McPoc/McPoc/Harmonic_Injection_Funcation/Harmonic_injection_of_11_and_13" /begin SUB_GROUP S86_Set_11_steps_current_amplitude_and_phase /end SUB_GROUP /end GROUP
/begin GROUP S62_Calculate_zero_sequence_alpha_and_beta_axis_voltage "SWC_MCF/RE_SWC_MCF_100us_sys/Subsystem/McPoc/McPoc/Zero Sequence Control Function/Calculate zero sequence alpha and beta axis voltage"
 /begin SUB_GROUP S92_Calculate_KpKi_for_uAlpha S92_Calculate_KpKi_for_uBeta S92_Incremental_PI S92_Incremental_PI1 S92_Signal_Filter_of_current_of_alpha_axis_1 S92_Signal_Filter_of_current_of_alpha_axis_2 /end SUB_GROUP
/end GROUP
/begin GROUP S107_Inductancetestfunction "SWC_MCF/RE_SWC_MCF_100us_sys/Subsystem/McSfc/McSfc/EOL Function/Inductancetestfunction"
 /begin SUB_GROUP S108_Close_Loop S108_Open_Loop S108_Output_UdDes_of_inductance S108_Switch_UdDes_of_inductance /end SUB_GROUP
/end GROUP
/begin GROUP S116_MCF_DPWM "SWC_MCF/RE_SWC_MCF_100us_sys/Subsystem/McVmc/McVmc/MCF_DPWM/MCF_DPWM" /begin SUB_GROUP S120_DPWM_tiModu /end SUB_GROUP /end GROUP
/begin GROUP S116_MCF_DeadTimeCalc "SWC_MCF/RE_SWC_MCF_100us_sys/Subsystem/McVmc/McVmc/MCF_DPWM/MCF_DeadTimeCalc" /begin REF_CHARACTERISTIC CAL_MCF_DeadTimeTableY_Ti_af32 /end REF_CHARACTERISTIC /end GROUP
/begin GROUP S116_MCF_DpwmEn "SWC_MCF/RE_SWC_MCF_100us_sys/Subsystem/McVmc/McVmc/MCF_DPWM/MCF_DpwmEn"
 /begin REF_CHARACTERISTIC CAL_MCF_flgDpwm_b CAL_MCF_nDpwmOffDelay_f32 CAL_MCF_nDpwmOff_f32 CAL_MCF_trqDpwmOff_f32 /end REF_CHARACTERISTIC
/end GROUP
/begin GROUP S116_MCF_NarrWaSupr "SWC_MCF/RE_SWC_MCF_100us_sys/Subsystem/McVmc/McVmc/MCF_DPWM/MCF_NarrWaSupr" /begin SUB_GROUP S124_OSC_SwtCalc /end SUB_GROUP /end GROUP
/begin GROUP S116_MCF_dycCalc "SWC_MCF/RE_SWC_MCF_100us_sys/Subsystem/McVmc/McVmc/MCF_DPWM/MCF_dycCalc" /begin REF_CHARACTERISTIC CAL_MCF_ratLo_f32 CAL_MCF_ratUp_f32 CAL_MCF_stChangePha_u8 /end REF_CHARACTERISTIC /end GROUP
/begin GROUP S117_MCF_OverModuEn "SWC_MCF/RE_SWC_MCF_100us_sys/Subsystem/McVmc/McVmc/MCF_OverModu/MCF_OverModuEn" /begin REF_CHARACTERISTIC CAL_MCF_cofOverModu_f32 /end REF_CHARACTERISTIC /begin REF_MEASUREMENT VAR_MCF_uAOm_f32 VAR_MCF_uBOm_f32 VAR_MCF_usPeak_f32 /end REF_MEASUREMENT /begin SUB_GROUP S168_Rem60 /end SUB_GROUP /end GROUP
/begin GROUP S118_Mcf_AgTranCalc "SWC_MCF/RE_SWC_MCF_100us_sys/Subsystem/McVmc/McVmc/MCF_RePark/Mcf_AgTranCalc" /begin REF_CHARACTERISTIC CAL_MCF_perCpnAg_f32 /end REF_CHARACTERISTIC /begin SUB_GROUP S177_First_LowPass /end SUB_GROUP /end GROUP
/begin GROUP S118_OSC_AlOfsClbCompen "SWC_MCF/RE_SWC_MCF_100us_sys/Subsystem/McVmc/McVmc/MCF_RePark/OSC_AlOfsClbCompen" /begin REF_CHARACTERISTIC CAL_MCF_flgOfsClbTest_b /end REF_CHARACTERISTIC /begin REF_MEASUREMENT VAR_MCF_uAOfsClb_f32 VAR_MCF_uBOfsClb_f32 /end REF_MEASUREMENT /end GROUP
/begin GROUP S119_FrqRamp "SWC_MCF/RE_SWC_MCF_100us_sys/Subsystem/McVmc/McVmc/MCF_frqpwmCalc/FrqRamp" /begin REF_CHARACTERISTIC CAL_MCF_FrqRmp_f32 /end REF_CHARACTERISTIC /end GROUP
/begin GROUP S119_FrqRamp1 "SWC_MCF/RE_SWC_MCF_100us_sys/Subsystem/McVmc/McVmc/MCF_frqpwmCalc/FrqRamp1" /begin REF_CHARACTERISTIC CAL_MCF_FrqRmp_f32 /end REF_CHARACTERISTIC /end GROUP
/begin GROUP S21_GetFwFlag "SWC_MCF/RE_SWC_MCF_100us_sys/Subsystem/McFwc/McFwc/Conditional Judgment /FwcUsRes/GetFwFlag" /begin REF_CHARACTERISTIC CAL_MCF_UsUseRateDesTableY_UsRes_af32 /end REF_CHARACTERISTIC /begin REF_MEASUREMENT VAR_MCF_UsUseRateDes_f32 VAR_MCF_flgFw_b /end REF_MEASUREMENT /end GROUP
/begin GROUP S21_GetUsResAct "SWC_MCF/RE_SWC_MCF_100us_sys/Subsystem/McFwc/McFwc/Conditional Judgment /FwcUsRes/GetUsResAct" /begin REF_MEASUREMENT VAR_MCF_UsUseRateReal_f32 /end REF_MEASUREMENT /end GROUP
/begin GROUP S21_UsdqDesCalc "SWC_MCF/RE_SWC_MCF_100us_sys/Subsystem/McFwc/McFwc/Conditional Judgment /FwcUsRes/UsdqDesCalc"
 /begin REF_CHARACTERISTIC CAL_MCF_UsdScalSet_f32 CAL_MCF_UsqScalSet_f32 CAL_MCF_flgUseUsdqSet_b /end REF_CHARACTERISTIC
 /begin REF_MEASUREMENT VAR_MCF_udDes_f32 VAR_MCF_uqDes_f32 /end REF_MEASUREMENT
/end GROUP
/begin GROUP S27_GetisdDesFw "SWC_MCF/RE_SWC_MCF_100us_sys/Subsystem/McFwc/McFwc/idqDes/FluxWeakeningLoop/GetisdDesFw" /begin SUB_GROUP S29_IncPI S29_Subsystem1 /end SUB_GROUP /end GROUP
/begin GROUP S27_isdDesCoordinate1 "SWC_MCF/RE_SWC_MCF_100us_sys/Subsystem/McFwc/McFwc/idqDes/FluxWeakeningLoop/isdDesCoordinate1" /begin REF_CHARACTERISTIC CAL_MCF_flgUseisTheta_b CAL_MCF_flgUseisdqSet_b /end REF_CHARACTERISTIC /begin REF_MEASUREMENT VAR_MCF_idDes_f32 /end REF_MEASUREMENT /begin SUB_GROUP S30_Discharge_id S30_id_Set S30_id_ThetaSet /end SUB_GROUP /end GROUP
/begin GROUP S27_isqDesCoordinate "SWC_MCF/RE_SWC_MCF_100us_sys/Subsystem/McFwc/McFwc/idqDes/FluxWeakeningLoop/isqDesCoordinate" /begin REF_CHARACTERISTIC CAL_MCF_flgUseisTheta_b CAL_MCF_flgUseisdqSet_b /end REF_CHARACTERISTIC /begin REF_MEASUREMENT VAR_MCF_iqDes_f32 /end REF_MEASUREMENT /begin SUB_GROUP S31_Discharge_iq S31_iq_Cal S31_iq_Set S31_iq_ThetaSet /end SUB_GROUP /end GROUP
/begin GROUP S55_Subsystem "SWC_MCF/RE_SWC_MCF_100us_sys/Subsystem/McFwc/McFwc/udqDes/CurrentLoop/Subsystem"
 /begin REF_CHARACTERISTIC CAL_MCF_flgUseUsOver_b CAL_MCF_udOverGain_f32 CAL_MCF_uqOverGain_f32 /end REF_CHARACTERISTIC
 /begin REF_MEASUREMENT VAR_MCF_EmfBack_f32 VAR_MCF_udRv_f32 VAR_MCF_uqRv_f32 /end REF_MEASUREMENT
 /begin SUB_GROUP S56_First_LowPass /end SUB_GROUP
/end GROUP
/begin GROUP S55_Subsystem1 "SWC_MCF/RE_SWC_MCF_100us_sys/Subsystem/McFwc/McFwc/udqDes/CurrentLoop/Subsystem1"
 /begin REF_CHARACTERISTIC CAL_MCF_udDecoupki_f32 CAL_MCF_udki_f32 CAL_MCF_udkp_f32 CAL_MCF_uqDecoupki_f32 CAL_MCF_uqki_f32 CAL_MCF_uqkp_f32 /end REF_CHARACTERISTIC
/end GROUP
/begin GROUP S63_Calculate_coefficient_alpha_and_beta_axis "SWC_MCF/RE_SWC_MCF_100us_sys/Subsystem/McPoc/McPoc/Calculat_ Dead_Compensation_Voltage/Calculate dead compensation voltage/Calculate coefficient alpha and beta axis"
 /begin REF_CHARACTERISTIC CAL_MCF_AgDiffCurrSec_f32 CAL_MCF_AgRangeDeadCpnY_Ag_af32 CAL_MCF_DeadTimeCpn_f32 /end REF_CHARACTERISTIC
/end GROUP
/begin GROUP S64__Flag_of_dead_compensation_according_to_torque "SWC_MCF/RE_SWC_MCF_100us_sys/Subsystem/McPoc/McPoc/Calculat_ Dead_Compensation_Voltage/Determines dead compensation is enabled/ Flag of dead compensation according to torque" /begin REF_CHARACTERISTIC CAL_MCF_TrqOffDeadCpn_f32 /end REF_CHARACTERISTIC /end GROUP
/begin GROUP S64_Determines_whether_dead_compensation_is_enabled "SWC_MCF/RE_SWC_MCF_100us_sys/Subsystem/McPoc/McPoc/Calculat_ Dead_Compensation_Voltage/Determines dead compensation is enabled/Determines whether dead compensation is enabled" /begin REF_CHARACTERISTIC CAL_MCF_FlgUseDeadCpn_b /end REF_CHARACTERISTIC /begin REF_MEASUREMENT VAR_MCF_FlgDeadCpn_b /end REF_MEASUREMENT /end GROUP
/begin GROUP S64_Flag_of_dead_compensation_according_to_speed "SWC_MCF/RE_SWC_MCF_100us_sys/Subsystem/McPoc/McPoc/Calculat_ Dead_Compensation_Voltage/Determines dead compensation is enabled/Flag of dead compensation according to speed" /begin REF_CHARACTERISTIC CAL_MCF_SpdOffDeadCpn_f32 CAL_MCF_SpdOnDeadCpn_f32 /end REF_CHARACTERISTIC /end GROUP
/begin GROUP S86_Set_11_steps_current_amplitude_and_phase "SWC_MCF/RE_SWC_MCF_100us_sys/Subsystem/McPoc/McPoc/Harmonic_Injection_Funcation/Harmonic_injection_of_11_and_13/Set_11_steps_current_amplitude_and_phase"
 /begin REF_CHARACTERISTIC CAL_MCF_HarmIn11ZRY_Is_af32 CAL_MCF_HarmIn11ZRY_Thetam_af32 CAL_MCF_IsSet11ZR_f32 CAL_MCF_IsThetaSet11ZR_f32 CAL_MCF_flgHarmInIsThetaTab11ZR_b /end REF_CHARACTERISTIC
 /begin REF_MEASUREMENT VAR_MCF_IsSet11ZR_f32 VAR_MCF_IsThetaSet11ZR_f32 /end REF_MEASUREMENT
/end GROUP
/begin GROUP S92_Calculate_KpKi_for_uAlpha "SWC_MCF/RE_SWC_MCF_100us_sys/Subsystem/McPoc/McPoc/Zero Sequence Control Function/Calculate zero sequence alpha and beta axis voltage/Calculate KpKi for uAlpha"
 /begin REF_CHARACTERISTIC CAL_MCF_CoefPIAlphaZeroCtlY_Ki_af32 CAL_MCF_CoefPIAlphaZeroFtlY_Kp_af32 CAL_MCF_KiAlphaZeroCtl_f32 CAL_MCF_KpAlphaZeroCtl_f32 CAL_MCF_flgTabZeroCtl_b /end REF_CHARACTERISTIC
/end GROUP
/begin GROUP S92_Calculate_KpKi_for_uBeta "SWC_MCF/RE_SWC_MCF_100us_sys/Subsystem/McPoc/McPoc/Zero Sequence Control Function/Calculate zero sequence alpha and beta axis voltage/Calculate KpKi for uBeta"
 /begin REF_CHARACTERISTIC CAL_MCF_CoefPIBetaZeroCtlY_Ki_af32 CAL_MCF_CoefPIBetaZeroCtlY_Kp_af32 CAL_MCF_KiBetaZeroCtl_f32 CAL_MCF_KpBetaZeroCtl_f32 CAL_MCF_flgTabZeroCtl_b /end REF_CHARACTERISTIC
/end GROUP
/begin GROUP S92_Incremental_PI "SWC_MCF/RE_SWC_MCF_100us_sys/Subsystem/McPoc/McPoc/Zero Sequence Control Function/Calculate zero sequence alpha and beta axis voltage/Incremental PI"
 /begin REF_CHARACTERISTIC CAL_MCF_AplhaRefZeroCtl_f32 CAL_MCF_DownLimPIZeroCtl_f32 CAL_MCF_UpLimPIZeroCtl_f32 /end REF_CHARACTERISTIC
/end GROUP
/begin GROUP S92_Incremental_PI1 "SWC_MCF/RE_SWC_MCF_100us_sys/Subsystem/McPoc/McPoc/Zero Sequence Control Function/Calculate zero sequence alpha and beta axis voltage/Incremental PI1"
 /begin REF_CHARACTERISTIC CAL_MCF_BetaRefZeroCtl_f32 CAL_MCF_DownLimPIZeroCtl_f32 CAL_MCF_UpLimPIZeroCtl_f32 /end REF_CHARACTERISTIC
/end GROUP
/begin GROUP S92_Signal_Filter_of_current_of_alpha_axis_1 "SWC_MCF/RE_SWC_MCF_100us_sys/Subsystem/McPoc/McPoc/Zero Sequence Control Function/Calculate zero sequence alpha and beta axis voltage/Signal Filter of current of alpha axis 1" /begin SUB_GROUP S97_First_low_pass S97_Second_band_stop_filter /end SUB_GROUP /end GROUP
/begin GROUP S92_Signal_Filter_of_current_of_alpha_axis_2 "SWC_MCF/RE_SWC_MCF_100us_sys/Subsystem/McPoc/McPoc/Zero Sequence Control Function/Calculate zero sequence alpha and beta axis voltage/Signal Filter of current of alpha axis 2" /begin SUB_GROUP S98_First_low_pass S98_Second_band_stop_filter /end SUB_GROUP /end GROUP
/begin GROUP S108_Close_Loop "SWC_MCF/RE_SWC_MCF_100us_sys/Subsystem/McSfc/McSfc/EOL Function/Inductancetestfunction/Close Loop"
 /begin REF_CHARACTERISTIC CAL_MCF_FlgUseSatuEOL_b CAL_MCF_IsrmsDesEOL_f32 CAL_MCF_KiUdEOL_f32 CAL_MCF_KpUdEOL_f32 CAL_MCF_uDDownLimEOL_f32 CAL_MCF_uDUpLimEOL_f32 /end REF_CHARACTERISTIC
/end GROUP
/begin GROUP S108_Open_Loop "SWC_MCF/RE_SWC_MCF_100us_sys/Subsystem/McSfc/McSfc/EOL Function/Inductancetestfunction/Open Loop" /begin REF_CHARACTERISTIC CAL_MCF_IsrmsDesEOL_f32 CAL_MCF_uDDesEOLY_af32 /end REF_CHARACTERISTIC /end GROUP
/begin GROUP S108_Output_UdDes_of_inductance "SWC_MCF/RE_SWC_MCF_100us_sys/Subsystem/McSfc/McSfc/EOL Function/Inductancetestfunction/Output UdDes of inductance"
 /begin REF_CHARACTERISTIC CAL_MCF_CoefuDCLimtEOL_f32 CAL_MCF_TrqInvMax_f32 CAL_MCF_uQDesEOL_f32 /end REF_CHARACTERISTIC
/end GROUP
/begin GROUP S108_Switch_UdDes_of_inductance "SWC_MCF/RE_SWC_MCF_100us_sys/Subsystem/McSfc/McSfc/EOL Function/Inductancetestfunction/Switch UdDes of inductance" /begin REF_CHARACTERISTIC CAL_MCF_FlgUseClose_b CAL_MCF_FlgUseOpen_b /end REF_CHARACTERISTIC /end GROUP
/begin GROUP S120_DPWM_tiModu "SWC_MCF/RE_SWC_MCF_100us_sys/Subsystem/McVmc/McVmc/MCF_DPWM/MCF_DPWM/DPWM_tiModu" /begin REF_CHARACTERISTIC CAL_MCF_stDpwm_u8 /end REF_CHARACTERISTIC /end GROUP
/begin GROUP S124_OSC_SwtCalc "SWC_MCF/RE_SWC_MCF_100us_sys/Subsystem/McVmc/McVmc/MCF_DPWM/MCF_NarrWaSupr/OSC_SwtCalc" /begin REF_CHARACTERISTIC CAL_MCF_flgNWS_b CAL_MCF_ratNarrWave_f32 /end REF_CHARACTERISTIC /end GROUP
/begin GROUP S168_Rem60 "SWC_MCF/RE_SWC_MCF_100us_sys/Subsystem/McVmc/McVmc/MCF_OverModu/MCF_OverModuEn/Rem60" /begin REF_MEASUREMENT VAR_MCF_AgRem_f32 /end REF_MEASUREMENT /end GROUP
/begin GROUP S177_First_LowPass "SWC_MCF/RE_SWC_MCF_100us_sys/Subsystem/McVmc/McVmc/MCF_RePark/Mcf_AgTranCalc/First_LowPass" /begin REF_CHARACTERISTIC CAL_MCF_cofFltN_f32 /end REF_CHARACTERISTIC /end GROUP
/begin GROUP S29_IncPI "SWC_MCF/RE_SWC_MCF_100us_sys/Subsystem/McFwc/McFwc/idqDes/FluxWeakeningLoop/GetisdDesFw/IncPI" /begin REF_CHARACTERISTIC CAL_MCF_flgUseFF_b CAL_MCF_isdfwKi_f32 CAL_MCF_isdfwKp_f32 /end REF_CHARACTERISTIC /begin REF_MEASUREMENT VAR_MCF_isdFW_f32 VAR_MCF_periodCalc_f32 /end REF_MEASUREMENT /end GROUP
/begin GROUP S29_Subsystem1 "SWC_MCF/RE_SWC_MCF_100us_sys/Subsystem/McFwc/McFwc/idqDes/FluxWeakeningLoop/GetisdDesFw/Subsystem1" /begin REF_MEASUREMENT VAR_MCF_idMotHeat_f32 /end REF_MEASUREMENT /begin SUB_GROUP S34_Subsystem S34_Subsystem4 S34_Subsystem5 /end SUB_GROUP /end GROUP
/begin GROUP S30_Discharge_id "SWC_MCF/RE_SWC_MCF_100us_sys/Subsystem/McFwc/McFwc/idqDes/FluxWeakeningLoop/isdDesCoordinate1/Discharge_id" /begin REF_CHARACTERISTIC CAL_MCF_DisChaisdDes_f32 /end REF_CHARACTERISTIC /end GROUP
/begin GROUP S30_id_Set "SWC_MCF/RE_SWC_MCF_100us_sys/Subsystem/McFwc/McFwc/idqDes/FluxWeakeningLoop/isdDesCoordinate1/id_Set" /begin REF_CHARACTERISTIC CAL_MCF_isdSet_f32 /end REF_CHARACTERISTIC /end GROUP
/begin GROUP S30_id_ThetaSet "SWC_MCF/RE_SWC_MCF_100us_sys/Subsystem/McFwc/McFwc/idqDes/FluxWeakeningLoop/isdDesCoordinate1/id_ThetaSet" /begin REF_CHARACTERISTIC CAL_MCF_isSet_f32 CAL_MCF_isThetaSet_f32 /end REF_CHARACTERISTIC /end GROUP
/begin GROUP S31_Discharge_iq "SWC_MCF/RE_SWC_MCF_100us_sys/Subsystem/McFwc/McFwc/idqDes/FluxWeakeningLoop/isqDesCoordinate/Discharge_iq" /begin REF_CHARACTERISTIC CAL_MCF_DisChaisqDes_f32 /end REF_CHARACTERISTIC /end GROUP
/begin GROUP S31_iq_Cal "SWC_MCF/RE_SWC_MCF_100us_sys/Subsystem/McFwc/McFwc/idqDes/FluxWeakeningLoop/isqDesCoordinate/iq_Cal" /begin REF_CHARACTERISTIC CAL_MCF_isMax_f32 /end REF_CHARACTERISTIC /end GROUP
/begin GROUP S31_iq_Set "SWC_MCF/RE_SWC_MCF_100us_sys/Subsystem/McFwc/McFwc/idqDes/FluxWeakeningLoop/isqDesCoordinate/iq_Set" /begin REF_CHARACTERISTIC CAL_MCF_isqSet_f32 /end REF_CHARACTERISTIC /end GROUP
/begin GROUP S31_iq_ThetaSet "SWC_MCF/RE_SWC_MCF_100us_sys/Subsystem/McFwc/McFwc/idqDes/FluxWeakeningLoop/isqDesCoordinate/iq_ThetaSet" /begin REF_CHARACTERISTIC CAL_MCF_isSet_f32 CAL_MCF_isThetaSet_f32 /end REF_CHARACTERISTIC /end GROUP
/begin GROUP S56_First_LowPass "SWC_MCF/RE_SWC_MCF_100us_sys/Subsystem/McFwc/McFwc/udqDes/CurrentLoop/Subsystem/First_LowPass" /begin REF_CHARACTERISTIC CAL_MCF_cofFltWe_f32 /end REF_CHARACTERISTIC /end GROUP
/begin GROUP S97_First_low_pass "SWC_MCF/RE_SWC_MCF_100us_sys/Subsystem/McPoc/McPoc/Zero Sequence Control Function/Calculate zero sequence alpha and beta axis voltage/Signal Filter of current of alpha axis 1/First low pass" /begin REF_CHARACTERISTIC CAL_MCF_OmbwFirstFltY_Ombw_af32 CAL_MCF_SampleTime_f32 /end REF_CHARACTERISTIC /begin REF_MEASUREMENT VAR_MCF_iBetaActFlt_f32 /end REF_MEASUREMENT /end GROUP
/begin GROUP S97_Second_band_stop_filter "SWC_MCF/RE_SWC_MCF_100us_sys/Subsystem/McPoc/McPoc/Zero Sequence Control Function/Calculate zero sequence alpha and beta axis voltage/Signal Filter of current of alpha axis 1/Second band stop filter"
 /begin REF_CHARACTERISTIC CAL_MCF_CoefFltZero_A_f32 CAL_MCF_CoefFltZero_B_f32 CAL_MCF_CoefFltZero_C_f32 CAL_MCF_SampleTime_f32 /end REF_CHARACTERISTIC
/end GROUP
/begin GROUP S98_First_low_pass "SWC_MCF/RE_SWC_MCF_100us_sys/Subsystem/McPoc/McPoc/Zero Sequence Control Function/Calculate zero sequence alpha and beta axis voltage/Signal Filter of current of alpha axis 2/First low pass" /begin REF_CHARACTERISTIC CAL_MCF_OmbwFirstFltY_Ombw_af32 CAL_MCF_SampleTime_f32 /end REF_CHARACTERISTIC /begin REF_MEASUREMENT VAR_MCF_iAlphaActFlt_f32 /end REF_MEASUREMENT /end GROUP
/begin GROUP S98_Second_band_stop_filter "SWC_MCF/RE_SWC_MCF_100us_sys/Subsystem/McPoc/McPoc/Zero Sequence Control Function/Calculate zero sequence alpha and beta axis voltage/Signal Filter of current of alpha axis 2/Second band stop filter"
 /begin REF_CHARACTERISTIC CAL_MCF_CoefFltZero_A_f32 CAL_MCF_CoefFltZero_B_f32 CAL_MCF_CoefFltZero_C_f32 CAL_MCF_SampleTime_f32 /end REF_CHARACTERISTIC
/end GROUP
/begin GROUP S34_Subsystem "SWC_MCF/RE_SWC_MCF_100us_sys/Subsystem/McFwc/McFwc/idqDes/FluxWeakeningLoop/GetisdDesFw/Subsystem1/Subsystem"
 /begin REF_CHARACTERISTIC CAL_MCF_ActiveHeatInit_u8 CAL_MCF_ActiveHeatNormal_u8 CAL_MCF_DeltaPower_f32 CAL_MCF_Non_ActiveHeat_u8 CAL_MCF_Part_ActiveHeat_u8 /end REF_CHARACTERISTIC
 /begin REF_MEASUREMENT VAR_MCF_TMAhtChsts_f32 /end REF_MEASUREMENT
 /begin SUB_GROUP S38_First_LowPass /end SUB_GROUP
/end GROUP
/begin GROUP S34_Subsystem4 "SWC_MCF/RE_SWC_MCF_100us_sys/Subsystem/McFwc/McFwc/idqDes/FluxWeakeningLoop/GetisdDesFw/Subsystem1/Subsystem4" /begin SUB_GROUP S39_Subsystem1 S39_Subsystem2 /end SUB_GROUP /end GROUP
/begin GROUP S34_Subsystem5 "SWC_MCF/RE_SWC_MCF_100us_sys/Subsystem/McFwc/McFwc/idqDes/FluxWeakeningLoop/GetisdDesFw/Subsystem1/Subsystem5" /begin SUB_GROUP S40_Subsystem S40_Subsystem4 /end SUB_GROUP /end GROUP
/begin MEASUREMENT VAR_ADM_BMSVolt_f32 "" FLOAT32_IEEE SWC_ADM_CM_single 0 0 0.0 1000.0 ECU_ADDRESS 0x70004E7C /end MEASUREMENT
/begin MEASUREMENT VAR_ADM_HiPrecVolt_f32 "" FLOAT32_IEEE SWC_ADM_CM_single 0 0 0.0 1000.0 ECU_ADDRESS 0x70004E80 /end MEASUREMENT
/begin MEASUREMENT VAR_ADM_stModeReq_u8 "" UBYTE SWC_ADM_CM_uint8 0 0 0.0 255.0 ECU_ADDRESS 0x70004E73 /end MEASUREMENT
/begin MEASUREMENT VAR_ADM_flgCrash_b "" UBYTE SWC_ADM_CM_boolean 0 0 0.0 1.0 ECU_ADDRESS 0x70004E6D /end MEASUREMENT
/begin MEASUREMENT VAR_ADM_BMSVoltRngErr_b "" UBYTE SWC_ADM_CM_boolean 0 0 0.0 1.0 ECU_ADDRESS 0x70004E71 /end MEASUREMENT
/begin MEASUREMENT VAR_ADM_VoltCmpChkErr_b "" UBYTE SWC_ADM_CM_boolean 0 0 0.0 1.0 ECU_ADDRESS 0x70004E72 /end MEASUREMENT
/begin MEASUREMENT VAR_ADM_GlbDchgErr_b "" UBYTE SWC_ADM_CM_boolean 0 0 0.0 1.0 ECU_ADDRESS 0x70004E6C /end MEASUREMENT
/begin MEASUREMENT VAR_ADM_flgDchgReq_b "" UBYTE SWC_ADM_CM_boolean 0 0 0.0 1.0 ECU_ADDRESS 0x70004E6E /end MEASUREMENT
/begin MEASUREMENT VAR_ADM_L2Com_HiPrecVolt_IN "" FLOAT32_IEEE SWC_ADM_CM_single 0 0 0.0 1000.0 ECU_ADDRESS 0x70004E78 /end MEASUREMENT
/begin MEASUREMENT VAR_ADM_L2Com_BMSVolt_IN "" FLOAT32_IEEE SWC_ADM_CM_single 0 0 0.0 1000.0 ECU_ADDRESS 0x70004E74 /end MEASUREMENT
/begin MEASUREMENT VAR_VoltCmpChkErrSt "" UBYTE SWC_ADM_CM_boolean 0 0 0.0 1.0 ECU_ADDRESS 0x70004E70 /end MEASUREMENT
/begin MEASUREMENT VAR_BMSVoltRngErrSt "" UBYTE SWC_ADM_CM_boolean 0 0 0.0 1.0 ECU_ADDRESS 0x70004E6F /end MEASUREMENT
/begin MEASUREMENT VAR_WilTjtIGBT_f32 "" FLOAT32_IEEE SWC_BCC_CM_single 0 0 -3.4E+38 3.4E+38 ECU_ADDRESS 0x70004FD4 /end MEASUREMENT
/begin MEASUREMENT VAR_UdhTjtIGBT_f32 "" FLOAT32_IEEE SWC_BCC_CM_single 0 0 -3.4E+38 3.4E+38 ECU_ADDRESS 0x70004FA0 /end MEASUREMENT
/begin MEASUREMENT VAR_BCC_iDcLnkEstFlt_f32 "" FLOAT32_IEEE SWC_BCC_CM_single 0 0 -3.4E+38 3.4E+38 ECU_ADDRESS 0x70004F94 /end MEASUREMENT
/begin MEASUREMENT VAR_WdlTjtIGBT_f32 "" FLOAT32_IEEE SWC_BCC_CM_single 0 0 -3.4E+38 3.4E+38 ECU_ADDRESS 0x70004FD0 /end MEASUREMENT
/begin MEASUREMENT VAR_VdlTjtIGBT_f32 "" FLOAT32_IEEE SWC_BCC_CM_single 0 0 -3.4E+38 3.4E+38 ECU_ADDRESS 0x70004FBC /end MEASUREMENT
/begin MEASUREMENT VAR_WCoolantTj_f32 "" FLOAT32_IEEE SWC_BCC_CM_single 0 0 -3.4E+38 3.4E+38 ECU_ADDRESS 0x70004FDC /end MEASUREMENT
/begin MEASUREMENT VAR_VTjpwr_f32 "" FLOAT32_IEEE SWC_BCC_CM_single 0 0 -3.4E+38 3.4E+38 ECU_ADDRESS 0x70004FC8 /end MEASUREMENT
/begin MEASUREMENT VAR_UdlTjtIGBT_f32 "" FLOAT32_IEEE SWC_BCC_CM_single 0 0 -3.4E+38 3.4E+38 ECU_ADDRESS 0x70004FA4 /end MEASUREMENT
/begin MEASUREMENT VAR_VCoolantTj_f32 "" FLOAT32_IEEE SWC_BCC_CM_single 0 0 -3.4E+38 3.4E+38 ECU_ADDRESS 0x70004FC4 /end MEASUREMENT
/begin MEASUREMENT VAR_UihTjtIGBT_f32 "" FLOAT32_IEEE SWC_BCC_CM_single 0 0 -3.4E+38 3.4E+38 ECU_ADDRESS 0x70004F9C /end MEASUREMENT
/begin MEASUREMENT VAR_BCC_iDcLnkEst_f32 "" FLOAT32_IEEE SWC_BCC_CM_single 0 0 -3.4E+38 3.4E+38 ECU_ADDRESS 0x70004F98 /end MEASUREMENT
/begin MEASUREMENT VAR_UCoolantTj_f32 "" FLOAT32_IEEE SWC_BCC_CM_single 0 0 -3.4E+38 3.4E+38 ECU_ADDRESS 0x70004FAC /end MEASUREMENT
/begin MEASUREMENT VAR_VilTjtIGBT_f32 "" FLOAT32_IEEE SWC_BCC_CM_single 0 0 -3.4E+38 3.4E+38 ECU_ADDRESS 0x70004FC0 /end MEASUREMENT
/begin MEASUREMENT VAR_WihTjtIGBT_f32 "" FLOAT32_IEEE SWC_BCC_CM_single 0 0 -3.4E+38 3.4E+38 ECU_ADDRESS 0x70004FD8 /end MEASUREMENT
/begin MEASUREMENT VAR_UilTjtIGBT_f32 "" FLOAT32_IEEE SWC_BCC_CM_single 0 0 -3.4E+38 3.4E+38 ECU_ADDRESS 0x70004FA8 /end MEASUREMENT
/begin MEASUREMENT VAR_WdhTjtIGBT_f32 "" FLOAT32_IEEE SWC_BCC_CM_single 0 0 -3.4E+38 3.4E+38 ECU_ADDRESS 0x70004FCC /end MEASUREMENT
/begin MEASUREMENT VAR_UTjpwr_f32 "" FLOAT32_IEEE SWC_BCC_CM_single 0 0 -3.4E+38 3.4E+38 ECU_ADDRESS 0x70004FB0 /end MEASUREMENT
/begin MEASUREMENT VAR_VihTjtIGBT_f32 "" FLOAT32_IEEE SWC_BCC_CM_single 0 0 -3.4E+38 3.4E+38 ECU_ADDRESS 0x70004FB4 /end MEASUREMENT
/begin MEASUREMENT VAR_BCC_flgstGateDrv_b "" UBYTE SWC_BCC_CM_boolean 0 0 0 1 ECU_ADDRESS 0x70004F90 /end MEASUREMENT
/begin MEASUREMENT VAR_WTjpwr_f32 "" FLOAT32_IEEE SWC_BCC_CM_single 0 0 -3.4E+38 3.4E+38 ECU_ADDRESS 0x70004FE0 /end MEASUREMENT
/begin MEASUREMENT VAR_VdhTjtIGBT_f32 "" FLOAT32_IEEE SWC_BCC_CM_single 0 0 -3.4E+38 3.4E+38 ECU_ADDRESS 0x70004FB8 /end MEASUREMENT
/begin MEASUREMENT VAR_Cspf_TrastGateDrv_u8 "" UBYTE SWC_CSPF_CM_uint8 0 0 0 255 ECU_ADDRESS 0x70004FFC /end MEASUREMENT
/begin MEASUREMENT VAR_Cspf_TraUdcCurr_f32 "" FLOAT32_IEEE SWC_CSPF_CM_single 0 0 -3.4E+38 3.4E+38 ECU_ADDRESS 0x7000504C /end MEASUREMENT
/begin MEASUREMENT VAR_Cspf_TrabDernTrqMax_u8 "" UBYTE SWC_CSPF_CM_uint8 0 0 0 255 ECU_ADDRESS 0x70004FF0 /end MEASUREMENT
/begin MEASUREMENT VAR_Cspf_TraagRtrELecSnsr_f32 "" FLOAT32_IEEE SWC_CSPF_CM_single 0 0 -3.4E+38 3.4E+38 ECU_ADDRESS 0x70005040 /end MEASUREMENT
/begin MEASUREMENT VAR_Cspf_TraiGBTTempV_f32 "" FLOAT32_IEEE SWC_CSPF_CM_single 0 0 -3.4E+38 3.4E+38 ECU_ADDRESS 0x70005028 /end MEASUREMENT
/begin MEASUREMENT VAR_Cspf_TrastTrqEmMax_u8 "" UBYTE SWC_CSPF_CM_uint8 0 0 0 255 ECU_ADDRESS 0x70004FF2 /end MEASUREMENT
/begin MEASUREMENT VAR_Cspf_TrastDischg_u8 "" UBYTE SWC_CSPF_CM_uint8 0 0 0 255 ECU_ADDRESS 0x70004FFB /end MEASUREMENT
/begin MEASUREMENT VAR_Cspf_TrabDernTempCooL_u8 "" UBYTE SWC_CSPF_CM_uint8 0 0 0 255 ECU_ADDRESS 0x70004FF5 /end MEASUREMENT
/begin MEASUREMENT VAR_Cspf_TrabDernOvrUdc_u8 "" UBYTE SWC_CSPF_CM_uint8 0 0 0 255 ECU_ADDRESS 0x70004FF7 /end MEASUREMENT
/begin MEASUREMENT VAR_Cspf_TraTrqCurr_f32 "" FLOAT32_IEEE SWC_CSPF_CM_single 0 0 -3.4E+38 3.4E+38 ECU_ADDRESS 0x70005050 /end MEASUREMENT
/begin MEASUREMENT VAR_Cspf_TraisCurr_f32 "" FLOAT32_IEEE SWC_CSPF_CM_single 0 0 -3.4E+38 3.4E+38 ECU_ADDRESS 0x70005044 /end MEASUREMENT
/begin MEASUREMENT VAR_Cspf_TraTempCurrStr2_f32 "" FLOAT32_IEEE SWC_CSPF_CM_single 0 0 -3.4E+38 3.4E+38 ECU_ADDRESS 0x7000501C /end MEASUREMENT
/begin MEASUREMENT VAR_Cspf_TraTrqAbsMin_f32 "" FLOAT32_IEEE SWC_CSPF_CM_single 0 0 -3.4E+38 3.4E+38 ECU_ADDRESS 0x7000500C /end MEASUREMENT
/begin MEASUREMENT VAR_Cspf_TraOfsAL_f32 "" FLOAT32_IEEE SWC_CSPF_CM_single 0 0 -3.4E+38 3.4E+38 ECU_ADDRESS 0x70005030 /end MEASUREMENT
/begin MEASUREMENT VAR_Cspf_TraHvMcuVer_u16 "" UWORD SWC_CSPF_CM_uint16 0 0 0 65535 ECU_ADDRESS 0x70005000 /end MEASUREMENT
/begin MEASUREMENT VAR_Cspf_TrastMode_u8 "" UBYTE SWC_CSPF_CM_uint8 0 0 0 255 ECU_ADDRESS 0x70004FFE /end MEASUREMENT
/begin MEASUREMENT VAR_Cspf_TraTrqAbsMax_f32 "" FLOAT32_IEEE SWC_CSPF_CM_single 0 0 -3.4E+38 3.4E+38 ECU_ADDRESS 0x70005010 /end MEASUREMENT
/begin MEASUREMENT VAR_Cspf_TrabDernUndrUdc_u8 "" UBYTE SWC_CSPF_CM_uint8 0 0 0 255 ECU_ADDRESS 0x70004FF3 /end MEASUREMENT
/begin MEASUREMENT VAR_Cspf_TraTempCurrCooL_f32 "" FLOAT32_IEEE SWC_CSPF_CM_single 0 0 -3.4E+38 3.4E+38 ECU_ADDRESS 0x70005018 /end MEASUREMENT
/begin MEASUREMENT VAR_Cspf_TraFailCode8_u8 "" UBYTE SWC_CSPF_CM_uint8 0 0 0 255 ECU_ADDRESS 0x70004FE6 /end MEASUREMENT
/begin MEASUREMENT VAR_Cspf_TraFailCode7_u8 "" UBYTE SWC_CSPF_CM_uint8 0 0 0 255 ECU_ADDRESS 0x70004FE7 /end MEASUREMENT
/begin MEASUREMENT VAR_Cspf_TraiGBTTempU_f32 "" FLOAT32_IEEE SWC_CSPF_CM_single 0 0 -3.4E+38 3.4E+38 ECU_ADDRESS 0x7000502C /end MEASUREMENT
/begin MEASUREMENT VAR_Cspf_TraFailCode6_u8 "" UBYTE SWC_CSPF_CM_uint8 0 0 0 255 ECU_ADDRESS 0x70004FE8 /end MEASUREMENT
/begin MEASUREMENT VAR_Cspf_TraFailCode5_u8 "" UBYTE SWC_CSPF_CM_uint8 0 0 0 255 ECU_ADDRESS 0x70004FE9 /end MEASUREMENT
/begin MEASUREMENT VAR_Cspf_TraFailCode4_u8 "" UBYTE SWC_CSPF_CM_uint8 0 0 0 255 ECU_ADDRESS 0x70004FEA /end MEASUREMENT
/begin MEASUREMENT VAR_Cspf_TrabDernOvridc_u8 "" UBYTE SWC_CSPF_CM_uint8 0 0 0 255 ECU_ADDRESS 0x70004FF8 /end MEASUREMENT
/begin MEASUREMENT VAR_Cspf_TraFailCode3_u8 "" UBYTE SWC_CSPF_CM_uint8 0 0 0 255 ECU_ADDRESS 0x70004FEB /end MEASUREMENT
/begin MEASUREMENT VAR_Cspf_TraFailCode2_u8 "" UBYTE SWC_CSPF_CM_uint8 0 0 0 255 ECU_ADDRESS 0x70004FEC /end MEASUREMENT
/begin MEASUREMENT VAR_Cspf_TrabDernStrTemp_u8 "" UBYTE SWC_CSPF_CM_uint8 0 0 0 255 ECU_ADDRESS 0x70004FF6 /end MEASUREMENT
/begin MEASUREMENT VAR_Cspf_TraFailCode1_u8 "" UBYTE SWC_CSPF_CM_uint8 0 0 0 255 ECU_ADDRESS 0x70004FED /end MEASUREMENT
/begin MEASUREMENT VAR_Cspf_Traisq_f32 "" FLOAT32_IEEE SWC_CSPF_CM_single 0 0 -3.4E+38 3.4E+38 ECU_ADDRESS 0x70005038 /end MEASUREMENT
/begin MEASUREMENT VAR_Cspf_TraflgOfsClbSuc_u8 "" UBYTE SWC_CSPF_CM_uint8 0 0 0 255 ECU_ADDRESS 0x70004FFD /end MEASUREMENT
/begin MEASUREMENT VAR_Cspf_TraCpldVer_u16 "" UWORD SWC_CSPF_CM_uint16 0 0 0 65535 ECU_ADDRESS 0x70005002 /end MEASUREMENT
/begin MEASUREMENT VAR_Cspf_TrabDernCAN_u8 "" UBYTE SWC_CSPF_CM_uint8 0 0 0 255 ECU_ADDRESS 0x70004FFA /end MEASUREMENT
/begin MEASUREMENT VAR_Cspf_TrabDernDrvBoardTemp_u16 "" UWORD SWC_CSPF_CM_uint16 0 0 0 65535 ECU_ADDRESS 0x70005004 /end MEASUREMENT
/begin MEASUREMENT VAR_Cspf_TraiGBTTempW_f32 "" FLOAT32_IEEE SWC_CSPF_CM_single 0 0 -3.4E+38 3.4E+38 ECU_ADDRESS 0x70005024 /end MEASUREMENT
/begin MEASUREMENT VAR_Cspf_TraNCurr_f32 "" FLOAT32_IEEE SWC_CSPF_CM_single 0 0 -3.4E+38 3.4E+38 ECU_ADDRESS 0x70005048 /end MEASUREMENT
/begin MEASUREMENT VAR_Cspf_TraHwVer_u16 "" UWORD SWC_CSPF_CM_uint16 0 0 0 65535 ECU_ADDRESS 0x70005006 /end MEASUREMENT
/begin MEASUREMENT VAR_Cspf_TraTempCurrStr1_f32 "" FLOAT32_IEEE SWC_CSPF_CM_single 0 0 -3.4E+38 3.4E+38 ECU_ADDRESS 0x70005020 /end MEASUREMENT
/begin MEASUREMENT VAR_Cspf_TrabDernN_u8 "" UBYTE SWC_CSPF_CM_uint8 0 0 0 255 ECU_ADDRESS 0x70004FF9 /end MEASUREMENT
/begin MEASUREMENT VAR_Cspf_TraTrqCurrWoDmpC_f32 "" FLOAT32_IEEE SWC_CSPF_CM_single 0 0 -3.4E+38 3.4E+38 ECU_ADDRESS 0x70005034 /end MEASUREMENT
/begin MEASUREMENT VAR_Cspf_TraUT30Curr_f32 "" FLOAT32_IEEE SWC_CSPF_CM_single 0 0 -3.4E+38 3.4E+38 ECU_ADDRESS 0x70005008 /end MEASUREMENT
/begin MEASUREMENT VAR_Cspf_TrabReadyHV_u8 "" UBYTE SWC_CSPF_CM_uint8 0 0 0 255 ECU_ADDRESS 0x70004FEE /end MEASUREMENT
/begin MEASUREMENT VAR_Cspf_TraidcCurr_f32 "" FLOAT32_IEEE SWC_CSPF_CM_single 0 0 -3.4E+38 3.4E+38 ECU_ADDRESS 0x70005014 /end MEASUREMENT
/begin MEASUREMENT VAR_Cspf_Traisd_f32 "" FLOAT32_IEEE SWC_CSPF_CM_single 0 0 -3.4E+38 3.4E+38 ECU_ADDRESS 0x7000503C /end MEASUREMENT
/begin MEASUREMENT VAR_Cspf_TrabDernTempiGBT_u8 "" UBYTE SWC_CSPF_CM_uint8 0 0 0 255 ECU_ADDRESS 0x70004FF4 /end MEASUREMENT
/begin MEASUREMENT VAR_Cspf_TrabDernTrqMin_u8 "" UBYTE SWC_CSPF_CM_uint8 0 0 0 255 ECU_ADDRESS 0x70004FEF /end MEASUREMENT
/begin MEASUREMENT VAR_Cspf_TrastTrqEmMin_u8 "" UBYTE SWC_CSPF_CM_uint8 0 0 0 255 ECU_ADDRESS 0x70004FF1 /end MEASUREMENT
/begin MEASUREMENT VAR_FRP_FaultReact_b "" UBYTE SWC_FRP_CM_boolean 0 0 0 1 ECU_ADDRESS 0x70005058 /end MEASUREMENT
/begin MEASUREMENT VAR_FRP_FaultInfo_u32 "" ULONG SWC_FRP_CM_uint32 0 0 0 4294967295 ECU_ADDRESS 0x7000505C /end MEASUREMENT
/begin MEASUREMENT VAR_Hspf_bSwtTempSttr1_b "" UBYTE SWC_HSPF_CM_boolean 0 0 0 1 ECU_ADDRESS 0x70005169 /end MEASUREMENT
/begin MEASUREMENT VAR_Hspf_flgSttr2NoErr_b "" UBYTE SWC_HSPF_CM_boolean 0 0 0 1 ECU_ADDRESS 0x70005161 /end MEASUREMENT
/begin MEASUREMENT VAR_Bsw_Wake_b "" UBYTE SWC_HSPF_CM_boolean 0 0 0 1 ECU_ADDRESS 0x70005164 /end MEASUREMENT
/begin MEASUREMENT VAR_Hspf_tDBCTempV_f32 "" FLOAT32_IEEE SWC_HSPF_CM_single 0 0 -3.4E+38 3.4E+38 ECU_ADDRESS 0x70005198 /end MEASUREMENT
/begin MEASUREMENT VAR_Bsw_tDBCTempU_u16 "" UWORD SWC_HSPF_CM_uint16 0 0 0 65535 ECU_ADDRESS 0x70005178 /end MEASUREMENT
/begin MEASUREMENT VAR_Bsw_bt15_b "" UBYTE SWC_HSPF_CM_boolean 0 0 0 1 ECU_ADDRESS 0x70005163 /end MEASUREMENT
/begin MEASUREMENT VAR_Bsw_tStrrTemp1_u16 "" UWORD SWC_HSPF_CM_uint16 0 0 0 65535 ECU_ADDRESS 0x7000517C /end MEASUREMENT
/begin MEASUREMENT VAR_Hspf_HWVer_u8 "" UBYTE SWC_HSPF_CM_uint8 0 0 0 255 ECU_ADDRESS 0x7000516A /end MEASUREMENT
/begin MEASUREMENT VAR_Hspf_uDcLnk_f32 "" FLOAT32_IEEE SWC_HSPF_CM_single 0 0 -3.4E+38 3.4E+38 ECU_ADDRESS 0x70005180 /end MEASUREMENT
/begin MEASUREMENT VAR_Hspf_tStrrTemp2_s16 "" SWORD SWC_HSPF_CM_int16 0 0 -32768 32767 ECU_ADDRESS 0x7000516E /end MEASUREMENT
/begin MEASUREMENT VAR_Bsw_Hwver_f32 "" FLOAT32_IEEE SWC_HSPF_CM_single 0 0 -3.4E+38 3.4E+38 ECU_ADDRESS 0x700051A0 /end MEASUREMENT
/begin MEASUREMENT VAR_Hspf_stVerChk_u8 "" UBYTE SWC_HSPF_CM_uint8 0 0 0 255 ECU_ADDRESS 0x7000516C /end MEASUREMENT
/begin MEASUREMENT VAR_Hspf_tDBCCmpErrDelay_b "" UBYTE SWC_HSPF_CM_boolean 0 0 0 1 ECU_ADDRESS 0x70005165 /end MEASUREMENT
/begin MEASUREMENT VAR_Hspf_flgSttr1NoErr_b "" UBYTE SWC_HSPF_CM_boolean 0 0 0 1 ECU_ADDRESS 0x70005160 /end MEASUREMENT
/begin MEASUREMENT VAR_Hspf_tDBCTempW_f32 "" FLOAT32_IEEE SWC_HSPF_CM_single 0 0 -3.4E+38 3.4E+38 ECU_ADDRESS 0x70005194 /end MEASUREMENT
/begin MEASUREMENT VAR_Bsw_tDBCTempV_u16 "" UWORD SWC_HSPF_CM_uint16 0 0 0 65535 ECU_ADDRESS 0x70005176 /end MEASUREMENT
/begin MEASUREMENT VAR_Bsw_tDrvBoardTemp_u16 "" UWORD SWC_HSPF_CM_uint16 0 0 0 65535 ECU_ADDRESS 0x70005172 /end MEASUREMENT
/begin MEASUREMENT VAR_Bsw_tStrrTemp2_u16 "" UWORD SWC_HSPF_CM_uint16 0 0 0 65535 ECU_ADDRESS 0x7000517A /end MEASUREMENT
/begin MEASUREMENT VAR_Hspf_tDrvBoardTemp_f32 "" FLOAT32_IEEE SWC_HSPF_CM_single 0 0 -3.4E+38 3.4E+38 ECU_ADDRESS 0x70005184 /end MEASUREMENT
/begin MEASUREMENT VAR_Bsw_INV_Open_b "" UBYTE SWC_HSPF_CM_boolean 0 0 0 1 ECU_ADDRESS 0x70005167 /end MEASUREMENT
/begin MEASUREMENT VAR_Hspf_tCoolantTemp_f32 "" FLOAT32_IEEE SWC_HSPF_CM_single 0 0 -3.4E+38 3.4E+38 ECU_ADDRESS 0x70005188 /end MEASUREMENT
/begin MEASUREMENT VAR_Hspf_bSwtTempSttr2_b "" UBYTE SWC_HSPF_CM_boolean 0 0 0 1 ECU_ADDRESS 0x70005168 /end MEASUREMENT
/begin MEASUREMENT VAR_Hspf_uKl30_f32 "" FLOAT32_IEEE SWC_HSPF_CM_single 0 0 -3.4E+38 3.4E+38 ECU_ADDRESS 0x7000518C /end MEASUREMENT
/begin MEASUREMENT VAR_Hspf_VerMatchFailureErr_u8 "" UBYTE SWC_HSPF_CM_uint8 0 0 0 255 ECU_ADDRESS 0x7000516B /end MEASUREMENT
/begin MEASUREMENT VAR_Hspf_tDBCTempU_f32 "" FLOAT32_IEEE SWC_HSPF_CM_single 0 0 -3.4E+38 3.4E+38 ECU_ADDRESS 0x7000519C /end MEASUREMENT
/begin MEASUREMENT VAR_Bsw_tCoolantTemp_f32 "" FLOAT32_IEEE SWC_HSPF_CM_single 0 0 -3.4E+38 3.4E+38 ECU_ADDRESS 0x70005190 /end MEASUREMENT
/begin MEASUREMENT VAR_Bsw_tDBCTempW_u16 "" UWORD SWC_HSPF_CM_uint16 0 0 0 65535 ECU_ADDRESS 0x70005174 /end MEASUREMENT
/begin MEASUREMENT VAR_Bsw_Motor_Open_b "" UBYTE SWC_HSPF_CM_boolean 0 0 0 1 ECU_ADDRESS 0x70005166 /end MEASUREMENT
/begin MEASUREMENT VAR_Bsw_Crash_b "" UBYTE SWC_HSPF_CM_boolean 0 0 0 1 ECU_ADDRESS 0x70005162 /end MEASUREMENT
/begin MEASUREMENT VAR_Hspf_tStrrTemp1_s16 "" SWORD SWC_HSPF_CM_int16 0 0 -32768 32767 ECU_ADDRESS 0x70005170 /end MEASUREMENT
/begin MEASUREMENT VAR_MCF_udRv_f32 "" FLOAT32_IEEE SWC_MCF_CM_single 0 0 -65535.0 65535.0 ECU_ADDRESS 0x70005300 /end MEASUREMENT
/begin MEASUREMENT VAR_MCF_MPC_Lq_f32 "" FLOAT32_IEEE SWC_MCF_CM_single 0 0 -65535.0 65535.0 ECU_ADDRESS 0x700052E4 /end MEASUREMENT
/begin MEASUREMENT VAR_MCF_uqDes_f32 "" FLOAT32_IEEE SWC_MCF_CM_single 0 0 -65535.0 65535.0 ECU_ADDRESS 0x700052CC /end MEASUREMENT
/begin MEASUREMENT VAR_MCF_agOffset_f32 "" FLOAT32_IEEE SWC_MCF_CM_single 0 0 -65535.0 65535.0 ECU_ADDRESS 0x70005318 /end MEASUREMENT
/begin MEASUREMENT VAR_MCF_HSPF_stIphaOffCal_u8 "" UBYTE SWC_MCF_CM_uint8 0 0 0.0 255.0 ECU_ADDRESS 0x7000526D /end MEASUREMENT
/begin MEASUREMENT VAR_MCF_MPC_LdSubLq_f32 "" FLOAT32_IEEE SWC_MCF_CM_single 0 0 -65535.0 65535.0 ECU_ADDRESS 0x700052E0 /end MEASUREMENT
/begin MEASUREMENT VAR_MCF_iqDes_f32 "" FLOAT32_IEEE SWC_MCF_CM_single 0 0 -65535.0 65535.0 ECU_ADDRESS 0x700052DC /end MEASUREMENT
/begin MEASUREMENT VAR_MCF_Rdc_nWoFlt_f32 "" FLOAT32_IEEE SWC_MCF_CM_single 0 0 -65535.0 65535.0 ECU_ADDRESS 0x700052E8 /end MEASUREMENT
/begin MEASUREMENT VAR_MCF_IsThetaSet11ZR_f32 "" FLOAT32_IEEE SWC_MCF_CM_single 0 0 -65535.0 65535.0 ECU_ADDRESS 0x70005280 /end MEASUREMENT
/begin MEASUREMENT VAR_MCF_uAOm_f32 "" FLOAT32_IEEE SWC_MCF_CM_single 0 0 -65535.0 65535.0 ECU_ADDRESS 0x70005294 /end MEASUREMENT
/begin MEASUREMENT VAR_MCF_uBOm_f32 "" FLOAT32_IEEE SWC_MCF_CM_single 0 0 -65535.0 65535.0 ECU_ADDRESS 0x70005290 /end MEASUREMENT
/begin MEASUREMENT VAR_MCF_uqRv_f32 "" FLOAT32_IEEE SWC_MCF_CM_single 0 0 -65535.0 65535.0 ECU_ADDRESS 0x700052D4 /end MEASUREMENT
/begin MEASUREMENT VAR_MCF_uDDesEOL_f32 "" FLOAT32_IEEE SWC_MCF_CM_single 0 0 -65535.0 65535.0 ECU_ADDRESS 0x700052AC /end MEASUREMENT
/begin MEASUREMENT VAR_MCF_idAct_f32 "" FLOAT32_IEEE SWC_MCF_CM_single 0 0 -65535.0 65535.0 ECU_ADDRESS 0x7000530C /end MEASUREMENT
/begin MEASUREMENT VAR_MCF_iAlphaActFlt_f32 "" FLOAT32_IEEE SWC_MCF_CM_single 0 0 -65535.0 65535.0 ECU_ADDRESS 0x7000528C /end MEASUREMENT
/begin MEASUREMENT VAR_MCF_IsSet11ZR_f32 "" FLOAT32_IEEE SWC_MCF_CM_single 0 0 -65535.0 65535.0 ECU_ADDRESS 0x70005284 /end MEASUREMENT
/begin MEASUREMENT VAR_MCF_MPC_Ld_f32 "" FLOAT32_IEEE SWC_MCF_CM_single 0 0 -65535.0 65535.0 ECU_ADDRESS 0x700052EC /end MEASUREMENT
/begin MEASUREMENT VAR_MCF_periodCalc_f32 "" FLOAT32_IEEE SWC_MCF_CM_single 0 0 -65535.0 65535.0 ECU_ADDRESS 0x700052FC /end MEASUREMENT
/begin MEASUREMENT VAR_MCF_uQDesEOL_f32 "" FLOAT32_IEEE SWC_MCF_CM_single 0 0 -65535.0 65535.0 ECU_ADDRESS 0x700052A8 /end MEASUREMENT
/begin MEASUREMENT VAR_MCF_iV_f32 "" FLOAT32_IEEE SWC_MCF_CM_single 0 0 -65535.0 65535.0 ECU_ADDRESS 0x70005324 /end MEASUREMENT
/begin MEASUREMENT VAR_MCF_uAlphaZero_f32 "" FLOAT32_IEEE SWC_MCF_CM_single 0 0 -65535.0 65535.0 ECU_ADDRESS 0x700052B4 /end MEASUREMENT
/begin MEASUREMENT VAR_MCF_uBOfsClb_f32 "" FLOAT32_IEEE SWC_MCF_CM_single 0 0 -65535.0 65535.0 ECU_ADDRESS 0x700052A0 /end MEASUREMENT
/begin MEASUREMENT VAR_MCF_iqAct_f32 "" FLOAT32_IEEE SWC_MCF_CM_single 0 0 -65535.0 65535.0 ECU_ADDRESS 0x70005308 /end MEASUREMENT
/begin MEASUREMENT VAR_MCF_uAOfsClb_f32 "" FLOAT32_IEEE SWC_MCF_CM_single 0 0 -65535.0 65535.0 ECU_ADDRESS 0x700052A4 /end MEASUREMENT
/begin MEASUREMENT VAR_MCF_AgRem_f32 "" FLOAT32_IEEE SWC_MCF_CM_single 0 0 -65535.0 65535.0 ECU_ADDRESS 0x70005298 /end MEASUREMENT
/begin MEASUREMENT VAR_MCF_UqDes11ZR_f32 "" FLOAT32_IEEE SWC_MCF_CM_single 0 0 -65535.0 65535.0 ECU_ADDRESS 0x700052B8 /end MEASUREMENT
/begin MEASUREMENT VAR_MCF_UdDes11ZR_f32 "" FLOAT32_IEEE SWC_MCF_CM_single 0 0 -65535.0 65535.0 ECU_ADDRESS 0x700052BC /end MEASUREMENT
/begin MEASUREMENT VAR_MCF_TMAhtChsts_f32 "" UBYTE SWC_MCF_CM_uint8 0 0 0.0 255.0 ECU_ADDRESS 0x7000526C /end MEASUREMENT
/begin MEASUREMENT VAR_MCF_agRtrEe_f32 "" FLOAT32_IEEE SWC_MCF_CM_single 0 0 -65535.0 65535.0 ECU_ADDRESS 0x70005314 /end MEASUREMENT
/begin MEASUREMENT VAR_MCF_idDes_f32 "" FLOAT32_IEEE SWC_MCF_CM_single 0 0 -65535.0 65535.0 ECU_ADDRESS 0x700052F0 /end MEASUREMENT
/begin MEASUREMENT VAR_MCF_uBetaDeadCpn_f32 "" FLOAT32_IEEE SWC_MCF_CM_single 0 0 -65535.0 65535.0 ECU_ADDRESS 0x700052C0 /end MEASUREMENT
/begin MEASUREMENT VAR_MCF_uDcLnk_f32 "" FLOAT32_IEEE SWC_MCF_CM_single 0 0 -65535.0 65535.0 ECU_ADDRESS 0x70005310 /end MEASUREMENT
/begin MEASUREMENT VAR_MCF_idMotHeat_f32 "" FLOAT32_IEEE SWC_MCF_CM_single 0 0 -65535.0 65535.0 ECU_ADDRESS 0x700052F4 /end MEASUREMENT
/begin MEASUREMENT VAR_MCF_udDes_f32 "" FLOAT32_IEEE SWC_MCF_CM_single 0 0 -65535.0 65535.0 ECU_ADDRESS 0x700052D0 /end MEASUREMENT
/begin MEASUREMENT VAR_MCF_isdFW_f32 "" FLOAT32_IEEE SWC_MCF_CM_single 0 0 -65535.0 65535.0 ECU_ADDRESS 0x700052F8 /end MEASUREMENT
/begin MEASUREMENT VAR_MCF_flgFw_b "" UBYTE SWC_MCF_CM_boolean 0 0 0.0 1.0 ECU_ADDRESS 0x7000526B /end MEASUREMENT
/begin MEASUREMENT VAR_MCF_iU_f32 "" FLOAT32_IEEE SWC_MCF_CM_single 0 0 -65535.0 65535.0 ECU_ADDRESS 0x70005328 /end MEASUREMENT
/begin MEASUREMENT VAR_MCF_usPeak_f32 "" FLOAT32_IEEE SWC_MCF_CM_single 0 0 -65535.0 65535.0 ECU_ADDRESS 0x7000529C /end MEASUREMENT
/begin MEASUREMENT VAR_MCF_uAlphaDeadCpn_f32 "" FLOAT32_IEEE SWC_MCF_CM_single 0 0 -65535.0 65535.0 ECU_ADDRESS 0x700052C4 /end MEASUREMENT
/begin MEASUREMENT VAR_MCF_uBetaZero_f32 "" FLOAT32_IEEE SWC_MCF_CM_single 0 0 -65535.0 65535.0 ECU_ADDRESS 0x700052B0 /end MEASUREMENT
/begin MEASUREMENT VAR_MCF_EmfBack_f32 "" FLOAT32_IEEE SWC_MCF_CM_single 0 0 -65535.0 65535.0 ECU_ADDRESS 0x700052D8 /end MEASUREMENT
/begin MEASUREMENT VAR_MCF_UsUseRateReal_f32 "" FLOAT32_IEEE SWC_MCF_CM_single 0 0 -65535.0 65535.0 ECU_ADDRESS 0x700052C8 /end MEASUREMENT
/begin MEASUREMENT VAR_MCF_UsUseRateDes_f32 "" FLOAT32_IEEE SWC_MCF_CM_single 0 0 -65535.0 65535.0 ECU_ADDRESS 0x70005304 /end MEASUREMENT
/begin MEASUREMENT VAR_MCF_iBetaActFlt_f32 "" FLOAT32_IEEE SWC_MCF_CM_single 0 0 -65535.0 65535.0 ECU_ADDRESS 0x70005288 /end MEASUREMENT
/begin MEASUREMENT VAR_MCF_SCF_flgInitEn_b "" UBYTE SWC_MCF_CM_boolean 0 0 0.0 1.0 ECU_ADDRESS 0x70005269 /end MEASUREMENT
/begin MEASUREMENT VAR_MCF_FlgDeadCpn_b "" UBYTE SWC_MCF_CM_boolean 0 0 0.0 1.0 ECU_ADDRESS 0x70005268 /end MEASUREMENT
/begin MEASUREMENT VAR_MCF_iW_f32 "" FLOAT32_IEEE SWC_MCF_CM_single 0 0 -65535.0 65535.0 ECU_ADDRESS 0x70005320 /end MEASUREMENT
/begin MEASUREMENT VAR_MCF_Is_f32 "" FLOAT32_IEEE SWC_MCF_CM_single 0 0 -65535.0 65535.0 ECU_ADDRESS 0x7000531C /end MEASUREMENT
/end MODULE
/end PROJECT
