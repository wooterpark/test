/*
* Product Info
* Isolar version: ISOLAR-AB 4.0.2
* Product release version: RTA-BSW 3.1.0
*/
/begin XCP_ON_CAN /************************ start of CAN *********************/ 0x0102 /* XCP on CAN version */ CAN_ID_MASTER 0x220 /* CMD/STIM CAN-ID */ /* master -> slave */ CAN_ID_SLAVE 0x300 /* RES/ERR/EV/SERV/DAQ CAN-ID */ /* slave -> master */ /* Bit31= 1: extended identifier */ BAUDRATE 500000 /* BAUDRATE [Hz] */ SAMPLE_POINT 100 /* sample point */ /* [% complete bit time] */ BTL_CYCLES 11 /* BTL_CYCLES */ /* [slots per bit time] */ SJW 0 /* length synchr. segment */ /* [BTL_CYCLES] */ /begin EVENT_CAN_ID_LIST 0 /* reference to EVENT_NUMBER: 2msRstr */ FIXED 0x310 /end EVENT_CAN_ID_LIST /begin EVENT_CAN_ID_LIST 1 /* reference to EVENT_NUMBER: 10msRstr */ FIXED 0x311 /end EVENT_CAN_ID_LIST /begin EVENT_CAN_ID_LIST 2 /* reference to EVENT_NUMBER: 100msRstr */ FIXED 0x312 /end EVENT_CAN_ID_LIST MAX_BUS_LOAD 100 /* maximum available bus */ /************************* end of CAN **********************/ /*************** start of PROTOCOL_LAYER *******************/
 /begin PROTOCOL_LAYER /* At MODULE */ 0x0102 /* XCP protocol layer version */ 2000 /* T1 [ms] */ 2000 /* T2 [ms] */ 0 /* T3 [ms] */ 0 /* T4 [ms] */ 0 /* T5 [ms] */ 0 /* T6 [ms] */ 2000 /* T7 [ms] */ 8 /* MAX_CTO */ 8 /* MAX_DTO default for DAQ and STIM */ BYTE_ORDER_MSB_LAST /* BYTE_ORDER: INTEL */ ADDRESS_GRANULARITY_BYTE /* ADDRESS_GRANULARITY */ OPTIONAL_CMD GET_SEED OPTIONAL_CMD UNLOCK OPTIONAL_CMD SET_MTA OPTIONAL_CMD UPLOAD OPTIONAL_CMD SHORT_UPLOAD OPTIONAL_CMD BUILD_CHECKSUM OPTIONAL_CMD DOWNLOAD OPTIONAL_CMD DOWNLOAD_NEXT OPTIONAL_CMD DOWNLOAD_MAX OPTIONAL_CMD MODIFY_BITS OPTIONAL_CMD SET_CAL_PAGE OPTIONAL_CMD GET_CAL_PAGE OPTIONAL_CMD GET_PAG_PROCESSOR_INFO OPTIONAL_CMD GET_SEGMENT_INFO OPTIONAL_CMD GET_PAGE_INFO OPTIONAL_CMD COPY_CAL_PAGE OPTIONAL_CMD CLEAR_DAQ_LIST OPTIONAL_CMD SET_DAQ_PTR OPTIONAL_CMD WRITE_DAQ OPTIONAL_CMD SET_DAQ_LIST_MODE OPTIONAL_CMD START_STOP_DAQ_LIST OPTIONAL_CMD START_STOP_SYNCH OPTIONAL_CMD GET_DAQ_CLOCK OPTIONAL_CMD READ_DAQ OPTIONAL_CMD GET_DAQ_PROCESSOR_INFO OPTIONAL_CMD GET_DAQ_RESOLUTION_INFO OPTIONAL_CMD GET_DAQ_EVENT_INFO OPTIONAL_CMD FREE_DAQ OPTIONAL_CMD ALLOC_DAQ OPTIONAL_CMD ALLOC_ODT OPTIONAL_CMD ALLOC_ODT_ENTRY COMMUNICATION_MODE_SUPPORTED /* optional modes supported */ BLOCK SLAVE /* Slave Block Mode supported */ MASTER /* Master Block Mode supported */ 255 /* MAX_BS */ 0 /* MIN_ST */ SEED_AND_KEY_EXTERNAL_FUNCTION "XcpSeedNKey.dll" /* Name of the SeedAndKey function */ /* including file extension */ /* without path */ /end PROTOCOL_LAYER
 /***************** end of PROTOCOL_LAYER *******************/ /********************* start of DAQ ************************/
 /begin DAQ /* DAQ supported, at MODULE*/ DYNAMIC /* DAQ_CONFIG_TYPE */ 65535 /* MAX_DAQ */ 3 /* MAX_EVENT_CHANNEL */ 0 /* MIN_DAQ */ OPTIMISATION_TYPE_DEFAULT /* OPTIMISATION_TYPE */ ADDRESS_EXTENSION_FREE /* ADDRESS_EXTENSION */ IDENTIFICATION_FIELD_TYPE_ABSOLUTE /* IDENTIFICATION_FIELD */ GRANULARITY_ODT_ENTRY_SIZE_DAQ_BYTE /* GRANULARITY_ODT_ENTRY_SIZE_DAQ */ 255 /* MAX_ODT_ENTRY_SIZE_DAQ */ NO_OVERLOAD_INDICATION /* OVERLOAD_INDICATION */ PRESCALER_SUPPORTED
  /begin TIMESTAMP_SUPPORTED 1 /* TIMESTAMP_TICKS */ SIZE_WORD /* TIMESTAMP_SIZE */ UNIT_1MS /* RESOLUTION OF TIMESTAMP */ /end TIMESTAMP_SUPPORTED
  /begin DAQ_MEMORY_CONSUMPTION 4091 /* DAQ_MEMORY_LIMIT: in Elements[AG] */ 46 /* DAQ_SIZE: number of elements[AG] per DAQ list */ 6 /* ODT_SIZE: number of elements[AG] per ODT */ 5 /* ODT_ENTRY_SIZE: number of elements[AG] per ODT_entry */ 2 /* ODT_DAQ_BUFFER_ELEMENT_SIZE: number of */ /* payload elements[AG]*factor = sizeof(send buffer)[AG] */ 0 /* ODT_STIM_BUFFER_ELEMENT_SIZE: number of */ /* payload elements[AG]*factor = sizeof(receive buffer)[AG] */ /end DAQ_MEMORY_CONSUMPTION
  /******************* start of EVENT ************************/
  /begin EVENT "XcpEvent_2ms_Raster" "2msRstr" 0 DAQ 1 2 6 /* EVENT_CHANNEL_TIME_UNIT: UNIT_1MS */ 3 /end EVENT
  /begin EVENT "XcpEvent_10ms_Raster" "10msRstr" 1 DAQ 1 10 6 /* EVENT_CHANNEL_TIME_UNIT: UNIT_1MS */ 2 /end EVENT
  /begin EVENT "XcpEvent_100ms_Raster" "100msRstr" 2 DAQ 1 10 7 /* EVENT_CHANNEL_TIME_UNIT: UNIT_10MS */ 1 /end EVENT
  /********************* end of EVENT ************************/ /end DAQ
 /********************* end of DAQ **************************/ TRANSPORT_LAYER_INSTANCE "XCP_TPL" /end XCP_ON_CAN
