AUTOSAR XML (schema 4-0-2)
package /ETAS/UBK/Project/EcucModuleConfigurationValuess
  module config rta_bsw_Reset
    rta_bsw_Reset_Config
      4 x rta_bsw_Reset_ConfData, all with rta_bsw_Reset_DemVis=RTA_BSW_RESET_DEM_0, rta_bsw_Reset_GrpId=RTA_BSW_RESET_GRP_RTA_BSW_BSWSRV_E, rta_bsw_Reset_HistBufVis=true, rta_bsw_Reset_LoopCond=RTA_BSW_RESET_DEFAULT_LOOPCOND, rta_bsw_Reset_SoftReset=false:
        RTA_BSW_RESET_RTA_BSW_BSWSRV_INTSUSP_CTR_VIOLATION_E: rta_bsw_Reset_Desc=Invalid use of interrupt resume: suspend counter underflow
        RTA_BSW_RESET_RTA_BSW_BSWSRV_INTSUSP_CORRUPTION: rta_bsw_Reset_Desc=Interrupt suspend state corrupted by other software
        RTA_BSW_RESET_RTA_BSW_BSWSRV_LOCK_NESTING_VIOLATION_E: rta_bsw_Reset_Desc=Invalid use of spinlock: lock nesting violation
        RTA_BSW_RESET_RTA_BSW_BSWSRV_LOCK_CTR_VIOLATION_E: rta_bsw_Reset_Desc=Invalid use of spinlock: lock counter underflow
