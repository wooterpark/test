AUTOSAR XML (schema 4-2-1)
package /Interfaces
  8 x client server interface, all with is-service=true:
    IoHwAb_IN_Interface
      operation IoHwAb_DIO_Get
        arg channel: type=uint16, direction=IN
        arg dio_status: type=boolean, direction=OUT
    IoHwAb_OUT_Interface
      operation IoHwAb_DIO_Set
        arg channel: type=uint16, direction=IN
        arg dio_status: type=boolean, direction=IN
    IoHwAb_ADC_Interface
      operation IoHwAb_ADC_GetPhyVoltage
        arg Channel: type=uint8, direction=IN
        arg RawVoltage: type=float32, direction=OUT
    IoHwAb_PWM_SetDutyCycle_Interface
      operation IoHwAb_PWM_SetDutyCycle
        arg channel: type=uint16, direction=IN
        arg dutycycle: type=float32, direction=IN
    IoHwAb_PWM_SetPeriod_DutyCycle_Interface
      operation IoHwAb_PWM_SetPeriod_DutyCycle
        arg channel: type=uint16, direction=IN
        arg period: type=uint32, direction=IN
        arg dutycycle: type=float32, direction=IN
    IoHwAb_ADC_Control_Interface
      operation IoHwAb_ADC_StartConversion
        arg Channel: type=uint8, direction=IN
        arg Start: type=boolean, direction=IN
    IoHwAb_ICU_GetPeriod_DutyCycle_Interface
      operation IoHwAb_ICU_GetPeriod_DutyCycle
        arg channel: type=uint8, direction=IN
        arg Period: type=float32, direction=OUT
        arg Dutycycle: type=float32, direction=OUT
    IoHwAb_ICU_StartMeasurement_Interface
      operation IoHwAb_ICU_StartMeasurement
        arg channel: type=uint8, direction=IN
        arg Mode: type=boolean, direction=IN
