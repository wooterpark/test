/******************************************************************************
* ASAP2 file: SWC_SWD.a2l
* Code generation for model "SWC_SWD".
* Model version : 1.555
* Simulink Coder version : 9.3 (R2020a) 18-Nov-2019
* C source code generated on : Wed Jan 12 17:55:55 2022
* Target selection: ert.tlc
* Embedded hardware selection: Intel->x86-64 (Windows64)
* Code generation objectives: Unspecified
* Validation result: Not run
* (add additional file header information here)
******************************************************************************/ ASAP2_VERSION 1 31
/* Version 1.31 */
/begin PROJECT ProjectName "Project Comment Goes Here"
/begin HEADER "Header Comments go here" /end HEADER
/begin MODULE ModuleName "Module Comment Goes Here"
/begin MOD_PAR "MOD PAR Comment Goes Here" /end MOD_PAR
/begin MOD_COMMON "Mod Common Comment Here" BYTE_ORDER MSB_LAST /end MOD_COMMON
/begin RECORD_LAYOUT Scalar_BOOLEAN FNC_VALUES 1 UBYTE COLUMN_DIR DIRECT /end RECORD_LAYOUT
/begin RECORD_LAYOUT Scalar_UBYTE FNC_VALUES 1 UBYTE COLUMN_DIR DIRECT /end RECORD_LAYOUT
/begin RECORD_LAYOUT Scalar_BYTE FNC_VALUES 1 SBYTE COLUMN_DIR DIRECT /end RECORD_LAYOUT
/begin RECORD_LAYOUT Scalar_UWORD FNC_VALUES 1 UWORD COLUMN_DIR DIRECT /end RECORD_LAYOUT
/begin RECORD_LAYOUT Scalar_SWORD FNC_VALUES 1 SWORD COLUMN_DIR DIRECT /end RECORD_LAYOUT
/begin RECORD_LAYOUT Scalar_ULONG FNC_VALUES 1 ULONG COLUMN_DIR DIRECT /end RECORD_LAYOUT
/begin RECORD_LAYOUT Scalar_LONG FNC_VALUES 1 SLONG COLUMN_DIR DIRECT /end RECORD_LAYOUT
/begin RECORD_LAYOUT Scalar_FLOAT32_IEEE FNC_VALUES 1 FLOAT32_IEEE COLUMN_DIR DIRECT /end RECORD_LAYOUT
/begin RECORD_LAYOUT Scalar_FLOAT64_IEEE FNC_VALUES 1 FLOAT64_IEEE COLUMN_DIR DIRECT /end RECORD_LAYOUT
/begin RECORD_LAYOUT Lookup1D_BOOLEAN FNC_VALUES 1 UBYTE COLUMN_DIR DIRECT /end RECORD_LAYOUT
/begin RECORD_LAYOUT Lookup1D_X_BOOLEAN AXIS_PTS_X 1 UBYTE INDEX_INCR DIRECT /end RECORD_LAYOUT
/begin RECORD_LAYOUT Lookup1D_BYTE FNC_VALUES 1 SBYTE COLUMN_DIR DIRECT /end RECORD_LAYOUT
/begin RECORD_LAYOUT Lookup1D_X_BYTE AXIS_PTS_X 1 SBYTE INDEX_INCR DIRECT /end RECORD_LAYOUT
/begin RECORD_LAYOUT Lookup1D_UBYTE FNC_VALUES 1 UBYTE COLUMN_DIR DIRECT /end RECORD_LAYOUT
/begin RECORD_LAYOUT Lookup1D_X_UBYTE AXIS_PTS_X 1 UBYTE INDEX_INCR DIRECT /end RECORD_LAYOUT
/begin RECORD_LAYOUT Lookup1D_UWORD FNC_VALUES 1 UWORD COLUMN_DIR DIRECT /end RECORD_LAYOUT
/begin RECORD_LAYOUT Lookup1D_X_UWORD AXIS_PTS_X 1 UWORD INDEX_INCR DIRECT /end RECORD_LAYOUT
/begin RECORD_LAYOUT Lookup1D_WORD FNC_VALUES 1 SWORD COLUMN_DIR DIRECT /end RECORD_LAYOUT
/begin RECORD_LAYOUT Lookup1D_X_WORD AXIS_PTS_X 1 SWORD INDEX_INCR DIRECT /end RECORD_LAYOUT
/begin RECORD_LAYOUT Lookup1D_ULONG FNC_VALUES 1 ULONG COLUMN_DIR DIRECT /end RECORD_LAYOUT
/begin RECORD_LAYOUT Lookup1D_X_ULONG AXIS_PTS_X 1 ULONG INDEX_INCR DIRECT /end RECORD_LAYOUT
/begin RECORD_LAYOUT Lookup1D_SLONG FNC_VALUES 1 SLONG COLUMN_DIR DIRECT /end RECORD_LAYOUT
/begin RECORD_LAYOUT Lookup1D_X_LONG AXIS_PTS_X 1 SLONG INDEX_INCR DIRECT /end RECORD_LAYOUT
/begin RECORD_LAYOUT Lookup1D_FLOAT32_IEEE FNC_VALUES 1 FLOAT32_IEEE COLUMN_DIR DIRECT /end RECORD_LAYOUT
/begin RECORD_LAYOUT Lookup1D_X_FLOAT32_IEEE AXIS_PTS_X 1 FLOAT32_IEEE INDEX_INCR DIRECT /end RECORD_LAYOUT
/begin RECORD_LAYOUT Lookup1D_FLOAT64_IEEE FNC_VALUES 1 FLOAT64_IEEE COLUMN_DIR DIRECT /end RECORD_LAYOUT
/begin RECORD_LAYOUT Lookup1D_X_FLOAT64_IEEE AXIS_PTS_X 1 FLOAT64_IEEE INDEX_INCR DIRECT /end RECORD_LAYOUT
/begin RECORD_LAYOUT Lookup2D_BOOLEAN FNC_VALUES 1 UBYTE COLUMN_DIR DIRECT /end RECORD_LAYOUT
/begin RECORD_LAYOUT Lookup2D_X_BOOLEAN AXIS_PTS_X 1 UBYTE INDEX_INCR DIRECT /end RECORD_LAYOUT
/begin RECORD_LAYOUT Lookup2D_UBYTE FNC_VALUES 1 UBYTE COLUMN_DIR DIRECT /end RECORD_LAYOUT
/begin RECORD_LAYOUT Lookup2D_X_UBYTE AXIS_PTS_X 1 UBYTE INDEX_INCR DIRECT /end RECORD_LAYOUT
/begin RECORD_LAYOUT Lookup2D_BYTE FNC_VALUES 1 SBYTE COLUMN_DIR DIRECT /end RECORD_LAYOUT
/begin RECORD_LAYOUT Lookup2D_X_BYTE AXIS_PTS_X 1 SBYTE INDEX_INCR DIRECT /end RECORD_LAYOUT
/begin RECORD_LAYOUT Lookup2D_UWORD FNC_VALUES 1 UWORD COLUMN_DIR DIRECT /end RECORD_LAYOUT
/begin RECORD_LAYOUT Lookup2D_X_UWORD AXIS_PTS_X 1 UWORD INDEX_INCR DIRECT /end RECORD_LAYOUT
/begin RECORD_LAYOUT Lookup2D_WORD FNC_VALUES 1 SWORD COLUMN_DIR DIRECT /end RECORD_LAYOUT
/begin RECORD_LAYOUT Lookup2D_X_WORD AXIS_PTS_X 1 SWORD INDEX_INCR DIRECT /end RECORD_LAYOUT
/begin RECORD_LAYOUT Lookup2D_ULONG FNC_VALUES 1 ULONG COLUMN_DIR DIRECT /end RECORD_LAYOUT
/begin RECORD_LAYOUT Lookup2D_X_ULONG AXIS_PTS_X 1 ULONG INDEX_INCR DIRECT /end RECORD_LAYOUT
/begin RECORD_LAYOUT Lookup2D_LONG FNC_VALUES 1 SLONG COLUMN_DIR DIRECT /end RECORD_LAYOUT
/begin RECORD_LAYOUT Lookup2D_X_LONG AXIS_PTS_X 1 SLONG INDEX_INCR DIRECT /end RECORD_LAYOUT
/begin RECORD_LAYOUT Lookup2D_FLOAT32_IEEE FNC_VALUES 1 FLOAT32_IEEE COLUMN_DIR DIRECT /end RECORD_LAYOUT
/begin RECORD_LAYOUT Lookup2D_X_FLOAT32_IEEE AXIS_PTS_X 1 FLOAT32_IEEE INDEX_INCR DIRECT /end RECORD_LAYOUT
/begin RECORD_LAYOUT Lookup2D_FLOAT64_IEEE FNC_VALUES 1 FLOAT64_IEEE COLUMN_DIR DIRECT /end RECORD_LAYOUT
/begin RECORD_LAYOUT Lookup2D_X_FLOAT64_IEEE AXIS_PTS_X 1 FLOAT64_IEEE INDEX_INCR DIRECT /end RECORD_LAYOUT
/begin CHARACTERISTIC CAL_SWD_Radian_u16 "" /* Characteristic Type */ CURVE 0x0000 /* @ECU_Address@CAL_SWD_Radian_u16@ */ Lookup1D_UWORD /* Maxdiff */ 0 SWC_SWD_CM_uint16 0 65535
 /begin AXIS_DESCR /* Description of X-Axis Points */ /* Axis Type */ FIX_AXIS /* Reference to Input */ NO_INPUT_QUANTITY SWC_SWD_CM_uint32 /* Number of Axis Pts */ 1025 0 1024 FIX_AXIS_PAR_DIST 0 1 1025 /end AXIS_DESCR
/end CHARACTERISTIC
/begin CHARACTERISTIC CAL_SWD_AgrslvCompCnt_f32 "" /* Type */ VALUE 0x0000 /* @ECU_Address@CAL_SWD_AgrslvCompCnt_f32@ */ Scalar_FLOAT32_IEEE /* Maximum Difference */ 0 SWC_SWD_CM_single -3.4E+38 3.4E+38 /end CHARACTERISTIC
/begin CHARACTERISTIC CAL_SWD_MotorPole_u8 "" /* Type */ VALUE 0x0000 /* @ECU_Address@CAL_SWD_MotorPole_u8@ */ Scalar_UBYTE /* Maximum Difference */ 0 SWC_SWD_CM_uint8 0.0 255.0 /end CHARACTERISTIC
/begin MEASUREMENT VAR_SWD_Spd_f32 "" FLOAT32_IEEE SWC_SWD_CM_single 0 0 -24000.0 24000.0 ECU_ADDRESS 0x0000 /* @ECU_Address@VAR_SWD_Spd_f32@ */ /end MEASUREMENT
/begin MEASUREMENT VAR_SWD_AgRslvDelta0_f32 "" FLOAT32_IEEE SWC_SWD_CM_single 0 0 -10000.0 10000.0 ECU_ADDRESS 0x0000 /* @ECU_Address@VAR_SWD_AgRslvDelta0_f32@ */ /end MEASUREMENT
/begin MEASUREMENT VAR_SWD_AgRslvDelta_f32 "" FLOAT32_IEEE SWC_SWD_CM_single 0 0 -10000.0 10000.0 ECU_ADDRESS 0x0000 /* @ECU_Address@VAR_SWD_AgRslvDelta_f32@ */ /end MEASUREMENT
/begin MEASUREMENT VAR_SWD_Tan_f32 "" FLOAT32_IEEE SWC_SWD_CM_single 0 0 0.0 1000.0 ECU_ADDRESS 0x0000 /* @ECU_Address@VAR_SWD_Tan_f32@ */ /end MEASUREMENT
/begin MEASUREMENT VAR_SWD_AgRslv45_f32 "" FLOAT32_IEEE SWC_SWD_CM_single 0 0 -360.0 360.0 ECU_ADDRESS 0x0000 /* @ECU_Address@VAR_SWD_AgRslv45_f32@ */ /end MEASUREMENT
/begin MEASUREMENT VAR_SWD_AgRslv_f32 "" FLOAT32_IEEE SWC_SWD_CM_single 0 0 -360.0 360.0 ECU_ADDRESS 0x0000 /* @ECU_Address@VAR_SWD_AgRslv_f32@ */ /end MEASUREMENT
/begin COMPU_METHOD SWC_SWD_CM_uint16 "Q = V" RAT_FUNC "%5.0" "" COEFFS 0 1 0 0 0 1 /end COMPU_METHOD
/begin COMPU_METHOD SWC_SWD_CM_uint32 "Q = V" RAT_FUNC "%10.0" "" COEFFS 0 1 0 0 0 1 /end COMPU_METHOD
/begin COMPU_METHOD SWC_SWD_CM_single "Q = V" RAT_FUNC "%8.6" "" COEFFS 0 1 0 0 0 1 /end COMPU_METHOD
/begin COMPU_METHOD SWC_SWD_CM_uint8 "Q = V" RAT_FUNC "%3.0" "" COEFFS 0 1 0 0 0 1 /end COMPU_METHOD
/begin GROUP SWC_SWD "SWC_SWD" /* Root */ ROOT /begin SUB_GROUP Root_SWC_SWD_100us_sys /end SUB_GROUP /end GROUP
/begin GROUP Root_SWC_SWD_100us_sys "SWC_SWD/SWC_SWD_100us_sys" /begin SUB_GROUP S1_SWDecode S1_SpdCalc /end SUB_GROUP /end GROUP
/begin GROUP S1_SWDecode "SWC_SWD/SWC_SWD_100us_sys/SWDecode" /begin SUB_GROUP S3_AgRslvCalc S3_TanCalc /end SUB_GROUP /end GROUP
/begin GROUP S1_SpdCalc "SWC_SWD/SWC_SWD_100us_sys/SpdCalc" /begin SUB_GROUP S4_AgRslvDeltaCalc S4_SpdCalc /end SUB_GROUP /end GROUP
/begin GROUP S3_AgRslvCalc "SWC_SWD/SWC_SWD_100us_sys/SWDecode/AgRslvCalc" /begin REF_CHARACTERISTIC CAL_SWD_AgrslvCompCnt_f32 CAL_SWD_Radian_u16 /end REF_CHARACTERISTIC /begin REF_MEASUREMENT VAR_SWD_AgRslv45_f32 VAR_SWD_AgRslv_f32 /end REF_MEASUREMENT /end GROUP
/begin GROUP S3_TanCalc "SWC_SWD/SWC_SWD_100us_sys/SWDecode/TanCalc" /begin REF_MEASUREMENT VAR_SWD_Tan_f32 /end REF_MEASUREMENT /end GROUP
/begin GROUP S4_AgRslvDeltaCalc "SWC_SWD/SWC_SWD_100us_sys/SpdCalc/AgRslvDeltaCalc" /begin REF_MEASUREMENT VAR_SWD_AgRslvDelta0_f32 VAR_SWD_AgRslvDelta_f32 /end REF_MEASUREMENT /end GROUP
/begin GROUP S4_SpdCalc "SWC_SWD/SWC_SWD_100us_sys/SpdCalc/SpdCalc" /begin REF_CHARACTERISTIC CAL_SWD_MotorPole_u8 /end REF_CHARACTERISTIC /begin REF_MEASUREMENT VAR_SWD_Spd_f32 /end REF_MEASUREMENT /end GROUP
/end MODULE
/end PROJECT
/* (add any file trailer comments here) */
/* EOF SWC_SWD.a2l */
