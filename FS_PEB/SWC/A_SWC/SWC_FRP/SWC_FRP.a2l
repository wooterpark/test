/******************************************************************************
* ASAP2 file: SWC_FRP.a2l
* Code generation for model "SWC_FRP".
* Model version : 1.238
* Simulink Coder version : 9.3 (R2020a) 18-Nov-2019
* C source code generated on : Fri Jun 24 16:31:10 2022
* Target selection: ert.tlc
* Embedded hardware selection: Intel->x86-64 (Windows64)
* Code generation objectives: Unspecified
* Validation result: Not run
* (add additional file header information here)
******************************************************************************/ ASAP2_VERSION 1 31
/* Version 1.31 */
/begin PROJECT ProjectName "Project Comment Goes Here"
/begin HEADER "Header Comments go here" /end HEADER
/begin MODULE ModuleName "Module Comment Goes Here"
/begin MOD_PAR "MOD PAR Comment Goes Here" /end MOD_PAR
/begin MOD_COMMON "Mod Common Comment Here" BYTE_ORDER MSB_LAST /end MOD_COMMON
/begin RECORD_LAYOUT Scalar_BOOLEAN FNC_VALUES 1 UBYTE COLUMN_DIR DIRECT /end RECORD_LAYOUT
/begin RECORD_LAYOUT Scalar_UBYTE FNC_VALUES 1 UBYTE COLUMN_DIR DIRECT /end RECORD_LAYOUT
/begin RECORD_LAYOUT Scalar_BYTE FNC_VALUES 1 SBYTE COLUMN_DIR DIRECT /end RECORD_LAYOUT
/begin RECORD_LAYOUT Scalar_UWORD FNC_VALUES 1 UWORD COLUMN_DIR DIRECT /end RECORD_LAYOUT
/begin RECORD_LAYOUT Scalar_SWORD FNC_VALUES 1 SWORD COLUMN_DIR DIRECT /end RECORD_LAYOUT
/begin RECORD_LAYOUT Scalar_ULONG FNC_VALUES 1 ULONG COLUMN_DIR DIRECT /end RECORD_LAYOUT
/begin RECORD_LAYOUT Scalar_LONG FNC_VALUES 1 SLONG COLUMN_DIR DIRECT /end RECORD_LAYOUT
/begin RECORD_LAYOUT Scalar_FLOAT32_IEEE FNC_VALUES 1 FLOAT32_IEEE COLUMN_DIR DIRECT /end RECORD_LAYOUT
/begin RECORD_LAYOUT Scalar_FLOAT64_IEEE FNC_VALUES 1 FLOAT64_IEEE COLUMN_DIR DIRECT /end RECORD_LAYOUT
/begin RECORD_LAYOUT Lookup1D_BOOLEAN FNC_VALUES 1 UBYTE COLUMN_DIR DIRECT /end RECORD_LAYOUT
/begin RECORD_LAYOUT Lookup1D_X_BOOLEAN AXIS_PTS_X 1 UBYTE INDEX_INCR DIRECT /end RECORD_LAYOUT
/begin RECORD_LAYOUT Lookup1D_BYTE FNC_VALUES 1 SBYTE COLUMN_DIR DIRECT /end RECORD_LAYOUT
/begin RECORD_LAYOUT Lookup1D_X_BYTE AXIS_PTS_X 1 SBYTE INDEX_INCR DIRECT /end RECORD_LAYOUT
/begin RECORD_LAYOUT Lookup1D_UBYTE FNC_VALUES 1 UBYTE COLUMN_DIR DIRECT /end RECORD_LAYOUT
/begin RECORD_LAYOUT Lookup1D_X_UBYTE AXIS_PTS_X 1 UBYTE INDEX_INCR DIRECT /end RECORD_LAYOUT
/begin RECORD_LAYOUT Lookup1D_UWORD FNC_VALUES 1 UWORD COLUMN_DIR DIRECT /end RECORD_LAYOUT
/begin RECORD_LAYOUT Lookup1D_X_UWORD AXIS_PTS_X 1 UWORD INDEX_INCR DIRECT /end RECORD_LAYOUT
/begin RECORD_LAYOUT Lookup1D_WORD FNC_VALUES 1 SWORD COLUMN_DIR DIRECT /end RECORD_LAYOUT
/begin RECORD_LAYOUT Lookup1D_X_WORD AXIS_PTS_X 1 SWORD INDEX_INCR DIRECT /end RECORD_LAYOUT
/begin RECORD_LAYOUT Lookup1D_ULONG FNC_VALUES 1 ULONG COLUMN_DIR DIRECT /end RECORD_LAYOUT
/begin RECORD_LAYOUT Lookup1D_X_ULONG AXIS_PTS_X 1 ULONG INDEX_INCR DIRECT /end RECORD_LAYOUT
/begin RECORD_LAYOUT Lookup1D_SLONG FNC_VALUES 1 SLONG COLUMN_DIR DIRECT /end RECORD_LAYOUT
/begin RECORD_LAYOUT Lookup1D_X_LONG AXIS_PTS_X 1 SLONG INDEX_INCR DIRECT /end RECORD_LAYOUT
/begin RECORD_LAYOUT Lookup1D_FLOAT32_IEEE FNC_VALUES 1 FLOAT32_IEEE COLUMN_DIR DIRECT /end RECORD_LAYOUT
/begin RECORD_LAYOUT Lookup1D_X_FLOAT32_IEEE AXIS_PTS_X 1 FLOAT32_IEEE INDEX_INCR DIRECT /end RECORD_LAYOUT
/begin RECORD_LAYOUT Lookup1D_FLOAT64_IEEE FNC_VALUES 1 FLOAT64_IEEE COLUMN_DIR DIRECT /end RECORD_LAYOUT
/begin RECORD_LAYOUT Lookup1D_X_FLOAT64_IEEE AXIS_PTS_X 1 FLOAT64_IEEE INDEX_INCR DIRECT /end RECORD_LAYOUT
/begin RECORD_LAYOUT Lookup2D_BOOLEAN FNC_VALUES 1 UBYTE COLUMN_DIR DIRECT /end RECORD_LAYOUT
/begin RECORD_LAYOUT Lookup2D_X_BOOLEAN AXIS_PTS_X 1 UBYTE INDEX_INCR DIRECT /end RECORD_LAYOUT
/begin RECORD_LAYOUT Lookup2D_UBYTE FNC_VALUES 1 UBYTE COLUMN_DIR DIRECT /end RECORD_LAYOUT
/begin RECORD_LAYOUT Lookup2D_X_UBYTE AXIS_PTS_X 1 UBYTE INDEX_INCR DIRECT /end RECORD_LAYOUT
/begin RECORD_LAYOUT Lookup2D_BYTE FNC_VALUES 1 SBYTE COLUMN_DIR DIRECT /end RECORD_LAYOUT
/begin RECORD_LAYOUT Lookup2D_X_BYTE AXIS_PTS_X 1 SBYTE INDEX_INCR DIRECT /end RECORD_LAYOUT
/begin RECORD_LAYOUT Lookup2D_UWORD FNC_VALUES 1 UWORD COLUMN_DIR DIRECT /end RECORD_LAYOUT
/begin RECORD_LAYOUT Lookup2D_X_UWORD AXIS_PTS_X 1 UWORD INDEX_INCR DIRECT /end RECORD_LAYOUT
/begin RECORD_LAYOUT Lookup2D_WORD FNC_VALUES 1 SWORD COLUMN_DIR DIRECT /end RECORD_LAYOUT
/begin RECORD_LAYOUT Lookup2D_X_WORD AXIS_PTS_X 1 SWORD INDEX_INCR DIRECT /end RECORD_LAYOUT
/begin RECORD_LAYOUT Lookup2D_ULONG FNC_VALUES 1 ULONG COLUMN_DIR DIRECT /end RECORD_LAYOUT
/begin RECORD_LAYOUT Lookup2D_X_ULONG AXIS_PTS_X 1 ULONG INDEX_INCR DIRECT /end RECORD_LAYOUT
/begin RECORD_LAYOUT Lookup2D_LONG FNC_VALUES 1 SLONG COLUMN_DIR DIRECT /end RECORD_LAYOUT
/begin RECORD_LAYOUT Lookup2D_X_LONG AXIS_PTS_X 1 SLONG INDEX_INCR DIRECT /end RECORD_LAYOUT
/begin RECORD_LAYOUT Lookup2D_FLOAT32_IEEE FNC_VALUES 1 FLOAT32_IEEE COLUMN_DIR DIRECT /end RECORD_LAYOUT
/begin RECORD_LAYOUT Lookup2D_X_FLOAT32_IEEE AXIS_PTS_X 1 FLOAT32_IEEE INDEX_INCR DIRECT /end RECORD_LAYOUT
/begin RECORD_LAYOUT Lookup2D_FLOAT64_IEEE FNC_VALUES 1 FLOAT64_IEEE COLUMN_DIR DIRECT /end RECORD_LAYOUT
/begin RECORD_LAYOUT Lookup2D_X_FLOAT64_IEEE AXIS_PTS_X 1 FLOAT64_IEEE INDEX_INCR DIRECT /end RECORD_LAYOUT
/begin CHARACTERISTIC CAL_FRP_18VHSVoltRngErrOutCtl_b "" VALUE 0x0000 /* @ECU_Address@CAL_FRP_18VHSVoltRngErrOutCtl_b@ */ Scalar_BOOLEAN 0 SWC_FRP_CM_boolean 0 1 /end CHARACTERISTIC
/begin CHARACTERISTIC CAL_FRP_1V8CPLDVoltRngErrOutCtl_b "" VALUE 0x0000 /* @ECU_Address@CAL_FRP_1V8CPLDVoltRngErrOutCtl_b@ */ Scalar_BOOLEAN 0 SWC_FRP_CM_boolean 0 1 /end CHARACTERISTIC
/begin CHARACTERISTIC CAL_FRP_3V3CPLDVoltRngErrOutCtl_b "" VALUE 0x0000 /* @ECU_Address@CAL_FRP_3V3CPLDVoltRngErrOutCtl_b@ */ Scalar_BOOLEAN 0 SWC_FRP_CM_boolean 0 1 /end CHARACTERISTIC
/begin CHARACTERISTIC CAL_FRP_BMSVoltRngErrOutCtl_b "" VALUE 0x0000 /* @ECU_Address@CAL_FRP_BMSVoltRngErrOutCtl_b@ */ Scalar_BOOLEAN 0 SWC_FRP_CM_boolean 0 1 /end CHARACTERISTIC
/begin CHARACTERISTIC CAL_FRP_CurrRngErrOutCtl_b "" VALUE 0x0000 /* @ECU_Address@CAL_FRP_CurrRngErrOutCtl_b@ */ Scalar_BOOLEAN 0 SWC_FRP_CM_boolean 0 1 /end CHARACTERISTIC
/begin CHARACTERISTIC CAL_FRP_CurrSumErrOutCtl_b "" VALUE 0x0000 /* @ECU_Address@CAL_FRP_CurrSumErrOutCtl_b@ */ Scalar_BOOLEAN 0 SWC_FRP_CM_boolean 0 1 /end CHARACTERISTIC
/begin CHARACTERISTIC CAL_FRP_FaultReactCtl_b "" VALUE 0x0000 /* @ECU_Address@CAL_FRP_FaultReactCtl_b@ */ Scalar_BOOLEAN 0 SWC_FRP_CM_boolean 0 1 /end CHARACTERISTIC
/begin CHARACTERISTIC CAL_FRP_ModeReqRngErrOutCtl_b "" VALUE 0x0000 /* @ECU_Address@CAL_FRP_ModeReqRngErrOutCtl_b@ */ Scalar_BOOLEAN 0 SWC_FRP_CM_boolean 0 1 /end CHARACTERISTIC
/begin CHARACTERISTIC CAL_FRP_NSetPRngErrOutCtl_b "" VALUE 0x0000 /* @ECU_Address@CAL_FRP_NSetPRngErrOutCtl_b@ */ Scalar_BOOLEAN 0 SWC_FRP_CM_boolean 0 1 /end CHARACTERISTIC
/begin CHARACTERISTIC CAL_FRP_OffsetRngErrrOutCtl_b "" VALUE 0x0000 /* @ECU_Address@CAL_FRP_OffsetRngErrrOutCtl_b@ */ Scalar_BOOLEAN 0 SWC_FRP_CM_boolean 0 1 /end CHARACTERISTIC
/begin CHARACTERISTIC CAL_FRP_RslvExciRngErrOutCtl_b "" VALUE 0x0000 /* @ECU_Address@CAL_FRP_RslvExciRngErrOutCtl_b@ */ Scalar_BOOLEAN 0 SWC_FRP_CM_boolean 0 1 /end CHARACTERISTIC
/begin CHARACTERISTIC CAL_FRP_RslvRngErrOutCtl_b "" VALUE 0x0000 /* @ECU_Address@CAL_FRP_RslvRngErrOutCtl_b@ */ Scalar_BOOLEAN 0 SWC_FRP_CM_boolean 0 1 /end CHARACTERISTIC
/begin CHARACTERISTIC CAL_FRP_RslvSensVolRngErrOutCtl_b "" VALUE 0x0000 /* @ECU_Address@CAL_FRP_RslvSensVolRngErrOutCtl_b@ */ Scalar_BOOLEAN 0 SWC_FRP_CM_boolean 0 1 /end CHARACTERISTIC
/begin CHARACTERISTIC CAL_FRP_RslvSqrtErrOutCtl_b "" VALUE 0x0000 /* @ECU_Address@CAL_FRP_RslvSqrtErrOutCtl_b@ */ Scalar_BOOLEAN 0 SWC_FRP_CM_boolean 0 1 /end CHARACTERISTIC
/begin CHARACTERISTIC CAL_FRP_TrqCalcErrOutCtl_b "" VALUE 0x0000 /* @ECU_Address@CAL_FRP_TrqCalcErrOutCtl_b@ */ Scalar_BOOLEAN 0 SWC_FRP_CM_boolean 0 1 /end CHARACTERISTIC
/begin CHARACTERISTIC CAL_FRP_TrqSetPRngErrOutCtl_b "" VALUE 0x0000 /* @ECU_Address@CAL_FRP_TrqSetPRngErrOutCtl_b@ */ Scalar_BOOLEAN 0 SWC_FRP_CM_boolean 0 1 /end CHARACTERISTIC
/begin CHARACTERISTIC CAL_FRP_UBRVoltRngErrOutCtl_b "" VALUE 0x0000 /* @ECU_Address@CAL_FRP_UBRVoltRngErrOutCtl_b@ */ Scalar_BOOLEAN 0 SWC_FRP_CM_boolean 0 1 /end CHARACTERISTIC
/begin CHARACTERISTIC CAL_FRP_UintndSpdErrOutCtl_b "" VALUE 0x0000 /* @ECU_Address@CAL_FRP_UintndSpdErrOutCtl_b@ */ Scalar_BOOLEAN 0 SWC_FRP_CM_boolean 0 1 /end CHARACTERISTIC
/begin CHARACTERISTIC CAL_FRP_UintndTrqErrOutCtl_b "" VALUE 0x0000 /* @ECU_Address@CAL_FRP_UintndTrqErrOutCtl_b@ */ Scalar_BOOLEAN 0 SWC_FRP_CM_boolean 0 1 /end CHARACTERISTIC
/begin CHARACTERISTIC CAL_FRP_VoltCmpChkErrOutCtl_b "" VALUE 0x0000 /* @ECU_Address@CAL_FRP_VoltCmpChkErrOutCtl_b@ */ Scalar_BOOLEAN 0 SWC_FRP_CM_boolean 0 1 /end CHARACTERISTIC
/begin CHARACTERISTIC CAL_FRP_iPhasSensVolRngErrOutCtl_b "" VALUE 0x0000 /* @ECU_Address@CAL_FRP_iPhasSensVolRngErrOutCtl_b@ */ Scalar_BOOLEAN 0 SWC_FRP_CM_boolean 0 1 /end CHARACTERISTIC
/begin MEASUREMENT VAR_FRP_FaultInfo_u32 "" /* Data type */ ULONG /* Conversion method */ SWC_FRP_CM_uint32 /* Resolution (Not used) */ 0 /* Accuracy (Not used) */ 0 /* Lower limit */ 0 /* Upper limit */ 4294967295 ECU_ADDRESS 0x0000 /* @ECU_Address@VAR_FRP_FaultInfo_u32@ */ /end MEASUREMENT
/begin MEASUREMENT VAR_FRP_FaultReact_b "" /* Data type */ UBYTE /* Conversion method */ SWC_FRP_CM_boolean /* Resolution (Not used) */ 0 /* Accuracy (Not used) */ 0 /* Lower limit */ 0 /* Upper limit */ 1 ECU_ADDRESS 0x0000 /* @ECU_Address@VAR_FRP_FaultReact_b@ */ /end MEASUREMENT
/begin COMPU_METHOD /* Name of CompuMethod */ SWC_FRP_CM_boolean "Q = V" /* Conversion Type */ RAT_FUNC /* Format */ "%1.0" /* Units */ "" /* Coefficients */ COEFFS 0 1 0 0 0 1 /end COMPU_METHOD
/begin COMPU_METHOD /* Name of CompuMethod */ SWC_FRP_CM_uint32 "Q = V" /* Conversion Type */ RAT_FUNC /* Format */ "%10.0" /* Units */ "" /* Coefficients */ COEFFS 0 1 0 0 0 1 /end COMPU_METHOD
/begin GROUP SWC_FRP "SWC_FRP" /* Root */ ROOT /begin SUB_GROUP Root_SWC_FRM_1ms_sys /end SUB_GROUP /end GROUP
/begin GROUP Root_SWC_FRM_1ms_sys "SWC_FRP/SWC_FRM_1ms_sys" /begin SUB_GROUP S1_FaultInfoGen S1_FaultReactGen /end SUB_GROUP /end GROUP
/begin GROUP S1_FaultInfoGen "SWC_FRP/SWC_FRM_1ms_sys/FaultInfoGen" /begin REF_MEASUREMENT VAR_FRP_FaultInfo_u32 /end REF_MEASUREMENT /end GROUP
/begin GROUP S1_FaultReactGen "SWC_FRP/SWC_FRM_1ms_sys/FaultReactGen"
 /begin REF_CHARACTERISTIC CAL_FRP_18VHSVoltRngErrOutCtl_b CAL_FRP_1V8CPLDVoltRngErrOutCtl_b CAL_FRP_3V3CPLDVoltRngErrOutCtl_b CAL_FRP_BMSVoltRngErrOutCtl_b CAL_FRP_CurrRngErrOutCtl_b CAL_FRP_CurrSumErrOutCtl_b CAL_FRP_FaultReactCtl_b CAL_FRP_ModeReqRngErrOutCtl_b CAL_FRP_NSetPRngErrOutCtl_b CAL_FRP_OffsetRngErrrOutCtl_b CAL_FRP_RslvExciRngErrOutCtl_b CAL_FRP_RslvRngErrOutCtl_b CAL_FRP_RslvSensVolRngErrOutCtl_b CAL_FRP_RslvSqrtErrOutCtl_b CAL_FRP_TrqCalcErrOutCtl_b CAL_FRP_TrqSetPRngErrOutCtl_b CAL_FRP_UBRVoltRngErrOutCtl_b CAL_FRP_UintndSpdErrOutCtl_b CAL_FRP_UintndTrqErrOutCtl_b CAL_FRP_VoltCmpChkErrOutCtl_b CAL_FRP_iPhasSensVolRngErrOutCtl_b /end REF_CHARACTERISTIC
 /begin REF_MEASUREMENT VAR_FRP_FaultReact_b /end REF_MEASUREMENT
/end GROUP
/end MODULE
/end PROJECT
/* (add any file trailer comments here) */
/* EOF SWC_FRP.a2l */
