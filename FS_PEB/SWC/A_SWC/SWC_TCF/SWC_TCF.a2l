/******************************************************************************
* ASAP2 file: SWC_TCF.a2l
* Code generation for model "SWC_TCF".
* Model version : 1.604
* Simulink Coder version : 9.3 (R2020a) 18-Nov-2019
* C source code generated on : Wed May 25 19:51:06 2022
* Target selection: ert.tlc
* Embedded hardware selection: Intel->x86-64 (Windows64)
* Code generation objectives: Unspecified
* Validation result: Not run
* (add additional file header information here)
******************************************************************************/ ASAP2_VERSION 1 31
/* Version 1.31 */
/begin PROJECT ProjectName "Project Comment Goes Here"
/begin HEADER "Header Comments go here" /end HEADER
/begin MODULE ModuleName "Module Comment Goes Here"
/begin MOD_PAR "MOD PAR Comment Goes Here" /end MOD_PAR
/begin MOD_COMMON "Mod Common Comment Here" BYTE_ORDER MSB_LAST /end MOD_COMMON
/begin RECORD_LAYOUT Scalar_BOOLEAN FNC_VALUES 1 UBYTE COLUMN_DIR DIRECT /end RECORD_LAYOUT
/begin RECORD_LAYOUT Scalar_UBYTE FNC_VALUES 1 UBYTE COLUMN_DIR DIRECT /end RECORD_LAYOUT
/begin RECORD_LAYOUT Scalar_BYTE FNC_VALUES 1 SBYTE COLUMN_DIR DIRECT /end RECORD_LAYOUT
/begin RECORD_LAYOUT Scalar_UWORD FNC_VALUES 1 UWORD COLUMN_DIR DIRECT /end RECORD_LAYOUT
/begin RECORD_LAYOUT Scalar_SWORD FNC_VALUES 1 SWORD COLUMN_DIR DIRECT /end RECORD_LAYOUT
/begin RECORD_LAYOUT Scalar_ULONG FNC_VALUES 1 ULONG COLUMN_DIR DIRECT /end RECORD_LAYOUT
/begin RECORD_LAYOUT Scalar_LONG FNC_VALUES 1 SLONG COLUMN_DIR DIRECT /end RECORD_LAYOUT
/begin RECORD_LAYOUT Scalar_FLOAT32_IEEE FNC_VALUES 1 FLOAT32_IEEE COLUMN_DIR DIRECT /end RECORD_LAYOUT
/begin RECORD_LAYOUT Scalar_FLOAT64_IEEE FNC_VALUES 1 FLOAT64_IEEE COLUMN_DIR DIRECT /end RECORD_LAYOUT
/begin RECORD_LAYOUT Lookup1D_BOOLEAN FNC_VALUES 1 UBYTE COLUMN_DIR DIRECT /end RECORD_LAYOUT
/begin RECORD_LAYOUT Lookup1D_X_BOOLEAN AXIS_PTS_X 1 UBYTE INDEX_INCR DIRECT /end RECORD_LAYOUT
/begin RECORD_LAYOUT Lookup1D_BYTE FNC_VALUES 1 SBYTE COLUMN_DIR DIRECT /end RECORD_LAYOUT
/begin RECORD_LAYOUT Lookup1D_X_BYTE AXIS_PTS_X 1 SBYTE INDEX_INCR DIRECT /end RECORD_LAYOUT
/begin RECORD_LAYOUT Lookup1D_UBYTE FNC_VALUES 1 UBYTE COLUMN_DIR DIRECT /end RECORD_LAYOUT
/begin RECORD_LAYOUT Lookup1D_X_UBYTE AXIS_PTS_X 1 UBYTE INDEX_INCR DIRECT /end RECORD_LAYOUT
/begin RECORD_LAYOUT Lookup1D_UWORD FNC_VALUES 1 UWORD COLUMN_DIR DIRECT /end RECORD_LAYOUT
/begin RECORD_LAYOUT Lookup1D_X_UWORD AXIS_PTS_X 1 UWORD INDEX_INCR DIRECT /end RECORD_LAYOUT
/begin RECORD_LAYOUT Lookup1D_WORD FNC_VALUES 1 SWORD COLUMN_DIR DIRECT /end RECORD_LAYOUT
/begin RECORD_LAYOUT Lookup1D_X_WORD AXIS_PTS_X 1 SWORD INDEX_INCR DIRECT /end RECORD_LAYOUT
/begin RECORD_LAYOUT Lookup1D_ULONG FNC_VALUES 1 ULONG COLUMN_DIR DIRECT /end RECORD_LAYOUT
/begin RECORD_LAYOUT Lookup1D_X_ULONG AXIS_PTS_X 1 ULONG INDEX_INCR DIRECT /end RECORD_LAYOUT
/begin RECORD_LAYOUT Lookup1D_SLONG FNC_VALUES 1 SLONG COLUMN_DIR DIRECT /end RECORD_LAYOUT
/begin RECORD_LAYOUT Lookup1D_X_LONG AXIS_PTS_X 1 SLONG INDEX_INCR DIRECT /end RECORD_LAYOUT
/begin RECORD_LAYOUT Lookup1D_FLOAT32_IEEE FNC_VALUES 1 FLOAT32_IEEE COLUMN_DIR DIRECT /end RECORD_LAYOUT
/begin RECORD_LAYOUT Lookup1D_X_FLOAT32_IEEE AXIS_PTS_X 1 FLOAT32_IEEE INDEX_INCR DIRECT /end RECORD_LAYOUT
/begin RECORD_LAYOUT Lookup1D_FLOAT64_IEEE FNC_VALUES 1 FLOAT64_IEEE COLUMN_DIR DIRECT /end RECORD_LAYOUT
/begin RECORD_LAYOUT Lookup1D_X_FLOAT64_IEEE AXIS_PTS_X 1 FLOAT64_IEEE INDEX_INCR DIRECT /end RECORD_LAYOUT
/begin RECORD_LAYOUT Lookup2D_BOOLEAN FNC_VALUES 1 UBYTE COLUMN_DIR DIRECT /end RECORD_LAYOUT
/begin RECORD_LAYOUT Lookup2D_X_BOOLEAN AXIS_PTS_X 1 UBYTE INDEX_INCR DIRECT /end RECORD_LAYOUT
/begin RECORD_LAYOUT Lookup2D_UBYTE FNC_VALUES 1 UBYTE COLUMN_DIR DIRECT /end RECORD_LAYOUT
/begin RECORD_LAYOUT Lookup2D_X_UBYTE AXIS_PTS_X 1 UBYTE INDEX_INCR DIRECT /end RECORD_LAYOUT
/begin RECORD_LAYOUT Lookup2D_BYTE FNC_VALUES 1 SBYTE COLUMN_DIR DIRECT /end RECORD_LAYOUT
/begin RECORD_LAYOUT Lookup2D_X_BYTE AXIS_PTS_X 1 SBYTE INDEX_INCR DIRECT /end RECORD_LAYOUT
/begin RECORD_LAYOUT Lookup2D_UWORD FNC_VALUES 1 UWORD COLUMN_DIR DIRECT /end RECORD_LAYOUT
/begin RECORD_LAYOUT Lookup2D_X_UWORD AXIS_PTS_X 1 UWORD INDEX_INCR DIRECT /end RECORD_LAYOUT
/begin RECORD_LAYOUT Lookup2D_WORD FNC_VALUES 1 SWORD COLUMN_DIR DIRECT /end RECORD_LAYOUT
/begin RECORD_LAYOUT Lookup2D_X_WORD AXIS_PTS_X 1 SWORD INDEX_INCR DIRECT /end RECORD_LAYOUT
/begin RECORD_LAYOUT Lookup2D_ULONG FNC_VALUES 1 ULONG COLUMN_DIR DIRECT /end RECORD_LAYOUT
/begin RECORD_LAYOUT Lookup2D_X_ULONG AXIS_PTS_X 1 ULONG INDEX_INCR DIRECT /end RECORD_LAYOUT
/begin RECORD_LAYOUT Lookup2D_LONG FNC_VALUES 1 SLONG COLUMN_DIR DIRECT /end RECORD_LAYOUT
/begin RECORD_LAYOUT Lookup2D_X_LONG AXIS_PTS_X 1 SLONG INDEX_INCR DIRECT /end RECORD_LAYOUT
/begin RECORD_LAYOUT Lookup2D_FLOAT32_IEEE FNC_VALUES 1 FLOAT32_IEEE COLUMN_DIR DIRECT /end RECORD_LAYOUT
/begin RECORD_LAYOUT Lookup2D_X_FLOAT32_IEEE AXIS_PTS_X 1 FLOAT32_IEEE INDEX_INCR DIRECT /end RECORD_LAYOUT
/begin RECORD_LAYOUT Lookup2D_FLOAT64_IEEE FNC_VALUES 1 FLOAT64_IEEE COLUMN_DIR DIRECT /end RECORD_LAYOUT
/begin RECORD_LAYOUT Lookup2D_X_FLOAT64_IEEE AXIS_PTS_X 1 FLOAT64_IEEE INDEX_INCR DIRECT /end RECORD_LAYOUT
/begin CHARACTERISTIC CAL_TCF_LdSubLqCAzGen_af32 "" MAP 0x0000 /* @ECU_Address@CAL_TCF_LdSubLqCAzGen_af32@ */ Lookup2D_FLOAT32_IEEE 0 SWC_TCF_CM_single -3.4E+38 3.4E+38
 /begin AXIS_DESCR COM_AXIS NO_INPUT_QUANTITY SWC_TCF_CM_single 15 -3.4E+38 3.4E+38 AXIS_PTS_REF CAL_TCF_LdSubLqIqCAy_af32 /end AXIS_DESCR
 /begin AXIS_DESCR COM_AXIS NO_INPUT_QUANTITY SWC_TCF_CM_single 18 -3.4E+38 3.4E+38 AXIS_PTS_REF CAL_TCF_LdSubLqIdCAx_af32 /end AXIS_DESCR
/end CHARACTERISTIC
/begin AXIS_PTS CAL_TCF_LdSubLqIdCAx_af32 "" 0x0000 /* @ECU_Address@CAL_TCF_LdSubLqIdCAx_af32@ */ NO_INPUT_QUANTITY Lookup2D_X_FLOAT32_IEEE 0 SWC_TCF_CM_single 18 -3.4E+38 3.4E+38 /end AXIS_PTS
/begin AXIS_PTS CAL_TCF_LdSubLqIqCAy_af32 "" 0x0000 /* @ECU_Address@CAL_TCF_LdSubLqIqCAy_af32@ */ NO_INPUT_QUANTITY Lookup2D_X_FLOAT32_IEEE 0 SWC_TCF_CM_single 15 -3.4E+38 3.4E+38 /end AXIS_PTS
/begin CHARACTERISTIC CAL_TCF_LdSubLqCAzMot_af32 "" MAP 0x0000 /* @ECU_Address@CAL_TCF_LdSubLqCAzMot_af32@ */ Lookup2D_FLOAT32_IEEE 0 SWC_TCF_CM_single -3.4E+38 3.4E+38
 /begin AXIS_DESCR COM_AXIS NO_INPUT_QUANTITY SWC_TCF_CM_single 15 -3.4E+38 3.4E+38 AXIS_PTS_REF CAL_TCF_LdSubLqIqCAy_af32 /end AXIS_DESCR
 /begin AXIS_DESCR COM_AXIS NO_INPUT_QUANTITY SWC_TCF_CM_single 18 -3.4E+38 3.4E+38 AXIS_PTS_REF CAL_TCF_LdSubLqIdCAx_af32 /end AXIS_DESCR
/end CHARACTERISTIC
/begin CHARACTERISTIC CAL_TCF_PwrLossCAz_af32 "" MAP 0x0000 /* @ECU_Address@CAL_TCF_PwrLossCAz_af32@ */ Lookup2D_FLOAT32_IEEE 0 SWC_TCF_CM_single -3.4E+38 3.4E+38
 /begin AXIS_DESCR COM_AXIS NO_INPUT_QUANTITY SWC_TCF_CM_single 16 -3.4E+38 3.4E+38 AXIS_PTS_REF CAL_TCF_NPwrLosCAy_af32 /end AXIS_DESCR
 /begin AXIS_DESCR COM_AXIS VAR_TCF_Isflt_f32 SWC_TCF_CM_single 35 -3.4E+38 3.4E+38 AXIS_PTS_REF CAL_TCF_IsPwrLosCAx_af32 /end AXIS_DESCR
/end CHARACTERISTIC
/begin AXIS_PTS CAL_TCF_IsPwrLosCAx_af32 "" 0x0000 /* @ECU_Address@CAL_TCF_IsPwrLosCAx_af32@ */ VAR_TCF_Isflt_f32 Lookup2D_X_FLOAT32_IEEE 0 SWC_TCF_CM_single 35 -3.4E+38 3.4E+38 /end AXIS_PTS
/begin AXIS_PTS CAL_TCF_NPwrLosCAy_af32 "" 0x0000 /* @ECU_Address@CAL_TCF_NPwrLosCAy_af32@ */ NO_INPUT_QUANTITY Lookup2D_X_FLOAT32_IEEE 0 SWC_TCF_CM_single 16 -3.4E+38 3.4E+38 /end AXIS_PTS
/begin CHARACTERISTIC CAL_TCF_PwrCompaElectCAz_af32 "" MAP 0x0000 /* @ECU_Address@CAL_TCF_PwrCompaElectCAz_af32@ */ Lookup2D_FLOAT32_IEEE 0 SWC_TCF_CM_single -3.4E+38 3.4E+38
 /begin AXIS_DESCR COM_AXIS VAR_TCF_Isflt_f32 SWC_TCF_CM_single 24 -3.4E+38 3.4E+38 AXIS_PTS_REF CAL_TCF_PwrCompaIsCAy_af32 /end AXIS_DESCR
 /begin AXIS_DESCR COM_AXIS NO_INPUT_QUANTITY SWC_TCF_CM_single 33 -3.4E+38 3.4E+38 AXIS_PTS_REF CAL_TCF_PwrCompaSpdCAx_af32 /end AXIS_DESCR
/end CHARACTERISTIC
/begin AXIS_PTS CAL_TCF_PwrCompaSpdCAx_af32 "" 0x0000 /* @ECU_Address@CAL_TCF_PwrCompaSpdCAx_af32@ */ NO_INPUT_QUANTITY Lookup2D_X_FLOAT32_IEEE 0 SWC_TCF_CM_single 33 -3.4E+38 3.4E+38 /end AXIS_PTS
/begin AXIS_PTS CAL_TCF_PwrCompaIsCAy_af32 "" 0x0000 /* @ECU_Address@CAL_TCF_PwrCompaIsCAy_af32@ */ VAR_TCF_Isflt_f32 Lookup2D_X_FLOAT32_IEEE 0 SWC_TCF_CM_single 24 -3.4E+38 3.4E+38 /end AXIS_PTS
/begin CHARACTERISTIC CAL_TCF_AgTrqTubeCAy_af32 "" CURVE 0x0000 /* @ECU_Address@CAL_TCF_AgTrqTubeCAy_af32@ */ Lookup1D_FLOAT32_IEEE 0 SWC_TCF_CM_single -3.4E+38 3.4E+38
 /begin AXIS_DESCR COM_AXIS NO_INPUT_QUANTITY SWC_TCF_CM_single 18 -3.4E+38 3.4E+38 AXIS_PTS_REF CAL_TCF_TrqTubeNCAx_af32 /end AXIS_DESCR
/end CHARACTERISTIC
/begin AXIS_PTS CAL_TCF_TrqTubeNCAx_af32 "" 0x0000 /* @ECU_Address@CAL_TCF_TrqTubeNCAx_af32@ */ NO_INPUT_QUANTITY Lookup1D_X_FLOAT32_IEEE 0 SWC_TCF_CM_single 18 -3.4E+38 3.4E+38 /end AXIS_PTS
/begin CHARACTERISTIC CAL_TCF_PwrTrqTubeCAy_af32 "" CURVE 0x0000 /* @ECU_Address@CAL_TCF_PwrTrqTubeCAy_af32@ */ Lookup1D_FLOAT32_IEEE 0 SWC_TCF_CM_single -3.4E+38 3.4E+38
 /begin AXIS_DESCR COM_AXIS NO_INPUT_QUANTITY SWC_TCF_CM_single 18 -3.4E+38 3.4E+38 AXIS_PTS_REF CAL_TCF_TrqTubeNCAx_af32 /end AXIS_DESCR
/end CHARACTERISTIC
/begin CHARACTERISTIC CAL_TCF_HiSpdDirStop_f32 "" VALUE 0x0000 /* @ECU_Address@CAL_TCF_HiSpdDirStop_f32@ */ Scalar_FLOAT32_IEEE 0 SWC_TCF_CM_single -25000.0 25000.0 /end CHARACTERISTIC
/begin CHARACTERISTIC CAL_TCF_HiTrqDirStop_f32 "" VALUE 0x0000 /* @ECU_Address@CAL_TCF_HiTrqDirStop_f32@ */ Scalar_FLOAT32_IEEE 0 SWC_TCF_CM_single -500.0 500.0 /end CHARACTERISTIC
/begin CHARACTERISTIC CAL_TCF_IsCutOffFrq_f32 "" VALUE 0x0000 /* @ECU_Address@CAL_TCF_IsCutOffFrq_f32@ */ Scalar_FLOAT32_IEEE 0 SWC_TCF_CM_single -3.4E+38 3.4E+38 /end CHARACTERISTIC
/begin CHARACTERISTIC CAL_TCF_LoSpdDirStop_f32 "" VALUE 0x0000 /* @ECU_Address@CAL_TCF_LoSpdDirStop_f32@ */ Scalar_FLOAT32_IEEE 0 SWC_TCF_CM_single -25000.0 25000.0 /end CHARACTERISTIC
/begin CHARACTERISTIC CAL_TCF_LoTrqDirStop_f32 "" VALUE 0x0000 /* @ECU_Address@CAL_TCF_LoTrqDirStop_f32@ */ Scalar_FLOAT32_IEEE 0 SWC_TCF_CM_single -500.0 500.0 /end CHARACTERISTIC
/begin CHARACTERISTIC CAL_TCF_Psi_f32 "" VALUE 0x0000 /* @ECU_Address@CAL_TCF_Psi_f32@ */ Scalar_FLOAT32_IEEE 0 SWC_TCF_CM_single 0.0 10.0 /end CHARACTERISTIC
/begin CHARACTERISTIC CAL_TCF_PwrInputCutOffFrq_f32 "" VALUE 0x0000 /* @ECU_Address@CAL_TCF_PwrInputCutOffFrq_f32@ */ Scalar_FLOAT32_IEEE 0 SWC_TCF_CM_single -3.4E+38 3.4E+38 /end CHARACTERISTIC
/begin CHARACTERISTIC CAL_TCF_PwrTrqCalcSpdThrH_f32 "" VALUE 0x0000 /* @ECU_Address@CAL_TCF_PwrTrqCalcSpdThrH_f32@ */ Scalar_FLOAT32_IEEE 0 SWC_TCF_CM_single -3.4E+38 3.4E+38 /end CHARACTERISTIC
/begin CHARACTERISTIC CAL_TCF_PwrTrqCalcSpdThrL_f32 "" VALUE 0x0000 /* @ECU_Address@CAL_TCF_PwrTrqCalcSpdThrL_f32@ */ Scalar_FLOAT32_IEEE 0 SWC_TCF_CM_single -3.4E+38 3.4E+38 /end CHARACTERISTIC
/begin CHARACTERISTIC CAL_TCF_TempStrMax_f32 "" VALUE 0x0000 /* @ECU_Address@CAL_TCF_TempStrMax_f32@ */ Scalar_FLOAT32_IEEE 0 SWC_TCF_CM_single -200.0 200.0 /end CHARACTERISTIC
/begin CHARACTERISTIC CAL_TCF_TempStrMin_f32 "" VALUE 0x0000 /* @ECU_Address@CAL_TCF_TempStrMin_f32@ */ Scalar_FLOAT32_IEEE 0 SWC_TCF_CM_single -200.0 200.0 /end CHARACTERISTIC
/begin CHARACTERISTIC CAL_TCF_TempStrPlossFact_f32 "" VALUE 0x0000 /* @ECU_Address@CAL_TCF_TempStrPlossFact_f32@ */ Scalar_FLOAT32_IEEE 0 SWC_TCF_CM_single -1.0 1.0 /end CHARACTERISTIC
/begin CHARACTERISTIC CAL_TCF_TrqMechCutOffFrq_f32 "" VALUE 0x0000 /* @ECU_Address@CAL_TCF_TrqMechCutOffFrq_f32@ */ Scalar_FLOAT32_IEEE 0 SWC_TCF_CM_single -3.4E+38 3.4E+38 /end CHARACTERISTIC
/begin CHARACTERISTIC CAL_TCF_TrqCalcMonCountTrh_s16 "" VALUE 0x0000 /* @ECU_Address@CAL_TCF_TrqCalcMonCountTrh_s16@ */ Scalar_SWORD 0 SWC_TCF_CM_int16 -200.0 200.0 /end CHARACTERISTIC
/begin CHARACTERISTIC CAL_TCF_TrqCalcMonDebTrh_s16 "" VALUE 0x0000 /* @ECU_Address@CAL_TCF_TrqCalcMonDebTrh_s16@ */ Scalar_SWORD 0 SWC_TCF_CM_int16 -200.0 200.0 /end CHARACTERISTIC
/begin CHARACTERISTIC CAL_TCF_TrqInvalid_s16 "" VALUE 0x0000 /* @ECU_Address@CAL_TCF_TrqInvalid_s16@ */ Scalar_SWORD 0 SWC_TCF_CM_int16 -32767.0 32767.0 /end CHARACTERISTIC
/begin CHARACTERISTIC PRV_CalFltFrq_1ms "" VALUE 0x0000 /* @ECU_Address@PRV_CalFltFrq_1ms@ */ Scalar_UWORD 0 SWC_TCF_CM_uint16 0 65535 /end CHARACTERISTIC
/begin CHARACTERISTIC PRV_IsCalFltFrq_1ms "" VALUE 0x0000 /* @ECU_Address@PRV_IsCalFltFrq_1ms@ */ Scalar_UWORD 0 SWC_TCF_CM_uint16 0 65535 /end CHARACTERISTIC
/begin CHARACTERISTIC CAL_TCF_TrqCalcMonErrRst_b "" VALUE 0x0000 /* @ECU_Address@CAL_TCF_TrqCalcMonErrRst_b@ */ Scalar_BOOLEAN 0 SWC_TCF_CM_boolean 0.0 1.0 /end CHARACTERISTIC
/begin CHARACTERISTIC CAL_TCF_flgUsePlossCompa_b "" VALUE 0x0000 /* @ECU_Address@CAL_TCF_flgUsePlossCompa_b@ */ Scalar_BOOLEAN 0 SWC_TCF_CM_boolean 0.0 1.0 /end CHARACTERISTIC
/begin CHARACTERISTIC CAL_TCF_MotorPole_u8 "" VALUE 0x0000 /* @ECU_Address@CAL_TCF_MotorPole_u8@ */ Scalar_UBYTE 0 SWC_TCF_CM_uint8 0.0 255.0 /end CHARACTERISTIC
/begin CHARACTERISTIC CAL_TCF_SpeedCtlMode_u8 "" VALUE 0x0000 /* @ECU_Address@CAL_TCF_SpeedCtlMode_u8@ */ Scalar_UBYTE 0 SWC_TCF_CM_uint8 0.0 255.0 /end CHARACTERISTIC
/begin MEASUREMENT VAR_L2Sampling_DycUMon_f32 "" FLOAT32_IEEE SWC_TCF_CM_single 0 0 0.0 1.0 ECU_ADDRESS 0x0000 /* @ECU_Address@VAR_L2Sampling_DycUMon_f32@ */ /end MEASUREMENT
/begin MEASUREMENT VAR_L2Sampling_DycVMon_f32 "" FLOAT32_IEEE SWC_TCF_CM_single 0 0 0.0 1.0 ECU_ADDRESS 0x0000 /* @ECU_Address@VAR_L2Sampling_DycVMon_f32@ */ /end MEASUREMENT
/begin MEASUREMENT VAR_L2Sampling_DycWMon_f32 "" FLOAT32_IEEE SWC_TCF_CM_single 0 0 0.0 1.0 ECU_ADDRESS 0x0000 /* @ECU_Address@VAR_L2Sampling_DycWMon_f32@ */ /end MEASUREMENT
/begin MEASUREMENT VAR_HSPF_StrrTempFlt_f32 "" FLOAT32_IEEE SWC_TCF_CM_single 0 0 0.0 1.0 ECU_ADDRESS 0x0000 /* @ECU_Address@VAR_HSPF_StrrTempFlt_f32@ */ /end MEASUREMENT
/begin MEASUREMENT VAR_TCF_CurrAgTrqTubeH1_f32 "" FLOAT32_IEEE SWC_TCF_CM_single 0 0 -500.0 500.0 ECU_ADDRESS 0x0000 /* @ECU_Address@VAR_TCF_CurrAgTrqTubeH1_f32@ */ /end MEASUREMENT
/begin MEASUREMENT VAR_TCF_CurrAgTrqTubeL1_f32 "" FLOAT32_IEEE SWC_TCF_CM_single 0 0 -500.0 500.0 ECU_ADDRESS 0x0000 /* @ECU_Address@VAR_TCF_CurrAgTrqTubeL1_f32@ */ /end MEASUREMENT
/begin MEASUREMENT VAR_TCF_PwrTrqfltcomp_f32 "" FLOAT32_IEEE SWC_TCF_CM_single 0 0 -500.0 500.0 ECU_ADDRESS 0x0000 /* @ECU_Address@VAR_TCF_PwrTrqfltcomp_f32@ */ /end MEASUREMENT
/begin MEASUREMENT VAR_TCF_PwrTrqTubeH1_f32 "" FLOAT32_IEEE SWC_TCF_CM_single 0 0 -500.0 500.0 ECU_ADDRESS 0x0000 /* @ECU_Address@VAR_TCF_PwrTrqTubeH1_f32@ */ /end MEASUREMENT
/begin MEASUREMENT VAR_TCF_PwrTrqTubeL1_f32 "" FLOAT32_IEEE SWC_TCF_CM_single 0 0 -500.0 500.0 ECU_ADDRESS 0x0000 /* @ECU_Address@VAR_TCF_PwrTrqTubeL1_f32@ */ /end MEASUREMENT
/begin MEASUREMENT VAR_TCF_BlendTrq_f32 "" FLOAT32_IEEE SWC_TCF_CM_single 0 0 -500.0 500.0 ECU_ADDRESS 0x0000 /* @ECU_Address@VAR_TCF_BlendTrq_f32@ */ /end MEASUREMENT
/begin MEASUREMENT VAR_TCF_PwrTrqCompCof_f32 "" FLOAT32_IEEE SWC_TCF_CM_single 0 0 -3.4E+38 3.4E+38 ECU_ADDRESS 0x0000 /* @ECU_Address@VAR_TCF_PwrTrqCompCof_f32@ */ /end MEASUREMENT
/begin MEASUREMENT VAR_TCF_PwrTrqNoflt_f32 "" FLOAT32_IEEE SWC_TCF_CM_single 0 0 -500.0 500.0 ECU_ADDRESS 0x0000 /* @ECU_Address@VAR_TCF_PwrTrqNoflt_f32@ */ /end MEASUREMENT
/begin MEASUREMENT VAR_TCF_PwrTrqflt_f32 "" FLOAT32_IEEE SWC_TCF_CM_single 0 0 -500.0 500.0 ECU_ADDRESS 0x0000 /* @ECU_Address@VAR_TCF_PwrTrqflt_f32@ */ /end MEASUREMENT
/begin MEASUREMENT VAR_TCF_Ploss_f32 "" FLOAT32_IEEE SWC_TCF_CM_single 0 0 -200000.0 200000.0 ECU_ADDRESS 0x0000 /* @ECU_Address@VAR_TCF_Ploss_f32@ */ /end MEASUREMENT
/begin MEASUREMENT VAR_TCF_PwrInputNoflt_f32 "" FLOAT32_IEEE SWC_TCF_CM_single 0 0 -200000.0 200000.0 ECU_ADDRESS 0x0000 /* @ECU_Address@VAR_TCF_PwrInputNoflt_f32@ */ /end MEASUREMENT
/begin MEASUREMENT VAR_TCF_PwrInputflt_f32 "" FLOAT32_IEEE SWC_TCF_CM_single 0 0 -200000.0 200000.0 ECU_ADDRESS 0x0000 /* @ECU_Address@VAR_TCF_PwrInputflt_f32@ */ /end MEASUREMENT
/begin MEASUREMENT VAR_TCF_IsNoflt_f32 "" FLOAT32_IEEE SWC_TCF_CM_single 0 0 -1200.0 1200.0 ECU_ADDRESS 0x0000 /* @ECU_Address@VAR_TCF_IsNoflt_f32@ */ /end MEASUREMENT
/begin MEASUREMENT VAR_TCF_Isflt_f32 "" FLOAT32_IEEE SWC_TCF_CM_single 0 0 -1200.0 1200.0 ECU_ADDRESS 0x0000 /* @ECU_Address@VAR_TCF_Isflt_f32@ */ /end MEASUREMENT
/begin MEASUREMENT VAR_TCF_LdsubLq_f32 "" FLOAT32_IEEE SWC_TCF_CM_single 0 0 -1.0 1.0 ECU_ADDRESS 0x0000 /* @ECU_Address@VAR_TCF_LdsubLq_f32@ */ /end MEASUREMENT
/begin MEASUREMENT VAR_TCF_idAct_f32 "" FLOAT32_IEEE SWC_TCF_CM_single 0 0 -1200.0 1200.0 ECU_ADDRESS 0x0000 /* @ECU_Address@VAR_TCF_idAct_f32@ */ /end MEASUREMENT
/begin MEASUREMENT VAR_TCF_iqAct_f32 "" FLOAT32_IEEE SWC_TCF_CM_single 0 0 -1200.0 1200.0 ECU_ADDRESS 0x0000 /* @ECU_Address@VAR_TCF_iqAct_f32@ */ /end MEASUREMENT
/begin MEASUREMENT VAR_TCF_CurrAgTrqNoComp_f32 "" FLOAT32_IEEE SWC_TCF_CM_single 0 0 -500.0 500.0 ECU_ADDRESS 0x0000 /* @ECU_Address@VAR_TCF_CurrAgTrqNoComp_f32@ */ /end MEASUREMENT
/begin MEASUREMENT VAR_TCF_CurrAgTrqflt_f32 "" FLOAT32_IEEE SWC_TCF_CM_single 0 0 -500.0 500.0 ECU_ADDRESS 0x0000 /* @ECU_Address@VAR_TCF_CurrAgTrqflt_f32@ */ /end MEASUREMENT
/begin MEASUREMENT VAR_TCF_nDir_u8 "" UBYTE SWC_TCF_CM_uint8 0 0 0.0 255.0 ECU_ADDRESS 0x0000 /* @ECU_Address@VAR_TCF_nDir_u8@ */ /end MEASUREMENT
/begin MEASUREMENT VAR_TCF_TrqDir_u8 "" UBYTE SWC_TCF_CM_uint8 0 0 0.0 255.0 ECU_ADDRESS 0x0000 /* @ECU_Address@VAR_TCF_TrqDir_u8@ */ /end MEASUREMENT
/begin MEASUREMENT VAR_TCF_MotorMode_u8 "" UBYTE SWC_TCF_CM_uint8 0 0 0.0 255.0 ECU_ADDRESS 0x0000 /* @ECU_Address@VAR_TCF_MotorMode_u8@ */ /end MEASUREMENT
/begin MEASUREMENT VAR_TCF_TrqCalcMonRslt_b "" UBYTE SWC_TCF_CM_boolean 0 0 0.0 1.0 ECU_ADDRESS 0x0000 /* @ECU_Address@VAR_TCF_TrqCalcMonRslt_b@ */ /end MEASUREMENT
/begin MEASUREMENT VAR_TCF_TrqCalcErr_b "" UBYTE SWC_TCF_CM_boolean 0 0 0.0 1.0 ECU_ADDRESS 0x0000 /* @ECU_Address@VAR_TCF_TrqCalcErr_b@ */ /end MEASUREMENT
/begin COMPU_METHOD SWC_TCF_CM_single "Q = V" RAT_FUNC "%8.6" "" COEFFS 0 1 0 0 0 1 /end COMPU_METHOD
/begin COMPU_METHOD SWC_TCF_CM_int16 "Q = V" RAT_FUNC "%5.0" "" COEFFS 0 1 0 0 0 1 /end COMPU_METHOD
/begin COMPU_METHOD SWC_TCF_CM_uint16 "Q = V" RAT_FUNC "%5.0" "" COEFFS 0 1 0 0 0 1 /end COMPU_METHOD
/begin COMPU_METHOD SWC_TCF_CM_boolean "Q = V" RAT_FUNC "%1.0" "" COEFFS 0 1 0 0 0 1 /end COMPU_METHOD
/begin COMPU_METHOD SWC_TCF_CM_uint8 "Q = V" RAT_FUNC "%3.0" "" COEFFS 0 1 0 0 0 1 /end COMPU_METHOD
/begin GROUP SWC_TCF "SWC_TCF" /* Root */ ROOT /begin SUB_GROUP Root_SWC_TCF_1ms_sys /end SUB_GROUP /end GROUP
/begin GROUP Root_SWC_TCF_1ms_sys "SWC_TCF/SWC_TCF_1ms_sys"
 /begin SUB_GROUP S1_CurrAgTrqCalcProc S1_PwrTrqCalcProc S1_TrqBlendProc S1_TrqCalcEnable /end SUB_GROUP
 /begin REF_MEASUREMENT VAR_HSPF_StrrTempFlt_f32 VAR_L2Sampling_DycUMon_f32 VAR_L2Sampling_DycVMon_f32 VAR_L2Sampling_DycWMon_f32 /end REF_MEASUREMENT
/end GROUP
/begin GROUP S1_CurrAgTrqCalcProc "SWC_TCF/SWC_TCF_1ms_sys/CurrAgTrqCalcProc"
 /begin SUB_GROUP S3_CurrAgTrqCalc S3_IdIqCalc S3_LdsubLqCalc S3_MotorModeJdg /end SUB_GROUP
/end GROUP
/begin GROUP S1_PwrTrqCalcProc "SWC_TCF/SWC_TCF_1ms_sys/PwrTrqCalcProc" /begin SUB_GROUP S4_IsCalc S4_PinputCalc S4_PlossCalc S4_PwrTrqCalc /end SUB_GROUP /end GROUP
/begin GROUP S1_TrqBlendProc "SWC_TCF/SWC_TCF_1ms_sys/TrqBlendProc" /begin SUB_GROUP S5_Debouncer S5_TrqBlend S5_TrqTube /end SUB_GROUP
 /begin REF_CHARACTERISTIC CAL_TCF_TrqCalcMonCountTrh_s16 CAL_TCF_TrqCalcMonDebTrh_s16 CAL_TCF_TrqCalcMonErrRst_b /end REF_CHARACTERISTIC
/end GROUP
/begin GROUP S1_TrqCalcEnable "SWC_TCF/SWC_TCF_1ms_sys/TrqCalcEnable"
 /begin REF_CHARACTERISTIC CAL_TCF_PwrTrqCalcSpdThrH_f32 CAL_TCF_PwrTrqCalcSpdThrL_f32 CAL_TCF_SpeedCtlMode_u8 /end REF_CHARACTERISTIC
/end GROUP
/begin GROUP S3_CurrAgTrqCalc "SWC_TCF/SWC_TCF_1ms_sys/CurrAgTrqCalcProc/CurrAgTrqCalc"
 /begin REF_CHARACTERISTIC CAL_TCF_MotorPole_u8 CAL_TCF_Psi_f32 CAL_TCF_TrqMechCutOffFrq_f32 PRV_CalFltFrq_1ms /end REF_CHARACTERISTIC
 /begin REF_MEASUREMENT VAR_TCF_CurrAgTrqNoComp_f32 VAR_TCF_CurrAgTrqflt_f32 /end REF_MEASUREMENT
/end GROUP
/begin GROUP S3_IdIqCalc "SWC_TCF/SWC_TCF_1ms_sys/CurrAgTrqCalcProc/IdIqCalc" /begin REF_MEASUREMENT VAR_TCF_idAct_f32 VAR_TCF_iqAct_f32 /end REF_MEASUREMENT /end GROUP
/begin GROUP S3_LdsubLqCalc "SWC_TCF/SWC_TCF_1ms_sys/CurrAgTrqCalcProc/LdsubLqCalc" /begin REF_CHARACTERISTIC CAL_TCF_LdSubLqCAzGen_af32 CAL_TCF_LdSubLqCAzMot_af32 /end REF_CHARACTERISTIC /begin REF_MEASUREMENT VAR_TCF_LdsubLq_f32 /end REF_MEASUREMENT /end GROUP
/begin GROUP S3_MotorModeJdg "SWC_TCF/SWC_TCF_1ms_sys/CurrAgTrqCalcProc/MotorModeJdg" /begin SUB_GROUP S10_MotorMode S10_TrqDir S10_nDir /end SUB_GROUP /end GROUP
/begin GROUP S4_IsCalc "SWC_TCF/SWC_TCF_1ms_sys/PwrTrqCalcProc/IsCalc" /begin REF_CHARACTERISTIC CAL_TCF_IsCutOffFrq_f32 PRV_IsCalFltFrq_1ms /end REF_CHARACTERISTIC /begin REF_MEASUREMENT VAR_TCF_IsNoflt_f32 VAR_TCF_Isflt_f32 /end REF_MEASUREMENT /end GROUP
/begin GROUP S4_PinputCalc "SWC_TCF/SWC_TCF_1ms_sys/PwrTrqCalcProc/PinputCalc" /begin REF_CHARACTERISTIC CAL_TCF_PwrInputCutOffFrq_f32 PRV_CalFltFrq_1ms /end REF_CHARACTERISTIC /begin REF_MEASUREMENT VAR_TCF_PwrInputNoflt_f32 VAR_TCF_PwrInputflt_f32 /end REF_MEASUREMENT /end GROUP
/begin GROUP S4_PlossCalc "SWC_TCF/SWC_TCF_1ms_sys/PwrTrqCalcProc/PlossCalc"
 /begin REF_CHARACTERISTIC CAL_TCF_PwrLossCAz_af32 CAL_TCF_TempStrMax_f32 CAL_TCF_TempStrMin_f32 CAL_TCF_TempStrPlossFact_f32 CAL_TCF_flgUsePlossCompa_b /end REF_CHARACTERISTIC
 /begin REF_MEASUREMENT VAR_TCF_Ploss_f32 /end REF_MEASUREMENT
/end GROUP
/begin GROUP S4_PwrTrqCalc "SWC_TCF/SWC_TCF_1ms_sys/PwrTrqCalcProc/PwrTrqCalc"
 /begin REF_CHARACTERISTIC CAL_TCF_PwrCompaElectCAz_af32 CAL_TCF_TrqMechCutOffFrq_f32 PRV_CalFltFrq_1ms /end REF_CHARACTERISTIC
 /begin REF_MEASUREMENT VAR_TCF_PwrTrqCompCof_f32 VAR_TCF_PwrTrqNoflt_f32 VAR_TCF_PwrTrqflt_f32 /end REF_MEASUREMENT
/end GROUP
/begin GROUP S5_Debouncer "SWC_TCF/SWC_TCF_1ms_sys/TrqBlendProc/Debouncer" /begin REF_MEASUREMENT VAR_TCF_TrqCalcErr_b /end REF_MEASUREMENT /end GROUP
/begin GROUP S5_TrqBlend "SWC_TCF/SWC_TCF_1ms_sys/TrqBlendProc/TrqBlend" /begin REF_CHARACTERISTIC CAL_TCF_TrqInvalid_s16 /end REF_CHARACTERISTIC /begin REF_MEASUREMENT VAR_TCF_BlendTrq_f32 VAR_TCF_TrqCalcMonRslt_b /end REF_MEASUREMENT /end GROUP
/begin GROUP S5_TrqTube "SWC_TCF/SWC_TCF_1ms_sys/TrqBlendProc/TrqTube" /begin REF_CHARACTERISTIC CAL_TCF_AgTrqTubeCAy_af32 CAL_TCF_PwrTrqTubeCAy_af32 /end REF_CHARACTERISTIC
 /begin REF_MEASUREMENT VAR_TCF_CurrAgTrqTubeH1_f32 VAR_TCF_CurrAgTrqTubeL1_f32 VAR_TCF_PwrTrqTubeH1_f32 VAR_TCF_PwrTrqTubeL1_f32 VAR_TCF_PwrTrqfltcomp_f32 /end REF_MEASUREMENT
/end GROUP
/begin GROUP S10_MotorMode "SWC_TCF/SWC_TCF_1ms_sys/CurrAgTrqCalcProc/MotorModeJdg/MotorMode" /begin REF_MEASUREMENT VAR_TCF_MotorMode_u8 /end REF_MEASUREMENT /end GROUP
/begin GROUP S10_TrqDir "SWC_TCF/SWC_TCF_1ms_sys/CurrAgTrqCalcProc/MotorModeJdg/TrqDir" /begin REF_CHARACTERISTIC CAL_TCF_HiTrqDirStop_f32 CAL_TCF_LoTrqDirStop_f32 /end REF_CHARACTERISTIC /begin REF_MEASUREMENT VAR_TCF_TrqDir_u8 /end REF_MEASUREMENT /end GROUP
/begin GROUP S10_nDir "SWC_TCF/SWC_TCF_1ms_sys/CurrAgTrqCalcProc/MotorModeJdg/nDir" /begin REF_CHARACTERISTIC CAL_TCF_HiSpdDirStop_f32 CAL_TCF_LoSpdDirStop_f32 /end REF_CHARACTERISTIC /begin REF_MEASUREMENT VAR_TCF_nDir_u8 /end REF_MEASUREMENT /end GROUP
/end MODULE
/end PROJECT
/* (add any file trailer comments here) */
/* EOF SWC_TCF.a2l */
