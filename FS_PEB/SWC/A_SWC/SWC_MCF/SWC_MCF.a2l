/******************************************************************************
* ASAP2 file: SWC_MCF.a2l
* Code generation for model "SWC_MCF".
* Model version : 1.10
* Simulink Coder version : 9.3 (R2020a) 18-Nov-2019
* C source code generated on : Mon Jan 25 16:58:23 2021
* Target selection: autosar.tlc
* Embedded hardware selection: Intel->x86-64 (Windows64)
* Code generation objectives: Unspecified
* Validation result: Not run
* (add additional file header information here)
******************************************************************************/ ASAP2_VERSION 1 31
/* Version 1.31 */
/begin PROJECT ProjectName "Project Comment Goes Here"
/begin HEADER "Header Comments go here" /end HEADER
/begin MODULE ModuleName "Module Comment Goes Here"
/begin MOD_PAR "MOD PAR Comment Goes Here" /end MOD_PAR
/begin MOD_COMMON "Mod Common Comment Here" BYTE_ORDER MSB_LAST /end MOD_COMMON
/begin RECORD_LAYOUT Scalar_BOOLEAN FNC_VALUES 1 UBYTE COLUMN_DIR DIRECT /end RECORD_LAYOUT
/begin RECORD_LAYOUT Scalar_UBYTE FNC_VALUES 1 UBYTE COLUMN_DIR DIRECT /end RECORD_LAYOUT
/begin RECORD_LAYOUT Scalar_BYTE FNC_VALUES 1 SBYTE COLUMN_DIR DIRECT /end RECORD_LAYOUT
/begin RECORD_LAYOUT Scalar_UWORD FNC_VALUES 1 UWORD COLUMN_DIR DIRECT /end RECORD_LAYOUT
/begin RECORD_LAYOUT Scalar_SWORD FNC_VALUES 1 SWORD COLUMN_DIR DIRECT /end RECORD_LAYOUT
/begin RECORD_LAYOUT Scalar_ULONG FNC_VALUES 1 ULONG COLUMN_DIR DIRECT /end RECORD_LAYOUT
/begin RECORD_LAYOUT Scalar_LONG FNC_VALUES 1 SLONG COLUMN_DIR DIRECT /end RECORD_LAYOUT
/begin RECORD_LAYOUT Scalar_FLOAT32_IEEE FNC_VALUES 1 FLOAT32_IEEE COLUMN_DIR DIRECT /end RECORD_LAYOUT
/begin RECORD_LAYOUT Scalar_FLOAT64_IEEE FNC_VALUES 1 FLOAT64_IEEE COLUMN_DIR DIRECT /end RECORD_LAYOUT
/begin RECORD_LAYOUT Lookup1D_BOOLEAN FNC_VALUES 1 UBYTE COLUMN_DIR DIRECT /end RECORD_LAYOUT
/begin RECORD_LAYOUT Lookup1D_X_BOOLEAN AXIS_PTS_X 1 UBYTE INDEX_INCR DIRECT /end RECORD_LAYOUT
/begin RECORD_LAYOUT Lookup1D_BYTE FNC_VALUES 1 SBYTE COLUMN_DIR DIRECT /end RECORD_LAYOUT
/begin RECORD_LAYOUT Lookup1D_X_BYTE AXIS_PTS_X 1 SBYTE INDEX_INCR DIRECT /end RECORD_LAYOUT
/begin RECORD_LAYOUT Lookup1D_UBYTE FNC_VALUES 1 UBYTE COLUMN_DIR DIRECT /end RECORD_LAYOUT
/begin RECORD_LAYOUT Lookup1D_X_UBYTE AXIS_PTS_X 1 UBYTE INDEX_INCR DIRECT /end RECORD_LAYOUT
/begin RECORD_LAYOUT Lookup1D_UWORD FNC_VALUES 1 UWORD COLUMN_DIR DIRECT /end RECORD_LAYOUT
/begin RECORD_LAYOUT Lookup1D_X_UWORD AXIS_PTS_X 1 UWORD INDEX_INCR DIRECT /end RECORD_LAYOUT
/begin RECORD_LAYOUT Lookup1D_WORD FNC_VALUES 1 SWORD COLUMN_DIR DIRECT /end RECORD_LAYOUT
/begin RECORD_LAYOUT Lookup1D_X_WORD AXIS_PTS_X 1 SWORD INDEX_INCR DIRECT /end RECORD_LAYOUT
/begin RECORD_LAYOUT Lookup1D_ULONG FNC_VALUES 1 ULONG COLUMN_DIR DIRECT /end RECORD_LAYOUT
/begin RECORD_LAYOUT Lookup1D_X_ULONG AXIS_PTS_X 1 ULONG INDEX_INCR DIRECT /end RECORD_LAYOUT
/begin RECORD_LAYOUT Lookup1D_SLONG FNC_VALUES 1 SLONG COLUMN_DIR DIRECT /end RECORD_LAYOUT
/begin RECORD_LAYOUT Lookup1D_X_LONG AXIS_PTS_X 1 SLONG INDEX_INCR DIRECT /end RECORD_LAYOUT
/begin RECORD_LAYOUT Lookup1D_FLOAT32_IEEE FNC_VALUES 1 FLOAT32_IEEE COLUMN_DIR DIRECT /end RECORD_LAYOUT
/begin RECORD_LAYOUT Lookup1D_X_FLOAT32_IEEE AXIS_PTS_X 1 FLOAT32_IEEE INDEX_INCR DIRECT /end RECORD_LAYOUT
/begin RECORD_LAYOUT Lookup1D_FLOAT64_IEEE FNC_VALUES 1 FLOAT64_IEEE COLUMN_DIR DIRECT /end RECORD_LAYOUT
/begin RECORD_LAYOUT Lookup1D_X_FLOAT64_IEEE AXIS_PTS_X 1 FLOAT64_IEEE INDEX_INCR DIRECT /end RECORD_LAYOUT
/begin RECORD_LAYOUT Lookup2D_BOOLEAN FNC_VALUES 1 UBYTE COLUMN_DIR DIRECT /end RECORD_LAYOUT
/begin RECORD_LAYOUT Lookup2D_X_BOOLEAN AXIS_PTS_X 1 UBYTE INDEX_INCR DIRECT /end RECORD_LAYOUT
/begin RECORD_LAYOUT Lookup2D_UBYTE FNC_VALUES 1 UBYTE COLUMN_DIR DIRECT /end RECORD_LAYOUT
/begin RECORD_LAYOUT Lookup2D_X_UBYTE AXIS_PTS_X 1 UBYTE INDEX_INCR DIRECT /end RECORD_LAYOUT
/begin RECORD_LAYOUT Lookup2D_BYTE FNC_VALUES 1 SBYTE COLUMN_DIR DIRECT /end RECORD_LAYOUT
/begin RECORD_LAYOUT Lookup2D_X_BYTE AXIS_PTS_X 1 SBYTE INDEX_INCR DIRECT /end RECORD_LAYOUT
/begin RECORD_LAYOUT Lookup2D_UWORD FNC_VALUES 1 UWORD COLUMN_DIR DIRECT /end RECORD_LAYOUT
/begin RECORD_LAYOUT Lookup2D_X_UWORD AXIS_PTS_X 1 UWORD INDEX_INCR DIRECT /end RECORD_LAYOUT
/begin RECORD_LAYOUT Lookup2D_WORD FNC_VALUES 1 SWORD COLUMN_DIR DIRECT /end RECORD_LAYOUT
/begin RECORD_LAYOUT Lookup2D_X_WORD AXIS_PTS_X 1 SWORD INDEX_INCR DIRECT /end RECORD_LAYOUT
/begin RECORD_LAYOUT Lookup2D_ULONG FNC_VALUES 1 ULONG COLUMN_DIR DIRECT /end RECORD_LAYOUT
/begin RECORD_LAYOUT Lookup2D_X_ULONG AXIS_PTS_X 1 ULONG INDEX_INCR DIRECT /end RECORD_LAYOUT
/begin RECORD_LAYOUT Lookup2D_LONG FNC_VALUES 1 SLONG COLUMN_DIR DIRECT /end RECORD_LAYOUT
/begin RECORD_LAYOUT Lookup2D_X_LONG AXIS_PTS_X 1 SLONG INDEX_INCR DIRECT /end RECORD_LAYOUT
/begin RECORD_LAYOUT Lookup2D_FLOAT32_IEEE FNC_VALUES 1 FLOAT32_IEEE COLUMN_DIR DIRECT /end RECORD_LAYOUT
/begin RECORD_LAYOUT Lookup2D_X_FLOAT32_IEEE AXIS_PTS_X 1 FLOAT32_IEEE INDEX_INCR DIRECT /end RECORD_LAYOUT
/begin RECORD_LAYOUT Lookup2D_FLOAT64_IEEE FNC_VALUES 1 FLOAT64_IEEE COLUMN_DIR DIRECT /end RECORD_LAYOUT
/begin RECORD_LAYOUT Lookup2D_X_FLOAT64_IEEE AXIS_PTS_X 1 FLOAT64_IEEE INDEX_INCR DIRECT /end RECORD_LAYOUT
/begin CHARACTERISTIC CAL_MCF_DeadTimeTableY_Ti_af32 "死区时间查表输出死区时间" CURVE 0x0000 /* @ECU_Address@CAL_MCF_DeadTimeTableY_Ti_af32@ */ Lookup1D_FLOAT32_IEEE 0 SWC_MCF_CM_single -3.4E+38 3.4E+38
 /begin AXIS_DESCR COM_AXIS NO_INPUT_QUANTITY SWC_MCF_CM_single 15 -3.4E+38 3.4E+38 AXIS_PTS_REF CAL_MCF_DeadTimeTableX_Frq_af32 /end AXIS_DESCR
/end CHARACTERISTIC
/begin AXIS_PTS CAL_MCF_DeadTimeTableX_Frq_af32 "死区时间查表输入载频" 0x0000 /* @ECU_Address@CAL_MCF_DeadTimeTableX_Frq_af32@ */ NO_INPUT_QUANTITY Lookup1D_X_FLOAT32_IEEE 0 SWC_MCF_CM_single 15 -3.4E+38 3.4E+38 /end AXIS_PTS
/begin CHARACTERISTIC CAL_MCF_UsUseRateDesTableY_UsRes_af32 "" CURVE 0x0000 /* @ECU_Address@CAL_MCF_UsUseRateDesTableY_UsRes_af32@ */ Lookup1D_FLOAT32_IEEE 0 SWC_MCF_CM_single -3.4E+38 3.4E+38
 /begin AXIS_DESCR COM_AXIS NO_INPUT_QUANTITY SWC_MCF_CM_single 11 -3.4E+38 3.4E+38 AXIS_PTS_REF CAL_MCF_UsUseRateDesTableX_Spd_af32 /end AXIS_DESCR
/end CHARACTERISTIC
/begin AXIS_PTS CAL_MCF_UsUseRateDesTableX_Spd_af32 "" 0x0000 /* @ECU_Address@CAL_MCF_UsUseRateDesTableX_Spd_af32@ */ NO_INPUT_QUANTITY Lookup1D_X_FLOAT32_IEEE 0 SWC_MCF_CM_single 11 -3.4E+38 3.4E+38 /end AXIS_PTS
/begin CHARACTERISTIC CAL_MCF_AgRangeDeadCpnY_Ag_af32 "" CURVE 0x0000 /* @ECU_Address@CAL_MCF_AgRangeDeadCpnY_Ag_af32@ */ Lookup1D_FLOAT32_IEEE 0 SWC_MCF_CM_single -65535.0 65535.0
 /begin AXIS_DESCR COM_AXIS NO_INPUT_QUANTITY SWC_MCF_CM_single 7 -65535.0 65535.0 AXIS_PTS_REF CAL_MCF_AgRangeDeadCpnX_Trq_af32 /end AXIS_DESCR
/end CHARACTERISTIC
/begin AXIS_PTS CAL_MCF_AgRangeDeadCpnX_Trq_af32 "" 0x0000 /* @ECU_Address@CAL_MCF_AgRangeDeadCpnX_Trq_af32@ */ NO_INPUT_QUANTITY Lookup1D_X_FLOAT32_IEEE 0 SWC_MCF_CM_single 7 -65535.0 65535.0 /end AXIS_PTS
/begin CHARACTERISTIC CAL_MCF_HarmIn11ZRY_Is_af32 "" CURVE 0x0000 /* @ECU_Address@CAL_MCF_HarmIn11ZRY_Is_af32@ */ Lookup1D_FLOAT32_IEEE 0 SWC_MCF_CM_single -3.4E+38 3.4E+38
 /begin AXIS_DESCR COM_AXIS NO_INPUT_QUANTITY SWC_MCF_CM_single 23 -3.4E+38 3.4E+38 AXIS_PTS_REF CAL_MCF_HarmIn1113ZRX_Spd_af32 /end AXIS_DESCR
/end CHARACTERISTIC
/begin AXIS_PTS CAL_MCF_HarmIn1113ZRX_Spd_af32 "" 0x0000 /* @ECU_Address@CAL_MCF_HarmIn1113ZRX_Spd_af32@ */ NO_INPUT_QUANTITY Lookup1D_X_FLOAT32_IEEE 0 SWC_MCF_CM_single 23 -3.4E+38 3.4E+38 /end AXIS_PTS
/begin CHARACTERISTIC CAL_MCF_HarmIn11ZRY_Thetam_af32 "" CURVE 0x0000 /* @ECU_Address@CAL_MCF_HarmIn11ZRY_Thetam_af32@ */ Lookup1D_FLOAT32_IEEE 0 SWC_MCF_CM_single -3.4E+38 3.4E+38
 /begin AXIS_DESCR COM_AXIS NO_INPUT_QUANTITY SWC_MCF_CM_single 23 -3.4E+38 3.4E+38 AXIS_PTS_REF CAL_MCF_HarmIn1113ZRX_Spd_af32 /end AXIS_DESCR
/end CHARACTERISTIC
/begin CHARACTERISTIC CAL_MCF_CoefPIAlphaZeroFtlY_Kp_af32 "" CURVE 0x0000 /* @ECU_Address@CAL_MCF_CoefPIAlphaZeroFtlY_Kp_af32@ */ Lookup1D_FLOAT32_IEEE 0 SWC_MCF_CM_single -3.4E+38 3.4E+38
 /begin AXIS_DESCR COM_AXIS NO_INPUT_QUANTITY SWC_MCF_CM_single 10 -3.4E+38 3.4E+38 AXIS_PTS_REF CAL_MCF_CoefPIZoreCtlX_N_af32 /end AXIS_DESCR
/end CHARACTERISTIC
/begin AXIS_PTS CAL_MCF_CoefPIZoreCtlX_N_af32 "" 0x0000 /* @ECU_Address@CAL_MCF_CoefPIZoreCtlX_N_af32@ */ NO_INPUT_QUANTITY Lookup1D_X_FLOAT32_IEEE 0 SWC_MCF_CM_single 10 -3.4E+38 3.4E+38 /end AXIS_PTS
/begin CHARACTERISTIC CAL_MCF_CoefPIAlphaZeroCtlY_Ki_af32 "" CURVE 0x0000 /* @ECU_Address@CAL_MCF_CoefPIAlphaZeroCtlY_Ki_af32@ */ Lookup1D_FLOAT32_IEEE 0 SWC_MCF_CM_single -3.4E+38 3.4E+38
 /begin AXIS_DESCR COM_AXIS NO_INPUT_QUANTITY SWC_MCF_CM_single 10 -3.4E+38 3.4E+38 AXIS_PTS_REF CAL_MCF_CoefPIZoreCtlX_N_af32 /end AXIS_DESCR
/end CHARACTERISTIC
/begin CHARACTERISTIC CAL_MCF_CoefPIBetaZeroCtlY_Kp_af32 "" CURVE 0x0000 /* @ECU_Address@CAL_MCF_CoefPIBetaZeroCtlY_Kp_af32@ */ Lookup1D_FLOAT32_IEEE 0 SWC_MCF_CM_single -3.4E+38 3.4E+38
 /begin AXIS_DESCR COM_AXIS NO_INPUT_QUANTITY SWC_MCF_CM_single 10 -3.4E+38 3.4E+38 AXIS_PTS_REF CAL_MCF_CoefPIZoreCtlX_N_af32 /end AXIS_DESCR
/end CHARACTERISTIC
/begin CHARACTERISTIC CAL_MCF_CoefPIBetaZeroCtlY_Ki_af32 "" CURVE 0x0000 /* @ECU_Address@CAL_MCF_CoefPIBetaZeroCtlY_Ki_af32@ */ Lookup1D_FLOAT32_IEEE 0 SWC_MCF_CM_single -3.4E+38 3.4E+38
 /begin AXIS_DESCR COM_AXIS NO_INPUT_QUANTITY SWC_MCF_CM_single 10 -3.4E+38 3.4E+38 AXIS_PTS_REF CAL_MCF_CoefPIZoreCtlX_N_af32 /end AXIS_DESCR
/end CHARACTERISTIC
/begin CHARACTERISTIC CAL_MCF_uDDesEOLY_af32 "" CURVE 0x0000 /* @ECU_Address@CAL_MCF_uDDesEOLY_af32@ */ Lookup1D_FLOAT32_IEEE 0 SWC_MCF_CM_single -3.4E+38 3.4E+38
 /begin AXIS_DESCR COM_AXIS NO_INPUT_QUANTITY SWC_MCF_CM_single 20 -3.4E+38 3.4E+38 AXIS_PTS_REF CAL_MCF_IrmsDesEOLX_af32 /end AXIS_DESCR
/end CHARACTERISTIC
/begin AXIS_PTS CAL_MCF_IrmsDesEOLX_af32 "" 0x0000 /* @ECU_Address@CAL_MCF_IrmsDesEOLX_af32@ */ NO_INPUT_QUANTITY Lookup1D_X_FLOAT32_IEEE 0 SWC_MCF_CM_single 20 -3.4E+38 3.4E+38 /end AXIS_PTS
/begin CHARACTERISTIC CAL_MCF_OmbwFirstFltY_Ombw_af32 "" CURVE 0x0000 /* @ECU_Address@CAL_MCF_OmbwFirstFltY_Ombw_af32@ */ Lookup1D_FLOAT32_IEEE 0 SWC_MCF_CM_single -3.4E+38 3.4E+38
 /begin AXIS_DESCR COM_AXIS NO_INPUT_QUANTITY SWC_MCF_CM_single 10 -3.4E+38 3.4E+38 AXIS_PTS_REF CAL_MCF_OmbwFirstFltX_N_af32 /end AXIS_DESCR
/end CHARACTERISTIC
/begin AXIS_PTS CAL_MCF_OmbwFirstFltX_N_af32 "" 0x0000 /* @ECU_Address@CAL_MCF_OmbwFirstFltX_N_af32@ */ NO_INPUT_QUANTITY Lookup1D_X_FLOAT32_IEEE 0 SWC_MCF_CM_single 10 -3.4E+38 3.4E+38 /end AXIS_PTS
/begin CHARACTERISTIC CAL_cofPowerLimitMotHeat_af32 "" CURVE 0x0000 /* @ECU_Address@CAL_cofPowerLimitMotHeat_af32@ */ Lookup1D_FLOAT32_IEEE 0 SWC_MCF_CM_single -3.4E+38 3.4E+38
 /begin AXIS_DESCR COM_AXIS NO_INPUT_QUANTITY SWC_MCF_CM_single 9 -3.4E+38 3.4E+38 AXIS_PTS_REF CAL_tStrrTempFltMotHeat_af32 /end AXIS_DESCR
/end CHARACTERISTIC
/begin AXIS_PTS CAL_tStrrTempFltMotHeat_af32 "" 0x0000 /* @ECU_Address@CAL_tStrrTempFltMotHeat_af32@ */ NO_INPUT_QUANTITY Lookup1D_X_FLOAT32_IEEE 0 SWC_MCF_CM_single 9 -3.4E+38 3.4E+38 /end AXIS_PTS
/begin CHARACTERISTIC CAL_MCF_TrqOffActiveHeat_af32 "" CURVE 0x0000 /* @ECU_Address@CAL_MCF_TrqOffActiveHeat_af32@ */ Lookup1D_FLOAT32_IEEE 0 SWC_MCF_CM_single -3.4E+38 3.4E+38
 /begin AXIS_DESCR COM_AXIS NO_INPUT_QUANTITY SWC_MCF_CM_single 9 -3.4E+38 3.4E+38 AXIS_PTS_REF CAL_MCF_SpdActiveHeat_af32 /end AXIS_DESCR
/end CHARACTERISTIC
/begin AXIS_PTS CAL_MCF_SpdActiveHeat_af32 "" 0x0000 /* @ECU_Address@CAL_MCF_SpdActiveHeat_af32@ */ NO_INPUT_QUANTITY Lookup1D_X_FLOAT32_IEEE 0 SWC_MCF_CM_single 9 -3.4E+38 3.4E+38 /end AXIS_PTS
/begin CHARACTERISTIC CAL_MCF_AgDiffCurrSec_f32 "" VALUE 0x0000 /* @ECU_Address@CAL_MCF_AgDiffCurrSec_f32@ */ Scalar_FLOAT32_IEEE 0 SWC_MCF_CM_single -65535.0 65535.0 /end CHARACTERISTIC
/begin CHARACTERISTIC CAL_MCF_AplhaRefZeroCtl_f32 "" VALUE 0x0000 /* @ECU_Address@CAL_MCF_AplhaRefZeroCtl_f32@ */ Scalar_FLOAT32_IEEE 0 SWC_MCF_CM_single -65535.0 65535.0 /end CHARACTERISTIC
/begin CHARACTERISTIC CAL_MCF_BetaRefZeroCtl_f32 "" VALUE 0x0000 /* @ECU_Address@CAL_MCF_BetaRefZeroCtl_f32@ */ Scalar_FLOAT32_IEEE 0 SWC_MCF_CM_single -65535.0 65535.0 /end CHARACTERISTIC
/begin CHARACTERISTIC CAL_MCF_CoefFltZero_A_f32 "" VALUE 0x0000 /* @ECU_Address@CAL_MCF_CoefFltZero_A_f32@ */ Scalar_FLOAT32_IEEE 0 SWC_MCF_CM_single -65535.0 65535.0 /end CHARACTERISTIC
/begin CHARACTERISTIC CAL_MCF_CoefFltZero_B_f32 "" VALUE 0x0000 /* @ECU_Address@CAL_MCF_CoefFltZero_B_f32@ */ Scalar_FLOAT32_IEEE 0 SWC_MCF_CM_single -65535.0 65535.0 /end CHARACTERISTIC
/begin CHARACTERISTIC CAL_MCF_CoefFltZero_C_f32 "" VALUE 0x0000 /* @ECU_Address@CAL_MCF_CoefFltZero_C_f32@ */ Scalar_FLOAT32_IEEE 0 SWC_MCF_CM_single -65535.0 65535.0 /end CHARACTERISTIC
/begin CHARACTERISTIC CAL_MCF_CoefuDCLimtEOL_f32 "" VALUE 0x0000 /* @ECU_Address@CAL_MCF_CoefuDCLimtEOL_f32@ */ Scalar_FLOAT32_IEEE 0 SWC_MCF_CM_single -65535.0 65535.0 /end CHARACTERISTIC
/begin CHARACTERISTIC CAL_MCF_DeadTimeCpn_f32 "" VALUE 0x0000 /* @ECU_Address@CAL_MCF_DeadTimeCpn_f32@ */ Scalar_FLOAT32_IEEE 0 SWC_MCF_CM_single -65535.0 65535.0 /end CHARACTERISTIC
/begin CHARACTERISTIC CAL_MCF_DeltaPower_f32 "" VALUE 0x0000 /* @ECU_Address@CAL_MCF_DeltaPower_f32@ */ Scalar_FLOAT32_IEEE 0 SWC_MCF_CM_single -65535.0 65535.0 /end CHARACTERISTIC
/begin CHARACTERISTIC CAL_MCF_DisChaisdDes_f32 "" VALUE 0x0000 /* @ECU_Address@CAL_MCF_DisChaisdDes_f32@ */ Scalar_FLOAT32_IEEE 0 SWC_MCF_CM_single -65535.0 65535.0 /end CHARACTERISTIC
/begin CHARACTERISTIC CAL_MCF_DisChaisqDes_f32 "" VALUE 0x0000 /* @ECU_Address@CAL_MCF_DisChaisqDes_f32@ */ Scalar_FLOAT32_IEEE 0 SWC_MCF_CM_single -65535.0 65535.0 /end CHARACTERISTIC
/begin CHARACTERISTIC CAL_MCF_DownLimPIZeroCtl_f32 "" VALUE 0x0000 /* @ECU_Address@CAL_MCF_DownLimPIZeroCtl_f32@ */ Scalar_FLOAT32_IEEE 0 SWC_MCF_CM_single -65535.0 65535.0 /end CHARACTERISTIC
/begin CHARACTERISTIC CAL_MCF_DownLimitIMotHeat_f32 "" VALUE 0x0000 /* @ECU_Address@CAL_MCF_DownLimitIMotHeat_f32@ */ Scalar_FLOAT32_IEEE 0 SWC_MCF_CM_single -65535.0 65535.0 /end CHARACTERISTIC
/begin CHARACTERISTIC CAL_MCF_DownLimitPIMotHeat_f32 "" VALUE 0x0000 /* @ECU_Address@CAL_MCF_DownLimitPIMotHeat_f32@ */ Scalar_FLOAT32_IEEE 0 SWC_MCF_CM_single -65535.0 65535.0 /end CHARACTERISTIC
/begin CHARACTERISTIC CAL_MCF_DycUSet_f32 "" VALUE 0x0000 /* @ECU_Address@CAL_MCF_DycUSet_f32@ */ Scalar_FLOAT32_IEEE 0 SWC_MCF_CM_single -65535.0 65535.0 /end CHARACTERISTIC
/begin CHARACTERISTIC CAL_MCF_DycVSet_f32 "" VALUE 0x0000 /* @ECU_Address@CAL_MCF_DycVSet_f32@ */ Scalar_FLOAT32_IEEE 0 SWC_MCF_CM_single -65535.0 65535.0 /end CHARACTERISTIC
/begin CHARACTERISTIC CAL_MCF_DycWSet_f32 "" VALUE 0x0000 /* @ECU_Address@CAL_MCF_DycWSet_f32@ */ Scalar_FLOAT32_IEEE 0 SWC_MCF_CM_single -65535.0 65535.0 /end CHARACTERISTIC
/begin CHARACTERISTIC CAL_MCF_FixFreq_f32 "定频" VALUE 0x0000 /* @ECU_Address@CAL_MCF_FixFreq_f32@ */ Scalar_FLOAT32_IEEE 0 SWC_MCF_CM_single 0.0 65535.0 /end CHARACTERISTIC
/begin CHARACTERISTIC CAL_MCF_FrqRmp_f32 "载频Ramp值" VALUE 0x0000 /* @ECU_Address@CAL_MCF_FrqRmp_f32@ */ Scalar_FLOAT32_IEEE 0 SWC_MCF_CM_single 0.0 65535.0 /end CHARACTERISTIC
/begin CHARACTERISTIC CAL_MCF_HalfFreq_f32 "半频" VALUE 0x0000 /* @ECU_Address@CAL_MCF_HalfFreq_f32@ */ Scalar_FLOAT32_IEEE 0 SWC_MCF_CM_single 0.0 65535.0 /end CHARACTERISTIC
/begin CHARACTERISTIC CAL_MCF_IsSet11ZR_f32 "" VALUE 0x0000 /* @ECU_Address@CAL_MCF_IsSet11ZR_f32@ */ Scalar_FLOAT32_IEEE 0 SWC_MCF_CM_single -65535.0 65535.0 /end CHARACTERISTIC
/begin CHARACTERISTIC CAL_MCF_IsThetaSet11ZR_f32 "" VALUE 0x0000 /* @ECU_Address@CAL_MCF_IsThetaSet11ZR_f32@ */ Scalar_FLOAT32_IEEE 0 SWC_MCF_CM_single -65535.0 65535.0 /end CHARACTERISTIC
/begin CHARACTERISTIC CAL_MCF_IsrmsDesEOL_f32 "" VALUE 0x0000 /* @ECU_Address@CAL_MCF_IsrmsDesEOL_f32@ */ Scalar_FLOAT32_IEEE 0 SWC_MCF_CM_single -65535.0 65535.0 /end CHARACTERISTIC
/begin CHARACTERISTIC CAL_MCF_KiAlphaZeroCtl_f32 "" VALUE 0x0000 /* @ECU_Address@CAL_MCF_KiAlphaZeroCtl_f32@ */ Scalar_FLOAT32_IEEE 0 SWC_MCF_CM_single -65535.0 65535.0 /end CHARACTERISTIC
/begin CHARACTERISTIC CAL_MCF_KiBetaZeroCtl_f32 "" VALUE 0x0000 /* @ECU_Address@CAL_MCF_KiBetaZeroCtl_f32@ */ Scalar_FLOAT32_IEEE 0 SWC_MCF_CM_single -65535.0 65535.0 /end CHARACTERISTIC
/begin CHARACTERISTIC CAL_MCF_KiMotHeat_f32 "" VALUE 0x0000 /* @ECU_Address@CAL_MCF_KiMotHeat_f32@ */ Scalar_FLOAT32_IEEE 0 SWC_MCF_CM_single -65535.0 65535.0 /end CHARACTERISTIC
/begin CHARACTERISTIC CAL_MCF_KiUdEOL_f32 "" VALUE 0x0000 /* @ECU_Address@CAL_MCF_KiUdEOL_f32@ */ Scalar_FLOAT32_IEEE 0 SWC_MCF_CM_single -65535.0 65535.0 /end CHARACTERISTIC
/begin CHARACTERISTIC CAL_MCF_KpAlphaZeroCtl_f32 "" VALUE 0x0000 /* @ECU_Address@CAL_MCF_KpAlphaZeroCtl_f32@ */ Scalar_FLOAT32_IEEE 0 SWC_MCF_CM_single -65535.0 65535.0 /end CHARACTERISTIC
/begin CHARACTERISTIC CAL_MCF_KpBetaZeroCtl_f32 "" VALUE 0x0000 /* @ECU_Address@CAL_MCF_KpBetaZeroCtl_f32@ */ Scalar_FLOAT32_IEEE 0 SWC_MCF_CM_single -65535.0 65535.0 /end CHARACTERISTIC
/begin CHARACTERISTIC CAL_MCF_KpMotHeat_f32 "" VALUE 0x0000 /* @ECU_Address@CAL_MCF_KpMotHeat_f32@ */ Scalar_FLOAT32_IEEE 0 SWC_MCF_CM_single -65535.0 65535.0 /end CHARACTERISTIC
/begin CHARACTERISTIC CAL_MCF_KpUdEOL_f32 "" VALUE 0x0000 /* @ECU_Address@CAL_MCF_KpUdEOL_f32@ */ Scalar_FLOAT32_IEEE 0 SWC_MCF_CM_single -65535.0 65535.0 /end CHARACTERISTIC
/begin CHARACTERISTIC CAL_MCF_OffsetInternal_f32 "" VALUE 0x0000 /* @ECU_Address@CAL_MCF_OffsetInternal_f32@ */ Scalar_FLOAT32_IEEE 0 SWC_MCF_CM_single 0.0 360.0 /end CHARACTERISTIC
/begin CHARACTERISTIC CAL_MCF_SampleTime_f32 "" VALUE 0x0000 /* @ECU_Address@CAL_MCF_SampleTime_f32@ */ Scalar_FLOAT32_IEEE 0 SWC_MCF_CM_single -65535.0 65535.0 /end CHARACTERISTIC
/begin CHARACTERISTIC CAL_MCF_SpdOffActiveHeat_f32 "" VALUE 0x0000 /* @ECU_Address@CAL_MCF_SpdOffActiveHeat_f32@ */ Scalar_FLOAT32_IEEE 0 SWC_MCF_CM_single -65535.0 65535.0 /end CHARACTERISTIC
/begin CHARACTERISTIC CAL_MCF_SpdOffDeadCpn_f32 "" VALUE 0x0000 /* @ECU_Address@CAL_MCF_SpdOffDeadCpn_f32@ */ Scalar_FLOAT32_IEEE 0 SWC_MCF_CM_single -65535.0 65535.0 /end CHARACTERISTIC
/begin CHARACTERISTIC CAL_MCF_SpdOnDeadCpn_f32 "" VALUE 0x0000 /* @ECU_Address@CAL_MCF_SpdOnDeadCpn_f32@ */ Scalar_FLOAT32_IEEE 0 SWC_MCF_CM_single -65535.0 65535.0 /end CHARACTERISTIC
/begin CHARACTERISTIC CAL_MCF_TrqInvMax_f32 "" VALUE 0x0000 /* @ECU_Address@CAL_MCF_TrqInvMax_f32@ */ Scalar_FLOAT32_IEEE 0 SWC_MCF_CM_single -65535.0 65535.0 /end CHARACTERISTIC
/begin CHARACTERISTIC CAL_MCF_TrqOffDeadCpn_f32 "" VALUE 0x0000 /* @ECU_Address@CAL_MCF_TrqOffDeadCpn_f32@ */ Scalar_FLOAT32_IEEE 0 SWC_MCF_CM_single -65535.0 65535.0 /end CHARACTERISTIC
/begin CHARACTERISTIC CAL_MCF_UpLimPIZeroCtl_f32 "" VALUE 0x0000 /* @ECU_Address@CAL_MCF_UpLimPIZeroCtl_f32@ */ Scalar_FLOAT32_IEEE 0 SWC_MCF_CM_single -65535.0 65535.0 /end CHARACTERISTIC
/begin CHARACTERISTIC CAL_MCF_UpLimitIMotHeat_f32 "" VALUE 0x0000 /* @ECU_Address@CAL_MCF_UpLimitIMotHeat_f32@ */ Scalar_FLOAT32_IEEE 0 SWC_MCF_CM_single -65535.0 65535.0 /end CHARACTERISTIC
/begin CHARACTERISTIC CAL_MCF_UpLimitPIMotHeat_f32 "" VALUE 0x0000 /* @ECU_Address@CAL_MCF_UpLimitPIMotHeat_f32@ */ Scalar_FLOAT32_IEEE 0 SWC_MCF_CM_single -65535.0 65535.0 /end CHARACTERISTIC
/begin CHARACTERISTIC CAL_MCF_UpPowerHeat_f32 "" VALUE 0x0000 /* @ECU_Address@CAL_MCF_UpPowerHeat_f32@ */ Scalar_FLOAT32_IEEE 0 SWC_MCF_CM_single -65535.0 65535.0 /end CHARACTERISTIC
/begin CHARACTERISTIC CAL_MCF_UsdScalSet_f32 "" VALUE 0x0000 /* @ECU_Address@CAL_MCF_UsdScalSet_f32@ */ Scalar_FLOAT32_IEEE 0 SWC_MCF_CM_single -65535.0 65535.0 /end CHARACTERISTIC
/begin CHARACTERISTIC CAL_MCF_UsqScalSet_f32 "" VALUE 0x0000 /* @ECU_Address@CAL_MCF_UsqScalSet_f32@ */ Scalar_FLOAT32_IEEE 0 SWC_MCF_CM_single -65535.0 65535.0 /end CHARACTERISTIC
/begin CHARACTERISTIC CAL_MCF_cofFltN_f32 "转速滤波系数" VALUE 0x0000 /* @ECU_Address@CAL_MCF_cofFltN_f32@ */ Scalar_FLOAT32_IEEE 0 SWC_MCF_CM_single -65535.0 65535.0 /end CHARACTERISTIC
/begin CHARACTERISTIC CAL_MCF_cofFltPowerHeat_f32 "" VALUE 0x0000 /* @ECU_Address@CAL_MCF_cofFltPowerHeat_f32@ */ Scalar_FLOAT32_IEEE 0 SWC_MCF_CM_single -65535.0 65535.0 /end CHARACTERISTIC
/begin CHARACTERISTIC CAL_MCF_cofFltWe_f32 "" VALUE 0x0000 /* @ECU_Address@CAL_MCF_cofFltWe_f32@ */ Scalar_FLOAT32_IEEE 0 SWC_MCF_CM_single -65535.0 65535.0 /end CHARACTERISTIC
/begin CHARACTERISTIC CAL_MCF_cofOverModu_f32 "过调制系数" VALUE 0x0000 /* @ECU_Address@CAL_MCF_cofOverModu_f32@ */ Scalar_FLOAT32_IEEE 0 SWC_MCF_CM_single -65535.0 65535.0 /end CHARACTERISTIC
/begin CHARACTERISTIC CAL_MCF_iUCnvFac_f32 "U相转换系数" VALUE 0x0000 /* @ECU_Address@CAL_MCF_iUCnvFac_f32@ */ Scalar_FLOAT32_IEEE 0 SWC_MCF_CM_single -65535.0 65535.0 /end CHARACTERISTIC
/begin CHARACTERISTIC CAL_MCF_iVCnvFac_f32 "V相转换系数" VALUE 0x0000 /* @ECU_Address@CAL_MCF_iVCnvFac_f32@ */ Scalar_FLOAT32_IEEE 0 SWC_MCF_CM_single -65535.0 65535.0 /end CHARACTERISTIC
/begin CHARACTERISTIC CAL_MCF_iWCnvFac_f32 "W相转换系数" VALUE 0x0000 /* @ECU_Address@CAL_MCF_iWCnvFac_f32@ */ Scalar_FLOAT32_IEEE 0 SWC_MCF_CM_single -65535.0 65535.0 /end CHARACTERISTIC
/begin CHARACTERISTIC CAL_MCF_isMax_f32 "" VALUE 0x0000 /* @ECU_Address@CAL_MCF_isMax_f32@ */ Scalar_FLOAT32_IEEE 0 SWC_MCF_CM_single -65535.0 65535.0 /end CHARACTERISTIC
/begin CHARACTERISTIC CAL_MCF_isSet_f32 "" VALUE 0x0000 /* @ECU_Address@CAL_MCF_isSet_f32@ */ Scalar_FLOAT32_IEEE 0 SWC_MCF_CM_single -65535.0 65535.0 /end CHARACTERISTIC
/begin CHARACTERISTIC CAL_MCF_isThetaSet_f32 "" VALUE 0x0000 /* @ECU_Address@CAL_MCF_isThetaSet_f32@ */ Scalar_FLOAT32_IEEE 0 SWC_MCF_CM_single -65535.0 65535.0 /end CHARACTERISTIC
/begin CHARACTERISTIC CAL_MCF_isdSet_f32 "" VALUE 0x0000 /* @ECU_Address@CAL_MCF_isdSet_f32@ */ Scalar_FLOAT32_IEEE 0 SWC_MCF_CM_single -65535.0 65535.0 /end CHARACTERISTIC
/begin CHARACTERISTIC CAL_MCF_isdfwKi_f32 "" VALUE 0x0000 /* @ECU_Address@CAL_MCF_isdfwKi_f32@ */ Scalar_FLOAT32_IEEE 0 SWC_MCF_CM_single -65535.0 65535.0 /end CHARACTERISTIC
/begin CHARACTERISTIC CAL_MCF_isdfwKp_f32 "" VALUE 0x0000 /* @ECU_Address@CAL_MCF_isdfwKp_f32@ */ Scalar_FLOAT32_IEEE 0 SWC_MCF_CM_single -65535.0 65535.0 /end CHARACTERISTIC
/begin CHARACTERISTIC CAL_MCF_isqSet_f32 "" VALUE 0x0000 /* @ECU_Address@CAL_MCF_isqSet_f32@ */ Scalar_FLOAT32_IEEE 0 SWC_MCF_CM_single -65535.0 65535.0 /end CHARACTERISTIC
/begin CHARACTERISTIC CAL_MCF_nDpwmOffDelay_f32 "DPWM功能关闭滞环条件(转速)" VALUE 0x0000 /* @ECU_Address@CAL_MCF_nDpwmOffDelay_f32@ */ Scalar_FLOAT32_IEEE 0 SWC_MCF_CM_single -65535.0 65535.0 /end CHARACTERISTIC
/begin CHARACTERISTIC CAL_MCF_nDpwmOff_f32 "DPWM功能关闭条件(转速)" VALUE 0x0000 /* @ECU_Address@CAL_MCF_nDpwmOff_f32@ */ Scalar_FLOAT32_IEEE 0 SWC_MCF_CM_single -65535.0 65535.0 /end CHARACTERISTIC
/begin CHARACTERISTIC CAL_MCF_perCpnAg_f32 "角度补偿周期" VALUE 0x0000 /* @ECU_Address@CAL_MCF_perCpnAg_f32@ */ Scalar_FLOAT32_IEEE 0 SWC_MCF_CM_single -65535.0 65535.0 /end CHARACTERISTIC
/begin CHARACTERISTIC CAL_MCF_ratLo_f32 "占空比限制下限" VALUE 0x0000 /* @ECU_Address@CAL_MCF_ratLo_f32@ */ Scalar_FLOAT32_IEEE 0 SWC_MCF_CM_single 0.0 1.0 /end CHARACTERISTIC
/begin CHARACTERISTIC CAL_MCF_ratNarrWave_f32 "窄波低阈值" VALUE 0x0000 /* @ECU_Address@CAL_MCF_ratNarrWave_f32@ */ Scalar_FLOAT32_IEEE 0 SWC_MCF_CM_single 0.0 65535.0 /end CHARACTERISTIC
/begin CHARACTERISTIC CAL_MCF_ratUp_f32 "占空比限制上限" VALUE 0x0000 /* @ECU_Address@CAL_MCF_ratUp_f32@ */ Scalar_FLOAT32_IEEE 0 SWC_MCF_CM_single 0.0 1.0 /end CHARACTERISTIC
/begin CHARACTERISTIC CAL_MCF_trqDpwmOff_f32 "DPWM功能关闭条件(扭矩)" VALUE 0x0000 /* @ECU_Address@CAL_MCF_trqDpwmOff_f32@ */ Scalar_FLOAT32_IEEE 0 SWC_MCF_CM_single -65535.0 65535.0 /end CHARACTERISTIC
/begin CHARACTERISTIC CAL_MCF_uDDownLimEOL_f32 "" VALUE 0x0000 /* @ECU_Address@CAL_MCF_uDDownLimEOL_f32@ */ Scalar_FLOAT32_IEEE 0 SWC_MCF_CM_single -65535.0 65535.0 /end CHARACTERISTIC
/begin CHARACTERISTIC CAL_MCF_uDUpLimEOL_f32 "" VALUE 0x0000 /* @ECU_Address@CAL_MCF_uDUpLimEOL_f32@ */ Scalar_FLOAT32_IEEE 0 SWC_MCF_CM_single -65535.0 65535.0 /end CHARACTERISTIC
/begin CHARACTERISTIC CAL_MCF_uDclnkSet_f32 "内部母线电压设置" VALUE 0x0000 /* @ECU_Address@CAL_MCF_uDclnkSet_f32@ */ Scalar_FLOAT32_IEEE 0 SWC_MCF_CM_single -65535.0 65535.0 /end CHARACTERISTIC
/begin CHARACTERISTIC CAL_MCF_uQDesEOL_f32 "" VALUE 0x0000 /* @ECU_Address@CAL_MCF_uQDesEOL_f32@ */ Scalar_FLOAT32_IEEE 0 SWC_MCF_CM_single -65535.0 65535.0 /end CHARACTERISTIC
/begin CHARACTERISTIC CAL_MCF_udDecoupki_f32 "" VALUE 0x0000 /* @ECU_Address@CAL_MCF_udDecoupki_f32@ */ Scalar_FLOAT32_IEEE 0 SWC_MCF_CM_single -65535.0 65535.0 /end CHARACTERISTIC
/begin CHARACTERISTIC CAL_MCF_udOverGain_f32 "" VALUE 0x0000 /* @ECU_Address@CAL_MCF_udOverGain_f32@ */ Scalar_FLOAT32_IEEE 0 SWC_MCF_CM_single -65535.0 65535.0 /end CHARACTERISTIC
/begin CHARACTERISTIC CAL_MCF_udki_f32 "" VALUE 0x0000 /* @ECU_Address@CAL_MCF_udki_f32@ */ Scalar_FLOAT32_IEEE 0 SWC_MCF_CM_single -65535.0 65535.0 /end CHARACTERISTIC
/begin CHARACTERISTIC CAL_MCF_udkp_f32 "" VALUE 0x0000 /* @ECU_Address@CAL_MCF_udkp_f32@ */ Scalar_FLOAT32_IEEE 0 SWC_MCF_CM_single -65535.0 65535.0 /end CHARACTERISTIC
/begin CHARACTERISTIC CAL_MCF_uqDecoupki_f32 "" VALUE 0x0000 /* @ECU_Address@CAL_MCF_uqDecoupki_f32@ */ Scalar_FLOAT32_IEEE 0 SWC_MCF_CM_single -65535.0 65535.0 /end CHARACTERISTIC
/begin CHARACTERISTIC CAL_MCF_uqOverGain_f32 "" VALUE 0x0000 /* @ECU_Address@CAL_MCF_uqOverGain_f32@ */ Scalar_FLOAT32_IEEE 0 SWC_MCF_CM_single -65535.0 65535.0 /end CHARACTERISTIC
/begin CHARACTERISTIC CAL_MCF_uqki_f32 "" VALUE 0x0000 /* @ECU_Address@CAL_MCF_uqki_f32@ */ Scalar_FLOAT32_IEEE 0 SWC_MCF_CM_single -65535.0 65535.0 /end CHARACTERISTIC
/begin CHARACTERISTIC CAL_MCF_uqkp_f32 "" VALUE 0x0000 /* @ECU_Address@CAL_MCF_uqkp_f32@ */ Scalar_FLOAT32_IEEE 0 SWC_MCF_CM_single -65535.0 65535.0 /end CHARACTERISTIC
/begin CHARACTERISTIC CAL_PowerMotHeat_f32 "" VALUE 0x0000 /* @ECU_Address@CAL_PowerMotHeat_f32@ */ Scalar_FLOAT32_IEEE 0 SWC_MCF_CM_single -65535.0 65535.0 /end CHARACTERISTIC
/begin CHARACTERISTIC CAL_MCF_FlgUpdateDyc_b "" VALUE 0x0000 /* @ECU_Address@CAL_MCF_FlgUpdateDyc_b@ */ Scalar_BOOLEAN 0 SWC_MCF_CM_boolean 0.0 1.0 /end CHARACTERISTIC
/begin CHARACTERISTIC CAL_MCF_FlgUseClose_b "" VALUE 0x0000 /* @ECU_Address@CAL_MCF_FlgUseClose_b@ */ Scalar_BOOLEAN 0 SWC_MCF_CM_boolean 0.0 1.0 /end CHARACTERISTIC
/begin CHARACTERISTIC CAL_MCF_FlgUseDeadCpn_b "" VALUE 0x0000 /* @ECU_Address@CAL_MCF_FlgUseDeadCpn_b@ */ Scalar_BOOLEAN 0 SWC_MCF_CM_boolean 0.0 1.0 /end CHARACTERISTIC
/begin CHARACTERISTIC CAL_MCF_FlgUseEOL_b "电感测试标志位" VALUE 0x0000 /* @ECU_Address@CAL_MCF_FlgUseEOL_b@ */ Scalar_BOOLEAN 0 SWC_MCF_CM_boolean 0.0 1.0 /end CHARACTERISTIC
/begin CHARACTERISTIC CAL_MCF_FlgUseOpen_b "" VALUE 0x0000 /* @ECU_Address@CAL_MCF_FlgUseOpen_b@ */ Scalar_BOOLEAN 0 SWC_MCF_CM_boolean 0.0 1.0 /end CHARACTERISTIC
/begin CHARACTERISTIC CAL_MCF_FlgUseSatuEOL_b "" VALUE 0x0000 /* @ECU_Address@CAL_MCF_FlgUseSatuEOL_b@ */ Scalar_BOOLEAN 0 SWC_MCF_CM_boolean 0.0 1.0 /end CHARACTERISTIC
/begin CHARACTERISTIC CAL_MCF_FlgUseSetDyc_b "" VALUE 0x0000 /* @ECU_Address@CAL_MCF_FlgUseSetDyc_b@ */ Scalar_BOOLEAN 0 SWC_MCF_CM_boolean 0.0 1.0 /end CHARACTERISTIC
/begin CHARACTERISTIC CAL_MCF_bUseduDclnkSet_b "内外部电压来源切换" VALUE 0x0000 /* @ECU_Address@CAL_MCF_bUseduDclnkSet_b@ */ Scalar_BOOLEAN 0 SWC_MCF_CM_boolean 0.0 1.0 /end CHARACTERISTIC
/begin CHARACTERISTIC CAL_MCF_flgCalibOffset_b "" VALUE 0x0000 /* @ECU_Address@CAL_MCF_flgCalibOffset_b@ */ Scalar_BOOLEAN 0 SWC_MCF_CM_boolean 0.0 1.0 /end CHARACTERISTIC
/begin CHARACTERISTIC CAL_MCF_flgDpwm_b "DPWM功能使能标志位" VALUE 0x0000 /* @ECU_Address@CAL_MCF_flgDpwm_b@ */ Scalar_BOOLEAN 0 SWC_MCF_CM_boolean 0.0 1.0 /end CHARACTERISTIC
/begin CHARACTERISTIC CAL_MCF_flgHarmInIsThetaTab11ZR_b "" VALUE 0x0000 /* @ECU_Address@CAL_MCF_flgHarmInIsThetaTab11ZR_b@ */ Scalar_BOOLEAN 0 SWC_MCF_CM_boolean 0.0 1.0 /end CHARACTERISTIC
/begin CHARACTERISTIC CAL_MCF_flgInternalOffset_b "" VALUE 0x0000 /* @ECU_Address@CAL_MCF_flgInternalOffset_b@ */ Scalar_BOOLEAN 0 SWC_MCF_CM_boolean 0.0 1.0 /end CHARACTERISTIC
/begin CHARACTERISTIC CAL_MCF_flgLowOrHvudcLnk_b "高压低压切换标志位" VALUE 0x0000 /* @ECU_Address@CAL_MCF_flgLowOrHvudcLnk_b@ */ Scalar_BOOLEAN 0 SWC_MCF_CM_boolean 0.0 1.0 /end CHARACTERISTIC
/begin CHARACTERISTIC CAL_MCF_flgMotHeat_b "" VALUE 0x0000 /* @ECU_Address@CAL_MCF_flgMotHeat_b@ */ Scalar_BOOLEAN 0 SWC_MCF_CM_boolean 0.0 1.0 /end CHARACTERISTIC
/begin CHARACTERISTIC CAL_MCF_flgNWS_b "窄波抑制功能使能标志位" VALUE 0x0000 /* @ECU_Address@CAL_MCF_flgNWS_b@ */ Scalar_BOOLEAN 0 SWC_MCF_CM_boolean 0.0 1.0 /end CHARACTERISTIC
/begin CHARACTERISTIC CAL_MCF_flgOfsClbTest_b "使用自标定数值调试标志位" VALUE 0x0000 /* @ECU_Address@CAL_MCF_flgOfsClbTest_b@ */ Scalar_BOOLEAN 0 SWC_MCF_CM_boolean 0.0 1.0 /end CHARACTERISTIC
/begin CHARACTERISTIC CAL_MCF_flgOverModu_b "过调制使能标志位" VALUE 0x0000 /* @ECU_Address@CAL_MCF_flgOverModu_b@ */ Scalar_BOOLEAN 0 SWC_MCF_CM_boolean 0.0 1.0 /end CHARACTERISTIC
/begin CHARACTERISTIC CAL_MCF_flgRpwmFrqRandom_b "Rpwm随机频率标志位" VALUE 0x0000 /* @ECU_Address@CAL_MCF_flgRpwmFrqRandom_b@ */ Scalar_BOOLEAN 0 SWC_MCF_CM_boolean 0.0 1.0 /end CHARACTERISTIC
/begin CHARACTERISTIC CAL_MCF_flgTabZeroCtl_b "" VALUE 0x0000 /* @ECU_Address@CAL_MCF_flgTabZeroCtl_b@ */ Scalar_BOOLEAN 0 SWC_MCF_CM_boolean 0.0 1.0 /end CHARACTERISTIC
/begin CHARACTERISTIC CAL_MCF_flgUse1113ZR_b "" VALUE 0x0000 /* @ECU_Address@CAL_MCF_flgUse1113ZR_b@ */ Scalar_BOOLEAN 0 SWC_MCF_CM_boolean 0.0 1.0 /end CHARACTERISTIC
/begin CHARACTERISTIC CAL_MCF_flgUseFF_b "" VALUE 0x0000 /* @ECU_Address@CAL_MCF_flgUseFF_b@ */ Scalar_BOOLEAN 0 SWC_MCF_CM_boolean 0.0 1.0 /end CHARACTERISTIC
/begin CHARACTERISTIC CAL_MCF_flgUseUsOver_b "" VALUE 0x0000 /* @ECU_Address@CAL_MCF_flgUseUsOver_b@ */ Scalar_BOOLEAN 0 SWC_MCF_CM_boolean 0.0 1.0 /end CHARACTERISTIC
/begin CHARACTERISTIC CAL_MCF_flgUseUsdqSet_b "" VALUE 0x0000 /* @ECU_Address@CAL_MCF_flgUseUsdqSet_b@ */ Scalar_BOOLEAN 0 SWC_MCF_CM_boolean 0.0 1.0 /end CHARACTERISTIC
/begin CHARACTERISTIC CAL_MCF_flgUseZeroCtl_b "" VALUE 0x0000 /* @ECU_Address@CAL_MCF_flgUseZeroCtl_b@ */ Scalar_BOOLEAN 0 SWC_MCF_CM_boolean 0.0 1.0 /end CHARACTERISTIC
/begin CHARACTERISTIC CAL_MCF_flgUseisTheta_b "" VALUE 0x0000 /* @ECU_Address@CAL_MCF_flgUseisTheta_b@ */ Scalar_BOOLEAN 0 SWC_MCF_CM_boolean 0.0 1.0 /end CHARACTERISTIC
/begin CHARACTERISTIC CAL_MCF_flgUseisdqSet_b "" VALUE 0x0000 /* @ECU_Address@CAL_MCF_flgUseisdqSet_b@ */ Scalar_BOOLEAN 0 SWC_MCF_CM_boolean 0.0 1.0 /end CHARACTERISTIC
/begin CHARACTERISTIC CAL_MCF_flgVF_b "变频使能标志位" VALUE 0x0000 /* @ECU_Address@CAL_MCF_flgVF_b@ */ Scalar_BOOLEAN 0 SWC_MCF_CM_boolean 0.0 1.0 /end CHARACTERISTIC
/begin CHARACTERISTIC CAL_MCF_ActiveHeatInit_u8 "" VALUE 0x0000 /* @ECU_Address@CAL_MCF_ActiveHeatInit_u8@ */ Scalar_UBYTE 0 SWC_MCF_CM_uint8 0.0 255.0 /end CHARACTERISTIC
/begin CHARACTERISTIC CAL_MCF_ActiveHeatNormal_u8 "" VALUE 0x0000 /* @ECU_Address@CAL_MCF_ActiveHeatNormal_u8@ */ Scalar_UBYTE 0 SWC_MCF_CM_uint8 0.0 255.0 /end CHARACTERISTIC
/begin CHARACTERISTIC CAL_MCF_Non_ActiveHeat_u8 "" VALUE 0x0000 /* @ECU_Address@CAL_MCF_Non_ActiveHeat_u8@ */ Scalar_UBYTE 0 SWC_MCF_CM_uint8 0.0 255.0 /end CHARACTERISTIC
/begin CHARACTERISTIC CAL_MCF_Part_ActiveHeat_u8 "" VALUE 0x0000 /* @ECU_Address@CAL_MCF_Part_ActiveHeat_u8@ */ Scalar_UBYTE 0 SWC_MCF_CM_uint8 0.0 255.0 /end CHARACTERISTIC
/begin CHARACTERISTIC CAL_MCF_stChangePha_u8 "换相标志位" VALUE 0x0000 /* @ECU_Address@CAL_MCF_stChangePha_u8@ */ Scalar_UBYTE 0 SWC_MCF_CM_uint8 1.0 6.0 /end CHARACTERISTIC
/begin CHARACTERISTIC CAL_MCF_stDpwm_u8 "DPWM调制方式选择" VALUE 0x0000 /* @ECU_Address@CAL_MCF_stDpwm_u8@ */ Scalar_UBYTE 0 SWC_MCF_CM_uint8 0.0 127.0 /end CHARACTERISTIC
/begin CHARACTERISTIC CAL_MCF_stPwmMode_u8 "" VALUE 0x0000 /* @ECU_Address@CAL_MCF_stPwmMode_u8@ */ Scalar_UBYTE 0 SWC_MCF_CM_uint8 0.0 255.0 /end CHARACTERISTIC
/begin MEASUREMENT VAR_MCF_iU_f32 "" FLOAT32_IEEE SWC_MCF_CM_single 0 0 -65535.0 65535.0 ECU_ADDRESS 0x0000 /* @ECU_Address@VAR_MCF_iU_f32@ */ /end MEASUREMENT
/begin MEASUREMENT VAR_MCF_iV_f32 "" FLOAT32_IEEE SWC_MCF_CM_single 0 0 -65535.0 65535.0 ECU_ADDRESS 0x0000 /* @ECU_Address@VAR_MCF_iV_f32@ */ /end MEASUREMENT
/begin MEASUREMENT VAR_MCF_iW_f32 "" FLOAT32_IEEE SWC_MCF_CM_single 0 0 -65535.0 65535.0 ECU_ADDRESS 0x0000 /* @ECU_Address@VAR_MCF_iW_f32@ */ /end MEASUREMENT
/begin MEASUREMENT VAR_MCF_Is_f32 "" FLOAT32_IEEE SWC_MCF_CM_single 0 0 -65535.0 65535.0 ECU_ADDRESS 0x0000 /* @ECU_Address@VAR_MCF_Is_f32@ */ /end MEASUREMENT
/begin MEASUREMENT VAR_MCF_agOffset_f32 "" FLOAT32_IEEE SWC_MCF_CM_single 0 0 -65535.0 65535.0 ECU_ADDRESS 0x0000 /* @ECU_Address@VAR_MCF_agOffset_f32@ */ /end MEASUREMENT
/begin MEASUREMENT VAR_MCF_agRtrEe_f32 "" FLOAT32_IEEE SWC_MCF_CM_single 0 0 -65535.0 65535.0 ECU_ADDRESS 0x0000 /* @ECU_Address@VAR_MCF_agRtrEe_f32@ */ /end MEASUREMENT
/begin MEASUREMENT VAR_MCF_uDcLnk_f32 "" FLOAT32_IEEE SWC_MCF_CM_single 0 0 -65535.0 65535.0 ECU_ADDRESS 0x0000 /* @ECU_Address@VAR_MCF_uDcLnk_f32@ */ /end MEASUREMENT
/begin MEASUREMENT VAR_MCF_idAct_f32 "" FLOAT32_IEEE SWC_MCF_CM_single 0 0 -65535.0 65535.0 ECU_ADDRESS 0x0000 /* @ECU_Address@VAR_MCF_idAct_f32@ */ /end MEASUREMENT
/begin MEASUREMENT VAR_MCF_iqAct_f32 "" FLOAT32_IEEE SWC_MCF_CM_single 0 0 -65535.0 65535.0 ECU_ADDRESS 0x0000 /* @ECU_Address@VAR_MCF_iqAct_f32@ */ /end MEASUREMENT
/begin MEASUREMENT VAR_MCF_UsUseRateDes_f32 "" FLOAT32_IEEE SWC_MCF_CM_single 0 0 -65535.0 65535.0 ECU_ADDRESS 0x0000 /* @ECU_Address@VAR_MCF_UsUseRateDes_f32@ */ /end MEASUREMENT
/begin MEASUREMENT VAR_MCF_udRv_f32 "" FLOAT32_IEEE SWC_MCF_CM_single 0 0 -65535.0 65535.0 ECU_ADDRESS 0x0000 /* @ECU_Address@VAR_MCF_udRv_f32@ */ /end MEASUREMENT
/begin MEASUREMENT VAR_MCF_periodCalc_f32 "" FLOAT32_IEEE SWC_MCF_CM_single 0 0 -65535.0 65535.0 ECU_ADDRESS 0x0000 /* @ECU_Address@VAR_MCF_periodCalc_f32@ */ /end MEASUREMENT
/begin MEASUREMENT VAR_MCF_isdFW_f32 "" FLOAT32_IEEE SWC_MCF_CM_single 0 0 -65535.0 65535.0 ECU_ADDRESS 0x0000 /* @ECU_Address@VAR_MCF_isdFW_f32@ */ /end MEASUREMENT
/begin MEASUREMENT VAR_MCF_idMotHeat_f32 "" FLOAT32_IEEE SWC_MCF_CM_single 0 0 -65535.0 65535.0 ECU_ADDRESS 0x0000 /* @ECU_Address@VAR_MCF_idMotHeat_f32@ */ /end MEASUREMENT
/begin MEASUREMENT VAR_MCF_idDes_f32 "" FLOAT32_IEEE SWC_MCF_CM_single 0 0 -65535.0 65535.0 ECU_ADDRESS 0x0000 /* @ECU_Address@VAR_MCF_idDes_f32@ */ /end MEASUREMENT
/begin MEASUREMENT VAR_MCF_MPC_Ld_f32 "" FLOAT32_IEEE SWC_MCF_CM_single 0 0 -65535.0 65535.0 ECU_ADDRESS 0x0000 /* @ECU_Address@VAR_MCF_MPC_Ld_f32@ */ /end MEASUREMENT
/begin MEASUREMENT VAR_MCF_Rdc_nWoFlt_f32 "" FLOAT32_IEEE SWC_MCF_CM_single 0 0 -65535.0 65535.0 ECU_ADDRESS 0x0000 /* @ECU_Address@VAR_MCF_Rdc_nWoFlt_f32@ */ /end MEASUREMENT
/begin MEASUREMENT VAR_MCF_MPC_Lq_f32 "" FLOAT32_IEEE SWC_MCF_CM_single 0 0 -65535.0 65535.0 ECU_ADDRESS 0x0000 /* @ECU_Address@VAR_MCF_MPC_Lq_f32@ */ /end MEASUREMENT
/begin MEASUREMENT VAR_MCF_MPC_LdSubLq_f32 "" FLOAT32_IEEE SWC_MCF_CM_single 0 0 -65535.0 65535.0 ECU_ADDRESS 0x0000 /* @ECU_Address@VAR_MCF_MPC_LdSubLq_f32@ */ /end MEASUREMENT
/begin MEASUREMENT VAR_MCF_iqDes_f32 "" FLOAT32_IEEE SWC_MCF_CM_single 0 0 -65535.0 65535.0 ECU_ADDRESS 0x0000 /* @ECU_Address@VAR_MCF_iqDes_f32@ */ /end MEASUREMENT
/begin MEASUREMENT VAR_MCF_EmfBack_f32 "" FLOAT32_IEEE SWC_MCF_CM_single 0 0 -65535.0 65535.0 ECU_ADDRESS 0x0000 /* @ECU_Address@VAR_MCF_EmfBack_f32@ */ /end MEASUREMENT
/begin MEASUREMENT VAR_MCF_uqRv_f32 "" FLOAT32_IEEE SWC_MCF_CM_single 0 0 -65535.0 65535.0 ECU_ADDRESS 0x0000 /* @ECU_Address@VAR_MCF_uqRv_f32@ */ /end MEASUREMENT
/begin MEASUREMENT VAR_MCF_udDes_f32 "" FLOAT32_IEEE SWC_MCF_CM_single 0 0 -65535.0 65535.0 ECU_ADDRESS 0x0000 /* @ECU_Address@VAR_MCF_udDes_f32@ */ /end MEASUREMENT
/begin MEASUREMENT VAR_MCF_uqDes_f32 "" FLOAT32_IEEE SWC_MCF_CM_single 0 0 -65535.0 65535.0 ECU_ADDRESS 0x0000 /* @ECU_Address@VAR_MCF_uqDes_f32@ */ /end MEASUREMENT
/begin MEASUREMENT VAR_MCF_UsUseRateReal_f32 "" FLOAT32_IEEE SWC_MCF_CM_single 0 0 -65535.0 65535.0 ECU_ADDRESS 0x0000 /* @ECU_Address@VAR_MCF_UsUseRateReal_f32@ */ /end MEASUREMENT
/begin MEASUREMENT VAR_MCF_uAlphaDeadCpn_f32 "" FLOAT32_IEEE SWC_MCF_CM_single 0 0 -65535.0 65535.0 ECU_ADDRESS 0x0000 /* @ECU_Address@VAR_MCF_uAlphaDeadCpn_f32@ */ /end MEASUREMENT
/begin MEASUREMENT VAR_MCF_uBetaDeadCpn_f32 "" FLOAT32_IEEE SWC_MCF_CM_single 0 0 -65535.0 65535.0 ECU_ADDRESS 0x0000 /* @ECU_Address@VAR_MCF_uBetaDeadCpn_f32@ */ /end MEASUREMENT
/begin MEASUREMENT VAR_MCF_UdDes11ZR_f32 "" FLOAT32_IEEE SWC_MCF_CM_single 0 0 -65535.0 65535.0 ECU_ADDRESS 0x0000 /* @ECU_Address@VAR_MCF_UdDes11ZR_f32@ */ /end MEASUREMENT
/begin MEASUREMENT VAR_MCF_UqDes11ZR_f32 "" FLOAT32_IEEE SWC_MCF_CM_single 0 0 -65535.0 65535.0 ECU_ADDRESS 0x0000 /* @ECU_Address@VAR_MCF_UqDes11ZR_f32@ */ /end MEASUREMENT
/begin MEASUREMENT VAR_MCF_uAlphaZero_f32 "" FLOAT32_IEEE SWC_MCF_CM_single 0 0 -65535.0 65535.0 ECU_ADDRESS 0x0000 /* @ECU_Address@VAR_MCF_uAlphaZero_f32@ */ /end MEASUREMENT
/begin MEASUREMENT VAR_MCF_uBetaZero_f32 "" FLOAT32_IEEE SWC_MCF_CM_single 0 0 -65535.0 65535.0 ECU_ADDRESS 0x0000 /* @ECU_Address@VAR_MCF_uBetaZero_f32@ */ /end MEASUREMENT
/begin MEASUREMENT VAR_MCF_uDDesEOL_f32 "" FLOAT32_IEEE SWC_MCF_CM_single 0 0 -65535.0 65535.0 ECU_ADDRESS 0x0000 /* @ECU_Address@VAR_MCF_uDDesEOL_f32@ */ /end MEASUREMENT
/begin MEASUREMENT VAR_MCF_uQDesEOL_f32 "" FLOAT32_IEEE SWC_MCF_CM_single 0 0 -65535.0 65535.0 ECU_ADDRESS 0x0000 /* @ECU_Address@VAR_MCF_uQDesEOL_f32@ */ /end MEASUREMENT
/begin MEASUREMENT VAR_MCF_uAOfsClb_f32 "" FLOAT32_IEEE SWC_MCF_CM_single 0 0 -65535.0 65535.0 ECU_ADDRESS 0x0000 /* @ECU_Address@VAR_MCF_uAOfsClb_f32@ */ /end MEASUREMENT
/begin MEASUREMENT VAR_MCF_uBOfsClb_f32 "" FLOAT32_IEEE SWC_MCF_CM_single 0 0 -65535.0 65535.0 ECU_ADDRESS 0x0000 /* @ECU_Address@VAR_MCF_uBOfsClb_f32@ */ /end MEASUREMENT
/begin MEASUREMENT VAR_MCF_usPeak_f32 "" FLOAT32_IEEE SWC_MCF_CM_single 0 0 -65535.0 65535.0 ECU_ADDRESS 0x0000 /* @ECU_Address@VAR_MCF_usPeak_f32@ */ /end MEASUREMENT
/begin MEASUREMENT VAR_MCF_AgRem_f32 "" FLOAT32_IEEE SWC_MCF_CM_single 0 0 -65535.0 65535.0 ECU_ADDRESS 0x0000 /* @ECU_Address@VAR_MCF_AgRem_f32@ */ /end MEASUREMENT
/begin MEASUREMENT VAR_MCF_uAOm_f32 "" FLOAT32_IEEE SWC_MCF_CM_single 0 0 -65535.0 65535.0 ECU_ADDRESS 0x0000 /* @ECU_Address@VAR_MCF_uAOm_f32@ */ /end MEASUREMENT
/begin MEASUREMENT VAR_MCF_uBOm_f32 "" FLOAT32_IEEE SWC_MCF_CM_single 0 0 -65535.0 65535.0 ECU_ADDRESS 0x0000 /* @ECU_Address@VAR_MCF_uBOm_f32@ */ /end MEASUREMENT
/begin MEASUREMENT VAR_MCF_iAlphaActFlt_f32 "" FLOAT32_IEEE SWC_MCF_CM_single 0 0 -65535.0 65535.0 ECU_ADDRESS 0x0000 /* @ECU_Address@VAR_MCF_iAlphaActFlt_f32@ */ /end MEASUREMENT
/begin MEASUREMENT VAR_MCF_iBetaActFlt_f32 "" FLOAT32_IEEE SWC_MCF_CM_single 0 0 -65535.0 65535.0 ECU_ADDRESS 0x0000 /* @ECU_Address@VAR_MCF_iBetaActFlt_f32@ */ /end MEASUREMENT
/begin MEASUREMENT VAR_MCF_IsSet11ZR_f32 "" FLOAT32_IEEE SWC_MCF_CM_single 0 0 -65535.0 65535.0 ECU_ADDRESS 0x0000 /* @ECU_Address@VAR_MCF_IsSet11ZR_f32@ */ /end MEASUREMENT
/begin MEASUREMENT VAR_MCF_IsThetaSet11ZR_f32 "" FLOAT32_IEEE SWC_MCF_CM_single 0 0 -65535.0 65535.0 ECU_ADDRESS 0x0000 /* @ECU_Address@VAR_MCF_IsThetaSet11ZR_f32@ */ /end MEASUREMENT
/begin MEASUREMENT VAR_MCF_PCUHeaterPower_f32 "" FLOAT32_IEEE SWC_MCF_CM_single 0 0 -65535.0 65535.0 ECU_ADDRESS 0x0000 /* @ECU_Address@VAR_MCF_PCUHeaterPower_f32@ */ /end MEASUREMENT
/begin MEASUREMENT VAR_MCF_PowerDcLnk_f32 "" FLOAT32_IEEE SWC_MCF_CM_single 0 0 -65535.0 65535.0 ECU_ADDRESS 0x0000 /* @ECU_Address@VAR_MCF_PowerDcLnk_f32@ */ /end MEASUREMENT
/begin MEASUREMENT VAR_MCF_PowerMech_f32 "" FLOAT32_IEEE SWC_MCF_CM_single 0 0 -65535.0 65535.0 ECU_ADDRESS 0x0000 /* @ECU_Address@VAR_MCF_PowerMech_f32@ */ /end MEASUREMENT
/begin MEASUREMENT VAR_MCF_PowerMotHeat_f32 "" FLOAT32_IEEE SWC_MCF_CM_single 0 0 -65535.0 65535.0 ECU_ADDRESS 0x0000 /* @ECU_Address@VAR_MCF_PowerMotHeat_f32@ */ /end MEASUREMENT
/begin MEASUREMENT VAR_MCF_HSPF_stIphaOffCal_u8 "" UBYTE SWC_MCF_CM_uint8 0 0 0.0 255.0 ECU_ADDRESS 0x0000 /* @ECU_Address@VAR_MCF_HSPF_stIphaOffCal_u8@ */ /end MEASUREMENT
/begin MEASUREMENT VAR_MCF_TMAhtChsts_f32 "" UBYTE SWC_MCF_CM_uint8 0 0 0.0 255.0 ECU_ADDRESS 0x0000 /* @ECU_Address@VAR_MCF_TMAhtChsts_f32@ */ /end MEASUREMENT
/begin MEASUREMENT VAR_MCF_flgFw_b "" UBYTE SWC_MCF_CM_boolean 0 0 0.0 1.0 ECU_ADDRESS 0x0000 /* @ECU_Address@VAR_MCF_flgFw_b@ */ /end MEASUREMENT
/begin MEASUREMENT VAR_MCF_flgMotHeat_b "" UBYTE SWC_MCF_CM_boolean 0 0 0.0 1.0 ECU_ADDRESS 0x0000 /* @ECU_Address@VAR_MCF_flgMotHeat_b@ */ /end MEASUREMENT
/begin MEASUREMENT VAR_MCF_SCF_flgInitEn_b "" UBYTE SWC_MCF_CM_boolean 0 0 0.0 1.0 ECU_ADDRESS 0x0000 /* @ECU_Address@VAR_MCF_SCF_flgInitEn_b@ */ /end MEASUREMENT
/begin MEASUREMENT VAR_MCF_FlgDeadCpn_b "" UBYTE SWC_MCF_CM_boolean 0 0 0.0 1.0 ECU_ADDRESS 0x0000 /* @ECU_Address@VAR_MCF_FlgDeadCpn_b@ */ /end MEASUREMENT
/begin COMPU_METHOD SWC_MCF_CM_single "Q = V" RAT_FUNC "%8.6" "" COEFFS 0 1 0 0 0 1 /end COMPU_METHOD
/begin COMPU_METHOD SWC_MCF_CM_boolean "Q = V" RAT_FUNC "%1.0" "" COEFFS 0 1 0 0 0 1 /end COMPU_METHOD
/begin COMPU_METHOD SWC_MCF_CM_uint8 "Q = V" RAT_FUNC "%3.0" "" COEFFS 0 1 0 0 0 1 /end COMPU_METHOD
/begin GROUP SWC_MCF "SWC_MCF" /* Root */ ROOT /begin SUB_GROUP Root_RE_SWC_MCF_100us_sys /end SUB_GROUP /end GROUP
/begin GROUP Root_RE_SWC_MCF_100us_sys "SWC_MCF/RE_SWC_MCF_100us_sys" /begin SUB_GROUP S1_Subsystem /end SUB_GROUP /end GROUP
/begin GROUP S1_Subsystem "SWC_MCF/RE_SWC_MCF_100us_sys/Subsystem" /begin SUB_GROUP S3_MCF_Signal S3_McFwc S3_McPoc S3_McSfc S3_McVmc /end SUB_GROUP /end GROUP
/begin GROUP S3_MCF_Signal "SWC_MCF/RE_SWC_MCF_100us_sys/Subsystem/MCF_Signal" /begin SUB_GROUP S4_MCF_Signal /end SUB_GROUP /end GROUP
/begin GROUP S3_McFwc "SWC_MCF/RE_SWC_MCF_100us_sys/Subsystem/McFwc" /begin SUB_GROUP S5_McFwc /end SUB_GROUP /end GROUP
/begin GROUP S3_McPoc "SWC_MCF/RE_SWC_MCF_100us_sys/Subsystem/McPoc" /begin SUB_GROUP S6_McPoc /end SUB_GROUP /end GROUP
/begin GROUP S3_McSfc "SWC_MCF/RE_SWC_MCF_100us_sys/Subsystem/McSfc" /begin SUB_GROUP S7_McSfc /end SUB_GROUP /end GROUP
/begin GROUP S3_McVmc "SWC_MCF/RE_SWC_MCF_100us_sys/Subsystem/McVmc" /begin SUB_GROUP S8_McVmc /end SUB_GROUP /end GROUP
/begin GROUP S4_MCF_Signal "SWC_MCF/RE_SWC_MCF_100us_sys/Subsystem/MCF_Signal/MCF_Signal" /begin SUB_GROUP S9_IsCalc S9_OffsetCal S9_SigCnv S9_park /end SUB_GROUP /begin REF_MEASUREMENT VAR_MCF_HSPF_stIphaOffCal_u8 /end REF_MEASUREMENT /end GROUP
/begin GROUP S5_McFwc "SWC_MCF/RE_SWC_MCF_100us_sys/Subsystem/McFwc/McFwc" /begin SUB_GROUP S17_Conditional_Judgment_ S17_idqDes S17_udqDes /end SUB_GROUP /end GROUP
/begin GROUP S6_McPoc "SWC_MCF/RE_SWC_MCF_100us_sys/Subsystem/McPoc/McPoc"
 /begin SUB_GROUP S59_Calculat__Dead_Compensation_Voltage S59_Harmonic_Injection_Funcation S59_Zero_Sequence_Control_Function /end SUB_GROUP
/end GROUP
/begin GROUP S7_McSfc "SWC_MCF/RE_SWC_MCF_100us_sys/Subsystem/McSfc/McSfc" /begin SUB_GROUP S105_Calibration_Duty_Cycle S105_EOL_Function /end SUB_GROUP /end GROUP
/begin GROUP S8_McVmc "SWC_MCF/RE_SWC_MCF_100us_sys/Subsystem/McVmc/McVmc"
 /begin SUB_GROUP S115_MCF_DPWM S115_MCF_OverModu S115_MCF_RePark S115_MCF_frqpwmCalc /end SUB_GROUP
/end GROUP
/begin GROUP S9_IsCalc "SWC_MCF/RE_SWC_MCF_100us_sys/Subsystem/MCF_Signal/MCF_Signal/IsCalc" /begin REF_MEASUREMENT VAR_MCF_Is_f32 /end REF_MEASUREMENT /end GROUP
/begin GROUP S9_OffsetCal "SWC_MCF/RE_SWC_MCF_100us_sys/Subsystem/MCF_Signal/MCF_Signal/OffsetCal" /begin SUB_GROUP S12_Rem3 /end SUB_GROUP
 /begin REF_CHARACTERISTIC CAL_MCF_OffsetInternal_f32 CAL_MCF_flgCalibOffset_b CAL_MCF_flgInternalOffset_b /end REF_CHARACTERISTIC
 /begin REF_MEASUREMENT VAR_MCF_agOffset_f32 /end REF_MEASUREMENT
/end GROUP
/begin GROUP S9_SigCnv "SWC_MCF/RE_SWC_MCF_100us_sys/Subsystem/MCF_Signal/MCF_Signal/SigCnv"
 /begin REF_CHARACTERISTIC CAL_MCF_bUseduDclnkSet_b CAL_MCF_flgLowOrHvudcLnk_b CAL_MCF_iUCnvFac_f32 CAL_MCF_iVCnvFac_f32 CAL_MCF_iWCnvFac_f32 CAL_MCF_stChangePha_u8 CAL_MCF_uDclnkSet_f32 /end REF_CHARACTERISTIC
 /begin REF_MEASUREMENT VAR_MCF_iU_f32 VAR_MCF_iV_f32 VAR_MCF_iW_f32 VAR_MCF_uDcLnk_f32 /end REF_MEASUREMENT
/end GROUP
/begin GROUP S9_park "SWC_MCF/RE_SWC_MCF_100us_sys/Subsystem/MCF_Signal/MCF_Signal/park" /begin REF_MEASUREMENT VAR_MCF_idAct_f32 VAR_MCF_iqAct_f32 /end REF_MEASUREMENT /end GROUP
/begin GROUP S17_Conditional_Judgment_ "SWC_MCF/RE_SWC_MCF_100us_sys/Subsystem/McFwc/McFwc/Conditional Judgment " /begin SUB_GROUP S18_FwcUsRes /end SUB_GROUP /end GROUP
/begin GROUP S17_idqDes "SWC_MCF/RE_SWC_MCF_100us_sys/Subsystem/McFwc/McFwc/idqDes" /begin SUB_GROUP S19_FluxWeakeningLoop /end SUB_GROUP /end GROUP
/begin GROUP S17_udqDes "SWC_MCF/RE_SWC_MCF_100us_sys/Subsystem/McFwc/McFwc/udqDes" /begin SUB_GROUP S20_CurrentLoop /end SUB_GROUP /end GROUP
/begin GROUP S59_Calculat__Dead_Compensation_Voltage "SWC_MCF/RE_SWC_MCF_100us_sys/Subsystem/McPoc/McPoc/Calculat_ Dead_Compensation_Voltage"
 /begin SUB_GROUP S60_Calculate_dead_compensation_voltage S60_Determines_dead_compensation_is_enabled /end SUB_GROUP
 /begin REF_MEASUREMENT VAR_MCF_uAlphaDeadCpn_f32 VAR_MCF_uBetaDeadCpn_f32 /end REF_MEASUREMENT
/end GROUP
/begin GROUP S59_Harmonic_Injection_Funcation "SWC_MCF/RE_SWC_MCF_100us_sys/Subsystem/McPoc/McPoc/Harmonic_Injection_Funcation" /begin SUB_GROUP S61_Harmonic_injection_of_11_and_13 /end SUB_GROUP /begin REF_CHARACTERISTIC CAL_MCF_flgUse1113ZR_b /end REF_CHARACTERISTIC /begin REF_MEASUREMENT VAR_MCF_UdDes11ZR_f32 VAR_MCF_UqDes11ZR_f32 /end REF_MEASUREMENT /end GROUP
/begin GROUP S59_Zero_Sequence_Control_Function "SWC_MCF/RE_SWC_MCF_100us_sys/Subsystem/McPoc/McPoc/Zero Sequence Control Function" /begin SUB_GROUP S62_Calculate_zero_sequence_alpha_and_beta_axis_voltage /end SUB_GROUP /begin REF_CHARACTERISTIC CAL_MCF_flgUseZeroCtl_b /end REF_CHARACTERISTIC /begin REF_MEASUREMENT VAR_MCF_uAlphaZero_f32 VAR_MCF_uBetaZero_f32 /end REF_MEASUREMENT /end GROUP
/begin GROUP S105_Calibration_Duty_Cycle "SWC_MCF/RE_SWC_MCF_100us_sys/Subsystem/McSfc/McSfc/Calibration Duty Cycle"
 /begin REF_CHARACTERISTIC CAL_MCF_DycUSet_f32 CAL_MCF_DycVSet_f32 CAL_MCF_DycWSet_f32 CAL_MCF_FlgUpdateDyc_b CAL_MCF_FlgUseSetDyc_b CAL_MCF_stPwmMode_u8 /end REF_CHARACTERISTIC
/end GROUP
/begin GROUP S105_EOL_Function "SWC_MCF/RE_SWC_MCF_100us_sys/Subsystem/McSfc/McSfc/EOL Function" /begin SUB_GROUP S107_Inductancetestfunction /end SUB_GROUP /begin REF_CHARACTERISTIC CAL_MCF_FlgUseEOL_b /end REF_CHARACTERISTIC /begin REF_MEASUREMENT VAR_MCF_uDDesEOL_f32 VAR_MCF_uQDesEOL_f32 /end REF_MEASUREMENT /end GROUP
/begin GROUP S115_MCF_DPWM "SWC_MCF/RE_SWC_MCF_100us_sys/Subsystem/McVmc/McVmc/MCF_DPWM"
 /begin SUB_GROUP S116_MCF_DPWM S116_MCF_DeadTimeCalc S116_MCF_DpwmEn S116_MCF_NarrWaSupr S116_MCF_dycCalc /end SUB_GROUP
/end GROUP
/begin GROUP S115_MCF_OverModu "SWC_MCF/RE_SWC_MCF_100us_sys/Subsystem/McVmc/McVmc/MCF_OverModu" /begin SUB_GROUP S117_MCF_OverModuEn /end SUB_GROUP /begin REF_CHARACTERISTIC CAL_MCF_flgOverModu_b /end REF_CHARACTERISTIC /end GROUP
/begin GROUP S115_MCF_RePark "SWC_MCF/RE_SWC_MCF_100us_sys/Subsystem/McVmc/McVmc/MCF_RePark" /begin SUB_GROUP S118_Mcf_AgTranCalc S118_OSC_AlOfsClbCompen /end SUB_GROUP /end GROUP
/begin GROUP S115_MCF_frqpwmCalc "SWC_MCF/RE_SWC_MCF_100us_sys/Subsystem/McVmc/McVmc/MCF_frqpwmCalc" /begin SUB_GROUP S119_FrqRamp S119_FrqRamp1 /end SUB_GROUP
 /begin REF_CHARACTERISTIC CAL_MCF_FixFreq_f32 CAL_MCF_HalfFreq_f32 CAL_MCF_flgRpwmFrqRandom_b CAL_MCF_flgVF_b /end REF_CHARACTERISTIC
/end GROUP
/begin GROUP S12_Rem3 "SWC_MCF/RE_SWC_MCF_100us_sys/Subsystem/MCF_Signal/MCF_Signal/OffsetCal/Rem3" /begin REF_MEASUREMENT VAR_MCF_agRtrEe_f32 /end REF_MEASUREMENT /end GROUP
/begin GROUP S18_FwcUsRes "SWC_MCF/RE_SWC_MCF_100us_sys/Subsystem/McFwc/McFwc/Conditional Judgment /FwcUsRes" /begin SUB_GROUP S21_GetFwFlag S21_GetUsResAct S21_UsdqDesCalc /end SUB_GROUP /end GROUP
/begin GROUP S19_FluxWeakeningLoop "SWC_MCF/RE_SWC_MCF_100us_sys/Subsystem/McFwc/McFwc/idqDes/FluxWeakeningLoop" /begin SUB_GROUP S27_GetisdDesFw S27_isdDesCoordinate1 S27_isqDesCoordinate /end SUB_GROUP /begin REF_MEASUREMENT VAR_MCF_MPC_LdSubLq_f32 /end REF_MEASUREMENT /end GROUP
/begin GROUP S20_CurrentLoop "SWC_MCF/RE_SWC_MCF_100us_sys/Subsystem/McFwc/McFwc/udqDes/CurrentLoop" /begin SUB_GROUP S55_Subsystem S55_Subsystem1 /end SUB_GROUP
 /begin REF_MEASUREMENT VAR_MCF_MPC_Ld_f32 VAR_MCF_MPC_Lq_f32 VAR_MCF_Rdc_nWoFlt_f32 VAR_MCF_SCF_flgInitEn_b /end REF_MEASUREMENT
/end GROUP
/begin GROUP S60_Calculate_dead_compensation_voltage "SWC_MCF/RE_SWC_MCF_100us_sys/Subsystem/McPoc/McPoc/Calculat_ Dead_Compensation_Voltage/Calculate dead compensation voltage" /begin SUB_GROUP S63_Calculate_coefficient_alpha_and_beta_axis /end SUB_GROUP /end GROUP
/begin GROUP S60_Determines_dead_compensation_is_enabled "SWC_MCF/RE_SWC_MCF_100us_sys/Subsystem/McPoc/McPoc/Calculat_ Dead_Compensation_Voltage/Determines dead compensation is enabled"
 /begin SUB_GROUP S64_Determines_whether_dead_compensation_is_enabled S64_Flag_of_dead_compensation_according_to_speed S64__Flag_of_dead_compensation_according_to_torque /end SUB_GROUP
/end GROUP
/begin GROUP S61_Harmonic_injection_of_11_and_13 "SWC_MCF/RE_SWC_MCF_100us_sys/Subsystem/McPoc/McPoc/Harmonic_Injection_Funcation/Harmonic_injection_of_11_and_13" /begin SUB_GROUP S86_Set_11_steps_current_amplitude_and_phase /end SUB_GROUP /end GROUP
/begin GROUP S62_Calculate_zero_sequence_alpha_and_beta_axis_voltage "SWC_MCF/RE_SWC_MCF_100us_sys/Subsystem/McPoc/McPoc/Zero Sequence Control Function/Calculate zero sequence alpha and beta axis voltage"
 /begin SUB_GROUP S92_Calculate_KpKi_for_uAlpha S92_Calculate_KpKi_for_uBeta S92_Incremental_PI S92_Incremental_PI1 S92_Signal_Filter_of_current_of_alpha_axis_1 S92_Signal_Filter_of_current_of_alpha_axis_2 /end SUB_GROUP
/end GROUP
/begin GROUP S107_Inductancetestfunction "SWC_MCF/RE_SWC_MCF_100us_sys/Subsystem/McSfc/McSfc/EOL Function/Inductancetestfunction"
 /begin SUB_GROUP S108_Close_Loop S108_Open_Loop S108_Output_UdDes_of_inductance S108_Switch_UdDes_of_inductance /end SUB_GROUP
/end GROUP
/begin GROUP S116_MCF_DPWM "SWC_MCF/RE_SWC_MCF_100us_sys/Subsystem/McVmc/McVmc/MCF_DPWM/MCF_DPWM" /begin SUB_GROUP S120_DPWM_tiModu /end SUB_GROUP /end GROUP
/begin GROUP S116_MCF_DeadTimeCalc "SWC_MCF/RE_SWC_MCF_100us_sys/Subsystem/McVmc/McVmc/MCF_DPWM/MCF_DeadTimeCalc" /begin REF_CHARACTERISTIC CAL_MCF_DeadTimeTableY_Ti_af32 /end REF_CHARACTERISTIC /end GROUP
/begin GROUP S116_MCF_DpwmEn "SWC_MCF/RE_SWC_MCF_100us_sys/Subsystem/McVmc/McVmc/MCF_DPWM/MCF_DpwmEn"
 /begin REF_CHARACTERISTIC CAL_MCF_flgDpwm_b CAL_MCF_nDpwmOffDelay_f32 CAL_MCF_nDpwmOff_f32 CAL_MCF_trqDpwmOff_f32 /end REF_CHARACTERISTIC
/end GROUP
/begin GROUP S116_MCF_NarrWaSupr "SWC_MCF/RE_SWC_MCF_100us_sys/Subsystem/McVmc/McVmc/MCF_DPWM/MCF_NarrWaSupr" /begin SUB_GROUP S124_OSC_SwtCalc /end SUB_GROUP /end GROUP
/begin GROUP S116_MCF_dycCalc "SWC_MCF/RE_SWC_MCF_100us_sys/Subsystem/McVmc/McVmc/MCF_DPWM/MCF_dycCalc" /begin REF_CHARACTERISTIC CAL_MCF_ratLo_f32 CAL_MCF_ratUp_f32 CAL_MCF_stChangePha_u8 /end REF_CHARACTERISTIC /end GROUP
/begin GROUP S117_MCF_OverModuEn "SWC_MCF/RE_SWC_MCF_100us_sys/Subsystem/McVmc/McVmc/MCF_OverModu/MCF_OverModuEn" /begin SUB_GROUP S168_Rem60 /end SUB_GROUP /begin REF_CHARACTERISTIC CAL_MCF_cofOverModu_f32 /end REF_CHARACTERISTIC /begin REF_MEASUREMENT VAR_MCF_uAOm_f32 VAR_MCF_uBOm_f32 VAR_MCF_usPeak_f32 /end REF_MEASUREMENT /end GROUP
/begin GROUP S118_Mcf_AgTranCalc "SWC_MCF/RE_SWC_MCF_100us_sys/Subsystem/McVmc/McVmc/MCF_RePark/Mcf_AgTranCalc" /begin SUB_GROUP S177_First_LowPass /end SUB_GROUP /begin REF_CHARACTERISTIC CAL_MCF_perCpnAg_f32 /end REF_CHARACTERISTIC /end GROUP
/begin GROUP S118_OSC_AlOfsClbCompen "SWC_MCF/RE_SWC_MCF_100us_sys/Subsystem/McVmc/McVmc/MCF_RePark/OSC_AlOfsClbCompen" /begin REF_CHARACTERISTIC CAL_MCF_flgOfsClbTest_b /end REF_CHARACTERISTIC /begin REF_MEASUREMENT VAR_MCF_uAOfsClb_f32 VAR_MCF_uBOfsClb_f32 /end REF_MEASUREMENT /end GROUP
/begin GROUP S119_FrqRamp "SWC_MCF/RE_SWC_MCF_100us_sys/Subsystem/McVmc/McVmc/MCF_frqpwmCalc/FrqRamp" /begin REF_CHARACTERISTIC CAL_MCF_FrqRmp_f32 /end REF_CHARACTERISTIC /end GROUP
/begin GROUP S119_FrqRamp1 "SWC_MCF/RE_SWC_MCF_100us_sys/Subsystem/McVmc/McVmc/MCF_frqpwmCalc/FrqRamp1" /begin REF_CHARACTERISTIC CAL_MCF_FrqRmp_f32 /end REF_CHARACTERISTIC /end GROUP
/begin GROUP S21_GetFwFlag "SWC_MCF/RE_SWC_MCF_100us_sys/Subsystem/McFwc/McFwc/Conditional Judgment /FwcUsRes/GetFwFlag" /begin REF_CHARACTERISTIC CAL_MCF_UsUseRateDesTableY_UsRes_af32 /end REF_CHARACTERISTIC /begin REF_MEASUREMENT VAR_MCF_UsUseRateDes_f32 VAR_MCF_flgFw_b /end REF_MEASUREMENT /end GROUP
/begin GROUP S21_GetUsResAct "SWC_MCF/RE_SWC_MCF_100us_sys/Subsystem/McFwc/McFwc/Conditional Judgment /FwcUsRes/GetUsResAct" /begin REF_MEASUREMENT VAR_MCF_UsUseRateReal_f32 /end REF_MEASUREMENT /end GROUP
/begin GROUP S21_UsdqDesCalc "SWC_MCF/RE_SWC_MCF_100us_sys/Subsystem/McFwc/McFwc/Conditional Judgment /FwcUsRes/UsdqDesCalc"
 /begin REF_CHARACTERISTIC CAL_MCF_UsdScalSet_f32 CAL_MCF_UsqScalSet_f32 CAL_MCF_flgUseUsdqSet_b /end REF_CHARACTERISTIC
 /begin REF_MEASUREMENT VAR_MCF_udDes_f32 VAR_MCF_uqDes_f32 /end REF_MEASUREMENT
/end GROUP
/begin GROUP S27_GetisdDesFw "SWC_MCF/RE_SWC_MCF_100us_sys/Subsystem/McFwc/McFwc/idqDes/FluxWeakeningLoop/GetisdDesFw" /begin SUB_GROUP S29_IncPI S29_Subsystem1 /end SUB_GROUP /end GROUP
/begin GROUP S27_isdDesCoordinate1 "SWC_MCF/RE_SWC_MCF_100us_sys/Subsystem/McFwc/McFwc/idqDes/FluxWeakeningLoop/isdDesCoordinate1" /begin SUB_GROUP S30_Discharge_id S30_id_Set S30_id_ThetaSet /end SUB_GROUP /begin REF_CHARACTERISTIC CAL_MCF_flgUseisTheta_b CAL_MCF_flgUseisdqSet_b /end REF_CHARACTERISTIC /begin REF_MEASUREMENT VAR_MCF_idDes_f32 /end REF_MEASUREMENT /end GROUP
/begin GROUP S27_isqDesCoordinate "SWC_MCF/RE_SWC_MCF_100us_sys/Subsystem/McFwc/McFwc/idqDes/FluxWeakeningLoop/isqDesCoordinate" /begin SUB_GROUP S31_Discharge_iq S31_iq_Cal S31_iq_Set S31_iq_ThetaSet /end SUB_GROUP /begin REF_CHARACTERISTIC CAL_MCF_flgUseisTheta_b CAL_MCF_flgUseisdqSet_b /end REF_CHARACTERISTIC /begin REF_MEASUREMENT VAR_MCF_iqDes_f32 /end REF_MEASUREMENT /end GROUP
/begin GROUP S55_Subsystem "SWC_MCF/RE_SWC_MCF_100us_sys/Subsystem/McFwc/McFwc/udqDes/CurrentLoop/Subsystem" /begin SUB_GROUP S56_First_LowPass /end SUB_GROUP
 /begin REF_CHARACTERISTIC CAL_MCF_flgUseUsOver_b CAL_MCF_udOverGain_f32 CAL_MCF_uqOverGain_f32 /end REF_CHARACTERISTIC
 /begin REF_MEASUREMENT VAR_MCF_EmfBack_f32 VAR_MCF_udRv_f32 VAR_MCF_uqRv_f32 /end REF_MEASUREMENT
/end GROUP
/begin GROUP S55_Subsystem1 "SWC_MCF/RE_SWC_MCF_100us_sys/Subsystem/McFwc/McFwc/udqDes/CurrentLoop/Subsystem1"
 /begin REF_CHARACTERISTIC CAL_MCF_udDecoupki_f32 CAL_MCF_udki_f32 CAL_MCF_udkp_f32 CAL_MCF_uqDecoupki_f32 CAL_MCF_uqki_f32 CAL_MCF_uqkp_f32 /end REF_CHARACTERISTIC
/end GROUP
/begin GROUP S63_Calculate_coefficient_alpha_and_beta_axis "SWC_MCF/RE_SWC_MCF_100us_sys/Subsystem/McPoc/McPoc/Calculat_ Dead_Compensation_Voltage/Calculate dead compensation voltage/Calculate coefficient alpha and beta axis"
 /begin REF_CHARACTERISTIC CAL_MCF_AgDiffCurrSec_f32 CAL_MCF_AgRangeDeadCpnY_Ag_af32 CAL_MCF_DeadTimeCpn_f32 /end REF_CHARACTERISTIC
/end GROUP
/begin GROUP S64__Flag_of_dead_compensation_according_to_torque "SWC_MCF/RE_SWC_MCF_100us_sys/Subsystem/McPoc/McPoc/Calculat_ Dead_Compensation_Voltage/Determines dead compensation is enabled/ Flag of dead compensation according to torque" /begin REF_CHARACTERISTIC CAL_MCF_TrqOffDeadCpn_f32 /end REF_CHARACTERISTIC /end GROUP
/begin GROUP S64_Determines_whether_dead_compensation_is_enabled "SWC_MCF/RE_SWC_MCF_100us_sys/Subsystem/McPoc/McPoc/Calculat_ Dead_Compensation_Voltage/Determines dead compensation is enabled/Determines whether dead compensation is enabled" /begin REF_CHARACTERISTIC CAL_MCF_FlgUseDeadCpn_b /end REF_CHARACTERISTIC /begin REF_MEASUREMENT VAR_MCF_FlgDeadCpn_b /end REF_MEASUREMENT /end GROUP
/begin GROUP S64_Flag_of_dead_compensation_according_to_speed "SWC_MCF/RE_SWC_MCF_100us_sys/Subsystem/McPoc/McPoc/Calculat_ Dead_Compensation_Voltage/Determines dead compensation is enabled/Flag of dead compensation according to speed" /begin REF_CHARACTERISTIC CAL_MCF_SpdOffDeadCpn_f32 CAL_MCF_SpdOnDeadCpn_f32 /end REF_CHARACTERISTIC /end GROUP
/begin GROUP S86_Set_11_steps_current_amplitude_and_phase "SWC_MCF/RE_SWC_MCF_100us_sys/Subsystem/McPoc/McPoc/Harmonic_Injection_Funcation/Harmonic_injection_of_11_and_13/Set_11_steps_current_amplitude_and_phase"
 /begin REF_CHARACTERISTIC CAL_MCF_HarmIn11ZRY_Is_af32 CAL_MCF_HarmIn11ZRY_Thetam_af32 CAL_MCF_IsSet11ZR_f32 CAL_MCF_IsThetaSet11ZR_f32 CAL_MCF_flgHarmInIsThetaTab11ZR_b /end REF_CHARACTERISTIC
 /begin REF_MEASUREMENT VAR_MCF_IsSet11ZR_f32 VAR_MCF_IsThetaSet11ZR_f32 /end REF_MEASUREMENT
/end GROUP
/begin GROUP S92_Calculate_KpKi_for_uAlpha "SWC_MCF/RE_SWC_MCF_100us_sys/Subsystem/McPoc/McPoc/Zero Sequence Control Function/Calculate zero sequence alpha and beta axis voltage/Calculate KpKi for uAlpha"
 /begin REF_CHARACTERISTIC CAL_MCF_CoefPIAlphaZeroCtlY_Ki_af32 CAL_MCF_CoefPIAlphaZeroFtlY_Kp_af32 CAL_MCF_KiAlphaZeroCtl_f32 CAL_MCF_KpAlphaZeroCtl_f32 CAL_MCF_flgTabZeroCtl_b /end REF_CHARACTERISTIC
/end GROUP
/begin GROUP S92_Calculate_KpKi_for_uBeta "SWC_MCF/RE_SWC_MCF_100us_sys/Subsystem/McPoc/McPoc/Zero Sequence Control Function/Calculate zero sequence alpha and beta axis voltage/Calculate KpKi for uBeta"
 /begin REF_CHARACTERISTIC CAL_MCF_CoefPIBetaZeroCtlY_Ki_af32 CAL_MCF_CoefPIBetaZeroCtlY_Kp_af32 CAL_MCF_KiBetaZeroCtl_f32 CAL_MCF_KpBetaZeroCtl_f32 CAL_MCF_flgTabZeroCtl_b /end REF_CHARACTERISTIC
/end GROUP
/begin GROUP S92_Incremental_PI "SWC_MCF/RE_SWC_MCF_100us_sys/Subsystem/McPoc/McPoc/Zero Sequence Control Function/Calculate zero sequence alpha and beta axis voltage/Incremental PI"
 /begin REF_CHARACTERISTIC CAL_MCF_AplhaRefZeroCtl_f32 CAL_MCF_DownLimPIZeroCtl_f32 CAL_MCF_UpLimPIZeroCtl_f32 /end REF_CHARACTERISTIC
/end GROUP
/begin GROUP S92_Incremental_PI1 "SWC_MCF/RE_SWC_MCF_100us_sys/Subsystem/McPoc/McPoc/Zero Sequence Control Function/Calculate zero sequence alpha and beta axis voltage/Incremental PI1"
 /begin REF_CHARACTERISTIC CAL_MCF_BetaRefZeroCtl_f32 CAL_MCF_DownLimPIZeroCtl_f32 CAL_MCF_UpLimPIZeroCtl_f32 /end REF_CHARACTERISTIC
/end GROUP
/begin GROUP S92_Signal_Filter_of_current_of_alpha_axis_1 "SWC_MCF/RE_SWC_MCF_100us_sys/Subsystem/McPoc/McPoc/Zero Sequence Control Function/Calculate zero sequence alpha and beta axis voltage/Signal Filter of current of alpha axis 1" /begin SUB_GROUP S97_First_low_pass S97_Second_band_stop_filter /end SUB_GROUP /end GROUP
/begin GROUP S92_Signal_Filter_of_current_of_alpha_axis_2 "SWC_MCF/RE_SWC_MCF_100us_sys/Subsystem/McPoc/McPoc/Zero Sequence Control Function/Calculate zero sequence alpha and beta axis voltage/Signal Filter of current of alpha axis 2" /begin SUB_GROUP S98_First_low_pass S98_Second_band_stop_filter /end SUB_GROUP /end GROUP
/begin GROUP S108_Close_Loop "SWC_MCF/RE_SWC_MCF_100us_sys/Subsystem/McSfc/McSfc/EOL Function/Inductancetestfunction/Close Loop"
 /begin REF_CHARACTERISTIC CAL_MCF_FlgUseSatuEOL_b CAL_MCF_IsrmsDesEOL_f32 CAL_MCF_KiUdEOL_f32 CAL_MCF_KpUdEOL_f32 CAL_MCF_uDDownLimEOL_f32 CAL_MCF_uDUpLimEOL_f32 /end REF_CHARACTERISTIC
/end GROUP
/begin GROUP S108_Open_Loop "SWC_MCF/RE_SWC_MCF_100us_sys/Subsystem/McSfc/McSfc/EOL Function/Inductancetestfunction/Open Loop" /begin REF_CHARACTERISTIC CAL_MCF_IsrmsDesEOL_f32 CAL_MCF_uDDesEOLY_af32 /end REF_CHARACTERISTIC /end GROUP
/begin GROUP S108_Output_UdDes_of_inductance "SWC_MCF/RE_SWC_MCF_100us_sys/Subsystem/McSfc/McSfc/EOL Function/Inductancetestfunction/Output UdDes of inductance"
 /begin REF_CHARACTERISTIC CAL_MCF_CoefuDCLimtEOL_f32 CAL_MCF_TrqInvMax_f32 CAL_MCF_uQDesEOL_f32 /end REF_CHARACTERISTIC
/end GROUP
/begin GROUP S108_Switch_UdDes_of_inductance "SWC_MCF/RE_SWC_MCF_100us_sys/Subsystem/McSfc/McSfc/EOL Function/Inductancetestfunction/Switch UdDes of inductance" /begin REF_CHARACTERISTIC CAL_MCF_FlgUseClose_b CAL_MCF_FlgUseOpen_b /end REF_CHARACTERISTIC /end GROUP
/begin GROUP S120_DPWM_tiModu "SWC_MCF/RE_SWC_MCF_100us_sys/Subsystem/McVmc/McVmc/MCF_DPWM/MCF_DPWM/DPWM_tiModu" /begin REF_CHARACTERISTIC CAL_MCF_stDpwm_u8 /end REF_CHARACTERISTIC /end GROUP
/begin GROUP S124_OSC_SwtCalc "SWC_MCF/RE_SWC_MCF_100us_sys/Subsystem/McVmc/McVmc/MCF_DPWM/MCF_NarrWaSupr/OSC_SwtCalc" /begin REF_CHARACTERISTIC CAL_MCF_flgNWS_b CAL_MCF_ratNarrWave_f32 /end REF_CHARACTERISTIC /end GROUP
/begin GROUP S168_Rem60 "SWC_MCF/RE_SWC_MCF_100us_sys/Subsystem/McVmc/McVmc/MCF_OverModu/MCF_OverModuEn/Rem60" /begin REF_MEASUREMENT VAR_MCF_AgRem_f32 /end REF_MEASUREMENT /end GROUP
/begin GROUP S177_First_LowPass "SWC_MCF/RE_SWC_MCF_100us_sys/Subsystem/McVmc/McVmc/MCF_RePark/Mcf_AgTranCalc/First_LowPass" /begin REF_CHARACTERISTIC CAL_MCF_cofFltN_f32 /end REF_CHARACTERISTIC /end GROUP
/begin GROUP S29_IncPI "SWC_MCF/RE_SWC_MCF_100us_sys/Subsystem/McFwc/McFwc/idqDes/FluxWeakeningLoop/GetisdDesFw/IncPI" /begin REF_CHARACTERISTIC CAL_MCF_flgUseFF_b CAL_MCF_isdfwKi_f32 CAL_MCF_isdfwKp_f32 /end REF_CHARACTERISTIC /begin REF_MEASUREMENT VAR_MCF_isdFW_f32 VAR_MCF_periodCalc_f32 /end REF_MEASUREMENT /end GROUP
/begin GROUP S29_Subsystem1 "SWC_MCF/RE_SWC_MCF_100us_sys/Subsystem/McFwc/McFwc/idqDes/FluxWeakeningLoop/GetisdDesFw/Subsystem1" /begin SUB_GROUP S34_Subsystem S34_Subsystem4 S34_Subsystem5 /end SUB_GROUP /begin REF_MEASUREMENT VAR_MCF_idMotHeat_f32 /end REF_MEASUREMENT /end GROUP
/begin GROUP S30_Discharge_id "SWC_MCF/RE_SWC_MCF_100us_sys/Subsystem/McFwc/McFwc/idqDes/FluxWeakeningLoop/isdDesCoordinate1/Discharge_id" /begin REF_CHARACTERISTIC CAL_MCF_DisChaisdDes_f32 /end REF_CHARACTERISTIC /end GROUP
/begin GROUP S30_id_Set "SWC_MCF/RE_SWC_MCF_100us_sys/Subsystem/McFwc/McFwc/idqDes/FluxWeakeningLoop/isdDesCoordinate1/id_Set" /begin REF_CHARACTERISTIC CAL_MCF_isdSet_f32 /end REF_CHARACTERISTIC /end GROUP
/begin GROUP S30_id_ThetaSet "SWC_MCF/RE_SWC_MCF_100us_sys/Subsystem/McFwc/McFwc/idqDes/FluxWeakeningLoop/isdDesCoordinate1/id_ThetaSet" /begin REF_CHARACTERISTIC CAL_MCF_isSet_f32 CAL_MCF_isThetaSet_f32 /end REF_CHARACTERISTIC /end GROUP
/begin GROUP S31_Discharge_iq "SWC_MCF/RE_SWC_MCF_100us_sys/Subsystem/McFwc/McFwc/idqDes/FluxWeakeningLoop/isqDesCoordinate/Discharge_iq" /begin REF_CHARACTERISTIC CAL_MCF_DisChaisqDes_f32 /end REF_CHARACTERISTIC /end GROUP
/begin GROUP S31_iq_Cal "SWC_MCF/RE_SWC_MCF_100us_sys/Subsystem/McFwc/McFwc/idqDes/FluxWeakeningLoop/isqDesCoordinate/iq_Cal" /begin REF_CHARACTERISTIC CAL_MCF_isMax_f32 /end REF_CHARACTERISTIC /end GROUP
/begin GROUP S31_iq_Set "SWC_MCF/RE_SWC_MCF_100us_sys/Subsystem/McFwc/McFwc/idqDes/FluxWeakeningLoop/isqDesCoordinate/iq_Set" /begin REF_CHARACTERISTIC CAL_MCF_isqSet_f32 /end REF_CHARACTERISTIC /end GROUP
/begin GROUP S31_iq_ThetaSet "SWC_MCF/RE_SWC_MCF_100us_sys/Subsystem/McFwc/McFwc/idqDes/FluxWeakeningLoop/isqDesCoordinate/iq_ThetaSet" /begin REF_CHARACTERISTIC CAL_MCF_isSet_f32 CAL_MCF_isThetaSet_f32 /end REF_CHARACTERISTIC /end GROUP
/begin GROUP S56_First_LowPass "SWC_MCF/RE_SWC_MCF_100us_sys/Subsystem/McFwc/McFwc/udqDes/CurrentLoop/Subsystem/First_LowPass" /begin REF_CHARACTERISTIC CAL_MCF_cofFltWe_f32 /end REF_CHARACTERISTIC /end GROUP
/begin GROUP S97_First_low_pass "SWC_MCF/RE_SWC_MCF_100us_sys/Subsystem/McPoc/McPoc/Zero Sequence Control Function/Calculate zero sequence alpha and beta axis voltage/Signal Filter of current of alpha axis 1/First low pass" /begin REF_CHARACTERISTIC CAL_MCF_OmbwFirstFltY_Ombw_af32 CAL_MCF_SampleTime_f32 /end REF_CHARACTERISTIC /begin REF_MEASUREMENT VAR_MCF_iBetaActFlt_f32 /end REF_MEASUREMENT /end GROUP
/begin GROUP S97_Second_band_stop_filter "SWC_MCF/RE_SWC_MCF_100us_sys/Subsystem/McPoc/McPoc/Zero Sequence Control Function/Calculate zero sequence alpha and beta axis voltage/Signal Filter of current of alpha axis 1/Second band stop filter"
 /begin REF_CHARACTERISTIC CAL_MCF_CoefFltZero_A_f32 CAL_MCF_CoefFltZero_B_f32 CAL_MCF_CoefFltZero_C_f32 CAL_MCF_SampleTime_f32 /end REF_CHARACTERISTIC
/end GROUP
/begin GROUP S98_First_low_pass "SWC_MCF/RE_SWC_MCF_100us_sys/Subsystem/McPoc/McPoc/Zero Sequence Control Function/Calculate zero sequence alpha and beta axis voltage/Signal Filter of current of alpha axis 2/First low pass" /begin REF_CHARACTERISTIC CAL_MCF_OmbwFirstFltY_Ombw_af32 CAL_MCF_SampleTime_f32 /end REF_CHARACTERISTIC /begin REF_MEASUREMENT VAR_MCF_iAlphaActFlt_f32 /end REF_MEASUREMENT /end GROUP
/begin GROUP S98_Second_band_stop_filter "SWC_MCF/RE_SWC_MCF_100us_sys/Subsystem/McPoc/McPoc/Zero Sequence Control Function/Calculate zero sequence alpha and beta axis voltage/Signal Filter of current of alpha axis 2/Second band stop filter"
 /begin REF_CHARACTERISTIC CAL_MCF_CoefFltZero_A_f32 CAL_MCF_CoefFltZero_B_f32 CAL_MCF_CoefFltZero_C_f32 CAL_MCF_SampleTime_f32 /end REF_CHARACTERISTIC
/end GROUP
/begin GROUP S34_Subsystem "SWC_MCF/RE_SWC_MCF_100us_sys/Subsystem/McFwc/McFwc/idqDes/FluxWeakeningLoop/GetisdDesFw/Subsystem1/Subsystem" /begin SUB_GROUP S38_First_LowPass /end SUB_GROUP
 /begin REF_CHARACTERISTIC CAL_MCF_ActiveHeatInit_u8 CAL_MCF_ActiveHeatNormal_u8 CAL_MCF_DeltaPower_f32 CAL_MCF_Non_ActiveHeat_u8 CAL_MCF_Part_ActiveHeat_u8 /end REF_CHARACTERISTIC
 /begin REF_MEASUREMENT VAR_MCF_TMAhtChsts_f32 /end REF_MEASUREMENT
/end GROUP
/begin GROUP S34_Subsystem4 "SWC_MCF/RE_SWC_MCF_100us_sys/Subsystem/McFwc/McFwc/idqDes/FluxWeakeningLoop/GetisdDesFw/Subsystem1/Subsystem4" /begin SUB_GROUP S39_Subsystem1 S39_Subsystem2 /end SUB_GROUP /end GROUP
/begin GROUP S34_Subsystem5 "SWC_MCF/RE_SWC_MCF_100us_sys/Subsystem/McFwc/McFwc/idqDes/FluxWeakeningLoop/GetisdDesFw/Subsystem1/Subsystem5" /begin SUB_GROUP S40_Subsystem S40_Subsystem4 /end SUB_GROUP /end GROUP
/begin GROUP S38_First_LowPass "SWC_MCF/RE_SWC_MCF_100us_sys/Subsystem/McFwc/McFwc/idqDes/FluxWeakeningLoop/GetisdDesFw/Subsystem1/Subsystem/First_LowPass" /begin REF_CHARACTERISTIC CAL_MCF_cofFltPowerHeat_f32 /end REF_CHARACTERISTIC /end GROUP
/begin GROUP S39_Subsystem1 "SWC_MCF/RE_SWC_MCF_100us_sys/Subsystem/McFwc/McFwc/idqDes/FluxWeakeningLoop/GetisdDesFw/Subsystem1/Subsystem4/Subsystem1"
 /begin REF_CHARACTERISTIC CAL_MCF_UpPowerHeat_f32 CAL_PowerMotHeat_f32 CAL_cofPowerLimitMotHeat_af32 /end REF_CHARACTERISTIC
 /begin REF_MEASUREMENT VAR_MCF_PCUHeaterPower_f32 VAR_MCF_PowerDcLnk_f32 VAR_MCF_PowerMech_f32 VAR_MCF_PowerMotHeat_f32 /end REF_MEASUREMENT
/end GROUP
/begin GROUP S39_Subsystem2 "SWC_MCF/RE_SWC_MCF_100us_sys/Subsystem/McFwc/McFwc/idqDes/FluxWeakeningLoop/GetisdDesFw/Subsystem1/Subsystem4/Subsystem2"
 /begin REF_CHARACTERISTIC CAL_MCF_DownLimitIMotHeat_f32 CAL_MCF_DownLimitPIMotHeat_f32 CAL_MCF_KiMotHeat_f32 CAL_MCF_KpMotHeat_f32 CAL_MCF_UpLimitIMotHeat_f32 CAL_MCF_UpLimitPIMotHeat_f32 /end REF_CHARACTERISTIC
/end GROUP
/begin GROUP S40_Subsystem "SWC_MCF/RE_SWC_MCF_100us_sys/Subsystem/McFwc/McFwc/idqDes/FluxWeakeningLoop/GetisdDesFw/Subsystem1/Subsystem5/Subsystem" /begin REF_CHARACTERISTIC CAL_MCF_flgMotHeat_b /end REF_CHARACTERISTIC /begin REF_MEASUREMENT VAR_MCF_flgMotHeat_b /end REF_MEASUREMENT /end GROUP
/begin GROUP S40_Subsystem4 "SWC_MCF/RE_SWC_MCF_100us_sys/Subsystem/McFwc/McFwc/idqDes/FluxWeakeningLoop/GetisdDesFw/Subsystem1/Subsystem5/Subsystem4" /begin REF_CHARACTERISTIC CAL_MCF_SpdOffActiveHeat_f32 CAL_MCF_TrqOffActiveHeat_af32 /end REF_CHARACTERISTIC /end GROUP
/end MODULE
/end PROJECT
/* (add any file trailer comments here) */
/* EOF SWC_MCF.a2l */
