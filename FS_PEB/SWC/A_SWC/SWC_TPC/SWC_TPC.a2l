/******************************************************************************
* ASAP2 file: SWC_TPC.a2l
* Code generation for model "SWC_TPC".
* Model version : 1.5
* Simulink Coder version : 9.3 (R2020a) 18-Nov-2019
* C source code generated on : Fri Jan 15 14:28:54 2021
* Target selection: autosar.tlc
* Embedded hardware selection: Intel->x86-64 (Windows64)
* Code generation objectives: Unspecified
* Validation result: Not run
* (add additional file header information here)
******************************************************************************/ ASAP2_VERSION 1 31
/* Version 1.31 */
/begin PROJECT ProjectName "Project Comment Goes Here"
/begin HEADER "Header Comments go here" /end HEADER
/begin MODULE ModuleName "Module Comment Goes Here"
/begin MOD_PAR "MOD PAR Comment Goes Here" /end MOD_PAR
/begin MOD_COMMON "Mod Common Comment Here" BYTE_ORDER MSB_LAST /end MOD_COMMON
/begin RECORD_LAYOUT Scalar_BOOLEAN FNC_VALUES 1 UBYTE COLUMN_DIR DIRECT /end RECORD_LAYOUT
/begin RECORD_LAYOUT Scalar_UBYTE FNC_VALUES 1 UBYTE COLUMN_DIR DIRECT /end RECORD_LAYOUT
/begin RECORD_LAYOUT Scalar_BYTE FNC_VALUES 1 SBYTE COLUMN_DIR DIRECT /end RECORD_LAYOUT
/begin RECORD_LAYOUT Scalar_UWORD FNC_VALUES 1 UWORD COLUMN_DIR DIRECT /end RECORD_LAYOUT
/begin RECORD_LAYOUT Scalar_SWORD FNC_VALUES 1 SWORD COLUMN_DIR DIRECT /end RECORD_LAYOUT
/begin RECORD_LAYOUT Scalar_ULONG FNC_VALUES 1 ULONG COLUMN_DIR DIRECT /end RECORD_LAYOUT
/begin RECORD_LAYOUT Scalar_LONG FNC_VALUES 1 SLONG COLUMN_DIR DIRECT /end RECORD_LAYOUT
/begin RECORD_LAYOUT Scalar_FLOAT32_IEEE FNC_VALUES 1 FLOAT32_IEEE COLUMN_DIR DIRECT /end RECORD_LAYOUT
/begin RECORD_LAYOUT Scalar_FLOAT64_IEEE FNC_VALUES 1 FLOAT64_IEEE COLUMN_DIR DIRECT /end RECORD_LAYOUT
/begin RECORD_LAYOUT Lookup1D_BOOLEAN FNC_VALUES 1 UBYTE COLUMN_DIR DIRECT /end RECORD_LAYOUT
/begin RECORD_LAYOUT Lookup1D_X_BOOLEAN AXIS_PTS_X 1 UBYTE INDEX_INCR DIRECT /end RECORD_LAYOUT
/begin RECORD_LAYOUT Lookup1D_BYTE FNC_VALUES 1 SBYTE COLUMN_DIR DIRECT /end RECORD_LAYOUT
/begin RECORD_LAYOUT Lookup1D_X_BYTE AXIS_PTS_X 1 SBYTE INDEX_INCR DIRECT /end RECORD_LAYOUT
/begin RECORD_LAYOUT Lookup1D_UBYTE FNC_VALUES 1 UBYTE COLUMN_DIR DIRECT /end RECORD_LAYOUT
/begin RECORD_LAYOUT Lookup1D_X_UBYTE AXIS_PTS_X 1 UBYTE INDEX_INCR DIRECT /end RECORD_LAYOUT
/begin RECORD_LAYOUT Lookup1D_UWORD FNC_VALUES 1 UWORD COLUMN_DIR DIRECT /end RECORD_LAYOUT
/begin RECORD_LAYOUT Lookup1D_X_UWORD AXIS_PTS_X 1 UWORD INDEX_INCR DIRECT /end RECORD_LAYOUT
/begin RECORD_LAYOUT Lookup1D_WORD FNC_VALUES 1 SWORD COLUMN_DIR DIRECT /end RECORD_LAYOUT
/begin RECORD_LAYOUT Lookup1D_X_WORD AXIS_PTS_X 1 SWORD INDEX_INCR DIRECT /end RECORD_LAYOUT
/begin RECORD_LAYOUT Lookup1D_ULONG FNC_VALUES 1 ULONG COLUMN_DIR DIRECT /end RECORD_LAYOUT
/begin RECORD_LAYOUT Lookup1D_X_ULONG AXIS_PTS_X 1 ULONG INDEX_INCR DIRECT /end RECORD_LAYOUT
/begin RECORD_LAYOUT Lookup1D_SLONG FNC_VALUES 1 SLONG COLUMN_DIR DIRECT /end RECORD_LAYOUT
/begin RECORD_LAYOUT Lookup1D_X_LONG AXIS_PTS_X 1 SLONG INDEX_INCR DIRECT /end RECORD_LAYOUT
/begin RECORD_LAYOUT Lookup1D_FLOAT32_IEEE FNC_VALUES 1 FLOAT32_IEEE COLUMN_DIR DIRECT /end RECORD_LAYOUT
/begin RECORD_LAYOUT Lookup1D_X_FLOAT32_IEEE AXIS_PTS_X 1 FLOAT32_IEEE INDEX_INCR DIRECT /end RECORD_LAYOUT
/begin RECORD_LAYOUT Lookup1D_FLOAT64_IEEE FNC_VALUES 1 FLOAT64_IEEE COLUMN_DIR DIRECT /end RECORD_LAYOUT
/begin RECORD_LAYOUT Lookup1D_X_FLOAT64_IEEE AXIS_PTS_X 1 FLOAT64_IEEE INDEX_INCR DIRECT /end RECORD_LAYOUT
/begin RECORD_LAYOUT Lookup2D_BOOLEAN FNC_VALUES 1 UBYTE COLUMN_DIR DIRECT /end RECORD_LAYOUT
/begin RECORD_LAYOUT Lookup2D_X_BOOLEAN AXIS_PTS_X 1 UBYTE INDEX_INCR DIRECT /end RECORD_LAYOUT
/begin RECORD_LAYOUT Lookup2D_UBYTE FNC_VALUES 1 UBYTE COLUMN_DIR DIRECT /end RECORD_LAYOUT
/begin RECORD_LAYOUT Lookup2D_X_UBYTE AXIS_PTS_X 1 UBYTE INDEX_INCR DIRECT /end RECORD_LAYOUT
/begin RECORD_LAYOUT Lookup2D_BYTE FNC_VALUES 1 SBYTE COLUMN_DIR DIRECT /end RECORD_LAYOUT
/begin RECORD_LAYOUT Lookup2D_X_BYTE AXIS_PTS_X 1 SBYTE INDEX_INCR DIRECT /end RECORD_LAYOUT
/begin RECORD_LAYOUT Lookup2D_UWORD FNC_VALUES 1 UWORD COLUMN_DIR DIRECT /end RECORD_LAYOUT
/begin RECORD_LAYOUT Lookup2D_X_UWORD AXIS_PTS_X 1 UWORD INDEX_INCR DIRECT /end RECORD_LAYOUT
/begin RECORD_LAYOUT Lookup2D_WORD FNC_VALUES 1 SWORD COLUMN_DIR DIRECT /end RECORD_LAYOUT
/begin RECORD_LAYOUT Lookup2D_X_WORD AXIS_PTS_X 1 SWORD INDEX_INCR DIRECT /end RECORD_LAYOUT
/begin RECORD_LAYOUT Lookup2D_ULONG FNC_VALUES 1 ULONG COLUMN_DIR DIRECT /end RECORD_LAYOUT
/begin RECORD_LAYOUT Lookup2D_X_ULONG AXIS_PTS_X 1 ULONG INDEX_INCR DIRECT /end RECORD_LAYOUT
/begin RECORD_LAYOUT Lookup2D_LONG FNC_VALUES 1 SLONG COLUMN_DIR DIRECT /end RECORD_LAYOUT
/begin RECORD_LAYOUT Lookup2D_X_LONG AXIS_PTS_X 1 SLONG INDEX_INCR DIRECT /end RECORD_LAYOUT
/begin RECORD_LAYOUT Lookup2D_FLOAT32_IEEE FNC_VALUES 1 FLOAT32_IEEE COLUMN_DIR DIRECT /end RECORD_LAYOUT
/begin RECORD_LAYOUT Lookup2D_X_FLOAT32_IEEE AXIS_PTS_X 1 FLOAT32_IEEE INDEX_INCR DIRECT /end RECORD_LAYOUT
/begin RECORD_LAYOUT Lookup2D_FLOAT64_IEEE FNC_VALUES 1 FLOAT64_IEEE COLUMN_DIR DIRECT /end RECORD_LAYOUT
/begin RECORD_LAYOUT Lookup2D_X_FLOAT64_IEEE AXIS_PTS_X 1 FLOAT64_IEEE INDEX_INCR DIRECT /end RECORD_LAYOUT
/begin CHARACTERISTIC CAL_TpcCod_CoolFlow2LTableZ_Trq_af32 "" MAP 0x0000 /* @ECU_Address@CAL_TpcCod_CoolFlow2LTableZ_Trq_af32@ */ Lookup2D_FLOAT32_IEEE 0 SWC_TPC_CM_single -3.4E+38 3.4E+38
 /begin AXIS_DESCR COM_AXIS NO_INPUT_QUANTITY SWC_TPC_CM_single 5 -3.4E+38 3.4E+38 AXIS_PTS_REF CAL_TpcCod_CoolFlow2LTableX_Udc_af32 /end AXIS_DESCR
 /begin AXIS_DESCR COM_AXIS NO_INPUT_QUANTITY SWC_TPC_CM_single 8 -3.4E+38 3.4E+38 AXIS_PTS_REF CAL_TpcCod_CoolFlow2LTableY_Spd_af32 /end AXIS_DESCR
/end CHARACTERISTIC
/begin AXIS_PTS CAL_TpcCod_CoolFlow2LTableY_Spd_af32 "" 0x0000 /* @ECU_Address@CAL_TpcCod_CoolFlow2LTableY_Spd_af32@ */ NO_INPUT_QUANTITY Lookup2D_X_FLOAT32_IEEE 0 SWC_TPC_CM_single 8 -3.4E+38 3.4E+38 /end AXIS_PTS
/begin AXIS_PTS CAL_TpcCod_CoolFlow2LTableX_Udc_af32 "" 0x0000 /* @ECU_Address@CAL_TpcCod_CoolFlow2LTableX_Udc_af32@ */ NO_INPUT_QUANTITY Lookup2D_X_FLOAT32_IEEE 0 SWC_TPC_CM_single 5 -3.4E+38 3.4E+38 /end AXIS_PTS
/begin CHARACTERISTIC CAL_TpcCod_CoolFlow4LTableZ_Trq_af32 "" MAP 0x0000 /* @ECU_Address@CAL_TpcCod_CoolFlow4LTableZ_Trq_af32@ */ Lookup2D_FLOAT32_IEEE 0 SWC_TPC_CM_single -3.4E+38 3.4E+38
 /begin AXIS_DESCR COM_AXIS NO_INPUT_QUANTITY SWC_TPC_CM_single 5 -3.4E+38 3.4E+38 AXIS_PTS_REF CAL_TpcCod_CoolFlow4LTableX_Udc_af32 /end AXIS_DESCR
 /begin AXIS_DESCR COM_AXIS NO_INPUT_QUANTITY SWC_TPC_CM_single 8 -3.4E+38 3.4E+38 AXIS_PTS_REF CAL_TpcCod_CoolFlow4LTableY_Spd_af32 /end AXIS_DESCR
/end CHARACTERISTIC
/begin AXIS_PTS CAL_TpcCod_CoolFlow4LTableY_Spd_af32 "" 0x0000 /* @ECU_Address@CAL_TpcCod_CoolFlow4LTableY_Spd_af32@ */ NO_INPUT_QUANTITY Lookup2D_X_FLOAT32_IEEE 0 SWC_TPC_CM_single 8 -3.4E+38 3.4E+38 /end AXIS_PTS
/begin AXIS_PTS CAL_TpcCod_CoolFlow4LTableX_Udc_af32 "" 0x0000 /* @ECU_Address@CAL_TpcCod_CoolFlow4LTableX_Udc_af32@ */ NO_INPUT_QUANTITY Lookup2D_X_FLOAT32_IEEE 0 SWC_TPC_CM_single 5 -3.4E+38 3.4E+38 /end AXIS_PTS
/begin CHARACTERISTIC CAL_TpcCod_CoolFlow6LTableZ_Trq_af32 "" MAP 0x0000 /* @ECU_Address@CAL_TpcCod_CoolFlow6LTableZ_Trq_af32@ */ Lookup2D_FLOAT32_IEEE 0 SWC_TPC_CM_single -3.4E+38 3.4E+38
 /begin AXIS_DESCR COM_AXIS NO_INPUT_QUANTITY SWC_TPC_CM_single 5 -3.4E+38 3.4E+38 AXIS_PTS_REF CAL_TpcCod_CoolFlow6LTableX_Udc_af32 /end AXIS_DESCR
 /begin AXIS_DESCR COM_AXIS NO_INPUT_QUANTITY SWC_TPC_CM_single 8 -3.4E+38 3.4E+38 AXIS_PTS_REF CAL_TpcCod_CoolFlow6LTableY_Spd_af32 /end AXIS_DESCR
/end CHARACTERISTIC
/begin AXIS_PTS CAL_TpcCod_CoolFlow6LTableY_Spd_af32 "" 0x0000 /* @ECU_Address@CAL_TpcCod_CoolFlow6LTableY_Spd_af32@ */ NO_INPUT_QUANTITY Lookup2D_X_FLOAT32_IEEE 0 SWC_TPC_CM_single 8 -3.4E+38 3.4E+38 /end AXIS_PTS
/begin AXIS_PTS CAL_TpcCod_CoolFlow6LTableX_Udc_af32 "" 0x0000 /* @ECU_Address@CAL_TpcCod_CoolFlow6LTableX_Udc_af32@ */ NO_INPUT_QUANTITY Lookup2D_X_FLOAT32_IEEE 0 SWC_TPC_CM_single 5 -3.4E+38 3.4E+38 /end AXIS_PTS
/begin CHARACTERISTIC CAL_TpcMot_ExCElecTableZ_Trq_af32 "外特性查表扭矩输出-电动模式" MAP 0x0000 /* @ECU_Address@CAL_TpcMot_ExCElecTableZ_Trq_af32@ */ Lookup2D_FLOAT32_IEEE 0 SWC_TPC_CM_single -3.4E+38 3.4E+38
 /begin AXIS_DESCR COM_AXIS NO_INPUT_QUANTITY SWC_TPC_CM_single 10 -3.4E+38 3.4E+38 AXIS_PTS_REF CAL_TpcMot_ExCElecTableX_Udc_af32 /end AXIS_DESCR
 /begin AXIS_DESCR COM_AXIS NO_INPUT_QUANTITY SWC_TPC_CM_single 17 -3.4E+38 3.4E+38 AXIS_PTS_REF CAL_TpcMot_ExCElecTableY_Spd_af32 /end AXIS_DESCR
/end CHARACTERISTIC
/begin AXIS_PTS CAL_TpcMot_ExCElecTableY_Spd_af32 "外特性查表电机转速输入-电动模式" 0x0000 /* @ECU_Address@CAL_TpcMot_ExCElecTableY_Spd_af32@ */ NO_INPUT_QUANTITY Lookup2D_X_FLOAT32_IEEE 0 SWC_TPC_CM_single 17 -3.4E+38 3.4E+38 /end AXIS_PTS
/begin AXIS_PTS CAL_TpcMot_ExCElecTableX_Udc_af32 "外特性查表母线电压输入-电动模式" 0x0000 /* @ECU_Address@CAL_TpcMot_ExCElecTableX_Udc_af32@ */ NO_INPUT_QUANTITY Lookup2D_X_FLOAT32_IEEE 0 SWC_TPC_CM_single 10 -3.4E+38 3.4E+38 /end AXIS_PTS
/begin CHARACTERISTIC CAL_TpcMot_ExCGenTableZ_Trq_af32 "外特性查表扭矩输出-发电模式" MAP 0x0000 /* @ECU_Address@CAL_TpcMot_ExCGenTableZ_Trq_af32@ */ Lookup2D_FLOAT32_IEEE 0 SWC_TPC_CM_single -3.4E+38 3.4E+38
 /begin AXIS_DESCR COM_AXIS NO_INPUT_QUANTITY SWC_TPC_CM_single 10 -3.4E+38 3.4E+38 AXIS_PTS_REF CAL_TpcMot_ExCGenTableX_Udc_af32 /end AXIS_DESCR
 /begin AXIS_DESCR COM_AXIS NO_INPUT_QUANTITY SWC_TPC_CM_single 17 -3.4E+38 3.4E+38 AXIS_PTS_REF CAL_TpcMot_ExCGenTableY_Spd_af32 /end AXIS_DESCR
/end CHARACTERISTIC
/begin AXIS_PTS CAL_TpcMot_ExCGenTableY_Spd_af32 "外特性查表电机转速输入-发电模式" 0x0000 /* @ECU_Address@CAL_TpcMot_ExCGenTableY_Spd_af32@ */ NO_INPUT_QUANTITY Lookup2D_X_FLOAT32_IEEE 0 SWC_TPC_CM_single 17 -3.4E+38 3.4E+38 /end AXIS_PTS
/begin AXIS_PTS CAL_TpcMot_ExCGenTableX_Udc_af32 "外特性查表母线电压输入-发电模式" 0x0000 /* @ECU_Address@CAL_TpcMot_ExCGenTableX_Udc_af32@ */ NO_INPUT_QUANTITY Lookup2D_X_FLOAT32_IEEE 0 SWC_TPC_CM_single 10 -3.4E+38 3.4E+38 /end AXIS_PTS
/begin CHARACTERISTIC CAL_TpcMot_tRiseSttrDertSave1TableY_Cof_af32 "" CURVE 0x0000 /* @ECU_Address@CAL_TpcMot_tRiseSttrDertSave1TableY_Cof_af32@ */ Lookup1D_FLOAT32_IEEE 0 SWC_TPC_CM_single -3.4E+38 3.4E+38
 /begin AXIS_DESCR COM_AXIS VAR_TpcMot_tRiseSttr_f32 SWC_TPC_CM_single 9 -3.4E+38 3.4E+38 AXIS_PTS_REF CAL_TpcMot_tRiseSttrDertSave1TableX_tSttr_af32 /end AXIS_DESCR
/end CHARACTERISTIC
/begin AXIS_PTS CAL_TpcMot_tRiseSttrDertSave1TableX_tSttr_af32 "" 0x0000 /* @ECU_Address@CAL_TpcMot_tRiseSttrDertSave1TableX_tSttr_af32@ */ VAR_TpcMot_tRiseSttr_f32 Lookup1D_X_FLOAT32_IEEE 0 SWC_TPC_CM_single 9 -3.4E+38 3.4E+38 /end AXIS_PTS
/begin CHARACTERISTIC CAL_TpcMot_tRiseSttrDertSave2TableY_Cof_af32 "" CURVE 0x0000 /* @ECU_Address@CAL_TpcMot_tRiseSttrDertSave2TableY_Cof_af32@ */ Lookup1D_FLOAT32_IEEE 0 SWC_TPC_CM_single -3.4E+38 3.4E+38
 /begin AXIS_DESCR COM_AXIS NO_INPUT_QUANTITY SWC_TPC_CM_single 9 -3.4E+38 3.4E+38 AXIS_PTS_REF CAL_TpcMot_tRiseSttrDertSave2TableX_tSttr_af32 /end AXIS_DESCR
/end CHARACTERISTIC
/begin AXIS_PTS CAL_TpcMot_tRiseSttrDertSave2TableX_tSttr_af32 "" 0x0000 /* @ECU_Address@CAL_TpcMot_tRiseSttrDertSave2TableX_tSttr_af32@ */ NO_INPUT_QUANTITY Lookup1D_X_FLOAT32_IEEE 0 SWC_TPC_CM_single 9 -3.4E+38 3.4E+38 /end AXIS_PTS
/begin CHARACTERISTIC CAL_TpcMot_tSttrDertSave1TableY_Cof_af32 "" CURVE 0x0000 /* @ECU_Address@CAL_TpcMot_tSttrDertSave1TableY_Cof_af32@ */ Lookup1D_FLOAT32_IEEE 0 SWC_TPC_CM_single -3.4E+38 3.4E+38
 /begin AXIS_DESCR COM_AXIS VAR_TpcMot_tSttrTempFlt_f32 SWC_TPC_CM_single 9 -3.4E+38 3.4E+38 AXIS_PTS_REF CAL_TpcMot_tSttrDertSave1TableX_tSttr_af32 /end AXIS_DESCR
/end CHARACTERISTIC
/begin AXIS_PTS CAL_TpcMot_tSttrDertSave1TableX_tSttr_af32 "" 0x0000 /* @ECU_Address@CAL_TpcMot_tSttrDertSave1TableX_tSttr_af32@ */ VAR_TpcMot_tSttrTempFlt_f32 Lookup1D_X_FLOAT32_IEEE 0 SWC_TPC_CM_single 9 -3.4E+38 3.4E+38 /end AXIS_PTS
/begin CHARACTERISTIC CAL_TpcMot_tSttrDertSave2TableY_Cof_af32 "" CURVE 0x0000 /* @ECU_Address@CAL_TpcMot_tSttrDertSave2TableY_Cof_af32@ */ Lookup1D_FLOAT32_IEEE 0 SWC_TPC_CM_single -3.4E+38 3.4E+38
 /begin AXIS_DESCR COM_AXIS NO_INPUT_QUANTITY SWC_TPC_CM_single 9 -3.4E+38 3.4E+38 AXIS_PTS_REF CAL_TpcMot_tSttrDertSave2TableX_tSttr_af32 /end AXIS_DESCR
/end CHARACTERISTIC
/begin AXIS_PTS CAL_TpcMot_tSttrDertSave2TableX_tSttr_af32 "" 0x0000 /* @ECU_Address@CAL_TpcMot_tSttrDertSave2TableX_tSttr_af32@ */ NO_INPUT_QUANTITY Lookup1D_X_FLOAT32_IEEE 0 SWC_TPC_CM_single 9 -3.4E+38 3.4E+38 /end AXIS_PTS
/begin CHARACTERISTIC CAL_TpcSmp_OvrSpdQurd1TableY_Cof_af32 "超速限扭系数输出_第一象限" CURVE 0x0000 /* @ECU_Address@CAL_TpcSmp_OvrSpdQurd1TableY_Cof_af32@ */ Lookup1D_FLOAT32_IEEE 0 SWC_TPC_CM_single -3.4E+38 3.4E+38
 /begin AXIS_DESCR COM_AXIS NO_INPUT_QUANTITY SWC_TPC_CM_single 7 -3.4E+38 3.4E+38 AXIS_PTS_REF CAL_TpcSmp_OvrSpdQurd1TableX_Spd_af32 /end AXIS_DESCR
/end CHARACTERISTIC
/begin AXIS_PTS CAL_TpcSmp_OvrSpdQurd1TableX_Spd_af32 "超速限扭转速输入_第一象限" 0x0000 /* @ECU_Address@CAL_TpcSmp_OvrSpdQurd1TableX_Spd_af32@ */ NO_INPUT_QUANTITY Lookup1D_X_FLOAT32_IEEE 0 SWC_TPC_CM_single 7 -3.4E+38 3.4E+38 /end AXIS_PTS
/begin CHARACTERISTIC CAL_TpcSmp_OvrSpdQurd2TableY_Cof_af32 "超速限扭系数输出_第二象限" CURVE 0x0000 /* @ECU_Address@CAL_TpcSmp_OvrSpdQurd2TableY_Cof_af32@ */ Lookup1D_FLOAT32_IEEE 0 SWC_TPC_CM_single -3.4E+38 3.4E+38
 /begin AXIS_DESCR COM_AXIS NO_INPUT_QUANTITY SWC_TPC_CM_single 7 -3.4E+38 3.4E+38 AXIS_PTS_REF CAL_TpcSmp_OvrSpdQurd2TableX_Spd_af32 /end AXIS_DESCR
/end CHARACTERISTIC
/begin AXIS_PTS CAL_TpcSmp_OvrSpdQurd2TableX_Spd_af32 "超速限扭转速输入_第二象限" 0x0000 /* @ECU_Address@CAL_TpcSmp_OvrSpdQurd2TableX_Spd_af32@ */ NO_INPUT_QUANTITY Lookup1D_X_FLOAT32_IEEE 0 SWC_TPC_CM_single 7 -3.4E+38 3.4E+38 /end AXIS_PTS
/begin CHARACTERISTIC CAL_TpcSmp_OvrSpdQurd3TableY_Cof_af32 "超速限扭系数输出_第三象限" CURVE 0x0000 /* @ECU_Address@CAL_TpcSmp_OvrSpdQurd3TableY_Cof_af32@ */ Lookup1D_FLOAT32_IEEE 0 SWC_TPC_CM_single -3.4E+38 3.4E+38
 /begin AXIS_DESCR COM_AXIS NO_INPUT_QUANTITY SWC_TPC_CM_single 7 -3.4E+38 3.4E+38 AXIS_PTS_REF CAL_TpcSmp_OvrSpdQurd3TableX_Spd_af32 /end AXIS_DESCR
/end CHARACTERISTIC
/begin AXIS_PTS CAL_TpcSmp_OvrSpdQurd3TableX_Spd_af32 "超速限扭转速输入_第三象限" 0x0000 /* @ECU_Address@CAL_TpcSmp_OvrSpdQurd3TableX_Spd_af32@ */ NO_INPUT_QUANTITY Lookup1D_X_FLOAT32_IEEE 0 SWC_TPC_CM_single 7 -3.4E+38 3.4E+38 /end AXIS_PTS
/begin CHARACTERISTIC CAL_TpcSmp_OvrSpdQurd4TableY_Cof_af32 "超速限扭系数输出_第四象限" CURVE 0x0000 /* @ECU_Address@CAL_TpcSmp_OvrSpdQurd4TableY_Cof_af32@ */ Lookup1D_FLOAT32_IEEE 0 SWC_TPC_CM_single -3.4E+38 3.4E+38
 /begin AXIS_DESCR COM_AXIS NO_INPUT_QUANTITY SWC_TPC_CM_single 7 -3.4E+38 3.4E+38 AXIS_PTS_REF CAL_TpcSmp_OvrSpdQurd4TableX_Spd_af32 /end AXIS_DESCR
/end CHARACTERISTIC
/begin AXIS_PTS CAL_TpcSmp_OvrSpdQurd4TableX_Spd_af32 "超速限扭转速输入_第四象限" 0x0000 /* @ECU_Address@CAL_TpcSmp_OvrSpdQurd4TableX_Spd_af32@ */ NO_INPUT_QUANTITY Lookup1D_X_FLOAT32_IEEE 0 SWC_TPC_CM_single 7 -3.4E+38 3.4E+38 /end AXIS_PTS
/begin CHARACTERISTIC CAL_TpcTmp_tDrvboardDertTableY_Cof_af32 "驱动板温度查表derating系数输出" CURVE 0x0000 /* @ECU_Address@CAL_TpcTmp_tDrvboardDertTableY_Cof_af32@ */ Lookup1D_FLOAT32_IEEE 0 SWC_TPC_CM_single -3.4E+38 3.4E+38
 /begin AXIS_DESCR COM_AXIS NO_INPUT_QUANTITY SWC_TPC_CM_single 9 -3.4E+38 3.4E+38 AXIS_PTS_REF CAL_TpcTmp_tDrvboardDertTableX_tDrv_af32 /end AXIS_DESCR
/end CHARACTERISTIC
/begin AXIS_PTS CAL_TpcTmp_tDrvboardDertTableX_tDrv_af32 "驱动板温度查表温度输入" 0x0000 /* @ECU_Address@CAL_TpcTmp_tDrvboardDertTableX_tDrv_af32@ */ NO_INPUT_QUANTITY Lookup1D_X_FLOAT32_IEEE 0 SWC_TPC_CM_single 9 -3.4E+38 3.4E+38 /end AXIS_PTS
/begin CHARACTERISTIC CAL_TpcTmp_tIGBTDertSave1TableY_Cof_af32 "" CURVE 0x0000 /* @ECU_Address@CAL_TpcTmp_tIGBTDertSave1TableY_Cof_af32@ */ Lookup1D_FLOAT32_IEEE 0 SWC_TPC_CM_single -3.4E+38 3.4E+38
 /begin AXIS_DESCR COM_AXIS VAR_TpcTmp_tIGBTTempFlt_f32 SWC_TPC_CM_single 9 -3.4E+38 3.4E+38 AXIS_PTS_REF CAL_TpcTmp_tIGBTDertSave1TableX_tSttr_af32 /end AXIS_DESCR
/end CHARACTERISTIC
/begin AXIS_PTS CAL_TpcTmp_tIGBTDertSave1TableX_tSttr_af32 "" 0x0000 /* @ECU_Address@CAL_TpcTmp_tIGBTDertSave1TableX_tSttr_af32@ */ VAR_TpcTmp_tIGBTTempFlt_f32 Lookup1D_X_FLOAT32_IEEE 0 SWC_TPC_CM_single 9 -3.4E+38 3.4E+38 /end AXIS_PTS
/begin CHARACTERISTIC CAL_TpcTmp_tIGBTDertSave2TableY_Cof_af32 "" CURVE 0x0000 /* @ECU_Address@CAL_TpcTmp_tIGBTDertSave2TableY_Cof_af32@ */ Lookup1D_FLOAT32_IEEE 0 SWC_TPC_CM_single -3.4E+38 3.4E+38
 /begin AXIS_DESCR COM_AXIS NO_INPUT_QUANTITY SWC_TPC_CM_single 9 -3.4E+38 3.4E+38 AXIS_PTS_REF CAL_TpcTmp_tIGBTDertSave2TableX_tSttr_af32 /end AXIS_DESCR
/end CHARACTERISTIC
/begin AXIS_PTS CAL_TpcTmp_tIGBTDertSave2TableX_tSttr_af32 "" 0x0000 /* @ECU_Address@CAL_TpcTmp_tIGBTDertSave2TableX_tSttr_af32@ */ NO_INPUT_QUANTITY Lookup1D_X_FLOAT32_IEEE 0 SWC_TPC_CM_single 9 -3.4E+38 3.4E+38 /end AXIS_PTS
/begin CHARACTERISTIC CAL_TpcTmp_tRiseIGBTDertSave1TableY_Cof_af32 "" CURVE 0x0000 /* @ECU_Address@CAL_TpcTmp_tRiseIGBTDertSave1TableY_Cof_af32@ */ Lookup1D_FLOAT32_IEEE 0 SWC_TPC_CM_single -3.4E+38 3.4E+38
 /begin AXIS_DESCR COM_AXIS VAR_TpcTmp_tRiseIGBTFlt_f32 SWC_TPC_CM_single 9 -3.4E+38 3.4E+38 AXIS_PTS_REF CAL_TpcTmp_tRiseIGBTDertSave1TableX_tSttr_af32 /end AXIS_DESCR
/end CHARACTERISTIC
/begin AXIS_PTS CAL_TpcTmp_tRiseIGBTDertSave1TableX_tSttr_af32 "" 0x0000 /* @ECU_Address@CAL_TpcTmp_tRiseIGBTDertSave1TableX_tSttr_af32@ */ VAR_TpcTmp_tRiseIGBTFlt_f32 Lookup1D_X_FLOAT32_IEEE 0 SWC_TPC_CM_single 9 -3.4E+38 3.4E+38 /end AXIS_PTS
/begin CHARACTERISTIC CAL_TpcTmp_tRiseIGBTDertSave2TableY_Cof_af32 "" CURVE 0x0000 /* @ECU_Address@CAL_TpcTmp_tRiseIGBTDertSave2TableY_Cof_af32@ */ Lookup1D_FLOAT32_IEEE 0 SWC_TPC_CM_single -3.4E+38 3.4E+38
 /begin AXIS_DESCR COM_AXIS NO_INPUT_QUANTITY SWC_TPC_CM_single 9 -3.4E+38 3.4E+38 AXIS_PTS_REF CAL_TpcTmp_tRiseIGBTDertSave2TableX_tSttr_af32 /end AXIS_DESCR
/end CHARACTERISTIC
/begin AXIS_PTS CAL_TpcTmp_tRiseIGBTDertSave2TableX_tSttr_af32 "" 0x0000 /* @ECU_Address@CAL_TpcTmp_tRiseIGBTDertSave2TableX_tSttr_af32@ */ NO_INPUT_QUANTITY Lookup1D_X_FLOAT32_IEEE 0 SWC_TPC_CM_single 9 -3.4E+38 3.4E+38 /end AXIS_PTS
/begin CHARACTERISTIC CAL_TpcSmp_OvrCurtLimElecTableY_Cof_af32 "电动过流线性降功率查表derating系数输出" CURVE 0x0000 /* @ECU_Address@CAL_TpcSmp_OvrCurtLimElecTableY_Cof_af32@ */ Lookup1D_FLOAT32_IEEE 0 SWC_TPC_CM_single -3.4E+38 3.4E+38
 /begin AXIS_DESCR COM_AXIS NO_INPUT_QUANTITY SWC_TPC_CM_single 5 -3.4E+38 3.4E+38 AXIS_PTS_REF CAL_TpcSmp_OvrCurtLimElecTableX_iDc_af32 /end AXIS_DESCR
/end CHARACTERISTIC
/begin AXIS_PTS CAL_TpcSmp_OvrCurtLimElecTableX_iDc_af32 "电动过流线性降功率查表电流输入" 0x0000 /* @ECU_Address@CAL_TpcSmp_OvrCurtLimElecTableX_iDc_af32@ */ NO_INPUT_QUANTITY Lookup1D_X_FLOAT32_IEEE 0 SWC_TPC_CM_single 5 -3.4E+38 3.4E+38 /end AXIS_PTS
/begin CHARACTERISTIC CAL_TpcSmp_OvrCurtLimGenTableY_Cof_af32 "发电过流线性降功率查表derating系数输出" CURVE 0x0000 /* @ECU_Address@CAL_TpcSmp_OvrCurtLimGenTableY_Cof_af32@ */ Lookup1D_FLOAT32_IEEE 0 SWC_TPC_CM_single -3.4E+38 3.4E+38
 /begin AXIS_DESCR COM_AXIS NO_INPUT_QUANTITY SWC_TPC_CM_single 5 -3.4E+38 3.4E+38 AXIS_PTS_REF CAL_TpcSmp_OvrCurtLimGenTableX_iDc_af32 /end AXIS_DESCR
/end CHARACTERISTIC
/begin AXIS_PTS CAL_TpcSmp_OvrCurtLimGenTableX_iDc_af32 "发电过流线性降功率查表电流输入" 0x0000 /* @ECU_Address@CAL_TpcSmp_OvrCurtLimGenTableX_iDc_af32@ */ NO_INPUT_QUANTITY Lookup1D_X_FLOAT32_IEEE 0 SWC_TPC_CM_single 5 -3.4E+38 3.4E+38 /end AXIS_PTS
/begin CHARACTERISTIC CAL_TpcSmp_OvrVoltGenTableY_Cof_af32 "过压线性降功率查表derating系数输出" CURVE 0x0000 /* @ECU_Address@CAL_TpcSmp_OvrVoltGenTableY_Cof_af32@ */ Lookup1D_FLOAT32_IEEE 0 SWC_TPC_CM_single -3.4E+38 3.4E+38
 /begin AXIS_DESCR COM_AXIS NO_INPUT_QUANTITY SWC_TPC_CM_single 5 -3.4E+38 3.4E+38 AXIS_PTS_REF CAL_TpcSmp_OvrVoltGenTableX_uDc_af32 /end AXIS_DESCR
/end CHARACTERISTIC
/begin AXIS_PTS CAL_TpcSmp_OvrVoltGenTableX_uDc_af32 "过压线性降功率查表电压输入" 0x0000 /* @ECU_Address@CAL_TpcSmp_OvrVoltGenTableX_uDc_af32@ */ NO_INPUT_QUANTITY Lookup1D_X_FLOAT32_IEEE 0 SWC_TPC_CM_single 5 -3.4E+38 3.4E+38 /end AXIS_PTS
/begin CHARACTERISTIC CAL_TpcSmp_UdrVoltElecTableY_Cof_af32 "欠压线性降功率查表derating系数输出" CURVE 0x0000 /* @ECU_Address@CAL_TpcSmp_UdrVoltElecTableY_Cof_af32@ */ Lookup1D_FLOAT32_IEEE 0 SWC_TPC_CM_single -3.4E+38 3.4E+38
 /begin AXIS_DESCR COM_AXIS NO_INPUT_QUANTITY SWC_TPC_CM_single 5 -3.4E+38 3.4E+38 AXIS_PTS_REF CAL_TpcSmp_UdrVoltElecTableX_uDc_af32 /end AXIS_DESCR
/end CHARACTERISTIC
/begin AXIS_PTS CAL_TpcSmp_UdrVoltElecTableX_uDc_af32 "欠压线性降功率查表电压输入" 0x0000 /* @ECU_Address@CAL_TpcSmp_UdrVoltElecTableX_uDc_af32@ */ NO_INPUT_QUANTITY Lookup1D_X_FLOAT32_IEEE 0 SWC_TPC_CM_single 5 -3.4E+38 3.4E+38 /end AXIS_PTS
/begin CHARACTERISTIC CAL_TpcTmp_tCoolantDertSave1TableY_Cof_af32 "" CURVE 0x0000 /* @ECU_Address@CAL_TpcTmp_tCoolantDertSave1TableY_Cof_af32@ */ Lookup1D_FLOAT32_IEEE 0 SWC_TPC_CM_single -3.4E+38 3.4E+38
 /begin AXIS_DESCR COM_AXIS VAR_TpcTmp_tCoolantTempFlt_f32 SWC_TPC_CM_single 9 -3.4E+38 3.4E+38 AXIS_PTS_REF CAL_TpcTmp_tCoolantDertSave1TableX_tSttr_af32 /end AXIS_DESCR
/end CHARACTERISTIC
/begin AXIS_PTS CAL_TpcTmp_tCoolantDertSave1TableX_tSttr_af32 "" 0x0000 /* @ECU_Address@CAL_TpcTmp_tCoolantDertSave1TableX_tSttr_af32@ */ VAR_TpcTmp_tCoolantTempFlt_f32 Lookup1D_X_FLOAT32_IEEE 0 SWC_TPC_CM_single 9 -3.4E+38 3.4E+38 /end AXIS_PTS
/begin CHARACTERISTIC CAL_TpcTmp_tCoolantDertSave2TableY_Cof_af32 "" CURVE 0x0000 /* @ECU_Address@CAL_TpcTmp_tCoolantDertSave2TableY_Cof_af32@ */ Lookup1D_FLOAT32_IEEE 0 SWC_TPC_CM_single -3.4E+38 3.4E+38
 /begin AXIS_DESCR COM_AXIS NO_INPUT_QUANTITY SWC_TPC_CM_single 9 -3.4E+38 3.4E+38 AXIS_PTS_REF CAL_TpcTmp_tCoolantDertSave2TableX_tSttr_af32 /end AXIS_DESCR
/end CHARACTERISTIC
/begin AXIS_PTS CAL_TpcTmp_tCoolantDertSave2TableX_tSttr_af32 "" 0x0000 /* @ECU_Address@CAL_TpcTmp_tCoolantDertSave2TableX_tSttr_af32@ */ NO_INPUT_QUANTITY Lookup1D_X_FLOAT32_IEEE 0 SWC_TPC_CM_single 9 -3.4E+38 3.4E+38 /end AXIS_PTS
/begin CHARACTERISTIC CAL_TpcTmp_tDbcDertSave1TableY_Cof_af32 "" CURVE 0x0000 /* @ECU_Address@CAL_TpcTmp_tDbcDertSave1TableY_Cof_af32@ */ Lookup1D_FLOAT32_IEEE 0 SWC_TPC_CM_single -3.4E+38 3.4E+38
 /begin AXIS_DESCR COM_AXIS VAR_TpcTmp_tDbcTempFlt_f32 SWC_TPC_CM_single 9 -3.4E+38 3.4E+38 AXIS_PTS_REF CAL_TpcTmp_tDbcDertSave1TableX_tSttr_af32 /end AXIS_DESCR
/end CHARACTERISTIC
/begin AXIS_PTS CAL_TpcTmp_tDbcDertSave1TableX_tSttr_af32 "" 0x0000 /* @ECU_Address@CAL_TpcTmp_tDbcDertSave1TableX_tSttr_af32@ */ VAR_TpcTmp_tDbcTempFlt_f32 Lookup1D_X_FLOAT32_IEEE 0 SWC_TPC_CM_single 9 -3.4E+38 3.4E+38 /end AXIS_PTS
/begin CHARACTERISTIC CAL_TpcTmp_tDbcDertSave2TableY_Cof_af32 "" CURVE 0x0000 /* @ECU_Address@CAL_TpcTmp_tDbcDertSave2TableY_Cof_af32@ */ Lookup1D_FLOAT32_IEEE 0 SWC_TPC_CM_single -3.4E+38 3.4E+38
 /begin AXIS_DESCR COM_AXIS NO_INPUT_QUANTITY SWC_TPC_CM_single 9 -3.4E+38 3.4E+38 AXIS_PTS_REF CAL_TpcTmp_tDbcDertSave2TableX_tSttr_af32 /end AXIS_DESCR
/end CHARACTERISTIC
/begin AXIS_PTS CAL_TpcTmp_tDbcDertSave2TableX_tSttr_af32 "" 0x0000 /* @ECU_Address@CAL_TpcTmp_tDbcDertSave2TableX_tSttr_af32@ */ NO_INPUT_QUANTITY Lookup1D_X_FLOAT32_IEEE 0 SWC_TPC_CM_single 9 -3.4E+38 3.4E+38 /end AXIS_PTS
/begin CHARACTERISTIC CAL_TpcTmp_tRiseDbcDertSave1TableY_Cof_af32 "" CURVE 0x0000 /* @ECU_Address@CAL_TpcTmp_tRiseDbcDertSave1TableY_Cof_af32@ */ Lookup1D_FLOAT32_IEEE 0 SWC_TPC_CM_single -3.4E+38 3.4E+38
 /begin AXIS_DESCR COM_AXIS VAR_TpcTmp_tRiseDbcFlt_f32 SWC_TPC_CM_single 9 -3.4E+38 3.4E+38 AXIS_PTS_REF CAL_TpcTmp_tRiseDbcDertSave1TableX_tSttr_af32 /end AXIS_DESCR
/end CHARACTERISTIC
/begin AXIS_PTS CAL_TpcTmp_tRiseDbcDertSave1TableX_tSttr_af32 "" 0x0000 /* @ECU_Address@CAL_TpcTmp_tRiseDbcDertSave1TableX_tSttr_af32@ */ VAR_TpcTmp_tRiseDbcFlt_f32 Lookup1D_X_FLOAT32_IEEE 0 SWC_TPC_CM_single 9 -3.4E+38 3.4E+38 /end AXIS_PTS
/begin CHARACTERISTIC CAL_TpcTmp_tRiseDbcDertSave2TableY_Cof_af32 "" CURVE 0x0000 /* @ECU_Address@CAL_TpcTmp_tRiseDbcDertSave2TableY_Cof_af32@ */ Lookup1D_FLOAT32_IEEE 0 SWC_TPC_CM_single -3.4E+38 3.4E+38
 /begin AXIS_DESCR COM_AXIS NO_INPUT_QUANTITY SWC_TPC_CM_single 9 -3.4E+38 3.4E+38 AXIS_PTS_REF CAL_TpcTmp_tRiseDbcDertSave2TableX_tSttr_af32 /end AXIS_DESCR
/end CHARACTERISTIC
/begin AXIS_PTS CAL_TpcTmp_tRiseDbcDertSave2TableX_tSttr_af32 "" 0x0000 /* @ECU_Address@CAL_TpcTmp_tRiseDbcDertSave2TableX_tSttr_af32@ */ NO_INPUT_QUANTITY Lookup1D_X_FLOAT32_IEEE 0 SWC_TPC_CM_single 9 -3.4E+38 3.4E+38 /end AXIS_PTS
/begin CHARACTERISTIC CAL_TpcBlk_MtrBlkIsFirstSet_f32 "" VALUE 0x0000 /* @ECU_Address@CAL_TpcBlk_MtrBlkIsFirstSet_f32@ */ Scalar_FLOAT32_IEEE 0 SWC_TPC_CM_single -3.4E+38 3.4E+38 /end CHARACTERISTIC
/begin CHARACTERISTIC CAL_TpcBlk_MtrBlkIsSecondSet_f32 "" VALUE 0x0000 /* @ECU_Address@CAL_TpcBlk_MtrBlkIsSecondSet_f32@ */ Scalar_FLOAT32_IEEE 0 SWC_TPC_CM_single -3.4E+38 3.4E+38 /end CHARACTERISTIC
/begin CHARACTERISTIC CAL_TpcBlk_MtrBlkSpdHighSet_f32 "" VALUE 0x0000 /* @ECU_Address@CAL_TpcBlk_MtrBlkSpdHighSet_f32@ */ Scalar_FLOAT32_IEEE 0 SWC_TPC_CM_single -3.4E+38 3.4E+38 /end CHARACTERISTIC
/begin CHARACTERISTIC CAL_TpcBlk_MtrBlkSpdLowSet_f32 "" VALUE 0x0000 /* @ECU_Address@CAL_TpcBlk_MtrBlkSpdLowSet_f32@ */ Scalar_FLOAT32_IEEE 0 SWC_TPC_CM_single -3.4E+38 3.4E+38 /end CHARACTERISTIC
/begin CHARACTERISTIC CAL_TpcBlk_TrqBlkStab_f32 "" VALUE 0x0000 /* @ECU_Address@CAL_TpcBlk_TrqBlkStab_f32@ */ Scalar_FLOAT32_IEEE 0 SWC_TPC_CM_single -3.4E+38 3.4E+38 /end CHARACTERISTIC
/begin CHARACTERISTIC CAL_TpcBlk_TrqDecRamp_f32 "" VALUE 0x0000 /* @ECU_Address@CAL_TpcBlk_TrqDecRamp_f32@ */ Scalar_FLOAT32_IEEE 0 SWC_TPC_CM_single -3.4E+38 3.4E+38 /end CHARACTERISTIC
/begin CHARACTERISTIC CAL_TpcBlk_TrqIncRamp_f32 "" VALUE 0x0000 /* @ECU_Address@CAL_TpcBlk_TrqIncRamp_f32@ */ Scalar_FLOAT32_IEEE 0 SWC_TPC_CM_single -3.4E+38 3.4E+38 /end CHARACTERISTIC
/begin CHARACTERISTIC CAL_TpcCod_CoolFlow1LReq_f32 "" VALUE 0x0000 /* @ECU_Address@CAL_TpcCod_CoolFlow1LReq_f32@ */ Scalar_FLOAT32_IEEE 0 SWC_TPC_CM_single -3.4E+38 3.4E+38 /end CHARACTERISTIC
/begin CHARACTERISTIC CAL_TpcCod_NTCHighTemp_f32 "" VALUE 0x0000 /* @ECU_Address@CAL_TpcCod_NTCHighTemp_f32@ */ Scalar_FLOAT32_IEEE 0 SWC_TPC_CM_single -3.4E+38 3.4E+38 /end CHARACTERISTIC
/begin CHARACTERISTIC CAL_TpcCod_NTCLowTemp_f32 "" VALUE 0x0000 /* @ECU_Address@CAL_TpcCod_NTCLowTemp_f32@ */ Scalar_FLOAT32_IEEE 0 SWC_TPC_CM_single -3.4E+38 3.4E+38 /end CHARACTERISTIC
/begin CHARACTERISTIC CAL_TpcCod_NegSpdDirStop_f32 "电机转速判定为0阈值下限" VALUE 0x0000 /* @ECU_Address@CAL_TpcCod_NegSpdDirStop_f32@ */ Scalar_FLOAT32_IEEE 0 SWC_TPC_CM_single -3.4E+38 3.4E+38 /end CHARACTERISTIC
/begin CHARACTERISTIC CAL_TpcCod_NegTrqDirStop_f32 "电机扭矩判定为0阈值下限" VALUE 0x0000 /* @ECU_Address@CAL_TpcCod_NegTrqDirStop_f32@ */ Scalar_FLOAT32_IEEE 0 SWC_TPC_CM_single -3.4E+38 3.4E+38 /end CHARACTERISTIC
/begin CHARACTERISTIC CAL_TpcCod_PosSpdDirStop_f32 "电机转速判定为0阈值上限" VALUE 0x0000 /* @ECU_Address@CAL_TpcCod_PosSpdDirStop_f32@ */ Scalar_FLOAT32_IEEE 0 SWC_TPC_CM_single -3.4E+38 3.4E+38 /end CHARACTERISTIC
/begin CHARACTERISTIC CAL_TpcCod_PosSpdHold_f32 "扭矩限值Mapping的转速阈值下限" VALUE 0x0000 /* @ECU_Address@CAL_TpcCod_PosSpdHold_f32@ */ Scalar_FLOAT32_IEEE 0 SWC_TPC_CM_single -3.4E+38 3.4E+38 /end CHARACTERISTIC
/begin CHARACTERISTIC CAL_TpcCod_PosSpdStart_f32 "扭矩限值Mapping的转速阈值上限" VALUE 0x0000 /* @ECU_Address@CAL_TpcCod_PosSpdStart_f32@ */ Scalar_FLOAT32_IEEE 0 SWC_TPC_CM_single -3.4E+38 3.4E+38 /end CHARACTERISTIC
/begin CHARACTERISTIC CAL_TpcCod_PosTrqDirStop_f32 "电机扭矩判定为0阈值上限" VALUE 0x0000 /* @ECU_Address@CAL_TpcCod_PosTrqDirStop_f32@ */ Scalar_FLOAT32_IEEE 0 SWC_TPC_CM_single -3.4E+38 3.4E+38 /end CHARACTERISTIC
/begin CHARACTERISTIC CAL_TpcCod_PowIncRatLim_f32 "" VALUE 0x0000 /* @ECU_Address@CAL_TpcCod_PowIncRatLim_f32@ */ Scalar_FLOAT32_IEEE 0 SWC_TPC_CM_single -3.4E+38 3.4E+38 /end CHARACTERISTIC
/begin CHARACTERISTIC CAL_TpcCod_TrqRelay_f32 "" VALUE 0x0000 /* @ECU_Address@CAL_TpcCod_TrqRelay_f32@ */ Scalar_FLOAT32_IEEE 0 SWC_TPC_CM_single -3.4E+38 3.4E+38 /end CHARACTERISTIC
/begin CHARACTERISTIC CAL_TpcFuv_CofPwrLimLv1_f32 "一级故障功率限值系数" VALUE 0x0000 /* @ECU_Address@CAL_TpcFuv_CofPwrLimLv1_f32@ */ Scalar_FLOAT32_IEEE 0 SWC_TPC_CM_single -3.4E+38 3.4E+38 /end CHARACTERISTIC
/begin CHARACTERISTIC CAL_TpcFuv_CofPwrLimLv2_f32 "二级故障功率限值系数" VALUE 0x0000 /* @ECU_Address@CAL_TpcFuv_CofPwrLimLv2_f32@ */ Scalar_FLOAT32_IEEE 0 SWC_TPC_CM_single -3.4E+38 3.4E+38 /end CHARACTERISTIC
/begin CHARACTERISTIC CAL_TpcFuv_CofPwrLimLv3_f32 "三级故障功率限值系数" VALUE 0x0000 /* @ECU_Address@CAL_TpcFuv_CofPwrLimLv3_f32@ */ Scalar_FLOAT32_IEEE 0 SWC_TPC_CM_single -3.4E+38 3.4E+38 /end CHARACTERISTIC
/begin CHARACTERISTIC CAL_TpcFuv_CofPwrLimLv4_f32 "四级故障功率限值系数" VALUE 0x0000 /* @ECU_Address@CAL_TpcFuv_CofPwrLimLv4_f32@ */ Scalar_FLOAT32_IEEE 0 SWC_TPC_CM_single -3.4E+38 3.4E+38 /end CHARACTERISTIC
/begin CHARACTERISTIC CAL_TpcFuv_CofTrqLimLv1_f32 "一级故障扭矩限值系数" VALUE 0x0000 /* @ECU_Address@CAL_TpcFuv_CofTrqLimLv1_f32@ */ Scalar_FLOAT32_IEEE 0 SWC_TPC_CM_single -3.4E+38 3.4E+38 /end CHARACTERISTIC
/begin CHARACTERISTIC CAL_TpcFuv_CofTrqLimLv2_f32 "二级故障扭矩限值系数" VALUE 0x0000 /* @ECU_Address@CAL_TpcFuv_CofTrqLimLv2_f32@ */ Scalar_FLOAT32_IEEE 0 SWC_TPC_CM_single -3.4E+38 3.4E+38 /end CHARACTERISTIC
/begin CHARACTERISTIC CAL_TpcFuv_CofTrqLimLv3_f32 "三级故障扭矩限值系数" VALUE 0x0000 /* @ECU_Address@CAL_TpcFuv_CofTrqLimLv3_f32@ */ Scalar_FLOAT32_IEEE 0 SWC_TPC_CM_single -3.4E+38 3.4E+38 /end CHARACTERISTIC
/begin CHARACTERISTIC CAL_TpcFuv_CofTrqLimLv4_f32 "四级故障扭矩限值系数" VALUE 0x0000 /* @ECU_Address@CAL_TpcFuv_CofTrqLimLv4_f32@ */ Scalar_FLOAT32_IEEE 0 SWC_TPC_CM_single -3.4E+38 3.4E+38 /end CHARACTERISTIC
/begin CHARACTERISTIC CAL_TpcMot_SttrChgTempDownDiff_f32 "" VALUE 0x0000 /* @ECU_Address@CAL_TpcMot_SttrChgTempDownDiff_f32@ */ Scalar_FLOAT32_IEEE 0 SWC_TPC_CM_single -3.4E+38 3.4E+38 /end CHARACTERISTIC
/begin CHARACTERISTIC CAL_TpcMot_SttrChgTempUpDiff_f32 "" VALUE 0x0000 /* @ECU_Address@CAL_TpcMot_SttrChgTempUpDiff_f32@ */ Scalar_FLOAT32_IEEE 0 SWC_TPC_CM_single -3.4E+38 3.4E+38 /end CHARACTERISTIC
/begin CHARACTERISTIC CAL_TpcMot_SttrTempAdds_f32 "" VALUE 0x0000 /* @ECU_Address@CAL_TpcMot_SttrTempAdds_f32@ */ Scalar_FLOAT32_IEEE 0 SWC_TPC_CM_single -3.4E+38 3.4E+38 /end CHARACTERISTIC
/begin CHARACTERISTIC CAL_TpcMot_SttrTempDecDiff_f32 "定子温度下降步长" VALUE 0x0000 /* @ECU_Address@CAL_TpcMot_SttrTempDecDiff_f32@ */ Scalar_FLOAT32_IEEE 0 SWC_TPC_CM_single -3.4E+38 3.4E+38 /end CHARACTERISTIC
/begin CHARACTERISTIC CAL_TpcMot_SttrTempKp_f32 "" VALUE 0x0000 /* @ECU_Address@CAL_TpcMot_SttrTempKp_f32@ */ Scalar_FLOAT32_IEEE 0 SWC_TPC_CM_single -3.4E+38 3.4E+38 /end CHARACTERISTIC
/begin CHARACTERISTIC CAL_TpcMot_SttrTempMinus_f32 "" VALUE 0x0000 /* @ECU_Address@CAL_TpcMot_SttrTempMinus_f32@ */ Scalar_FLOAT32_IEEE 0 SWC_TPC_CM_single -3.4E+38 3.4E+38 /end CHARACTERISTIC
/begin CHARACTERISTIC CAL_TpcMot_SttrTempRiseDiff_f32 "" VALUE 0x0000 /* @ECU_Address@CAL_TpcMot_SttrTempRiseDiff_f32@ */ Scalar_FLOAT32_IEEE 0 SWC_TPC_CM_single -3.4E+38 3.4E+38 /end CHARACTERISTIC
/begin CHARACTERISTIC CAL_TpcMot_tRiseSttrTraNormalToSave1_f32 "" VALUE 0x0000 /* @ECU_Address@CAL_TpcMot_tRiseSttrTraNormalToSave1_f32@ */ Scalar_FLOAT32_IEEE 0 SWC_TPC_CM_single -3.4E+38 3.4E+38 /end CHARACTERISTIC
/begin CHARACTERISTIC CAL_TpcMot_tRiseSttrTraSave1ToNormal_f32 "" VALUE 0x0000 /* @ECU_Address@CAL_TpcMot_tRiseSttrTraSave1ToNormal_f32@ */ Scalar_FLOAT32_IEEE 0 SWC_TPC_CM_single -3.4E+38 3.4E+38 /end CHARACTERISTIC
/begin CHARACTERISTIC CAL_TpcMot_tRiseSttrTraSave1ToSave2_f32 "" VALUE 0x0000 /* @ECU_Address@CAL_TpcMot_tRiseSttrTraSave1ToSave2_f32@ */ Scalar_FLOAT32_IEEE 0 SWC_TPC_CM_single -3.4E+38 3.4E+38 /end CHARACTERISTIC
/begin CHARACTERISTIC CAL_TpcMot_tRiseSttrTraSave2ToOverheating_f32 "" VALUE 0x0000 /* @ECU_Address@CAL_TpcMot_tRiseSttrTraSave2ToOverheating_f32@ */ Scalar_FLOAT32_IEEE 0 SWC_TPC_CM_single -3.4E+38 3.4E+38 /end CHARACTERISTIC
/begin CHARACTERISTIC CAL_TpcMot_tSttrHiLim_f32 "定子温度过高故障阈值" VALUE 0x0000 /* @ECU_Address@CAL_TpcMot_tSttrHiLim_f32@ */ Scalar_FLOAT32_IEEE 0 SWC_TPC_CM_single -3.4E+38 3.4E+38 /end CHARACTERISTIC
/begin CHARACTERISTIC CAL_TpcMot_tSttrLoLim_f32 "定子温度过低报警阈值" VALUE 0x0000 /* @ECU_Address@CAL_TpcMot_tSttrLoLim_f32@ */ Scalar_FLOAT32_IEEE 0 SWC_TPC_CM_single -3.4E+38 3.4E+38 /end CHARACTERISTIC
/begin CHARACTERISTIC CAL_TpcMot_tSttrTraNormalToSave1_f32 "" VALUE 0x0000 /* @ECU_Address@CAL_TpcMot_tSttrTraNormalToSave1_f32@ */ Scalar_FLOAT32_IEEE 0 SWC_TPC_CM_single -3.4E+38 3.4E+38 /end CHARACTERISTIC
/begin CHARACTERISTIC CAL_TpcMot_tSttrTraSave1ToNormal_f32 "" VALUE 0x0000 /* @ECU_Address@CAL_TpcMot_tSttrTraSave1ToNormal_f32@ */ Scalar_FLOAT32_IEEE 0 SWC_TPC_CM_single -3.4E+38 3.4E+38 /end CHARACTERISTIC
/begin CHARACTERISTIC CAL_TpcMot_tSttrTraSave1ToSave2_f32 "" VALUE 0x0000 /* @ECU_Address@CAL_TpcMot_tSttrTraSave1ToSave2_f32@ */ Scalar_FLOAT32_IEEE 0 SWC_TPC_CM_single -3.4E+38 3.4E+38 /end CHARACTERISTIC
/begin CHARACTERISTIC CAL_TpcMot_tSttrTraSave2ToOverheating_f32 "" VALUE 0x0000 /* @ECU_Address@CAL_TpcMot_tSttrTraSave2ToOverheating_f32@ */ Scalar_FLOAT32_IEEE 0 SWC_TPC_CM_single -3.4E+38 3.4E+38 /end CHARACTERISTIC
/begin CHARACTERISTIC CAL_TpcMot_tSttrTrqLimRamp_f32 "定子温度扭矩限值slop" VALUE 0x0000 /* @ECU_Address@CAL_TpcMot_tSttrTrqLimRamp_f32@ */ Scalar_FLOAT32_IEEE 0 SWC_TPC_CM_single -3.4E+38 3.4E+38 /end CHARACTERISTIC
/begin CHARACTERISTIC CAL_TpcSmp_ElecOvrCurtKi_f32 "电动过流限功率PI模块Ki" VALUE 0x0000 /* @ECU_Address@CAL_TpcSmp_ElecOvrCurtKi_f32@ */ Scalar_FLOAT32_IEEE 0 SWC_TPC_CM_single -3.4E+38 3.4E+38 /end CHARACTERISTIC
/begin CHARACTERISTIC CAL_TpcSmp_ElecOvrCurtKp_f32 "电动过流限功率PI模块Kp" VALUE 0x0000 /* @ECU_Address@CAL_TpcSmp_ElecOvrCurtKp_f32@ */ Scalar_FLOAT32_IEEE 0 SWC_TPC_CM_single -3.4E+38 3.4E+38 /end CHARACTERISTIC
/begin CHARACTERISTIC CAL_TpcSmp_ElecOvrCurtypLim_f32 "电动过流限功率PI模块限幅" VALUE 0x0000 /* @ECU_Address@CAL_TpcSmp_ElecOvrCurtypLim_f32@ */ Scalar_FLOAT32_IEEE 0 SWC_TPC_CM_single -3.4E+38 3.4E+38 /end CHARACTERISTIC
/begin CHARACTERISTIC CAL_TpcSmp_ElecUdrVoltKi_f32 "电动欠压限功率PI模块Ki" VALUE 0x0000 /* @ECU_Address@CAL_TpcSmp_ElecUdrVoltKi_f32@ */ Scalar_FLOAT32_IEEE 0 SWC_TPC_CM_single -3.4E+38 3.4E+38 /end CHARACTERISTIC
/begin CHARACTERISTIC CAL_TpcSmp_ElecUdrVoltKp_f32 "电动欠压限功率PI模块Kp" VALUE 0x0000 /* @ECU_Address@CAL_TpcSmp_ElecUdrVoltKp_f32@ */ Scalar_FLOAT32_IEEE 0 SWC_TPC_CM_single -3.4E+38 3.4E+38 /end CHARACTERISTIC
/begin CHARACTERISTIC CAL_TpcSmp_ElecUdrVoltypLim_f32 "电动欠压限功率PI模块限幅" VALUE 0x0000 /* @ECU_Address@CAL_TpcSmp_ElecUdrVoltypLim_f32@ */ Scalar_FLOAT32_IEEE 0 SWC_TPC_CM_single -3.4E+38 3.4E+38 /end CHARACTERISTIC
/begin CHARACTERISTIC CAL_TpcSmp_GenOvrCurtKi_f32 "发电过流限功率PI模块Ki" VALUE 0x0000 /* @ECU_Address@CAL_TpcSmp_GenOvrCurtKi_f32@ */ Scalar_FLOAT32_IEEE 0 SWC_TPC_CM_single -3.4E+38 3.4E+38 /end CHARACTERISTIC
/begin CHARACTERISTIC CAL_TpcSmp_GenOvrCurtKp_f32 "发电过流限功率PI模块Kp" VALUE 0x0000 /* @ECU_Address@CAL_TpcSmp_GenOvrCurtKp_f32@ */ Scalar_FLOAT32_IEEE 0 SWC_TPC_CM_single -3.4E+38 3.4E+38 /end CHARACTERISTIC
/begin CHARACTERISTIC CAL_TpcSmp_GenOvrCurtypLim_f32 "发电过流限功率PI模块限幅" VALUE 0x0000 /* @ECU_Address@CAL_TpcSmp_GenOvrCurtypLim_f32@ */ Scalar_FLOAT32_IEEE 0 SWC_TPC_CM_single -3.4E+38 3.4E+38 /end CHARACTERISTIC
/begin CHARACTERISTIC CAL_TpcSmp_GenOvrVoltKi_f32 "发电过压限功率PI模块Ki" VALUE 0x0000 /* @ECU_Address@CAL_TpcSmp_GenOvrVoltKi_f32@ */ Scalar_FLOAT32_IEEE 0 SWC_TPC_CM_single -3.4E+38 3.4E+38 /end CHARACTERISTIC
/begin CHARACTERISTIC CAL_TpcSmp_GenOvrVoltKp_f32 "发电过压限功率PI模块Kp" VALUE 0x0000 /* @ECU_Address@CAL_TpcSmp_GenOvrVoltKp_f32@ */ Scalar_FLOAT32_IEEE 0 SWC_TPC_CM_single -3.4E+38 3.4E+38 /end CHARACTERISTIC
/begin CHARACTERISTIC CAL_TpcSmp_GenOvrVoltypLim_f32 "发电过压限功率PI模块限幅" VALUE 0x0000 /* @ECU_Address@CAL_TpcSmp_GenOvrVoltypLim_f32@ */ Scalar_FLOAT32_IEEE 0 SWC_TPC_CM_single -3.4E+38 3.4E+38 /end CHARACTERISTIC
/begin CHARACTERISTIC CAL_TpcSmp_OvSpdWarnHiLim_f32 "电机转速超速报警触发阈值" VALUE 0x0000 /* @ECU_Address@CAL_TpcSmp_OvSpdWarnHiLim_f32@ */ Scalar_FLOAT32_IEEE 0 SWC_TPC_CM_single -3.4E+38 3.4E+38 /end CHARACTERISTIC
/begin CHARACTERISTIC CAL_TpcSmp_OvSpdWarnLoLim_f32 "电机转速超速报警恢复阈值" VALUE 0x0000 /* @ECU_Address@CAL_TpcSmp_OvSpdWarnLoLim_f32@ */ Scalar_FLOAT32_IEEE 0 SWC_TPC_CM_single -3.4E+38 3.4E+38 /end CHARACTERISTIC
/begin CHARACTERISTIC CAL_TpcSmp_PwrAddMaxGen_f32 "" VALUE 0x0000 /* @ECU_Address@CAL_TpcSmp_PwrAddMaxGen_f32@ */ Scalar_FLOAT32_IEEE 0 SWC_TPC_CM_single -3.4E+38 3.4E+38 /end CHARACTERISTIC
/begin CHARACTERISTIC CAL_TpcSmp_PwrAddMax_f32 "电动过流测试补偿功率" VALUE 0x0000 /* @ECU_Address@CAL_TpcSmp_PwrAddMax_f32@ */ Scalar_FLOAT32_IEEE 0 SWC_TPC_CM_single -3.4E+38 3.4E+38 /end CHARACTERISTIC
/begin CHARACTERISTIC CAL_TpcSmp_SystemEffiElec_f32 "" VALUE 0x0000 /* @ECU_Address@CAL_TpcSmp_SystemEffiElec_f32@ */ Scalar_FLOAT32_IEEE 0 SWC_TPC_CM_single -3.4E+38 3.4E+38 /end CHARACTERISTIC
/begin CHARACTERISTIC CAL_TpcSmp_SystemEffiGen_f32 "" VALUE 0x0000 /* @ECU_Address@CAL_TpcSmp_SystemEffiGen_f32@ */ Scalar_FLOAT32_IEEE 0 SWC_TPC_CM_single -3.4E+38 3.4E+38 /end CHARACTERISTIC
/begin CHARACTERISTIC CAL_TpcSmp_ThresOverSpd_f32 "电机转速超速故障阈值" VALUE 0x0000 /* @ECU_Address@CAL_TpcSmp_ThresOverSpd_f32@ */ Scalar_FLOAT32_IEEE 0 SWC_TPC_CM_single -3.4E+38 3.4E+38 /end CHARACTERISTIC
/begin CHARACTERISTIC CAL_TpcSmp_TrqAddMaxGen_f32 "" VALUE 0x0000 /* @ECU_Address@CAL_TpcSmp_TrqAddMaxGen_f32@ */ Scalar_FLOAT32_IEEE 0 SWC_TPC_CM_single -3.4E+38 3.4E+38 /end CHARACTERISTIC
/begin CHARACTERISTIC CAL_TpcSmp_TrqAddMax_f32 "电动过流测试补偿扭矩" VALUE 0x0000 /* @ECU_Address@CAL_TpcSmp_TrqAddMax_f32@ */ Scalar_FLOAT32_IEEE 0 SWC_TPC_CM_single -3.4E+38 3.4E+38 /end CHARACTERISTIC
/begin CHARACTERISTIC CAL_TpcSmp_iDcLnkMaxMax_f32 "电池允许最大电流最大值" VALUE 0x0000 /* @ECU_Address@CAL_TpcSmp_iDcLnkMaxMax_f32@ */ Scalar_FLOAT32_IEEE 0 SWC_TPC_CM_single -3.4E+38 3.4E+38 /end CHARACTERISTIC
/begin CHARACTERISTIC CAL_TpcSmp_iDcLnkMaxMin_f32 "电池允许最大电流最小值" VALUE 0x0000 /* @ECU_Address@CAL_TpcSmp_iDcLnkMaxMin_f32@ */ Scalar_FLOAT32_IEEE 0 SWC_TPC_CM_single -3.4E+38 3.4E+38 /end CHARACTERISTIC
/begin CHARACTERISTIC CAL_TpcSmp_iDcLnkMinMax_f32 "电池允许最小电流最大值" VALUE 0x0000 /* @ECU_Address@CAL_TpcSmp_iDcLnkMinMax_f32@ */ Scalar_FLOAT32_IEEE 0 SWC_TPC_CM_single -3.4E+38 3.4E+38 /end CHARACTERISTIC
/begin CHARACTERISTIC CAL_TpcSmp_iDcLnkMinMin_f32 "电池允许最小电流最小值" VALUE 0x0000 /* @ECU_Address@CAL_TpcSmp_iDcLnkMinMin_f32@ */ Scalar_FLOAT32_IEEE 0 SWC_TPC_CM_single -3.4E+38 3.4E+38 /end CHARACTERISTIC
/begin CHARACTERISTIC CAL_TpcSmp_iDcLnkOvCElecLim_f32 "母线电流电动过流故障阈值" VALUE 0x0000 /* @ECU_Address@CAL_TpcSmp_iDcLnkOvCElecLim_f32@ */ Scalar_FLOAT32_IEEE 0 SWC_TPC_CM_single -3.4E+38 3.4E+38 /end CHARACTERISTIC
/begin CHARACTERISTIC CAL_TpcSmp_iDcLnkOvCGenLim_f32 "母线电流发电过流故障阈值" VALUE 0x0000 /* @ECU_Address@CAL_TpcSmp_iDcLnkOvCGenLim_f32@ */ Scalar_FLOAT32_IEEE 0 SWC_TPC_CM_single -3.4E+38 3.4E+38 /end CHARACTERISTIC
/begin CHARACTERISTIC CAL_TpcSmp_uDcLnkMaxMax_f32 "电池允许最大电压最大值" VALUE 0x0000 /* @ECU_Address@CAL_TpcSmp_uDcLnkMaxMax_f32@ */ Scalar_FLOAT32_IEEE 0 SWC_TPC_CM_single -3.4E+38 3.4E+38 /end CHARACTERISTIC
/begin CHARACTERISTIC CAL_TpcSmp_uDcLnkMaxMin_f32 "电池允许最大电压最小值" VALUE 0x0000 /* @ECU_Address@CAL_TpcSmp_uDcLnkMaxMin_f32@ */ Scalar_FLOAT32_IEEE 0 SWC_TPC_CM_single -3.4E+38 3.4E+38 /end CHARACTERISTIC
/begin CHARACTERISTIC CAL_TpcSmp_uDcLnkMinMax_f32 "电池允许最小电压最大值" VALUE 0x0000 /* @ECU_Address@CAL_TpcSmp_uDcLnkMinMax_f32@ */ Scalar_FLOAT32_IEEE 0 SWC_TPC_CM_single -3.4E+38 3.4E+38 /end CHARACTERISTIC
/begin CHARACTERISTIC CAL_TpcSmp_uDcLnkMinMin_f32 "电池允许最小电压最小值" VALUE 0x0000 /* @ECU_Address@CAL_TpcSmp_uDcLnkMinMin_f32@ */ Scalar_FLOAT32_IEEE 0 SWC_TPC_CM_single -3.4E+38 3.4E+38 /end CHARACTERISTIC
/begin CHARACTERISTIC CAL_TpcSmp_uDcLnkOvVLim_f32 "母线电压过压故障阈值" VALUE 0x0000 /* @ECU_Address@CAL_TpcSmp_uDcLnkOvVLim_f32@ */ Scalar_FLOAT32_IEEE 0 SWC_TPC_CM_single -3.4E+38 3.4E+38 /end CHARACTERISTIC
/begin CHARACTERISTIC CAL_TpcSmp_uDcLnkUnVLim_f32 "母线电压欠压故障阈值" VALUE 0x0000 /* @ECU_Address@CAL_TpcSmp_uDcLnkUnVLim_f32@ */ Scalar_FLOAT32_IEEE 0 SWC_TPC_CM_single -3.4E+38 3.4E+38 /end CHARACTERISTIC
/begin CHARACTERISTIC CAL_TpcTmp_CoolChgTempDownDiff_f32 "" VALUE 0x0000 /* @ECU_Address@CAL_TpcTmp_CoolChgTempDownDiff_f32@ */ Scalar_FLOAT32_IEEE 0 SWC_TPC_CM_single -3.4E+38 3.4E+38 /end CHARACTERISTIC
/begin CHARACTERISTIC CAL_TpcTmp_CoolChgTempUpDiff_f32 "" VALUE 0x0000 /* @ECU_Address@CAL_TpcTmp_CoolChgTempUpDiff_f32@ */ Scalar_FLOAT32_IEEE 0 SWC_TPC_CM_single -3.4E+38 3.4E+38 /end CHARACTERISTIC
/begin CHARACTERISTIC CAL_TpcTmp_CoolTempAdds_f32 "" VALUE 0x0000 /* @ECU_Address@CAL_TpcTmp_CoolTempAdds_f32@ */ Scalar_FLOAT32_IEEE 0 SWC_TPC_CM_single -3.4E+38 3.4E+38 /end CHARACTERISTIC
/begin CHARACTERISTIC CAL_TpcTmp_CoolTempDecDiff_f32 "" VALUE 0x0000 /* @ECU_Address@CAL_TpcTmp_CoolTempDecDiff_f32@ */ Scalar_FLOAT32_IEEE 0 SWC_TPC_CM_single -3.4E+38 3.4E+38 /end CHARACTERISTIC
/begin CHARACTERISTIC CAL_TpcTmp_CoolTempKp_f32 "" VALUE 0x0000 /* @ECU_Address@CAL_TpcTmp_CoolTempKp_f32@ */ Scalar_FLOAT32_IEEE 0 SWC_TPC_CM_single -3.4E+38 3.4E+38 /end CHARACTERISTIC
/begin CHARACTERISTIC CAL_TpcTmp_CoolTempMinus_f32 "" VALUE 0x0000 /* @ECU_Address@CAL_TpcTmp_CoolTempMinus_f32@ */ Scalar_FLOAT32_IEEE 0 SWC_TPC_CM_single -3.4E+38 3.4E+38 /end CHARACTERISTIC
/begin CHARACTERISTIC CAL_TpcTmp_CoolTempRiseDiff_f32 "" VALUE 0x0000 /* @ECU_Address@CAL_TpcTmp_CoolTempRiseDiff_f32@ */ Scalar_FLOAT32_IEEE 0 SWC_TPC_CM_single -3.4E+38 3.4E+38 /end CHARACTERISTIC
/begin CHARACTERISTIC CAL_TpcTmp_DBCRiseTempAdds_f32 "" VALUE 0x0000 /* @ECU_Address@CAL_TpcTmp_DBCRiseTempAdds_f32@ */ Scalar_FLOAT32_IEEE 0 SWC_TPC_CM_single -3.4E+38 3.4E+38 /end CHARACTERISTIC
/begin CHARACTERISTIC CAL_TpcTmp_DBCRiseTempDecDiff_f32 "" VALUE 0x0000 /* @ECU_Address@CAL_TpcTmp_DBCRiseTempDecDiff_f32@ */ Scalar_FLOAT32_IEEE 0 SWC_TPC_CM_single -3.4E+38 3.4E+38 /end CHARACTERISTIC
/begin CHARACTERISTIC CAL_TpcTmp_DBCRiseTempKp_f32 "" VALUE 0x0000 /* @ECU_Address@CAL_TpcTmp_DBCRiseTempKp_f32@ */ Scalar_FLOAT32_IEEE 0 SWC_TPC_CM_single -3.4E+38 3.4E+38 /end CHARACTERISTIC
/begin CHARACTERISTIC CAL_TpcTmp_DBCRiseTempMinus_f32 "" VALUE 0x0000 /* @ECU_Address@CAL_TpcTmp_DBCRiseTempMinus_f32@ */ Scalar_FLOAT32_IEEE 0 SWC_TPC_CM_single -3.4E+38 3.4E+38 /end CHARACTERISTIC
/begin CHARACTERISTIC CAL_TpcTmp_DBCRiseTempRiseDiff_f32 "" VALUE 0x0000 /* @ECU_Address@CAL_TpcTmp_DBCRiseTempRiseDiff_f32@ */ Scalar_FLOAT32_IEEE 0 SWC_TPC_CM_single -3.4E+38 3.4E+38 /end CHARACTERISTIC
/begin CHARACTERISTIC CAL_TpcTmp_DBCTempAdds_f32 "" VALUE 0x0000 /* @ECU_Address@CAL_TpcTmp_DBCTempAdds_f32@ */ Scalar_FLOAT32_IEEE 0 SWC_TPC_CM_single -3.4E+38 3.4E+38 /end CHARACTERISTIC
/begin CHARACTERISTIC CAL_TpcTmp_DBCTempDecDiff_f32 "" VALUE 0x0000 /* @ECU_Address@CAL_TpcTmp_DBCTempDecDiff_f32@ */ Scalar_FLOAT32_IEEE 0 SWC_TPC_CM_single -3.4E+38 3.4E+38 /end CHARACTERISTIC
/begin CHARACTERISTIC CAL_TpcTmp_DBCTempKp_f32 "" VALUE 0x0000 /* @ECU_Address@CAL_TpcTmp_DBCTempKp_f32@ */ Scalar_FLOAT32_IEEE 0 SWC_TPC_CM_single -3.4E+38 3.4E+38 /end CHARACTERISTIC
/begin CHARACTERISTIC CAL_TpcTmp_DBCTempMinus_f32 "" VALUE 0x0000 /* @ECU_Address@CAL_TpcTmp_DBCTempMinus_f32@ */ Scalar_FLOAT32_IEEE 0 SWC_TPC_CM_single -3.4E+38 3.4E+38 /end CHARACTERISTIC
/begin CHARACTERISTIC CAL_TpcTmp_DBCTempRiseDiff_f32 "" VALUE 0x0000 /* @ECU_Address@CAL_TpcTmp_DBCTempRiseDiff_f32@ */ Scalar_FLOAT32_IEEE 0 SWC_TPC_CM_single -3.4E+38 3.4E+38 /end CHARACTERISTIC
/begin CHARACTERISTIC CAL_TpcTmp_DbcChgTempDownDiff_f32 "" VALUE 0x0000 /* @ECU_Address@CAL_TpcTmp_DbcChgTempDownDiff_f32@ */ Scalar_FLOAT32_IEEE 0 SWC_TPC_CM_single -3.4E+38 3.4E+38 /end CHARACTERISTIC
/begin CHARACTERISTIC CAL_TpcTmp_DbcChgTempUpDiff_f32 "" VALUE 0x0000 /* @ECU_Address@CAL_TpcTmp_DbcChgTempUpDiff_f32@ */ Scalar_FLOAT32_IEEE 0 SWC_TPC_CM_single -3.4E+38 3.4E+38 /end CHARACTERISTIC
/begin CHARACTERISTIC CAL_TpcTmp_DbcRiseChgTempDownDiff_f32 "" VALUE 0x0000 /* @ECU_Address@CAL_TpcTmp_DbcRiseChgTempDownDiff_f32@ */ Scalar_FLOAT32_IEEE 0 SWC_TPC_CM_single -3.4E+38 3.4E+38 /end CHARACTERISTIC
/begin CHARACTERISTIC CAL_TpcTmp_DbcRiseChgTempUpDiff_f32 "" VALUE 0x0000 /* @ECU_Address@CAL_TpcTmp_DbcRiseChgTempUpDiff_f32@ */ Scalar_FLOAT32_IEEE 0 SWC_TPC_CM_single -3.4E+38 3.4E+38 /end CHARACTERISTIC
/begin CHARACTERISTIC CAL_TpcTmp_IGBRiseTTempAdds_f32 "" VALUE 0x0000 /* @ECU_Address@CAL_TpcTmp_IGBRiseTTempAdds_f32@ */ Scalar_FLOAT32_IEEE 0 SWC_TPC_CM_single -3.4E+38 3.4E+38 /end CHARACTERISTIC
/begin CHARACTERISTIC CAL_TpcTmp_IGBTRiseTempDecDiff_f32 "" VALUE 0x0000 /* @ECU_Address@CAL_TpcTmp_IGBTRiseTempDecDiff_f32@ */ Scalar_FLOAT32_IEEE 0 SWC_TPC_CM_single -3.4E+38 3.4E+38 /end CHARACTERISTIC
/begin CHARACTERISTIC CAL_TpcTmp_IGBTRiseTempKp_f32 "" VALUE 0x0000 /* @ECU_Address@CAL_TpcTmp_IGBTRiseTempKp_f32@ */ Scalar_FLOAT32_IEEE 0 SWC_TPC_CM_single -3.4E+38 3.4E+38 /end CHARACTERISTIC
/begin CHARACTERISTIC CAL_TpcTmp_IGBTRiseTempMinus_f32 "" VALUE 0x0000 /* @ECU_Address@CAL_TpcTmp_IGBTRiseTempMinus_f32@ */ Scalar_FLOAT32_IEEE 0 SWC_TPC_CM_single -3.4E+38 3.4E+38 /end CHARACTERISTIC
/begin CHARACTERISTIC CAL_TpcTmp_IGBTRiseTempRiseDiff_f32 "" VALUE 0x0000 /* @ECU_Address@CAL_TpcTmp_IGBTRiseTempRiseDiff_f32@ */ Scalar_FLOAT32_IEEE 0 SWC_TPC_CM_single -3.4E+38 3.4E+38 /end CHARACTERISTIC
/begin CHARACTERISTIC CAL_TpcTmp_IGBTTempAdds_f32 "" VALUE 0x0000 /* @ECU_Address@CAL_TpcTmp_IGBTTempAdds_f32@ */ Scalar_FLOAT32_IEEE 0 SWC_TPC_CM_single -3.4E+38 3.4E+38 /end CHARACTERISTIC
/begin CHARACTERISTIC CAL_TpcTmp_IGBTTempDecDiff_f32 "" VALUE 0x0000 /* @ECU_Address@CAL_TpcTmp_IGBTTempDecDiff_f32@ */ Scalar_FLOAT32_IEEE 0 SWC_TPC_CM_single -3.4E+38 3.4E+38 /end CHARACTERISTIC
/begin CHARACTERISTIC CAL_TpcTmp_IGBTTempKp_f32 "" VALUE 0x0000 /* @ECU_Address@CAL_TpcTmp_IGBTTempKp_f32@ */ Scalar_FLOAT32_IEEE 0 SWC_TPC_CM_single -3.4E+38 3.4E+38 /end CHARACTERISTIC
/begin CHARACTERISTIC CAL_TpcTmp_IGBTTempMinus_f32 "" VALUE 0x0000 /* @ECU_Address@CAL_TpcTmp_IGBTTempMinus_f32@ */ Scalar_FLOAT32_IEEE 0 SWC_TPC_CM_single -3.4E+38 3.4E+38 /end CHARACTERISTIC
/begin CHARACTERISTIC CAL_TpcTmp_IGBTTempRiseDiff_f32 "" VALUE 0x0000 /* @ECU_Address@CAL_TpcTmp_IGBTTempRiseDiff_f32@ */ Scalar_FLOAT32_IEEE 0 SWC_TPC_CM_single -3.4E+38 3.4E+38 /end CHARACTERISTIC
/begin CHARACTERISTIC CAL_TpcTmp_IgbtChgTempDownDiff_f32 "" VALUE 0x0000 /* @ECU_Address@CAL_TpcTmp_IgbtChgTempDownDiff_f32@ */ Scalar_FLOAT32_IEEE 0 SWC_TPC_CM_single -3.4E+38 3.4E+38 /end CHARACTERISTIC
/begin CHARACTERISTIC CAL_TpcTmp_IgbtChgTempUpDiff_f32 "" VALUE 0x0000 /* @ECU_Address@CAL_TpcTmp_IgbtChgTempUpDiff_f32@ */ Scalar_FLOAT32_IEEE 0 SWC_TPC_CM_single -3.4E+38 3.4E+38 /end CHARACTERISTIC
/begin CHARACTERISTIC CAL_TpcTmp_IgbtRiseChgTempDownDiff_f32 "" VALUE 0x0000 /* @ECU_Address@CAL_TpcTmp_IgbtRiseChgTempDownDiff_f32@ */ Scalar_FLOAT32_IEEE 0 SWC_TPC_CM_single -3.4E+38 3.4E+38 /end CHARACTERISTIC
/begin CHARACTERISTIC CAL_TpcTmp_IgbtRiseChgTempUpDiff_f32 "" VALUE 0x0000 /* @ECU_Address@CAL_TpcTmp_IgbtRiseChgTempUpDiff_f32@ */ Scalar_FLOAT32_IEEE 0 SWC_TPC_CM_single -3.4E+38 3.4E+38 /end CHARACTERISTIC
/begin CHARACTERISTIC CAL_TpcTmp_tCoolantTraNormalToSave1_f32 "" VALUE 0x0000 /* @ECU_Address@CAL_TpcTmp_tCoolantTraNormalToSave1_f32@ */ Scalar_FLOAT32_IEEE 0 SWC_TPC_CM_single -3.4E+38 3.4E+38 /end CHARACTERISTIC
/begin CHARACTERISTIC CAL_TpcTmp_tCoolantTraSave1ToNormal_f32 "" VALUE 0x0000 /* @ECU_Address@CAL_TpcTmp_tCoolantTraSave1ToNormal_f32@ */ Scalar_FLOAT32_IEEE 0 SWC_TPC_CM_single -3.4E+38 3.4E+38 /end CHARACTERISTIC
/begin CHARACTERISTIC CAL_TpcTmp_tCoolantTraSave1ToSave2_f32 "" VALUE 0x0000 /* @ECU_Address@CAL_TpcTmp_tCoolantTraSave1ToSave2_f32@ */ Scalar_FLOAT32_IEEE 0 SWC_TPC_CM_single -3.4E+38 3.4E+38 /end CHARACTERISTIC
/begin CHARACTERISTIC CAL_TpcTmp_tCoolantTraSave2ToOverheating_f32 "" VALUE 0x0000 /* @ECU_Address@CAL_TpcTmp_tCoolantTraSave2ToOverheating_f32@ */ Scalar_FLOAT32_IEEE 0 SWC_TPC_CM_single -3.4E+38 3.4E+38 /end CHARACTERISTIC
/begin CHARACTERISTIC CAL_TpcTmp_tDBCTrqLimRamp_f32 "" VALUE 0x0000 /* @ECU_Address@CAL_TpcTmp_tDBCTrqLimRamp_f32@ */ Scalar_FLOAT32_IEEE 0 SWC_TPC_CM_single -3.4E+38 3.4E+38 /end CHARACTERISTIC
/begin CHARACTERISTIC CAL_TpcTmp_tDbcTempUHiLim_f32 "U相温度超高限" VALUE 0x0000 /* @ECU_Address@CAL_TpcTmp_tDbcTempUHiLim_f32@ */ Scalar_FLOAT32_IEEE 0 SWC_TPC_CM_single -3.4E+38 3.4E+38 /end CHARACTERISTIC
/begin CHARACTERISTIC CAL_TpcTmp_tDbcTempULoLim_f32 "U相温度超低限" VALUE 0x0000 /* @ECU_Address@CAL_TpcTmp_tDbcTempULoLim_f32@ */ Scalar_FLOAT32_IEEE 0 SWC_TPC_CM_single -3.4E+38 3.4E+38 /end CHARACTERISTIC
/begin CHARACTERISTIC CAL_TpcTmp_tDbcTempVHiLim_f32 "V相温度超高限" VALUE 0x0000 /* @ECU_Address@CAL_TpcTmp_tDbcTempVHiLim_f32@ */ Scalar_FLOAT32_IEEE 0 SWC_TPC_CM_single -3.4E+38 3.4E+38 /end CHARACTERISTIC
/begin CHARACTERISTIC CAL_TpcTmp_tDbcTempVLoLim_f32 "V相温度超低限" VALUE 0x0000 /* @ECU_Address@CAL_TpcTmp_tDbcTempVLoLim_f32@ */ Scalar_FLOAT32_IEEE 0 SWC_TPC_CM_single -3.4E+38 3.4E+38 /end CHARACTERISTIC
/begin CHARACTERISTIC CAL_TpcTmp_tDbcTempWHiLim_f32 "W相温度超高限" VALUE 0x0000 /* @ECU_Address@CAL_TpcTmp_tDbcTempWHiLim_f32@ */ Scalar_FLOAT32_IEEE 0 SWC_TPC_CM_single -3.4E+38 3.4E+38 /end CHARACTERISTIC
/begin CHARACTERISTIC CAL_TpcTmp_tDbcTempWLoLim_f32 "W相温度超低限" VALUE 0x0000 /* @ECU_Address@CAL_TpcTmp_tDbcTempWLoLim_f32@ */ Scalar_FLOAT32_IEEE 0 SWC_TPC_CM_single -3.4E+38 3.4E+38 /end CHARACTERISTIC
/begin CHARACTERISTIC CAL_TpcTmp_tDbcThrPhLoLim_f32 "DBC温度过低报警阈值" VALUE 0x0000 /* @ECU_Address@CAL_TpcTmp_tDbcThrPhLoLim_f32@ */ Scalar_FLOAT32_IEEE 0 SWC_TPC_CM_single -3.4E+38 3.4E+38 /end CHARACTERISTIC
/begin CHARACTERISTIC CAL_TpcTmp_tDbcTraNormalToSave1_f32 "" VALUE 0x0000 /* @ECU_Address@CAL_TpcTmp_tDbcTraNormalToSave1_f32@ */ Scalar_FLOAT32_IEEE 0 SWC_TPC_CM_single -3.4E+38 3.4E+38 /end CHARACTERISTIC
/begin CHARACTERISTIC CAL_TpcTmp_tDbcTraSave1ToNormal_f32 "" VALUE 0x0000 /* @ECU_Address@CAL_TpcTmp_tDbcTraSave1ToNormal_f32@ */ Scalar_FLOAT32_IEEE 0 SWC_TPC_CM_single -3.4E+38 3.4E+38 /end CHARACTERISTIC
/begin CHARACTERISTIC CAL_TpcTmp_tDbcTraSave1ToSave2_f32 "" VALUE 0x0000 /* @ECU_Address@CAL_TpcTmp_tDbcTraSave1ToSave2_f32@ */ Scalar_FLOAT32_IEEE 0 SWC_TPC_CM_single -3.4E+38 3.4E+38 /end CHARACTERISTIC
/begin CHARACTERISTIC CAL_TpcTmp_tDbcTraSave2ToOverheating_f32 "" VALUE 0x0000 /* @ECU_Address@CAL_TpcTmp_tDbcTraSave2ToOverheating_f32@ */ Scalar_FLOAT32_IEEE 0 SWC_TPC_CM_single -3.4E+38 3.4E+38 /end CHARACTERISTIC
/begin CHARACTERISTIC CAL_TpcTmp_tIGBTTempHiLim_f32 "" VALUE 0x0000 /* @ECU_Address@CAL_TpcTmp_tIGBTTempHiLim_f32@ */ Scalar_FLOAT32_IEEE 0 SWC_TPC_CM_single -3.4E+38 3.4E+38 /end CHARACTERISTIC
/begin CHARACTERISTIC CAL_TpcTmp_tIGBTTempLoLim_f32 "" VALUE 0x0000 /* @ECU_Address@CAL_TpcTmp_tIGBTTempLoLim_f32@ */ Scalar_FLOAT32_IEEE 0 SWC_TPC_CM_single -3.4E+38 3.4E+38 /end CHARACTERISTIC
/begin CHARACTERISTIC CAL_TpcTmp_tIGBTTraNormalToSave1_f32 "" VALUE 0x0000 /* @ECU_Address@CAL_TpcTmp_tIGBTTraNormalToSave1_f32@ */ Scalar_FLOAT32_IEEE 0 SWC_TPC_CM_single -3.4E+38 3.4E+38 /end CHARACTERISTIC
/begin CHARACTERISTIC CAL_TpcTmp_tIGBTTraSave1ToNormal_f32 "" VALUE 0x0000 /* @ECU_Address@CAL_TpcTmp_tIGBTTraSave1ToNormal_f32@ */ Scalar_FLOAT32_IEEE 0 SWC_TPC_CM_single -3.4E+38 3.4E+38 /end CHARACTERISTIC
/begin CHARACTERISTIC CAL_TpcTmp_tIGBTTraSave1ToSave2_f32 "" VALUE 0x0000 /* @ECU_Address@CAL_TpcTmp_tIGBTTraSave1ToSave2_f32@ */ Scalar_FLOAT32_IEEE 0 SWC_TPC_CM_single -3.4E+38 3.4E+38 /end CHARACTERISTIC
/begin CHARACTERISTIC CAL_TpcTmp_tIGBTTraSave2ToOverheating_f32 "" VALUE 0x0000 /* @ECU_Address@CAL_TpcTmp_tIGBTTraSave2ToOverheating_f32@ */ Scalar_FLOAT32_IEEE 0 SWC_TPC_CM_single -3.4E+38 3.4E+38 /end CHARACTERISTIC
/begin CHARACTERISTIC CAL_TpcTmp_tIGBTTrqLimRamp_f32 "" VALUE 0x0000 /* @ECU_Address@CAL_TpcTmp_tIGBTTrqLimRamp_f32@ */ Scalar_FLOAT32_IEEE 0 SWC_TPC_CM_single -3.4E+38 3.4E+38 /end CHARACTERISTIC
/begin CHARACTERISTIC CAL_TpcTmp_tRiseDbcTraNormalToSave1_f32 "" VALUE 0x0000 /* @ECU_Address@CAL_TpcTmp_tRiseDbcTraNormalToSave1_f32@ */ Scalar_FLOAT32_IEEE 0 SWC_TPC_CM_single -3.4E+38 3.4E+38 /end CHARACTERISTIC
/begin CHARACTERISTIC CAL_TpcTmp_tRiseDbcTraSave1ToNormal_f32 "" VALUE 0x0000 /* @ECU_Address@CAL_TpcTmp_tRiseDbcTraSave1ToNormal_f32@ */ Scalar_FLOAT32_IEEE 0 SWC_TPC_CM_single -3.4E+38 3.4E+38 /end CHARACTERISTIC
/begin CHARACTERISTIC CAL_TpcTmp_tRiseDbcTraSave1ToSave2_f32 "" VALUE 0x0000 /* @ECU_Address@CAL_TpcTmp_tRiseDbcTraSave1ToSave2_f32@ */ Scalar_FLOAT32_IEEE 0 SWC_TPC_CM_single -3.4E+38 3.4E+38 /end CHARACTERISTIC
/begin CHARACTERISTIC CAL_TpcTmp_tRiseDbcTraSave2ToOverheating_f32 "" VALUE 0x0000 /* @ECU_Address@CAL_TpcTmp_tRiseDbcTraSave2ToOverheating_f32@ */ Scalar_FLOAT32_IEEE 0 SWC_TPC_CM_single -3.4E+38 3.4E+38 /end CHARACTERISTIC
/begin CHARACTERISTIC CAL_TpcTmp_tRiseIGBTTraNormalToSave1_f32 "" VALUE 0x0000 /* @ECU_Address@CAL_TpcTmp_tRiseIGBTTraNormalToSave1_f32@ */ Scalar_FLOAT32_IEEE 0 SWC_TPC_CM_single -3.4E+38 3.4E+38 /end CHARACTERISTIC
/begin CHARACTERISTIC CAL_TpcTmp_tRiseIGBTTraSave1ToNormal_f32 "" VALUE 0x0000 /* @ECU_Address@CAL_TpcTmp_tRiseIGBTTraSave1ToNormal_f32@ */ Scalar_FLOAT32_IEEE 0 SWC_TPC_CM_single -3.4E+38 3.4E+38 /end CHARACTERISTIC
/begin CHARACTERISTIC CAL_TpcTmp_tRiseIGBTTraSave1ToSave2_f32 "" VALUE 0x0000 /* @ECU_Address@CAL_TpcTmp_tRiseIGBTTraSave1ToSave2_f32@ */ Scalar_FLOAT32_IEEE 0 SWC_TPC_CM_single -3.4E+38 3.4E+38 /end CHARACTERISTIC
/begin CHARACTERISTIC CAL_TpcTmp_tRiseIGBTTraSave2ToOverheating_f32 "" VALUE 0x0000 /* @ECU_Address@CAL_TpcTmp_tRiseIGBTTraSave2ToOverheating_f32@ */ Scalar_FLOAT32_IEEE 0 SWC_TPC_CM_single -3.4E+38 3.4E+38 /end CHARACTERISTIC
/begin CHARACTERISTIC CAL_Tpc_TrqReduceRevStep_f32 "" VALUE 0x0000 /* @ECU_Address@CAL_Tpc_TrqReduceRevStep_f32@ */ Scalar_FLOAT32_IEEE 0 SWC_TPC_CM_single -3.4E+38 3.4E+38 /end CHARACTERISTIC
/begin CHARACTERISTIC CAL_Tpc_TrqRevStep_f32 "扭矩限值恢复slop" VALUE 0x0000 /* @ECU_Address@CAL_Tpc_TrqRevStep_f32@ */ Scalar_FLOAT32_IEEE 0 SWC_TPC_CM_single -3.4E+38 3.4E+38 /end CHARACTERISTIC
/begin CHARACTERISTIC CAL_Tpc_TrqRiseRevStep_f32 "" VALUE 0x0000 /* @ECU_Address@CAL_Tpc_TrqRiseRevStep_f32@ */ Scalar_FLOAT32_IEEE 0 SWC_TPC_CM_single -3.4E+38 3.4E+38 /end CHARACTERISTIC
/begin CHARACTERISTIC CAL_Tpcmot_TrqDiffExc_f32 "" VALUE 0x0000 /* @ECU_Address@CAL_Tpcmot_TrqDiffExc_f32@ */ Scalar_FLOAT32_IEEE 0 SWC_TPC_CM_single -3.4E+38 3.4E+38 /end CHARACTERISTIC
/begin CHARACTERISTIC CAL_Tpcmot_TrqDiffGen_f32 "" VALUE 0x0000 /* @ECU_Address@CAL_Tpcmot_TrqDiffGen_f32@ */ Scalar_FLOAT32_IEEE 0 SWC_TPC_CM_single -3.4E+38 3.4E+38 /end CHARACTERISTIC
/begin CHARACTERISTIC CAL_Tpcmot_uDcHiset_f32 "" VALUE 0x0000 /* @ECU_Address@CAL_Tpcmot_uDcHiset_f32@ */ Scalar_FLOAT32_IEEE 0 SWC_TPC_CM_single -3.4E+38 3.4E+38 /end CHARACTERISTIC
/begin CHARACTERISTIC CAL_Tpcmot_uDcLoset_f32 "" VALUE 0x0000 /* @ECU_Address@CAL_Tpcmot_uDcLoset_f32@ */ Scalar_FLOAT32_IEEE 0 SWC_TPC_CM_single -3.4E+38 3.4E+38 /end CHARACTERISTIC
/begin CHARACTERISTIC CAL_TpcBlk_BlkRevTimSet_u16 "" VALUE 0x0000 /* @ECU_Address@CAL_TpcBlk_BlkRevTimSet_u16@ */ Scalar_UWORD 0 SWC_TPC_CM_uint16 0 65535 /end CHARACTERISTIC
/begin CHARACTERISTIC CAL_TpcBlk_BlkTimSet_u16 "" VALUE 0x0000 /* @ECU_Address@CAL_TpcBlk_BlkTimSet_u16@ */ Scalar_UWORD 0 SWC_TPC_CM_uint16 0 65535 /end CHARACTERISTIC
/begin CHARACTERISTIC CAL_TpcCod_CntHysteresislop_u16 "" VALUE 0x0000 /* @ECU_Address@CAL_TpcCod_CntHysteresislop_u16@ */ Scalar_UWORD 0 SWC_TPC_CM_uint16 0 65535 /end CHARACTERISTIC
/begin CHARACTERISTIC CAL_TpcBlk_flgEnBlkFun_b "" VALUE 0x0000 /* @ECU_Address@CAL_TpcBlk_flgEnBlkFun_b@ */ Scalar_BOOLEAN 0 SWC_TPC_CM_boolean 0 1 /end CHARACTERISTIC
/begin CHARACTERISTIC CAL_TpcCod_FlgUseTrqLimRampSet_b "" VALUE 0x0000 /* @ECU_Address@CAL_TpcCod_FlgUseTrqLimRampSet_b@ */ Scalar_BOOLEAN 0 SWC_TPC_CM_boolean 0 1 /end CHARACTERISTIC
/begin CHARACTERISTIC CAL_TpcCod_IGBTSampErr_b "" VALUE 0x0000 /* @ECU_Address@CAL_TpcCod_IGBTSampErr_b@ */ Scalar_BOOLEAN 0 SWC_TPC_CM_boolean 0 1 /end CHARACTERISTIC
/begin CHARACTERISTIC CAL_TpcCod_MotorSampErr_b "" VALUE 0x0000 /* @ECU_Address@CAL_TpcCod_MotorSampErr_b@ */ Scalar_BOOLEAN 0 SWC_TPC_CM_boolean 0 1 /end CHARACTERISTIC
/begin CHARACTERISTIC CAL_TpcCod_MotorStallWarn_b "" VALUE 0x0000 /* @ECU_Address@CAL_TpcCod_MotorStallWarn_b@ */ Scalar_BOOLEAN 0 SWC_TPC_CM_boolean 0 1 /end CHARACTERISTIC
/begin CHARACTERISTIC CAL_TpcMot_flgPwrRefSwt_b "使用外特性功率标志-tpcmot" VALUE 0x0000 /* @ECU_Address@CAL_TpcMot_flgPwrRefSwt_b@ */ Scalar_BOOLEAN 0 SWC_TPC_CM_boolean 0 1 /end CHARACTERISTIC
/begin CHARACTERISTIC CAL_TpcMot_flgTrqRefSwt_b "使用外特性扭矩标志-tpcmot" VALUE 0x0000 /* @ECU_Address@CAL_TpcMot_flgTrqRefSwt_b@ */ Scalar_BOOLEAN 0 SWC_TPC_CM_boolean 0 1 /end CHARACTERISTIC
/begin CHARACTERISTIC CAL_TpcSmp_CurtModeSelc_b "" VALUE 0x0000 /* @ECU_Address@CAL_TpcSmp_CurtModeSelc_b@ */ Scalar_BOOLEAN 0 SWC_TPC_CM_boolean 0 1 /end CHARACTERISTIC
/begin CHARACTERISTIC CAL_TpcSmp_flgUsePwrLossGen_b "" VALUE 0x0000 /* @ECU_Address@CAL_TpcSmp_flgUsePwrLossGen_b@ */ Scalar_BOOLEAN 0 SWC_TPC_CM_boolean 0 1 /end CHARACTERISTIC
/begin CHARACTERISTIC CAL_TpcSmp_flgUsePwrLoss_b "" VALUE 0x0000 /* @ECU_Address@CAL_TpcSmp_flgUsePwrLoss_b@ */ Scalar_BOOLEAN 0 SWC_TPC_CM_boolean 0 1 /end CHARACTERISTIC
/begin CHARACTERISTIC CAL_Tpcmot_flgOpenExcLimRamp_b "" VALUE 0x0000 /* @ECU_Address@CAL_Tpcmot_flgOpenExcLimRamp_b@ */ Scalar_BOOLEAN 0 SWC_TPC_CM_boolean 0 1 /end CHARACTERISTIC
/begin CHARACTERISTIC CAL_TpcSmp_CntElecOvrCurt_u8 "电动过流derating触发标志Debounce模块计数" VALUE 0x0000 /* @ECU_Address@CAL_TpcSmp_CntElecOvrCurt_u8@ */ Scalar_UBYTE 0 SWC_TPC_CM_uint8 0 255 /end CHARACTERISTIC
/begin CHARACTERISTIC CAL_TpcSmp_CntElecUdrVolt_u8 "电动欠压derating触发标志Debounce模块计数" VALUE 0x0000 /* @ECU_Address@CAL_TpcSmp_CntElecUdrVolt_u8@ */ Scalar_UBYTE 0 SWC_TPC_CM_uint8 0 255 /end CHARACTERISTIC
/begin CHARACTERISTIC CAL_TpcSmp_CntGenOvrCurt_u8 "发电过流derating触发标志Debounce模块计数" VALUE 0x0000 /* @ECU_Address@CAL_TpcSmp_CntGenOvrCurt_u8@ */ Scalar_UBYTE 0 SWC_TPC_CM_uint8 0 255 /end CHARACTERISTIC
/begin CHARACTERISTIC CAL_TpcSmp_CntGenOvrVolt_u8 "发电过压derating触发标志Debounce模块计数" VALUE 0x0000 /* @ECU_Address@CAL_TpcSmp_CntGenOvrVolt_u8@ */ Scalar_UBYTE 0 SWC_TPC_CM_uint8 0 255 /end CHARACTERISTIC
/begin CHARACTERISTIC CAL_TpcSmp_FacElecOvrCurt_u8 "电动过流derating触发标志Debounce模块系数" VALUE 0x0000 /* @ECU_Address@CAL_TpcSmp_FacElecOvrCurt_u8@ */ Scalar_UBYTE 0 SWC_TPC_CM_uint8 0 255 /end CHARACTERISTIC
/begin CHARACTERISTIC CAL_TpcSmp_FacElecUdrVolt_u8 "电动欠压derating触发标志Debounce模块系数" VALUE 0x0000 /* @ECU_Address@CAL_TpcSmp_FacElecUdrVolt_u8@ */ Scalar_UBYTE 0 SWC_TPC_CM_uint8 0 255 /end CHARACTERISTIC
/begin CHARACTERISTIC CAL_TpcSmp_FacGenOvrCurt_u8 "发电过流derating触发标志Debounce模块系数" VALUE 0x0000 /* @ECU_Address@CAL_TpcSmp_FacGenOvrCurt_u8@ */ Scalar_UBYTE 0 SWC_TPC_CM_uint8 0 255 /end CHARACTERISTIC
/begin CHARACTERISTIC CAL_TpcSmp_FacGenOvrVolt_u8 "发电过压derating触发标志Debounce模块系数" VALUE 0x0000 /* @ECU_Address@CAL_TpcSmp_FacGenOvrVolt_u8@ */ Scalar_UBYTE 0 SWC_TPC_CM_uint8 0 255 /end CHARACTERISTIC
/begin CHARACTERISTIC CAL_TpcSmp_nCtlExtReq_u8 "VCU请求外部速度环控制" VALUE 0x0000 /* @ECU_Address@CAL_TpcSmp_nCtlExtReq_u8@ */ Scalar_UBYTE 0 SWC_TPC_CM_uint8 0 255 /end CHARACTERISTIC
/begin CHARACTERISTIC CAL_TpcSmp_nCtlIntReq_u8 "VCU请求内部速度环控制" VALUE 0x0000 /* @ECU_Address@CAL_TpcSmp_nCtlIntReq_u8@ */ Scalar_UBYTE 0 SWC_TPC_CM_uint8 0 255 /end CHARACTERISTIC
/begin CHARACTERISTIC CAL_Tpc_NormalMode_u8 "" VALUE 0x0000 /* @ECU_Address@CAL_Tpc_NormalMode_u8@ */ Scalar_UBYTE 0 SWC_TPC_CM_uint8 0 255 /end CHARACTERISTIC
/begin CHARACTERISTIC CAL_Tpc_OverheatingMode_u8 "" VALUE 0x0000 /* @ECU_Address@CAL_Tpc_OverheatingMode_u8@ */ Scalar_UBYTE 0 SWC_TPC_CM_uint8 0 255 /end CHARACTERISTIC
/begin CHARACTERISTIC CAL_Tpc_Powersave1Mode_u8 "" VALUE 0x0000 /* @ECU_Address@CAL_Tpc_Powersave1Mode_u8@ */ Scalar_UBYTE 0 SWC_TPC_CM_uint8 0 255 /end CHARACTERISTIC
/begin CHARACTERISTIC CAL_Tpc_Powersave2Mode_u8 "" VALUE 0x0000 /* @ECU_Address@CAL_Tpc_Powersave2Mode_u8@ */ Scalar_UBYTE 0 SWC_TPC_CM_uint8 0 255 /end CHARACTERISTIC
/begin CHARACTERISTIC CAL_Tpcmot_CofuDclnk_u8 "" VALUE 0x0000 /* @ECU_Address@CAL_Tpcmot_CofuDclnk_u8@ */ Scalar_UBYTE 0 SWC_TPC_CM_uint8 0 255 /end CHARACTERISTIC
/begin MEASUREMENT VAR_TpcTmp_tCoolantTempFlt_f32 "" FLOAT32_IEEE SWC_TPC_CM_single 0 0 -3.4E+38 3.4E+38 ECU_ADDRESS 0x0000 /* @ECU_Address@VAR_TpcTmp_tCoolantTempFlt_f32@ */ /end MEASUREMENT
/begin MEASUREMENT VAR_TpcTmp_CofDertTCoolantSave1_f32 "" FLOAT32_IEEE SWC_TPC_CM_single 0 0 -3.4E+38 3.4E+38 ECU_ADDRESS 0x0000 /* @ECU_Address@VAR_TpcTmp_CofDertTCoolantSave1_f32@ */ /end MEASUREMENT
/begin MEASUREMENT VAR_TpcTmp_CofDertTCoolantSave2_f32 "" FLOAT32_IEEE SWC_TPC_CM_single 0 0 -3.4E+38 3.4E+38 ECU_ADDRESS 0x0000 /* @ECU_Address@VAR_TpcTmp_CofDertTCoolantSave2_f32@ */ /end MEASUREMENT
/begin MEASUREMENT VAR_TpcTmp_CofDertTcoolant_f32 "冷却水温度限扭Derating系数" FLOAT32_IEEE SWC_TPC_CM_single 0 0 0.0 1.0 ECU_ADDRESS 0x0000 /* @ECU_Address@VAR_TpcTmp_CofDertTcoolant_f32@ */ /end MEASUREMENT
/begin MEASUREMENT VAR_TpcTmp_tDbcMax_f32 "三相Dbc温度最大值" FLOAT32_IEEE SWC_TPC_CM_single__ 0 0 -3.4E+38 3.4E+38 ECU_ADDRESS 0x0000 /* @ECU_Address@VAR_TpcTmp_tDbcMax_f32@ */ /end MEASUREMENT
/begin MEASUREMENT VAR_TpcTmp_tDbcTempFlt_f32 "" FLOAT32_IEEE SWC_TPC_CM_single 0 0 -3.4E+38 3.4E+38 ECU_ADDRESS 0x0000 /* @ECU_Address@VAR_TpcTmp_tDbcTempFlt_f32@ */ /end MEASUREMENT
/begin MEASUREMENT VAR_TpcTmp_CofDertTDbcSave1_f32 "" FLOAT32_IEEE SWC_TPC_CM_single 0 0 -3.4E+38 3.4E+38 ECU_ADDRESS 0x0000 /* @ECU_Address@VAR_TpcTmp_CofDertTDbcSave1_f32@ */ /end MEASUREMENT
/begin MEASUREMENT VAR_TpcTmp_CofDertTDbcSave2_f32 "" FLOAT32_IEEE SWC_TPC_CM_single 0 0 -3.4E+38 3.4E+38 ECU_ADDRESS 0x0000 /* @ECU_Address@VAR_TpcTmp_CofDertTDbcSave2_f32@ */ /end MEASUREMENT
/begin MEASUREMENT VAR_TpcTmp_CofDertDbc_f32 "" FLOAT32_IEEE SWC_TPC_CM_single 0 0 -3.4E+38 3.4E+38 ECU_ADDRESS 0x0000 /* @ECU_Address@VAR_TpcTmp_CofDertDbc_f32@ */ /end MEASUREMENT
/begin MEASUREMENT VAR_TpcTmp_tRiseDbc_f32 "" FLOAT32_IEEE SWC_TPC_CM_single 0 0 -3.4E+38 3.4E+38 ECU_ADDRESS 0x0000 /* @ECU_Address@VAR_TpcTmp_tRiseDbc_f32@ */ /end MEASUREMENT
/begin MEASUREMENT VAR_TpcTmp_tRiseDbcFlt_f32 "" FLOAT32_IEEE SWC_TPC_CM_single 0 0 -3.4E+38 3.4E+38 ECU_ADDRESS 0x0000 /* @ECU_Address@VAR_TpcTmp_tRiseDbcFlt_f32@ */ /end MEASUREMENT
/begin MEASUREMENT VAR_TpcTmp_CofDertTRiseDbcSave1_f32 "" FLOAT32_IEEE SWC_TPC_CM_single 0 0 -3.4E+38 3.4E+38 ECU_ADDRESS 0x0000 /* @ECU_Address@VAR_TpcTmp_CofDertTRiseDbcSave1_f32@ */ /end MEASUREMENT
/begin MEASUREMENT VAR_TpcTmp_CofDertTRiseDbcSave2_f32 "" FLOAT32_IEEE SWC_TPC_CM_single 0 0 -3.4E+38 3.4E+38 ECU_ADDRESS 0x0000 /* @ECU_Address@VAR_TpcTmp_CofDertTRiseDbcSave2_f32@ */ /end MEASUREMENT
/begin MEASUREMENT VAR_TpcTmp_CofDertTRiseDbc_f32 "" FLOAT32_IEEE SWC_TPC_CM_single 0 0 -3.4E+38 3.4E+38 ECU_ADDRESS 0x0000 /* @ECU_Address@VAR_TpcTmp_CofDertTRiseDbc_f32@ */ /end MEASUREMENT
/begin MEASUREMENT VAR_TpcTmp_CofDertTdrvboard_f32 "驱动板温度限扭Derating系数" FLOAT32_IEEE SWC_TPC_CM_single 0 0 0.0 1.0 ECU_ADDRESS 0x0000 /* @ECU_Address@VAR_TpcTmp_CofDertTdrvboard_f32@ */ /end MEASUREMENT
/begin MEASUREMENT VAR_TpcTmp_tIGBTTempFlt_f32 "" FLOAT32_IEEE SWC_TPC_CM_single 0 0 -3.4E+38 3.4E+38 ECU_ADDRESS 0x0000 /* @ECU_Address@VAR_TpcTmp_tIGBTTempFlt_f32@ */ /end MEASUREMENT
/begin MEASUREMENT VAR_TpcTmp_CofDertTIGBTSave1_f32 "" FLOAT32_IEEE SWC_TPC_CM_single 0 0 -3.4E+38 3.4E+38 ECU_ADDRESS 0x0000 /* @ECU_Address@VAR_TpcTmp_CofDertTIGBTSave1_f32@ */ /end MEASUREMENT
/begin MEASUREMENT VAR_TpcTmp_CofDertTIGBTSave2_f32 "" FLOAT32_IEEE SWC_TPC_CM_single 0 0 -3.4E+38 3.4E+38 ECU_ADDRESS 0x0000 /* @ECU_Address@VAR_TpcTmp_CofDertTIGBTSave2_f32@ */ /end MEASUREMENT
/begin MEASUREMENT VAR_TpcTmp_CofDertIGBT_f32 "" FLOAT32_IEEE SWC_TPC_CM_single 0 0 -3.4E+38 3.4E+38 ECU_ADDRESS 0x0000 /* @ECU_Address@VAR_TpcTmp_CofDertIGBT_f32@ */ /end MEASUREMENT
/begin MEASUREMENT VAR_TpcTmp_tRiseIGBT_f32 "" FLOAT32_IEEE SWC_TPC_CM_single 0 0 -3.4E+38 3.4E+38 ECU_ADDRESS 0x0000 /* @ECU_Address@VAR_TpcTmp_tRiseIGBT_f32@ */ /end MEASUREMENT
/begin MEASUREMENT VAR_TpcTmp_tRiseIGBTFlt_f32 "" FLOAT32_IEEE SWC_TPC_CM_single 0 0 -3.4E+38 3.4E+38 ECU_ADDRESS 0x0000 /* @ECU_Address@VAR_TpcTmp_tRiseIGBTFlt_f32@ */ /end MEASUREMENT
/begin MEASUREMENT VAR_TpcTmp_CofDertTRiseIGBTSave1_f32 "" FLOAT32_IEEE SWC_TPC_CM_single 0 0 -3.4E+38 3.4E+38 ECU_ADDRESS 0x0000 /* @ECU_Address@VAR_TpcTmp_CofDertTRiseIGBTSave1_f32@ */ /end MEASUREMENT
/begin MEASUREMENT VAR_TpcTmp_CofDertTRiseIGBTSave2_f32 "" FLOAT32_IEEE SWC_TPC_CM_single 0 0 -3.4E+38 3.4E+38 ECU_ADDRESS 0x0000 /* @ECU_Address@VAR_TpcTmp_CofDertTRiseIGBTSave2_f32@ */ /end MEASUREMENT
/begin MEASUREMENT VAR_TpcTmp_CofDertTRiseIGBT_f32 "" FLOAT32_IEEE SWC_TPC_CM_single 0 0 -3.4E+38 3.4E+38 ECU_ADDRESS 0x0000 /* @ECU_Address@VAR_TpcTmp_CofDertTRiseIGBT_f32@ */ /end MEASUREMENT
/begin MEASUREMENT VAR_TpcMot_tSttrTempFlt_f32 "" FLOAT32_IEEE SWC_TPC_CM_single 0 0 -3.4E+38 3.4E+38 ECU_ADDRESS 0x0000 /* @ECU_Address@VAR_TpcMot_tSttrTempFlt_f32@ */ /end MEASUREMENT
/begin MEASUREMENT VAR_TpcMot_CofDertTSttrSave1_f32 "" FLOAT32_IEEE SWC_TPC_CM_single 0 0 -3.4E+38 3.4E+38 ECU_ADDRESS 0x0000 /* @ECU_Address@VAR_TpcMot_CofDertTSttrSave1_f32@ */ /end MEASUREMENT
/begin MEASUREMENT VAR_TpcMot_CofDertTSttrSave2_f32 "" FLOAT32_IEEE SWC_TPC_CM_single 0 0 -3.4E+38 3.4E+38 ECU_ADDRESS 0x0000 /* @ECU_Address@VAR_TpcMot_CofDertTSttrSave2_f32@ */ /end MEASUREMENT
/begin MEASUREMENT VAR_TpcMot_CofDertTsttr_f32 "定子温度限扭derating系数" FLOAT32_IEEE SWC_TPC_CM_single 0 0 0.0 1.0 ECU_ADDRESS 0x0000 /* @ECU_Address@VAR_TpcMot_CofDertTsttr_f32@ */ /end MEASUREMENT
/begin MEASUREMENT VAR_TpcMot_tRiseSttr_f32 "" FLOAT32_IEEE SWC_TPC_CM_single 0 0 -3.4E+38 3.4E+38 ECU_ADDRESS 0x0000 /* @ECU_Address@VAR_TpcMot_tRiseSttr_f32@ */ /end MEASUREMENT
/begin MEASUREMENT VAR_TpcMot_CofDertTRiseSttrSave1_f32 "" FLOAT32_IEEE SWC_TPC_CM_single 0 0 -3.4E+38 3.4E+38 ECU_ADDRESS 0x0000 /* @ECU_Address@VAR_TpcMot_CofDertTRiseSttrSave1_f32@ */ /end MEASUREMENT
/begin MEASUREMENT VAR_TpcMot_CofDertTRiseSttrSave2_f32 "" FLOAT32_IEEE SWC_TPC_CM_single 0 0 -3.4E+38 3.4E+38 ECU_ADDRESS 0x0000 /* @ECU_Address@VAR_TpcMot_CofDertTRiseSttrSave2_f32@ */ /end MEASUREMENT
/begin MEASUREMENT VAR_TpcMot_CofDertTRiseSttr_f32 "" FLOAT32_IEEE SWC_TPC_CM_single 0 0 -3.4E+38 3.4E+38 ECU_ADDRESS 0x0000 /* @ECU_Address@VAR_TpcMot_CofDertTRiseSttr_f32@ */ /end MEASUREMENT
/begin MEASUREMENT VAR_TpcSmp_iDcLnkMax_f32 "限幅的电池允许最大放电电流" FLOAT32_IEEE SWC_TPC_CM_single_A 0 0 -3.4E+38 3.4E+38 ECU_ADDRESS 0x0000 /* @ECU_Address@VAR_TpcSmp_iDcLnkMax_f32@ */ /end MEASUREMENT
/begin MEASUREMENT VAR_TpcSmp_cofDertOvrCurtElec_f32 "母线过流线性降电动功率derating系数" FLOAT32_IEEE SWC_TPC_CM_single 0 0 0.0 1.0 ECU_ADDRESS 0x0000 /* @ECU_Address@VAR_TpcSmp_cofDertOvrCurtElec_f32@ */ /end MEASUREMENT
/begin MEASUREMENT VAR_tpcsmp_yiDelay_f32 "" FLOAT32_IEEE SWC_TPC_CM_single 0 0 -3.4E+38 3.4E+38 ECU_ADDRESS 0x0000 /* @ECU_Address@VAR_tpcsmp_yiDelay_f32@ */ /end MEASUREMENT
/begin MEASUREMENT VAR_TpcSmp_ElecPwrAlowMax_f32 "电池允许最大放电功率" FLOAT32_IEEE SWC_TPC_CM_single_KW 0 0 -3.4E+38 3.4E+38 ECU_ADDRESS 0x0000 /* @ECU_Address@VAR_TpcSmp_ElecPwrAlowMax_f32@ */ /end MEASUREMENT
/begin MEASUREMENT VAR_TpcSmp_ErrElecOvrCurt_f32 "过流降电动功率PI模块差值输入" FLOAT32_IEEE SWC_TPC_CM_single 0 0 -3.4E+38 3.4E+38 ECU_ADDRESS 0x0000 /* @ECU_Address@VAR_TpcSmp_ErrElecOvrCurt_f32@ */ /end MEASUREMENT
/begin MEASUREMENT VAR_tpcsmp_KiProduct_f32 "" FLOAT32_IEEE SWC_TPC_CM_single 0 0 -3.4E+38 3.4E+38 ECU_ADDRESS 0x0000 /* @ECU_Address@VAR_tpcsmp_KiProduct_f32@ */ /end MEASUREMENT
/begin MEASUREMENT VAR_tpcsmp_KiProductSum_f32 "" FLOAT32_IEEE SWC_TPC_CM_single 0 0 -3.4E+38 3.4E+38 ECU_ADDRESS 0x0000 /* @ECU_Address@VAR_tpcsmp_KiProductSum_f32@ */ /end MEASUREMENT
/begin MEASUREMENT VAR_tpcsmp_KpProduct_f32 "" FLOAT32_IEEE SWC_TPC_CM_single 0 0 -3.4E+38 3.4E+38 ECU_ADDRESS 0x0000 /* @ECU_Address@VAR_tpcsmp_KpProduct_f32@ */ /end MEASUREMENT
/begin MEASUREMENT VAR_tpcsmp_KpProductSau_f32 "" FLOAT32_IEEE SWC_TPC_CM_single 0 0 -3.4E+38 3.4E+38 ECU_ADDRESS 0x0000 /* @ECU_Address@VAR_tpcsmp_KpProductSau_f32@ */ /end MEASUREMENT
/begin MEASUREMENT VAR_tpcsmp_PIOutput_f32 "" FLOAT32_IEEE SWC_TPC_CM_single 0 0 -3.4E+38 3.4E+38 ECU_ADDRESS 0x0000 /* @ECU_Address@VAR_tpcsmp_PIOutput_f32@ */ /end MEASUREMENT
/begin MEASUREMENT VAR_tpcsmp_PwrLoss_f32 "" FLOAT32_IEEE SWC_TPC_CM_single 0 0 -3.4E+38 3.4E+38 ECU_ADDRESS 0x0000 /* @ECU_Address@VAR_tpcsmp_PwrLoss_f32@ */ /end MEASUREMENT
/begin MEASUREMENT VAR_tpcsmp_AddPwrElecOvrCurt_f32 "" FLOAT32_IEEE SWC_TPC_CM_single 0 0 -3.4E+38 3.4E+38 ECU_ADDRESS 0x0000 /* @ECU_Address@VAR_tpcsmp_AddPwrElecOvrCurt_f32@ */ /end MEASUREMENT
/begin MEASUREMENT VAR_tpcsmp_RefPwrElecOvrCurt_f32 "" FLOAT32_IEEE SWC_TPC_CM_single 0 0 -3.4E+38 3.4E+38 ECU_ADDRESS 0x0000 /* @ECU_Address@VAR_tpcsmp_RefPwrElecOvrCurt_f32@ */ /end MEASUREMENT
/begin MEASUREMENT VAR_TpcSmp_ElecPwrPIDertOvrCurt_f32 "母线过流PI降电动功率" FLOAT32_IEEE SWC_TPC_CM_single_KW 0 0 -3.4E+38 3.4E+38 ECU_ADDRESS 0x0000 /* @ECU_Address@VAR_TpcSmp_ElecPwrPIDertOvrCurt_f32@ */ /end MEASUREMENT
/begin MEASUREMENT VAR_TpcSmp_iDcLnkMin_f32 "限幅的电池允许最大充电电流" FLOAT32_IEEE SWC_TPC_CM_single_A 0 0 -3.4E+38 3.4E+38 ECU_ADDRESS 0x0000 /* @ECU_Address@VAR_TpcSmp_iDcLnkMin_f32@ */ /end MEASUREMENT
/begin MEASUREMENT VAR_TpcSmp_cofDertOvrCurtGen_f32 "母线过流线性降发电功率derating系数" FLOAT32_IEEE SWC_TPC_CM_single 0 0 0.0 1.0 ECU_ADDRESS 0x0000 /* @ECU_Address@VAR_TpcSmp_cofDertOvrCurtGen_f32@ */ /end MEASUREMENT
/begin MEASUREMENT VAR_TpcSmp_GenPwrAlowMax_f32 "" FLOAT32_IEEE SWC_TPC_CM_single 0 0 -3.4E+38 3.4E+38 ECU_ADDRESS 0x0000 /* @ECU_Address@VAR_TpcSmp_GenPwrAlowMax_f32@ */ /end MEASUREMENT
/begin MEASUREMENT VAR_TpcSmp_ErrGenOvrCurt_f32 "" FLOAT32_IEEE SWC_TPC_CM_single 0 0 -3.4E+38 3.4E+38 ECU_ADDRESS 0x0000 /* @ECU_Address@VAR_TpcSmp_ErrGenOvrCurt_f32@ */ /end MEASUREMENT
/begin MEASUREMENT VAR_tpcsmp_PwrLossGen_f32 "" FLOAT32_IEEE SWC_TPC_CM_single 0 0 -3.4E+38 3.4E+38 ECU_ADDRESS 0x0000 /* @ECU_Address@VAR_tpcsmp_PwrLossGen_f32@ */ /end MEASUREMENT
/begin MEASUREMENT VAR_tpcsmp_RefPwrGenOvrCurt_f32 "" FLOAT32_IEEE SWC_TPC_CM_single 0 0 -3.4E+38 3.4E+38 ECU_ADDRESS 0x0000 /* @ECU_Address@VAR_tpcsmp_RefPwrGenOvrCurt_f32@ */ /end MEASUREMENT
/begin MEASUREMENT VAR_TpcSmp_uDcLnkMax_f32 "限幅的电池允许最大充电电压" FLOAT32_IEEE SWC_TPC_CM_single_V 0 0 -3.4E+38 3.4E+38 ECU_ADDRESS 0x0000 /* @ECU_Address@VAR_TpcSmp_uDcLnkMax_f32@ */ /end MEASUREMENT
/begin MEASUREMENT VAR_TpcSmp_cofDertOvrVoltGen_f32 "母线过压线性降发电功率derating系数" FLOAT32_IEEE SWC_TPC_CM_single 0 0 0.0 1.0 ECU_ADDRESS 0x0000 /* @ECU_Address@VAR_TpcSmp_cofDertOvrVoltGen_f32@ */ /end MEASUREMENT
/begin MEASUREMENT VAR_TpcMot_TrqGenExCOrg_f32 "" FLOAT32_IEEE SWC_TPC_CM_single 0 0 -3.4E+38 3.4E+38 ECU_ADDRESS 0x0000 /* @ECU_Address@VAR_TpcMot_TrqGenExCOrg_f32@ */ /end MEASUREMENT
/begin MEASUREMENT VAR_TpcMot_TrqElecExCOrg_f32 "" FLOAT32_IEEE SWC_TPC_CM_single 0 0 -3.4E+38 3.4E+38 ECU_ADDRESS 0x0000 /* @ECU_Address@VAR_TpcMot_TrqElecExCOrg_f32@ */ /end MEASUREMENT
/begin MEASUREMENT VAR_TpcMot_TrqGenExC_f32 "外特性限制发电扭矩" FLOAT32_IEEE SWC_TPC_CM_single_Nm 0 0 -310.0 0.0 ECU_ADDRESS 0x0000 /* @ECU_Address@VAR_TpcMot_TrqGenExC_f32@ */ /end MEASUREMENT
/begin MEASUREMENT VAR_TpcMot_GenPwrRef_f32 "TpcMot限扭基准发电功率" FLOAT32_IEEE SWC_TPC_CM_single_KW 0 0 -150.0 0.0 ECU_ADDRESS 0x0000 /* @ECU_Address@VAR_TpcMot_GenPwrRef_f32@ */ /end MEASUREMENT
/begin MEASUREMENT VAR_TpcSmp_uDcLnkMin_f32 "限幅的电池允许最小放电电压" FLOAT32_IEEE SWC_TPC_CM_single_V 0 0 -3.4E+38 3.4E+38 ECU_ADDRESS 0x0000 /* @ECU_Address@VAR_TpcSmp_uDcLnkMin_f32@ */ /end MEASUREMENT
/begin MEASUREMENT VAR_TpcSmp_cofDertUdrVoltElec_f32 "母线欠压线性降电动功率derating系数" FLOAT32_IEEE SWC_TPC_CM_single 0 0 0.0 1.0 ECU_ADDRESS 0x0000 /* @ECU_Address@VAR_TpcSmp_cofDertUdrVoltElec_f32@ */ /end MEASUREMENT
/begin MEASUREMENT VAR_TpcMot_TrqElecExC_f32 "外特性限制电动扭矩" FLOAT32_IEEE SWC_TPC_CM_single_Nm 0 0 0.0 310.0 ECU_ADDRESS 0x0000 /* @ECU_Address@VAR_TpcMot_TrqElecExC_f32@ */ /end MEASUREMENT
/begin MEASUREMENT VAR_TpcMot_ElecPwrRef_f32 "TpcMot限扭基准电动功率" FLOAT32_IEEE SWC_TPC_CM_single_KW 0 0 0.0 150.0 ECU_ADDRESS 0x0000 /* @ECU_Address@VAR_TpcMot_ElecPwrRef_f32@ */ /end MEASUREMENT
/begin MEASUREMENT VAR_TpcSmp_ElecPwrPIDertUdrVolt_f32 "母线欠压PI降电动功率" FLOAT32_IEEE SWC_TPC_CM_single_KW 0 0 -3.4E+38 3.4E+38 ECU_ADDRESS 0x0000 /* @ECU_Address@VAR_TpcSmp_ElecPwrPIDertUdrVolt_f32@ */ /end MEASUREMENT
/begin MEASUREMENT VAR_TpcCod_PowerAdd_f32 "" FLOAT32_IEEE SWC_TPC_CM_single 0 0 -3.4E+38 3.4E+38 ECU_ADDRESS 0x0000 /* @ECU_Address@VAR_TpcCod_PowerAdd_f32@ */ /end MEASUREMENT
/begin MEASUREMENT VAR_TpcCod_PowerIncreaseRate_f32 "" FLOAT32_IEEE SWC_TPC_CM_single 0 0 -3.4E+38 3.4E+38 ECU_ADDRESS 0x0000 /* @ECU_Address@VAR_TpcCod_PowerIncreaseRate_f32@ */ /end MEASUREMENT
/begin MEASUREMENT VAR_TpcCod_CoolantFlowFinReq_f32 "" FLOAT32_IEEE SWC_TPC_CM_single 0 0 -3.4E+38 3.4E+38 ECU_ADDRESS 0x0000 /* @ECU_Address@VAR_TpcCod_CoolantFlowFinReq_f32@ */ /end MEASUREMENT
/begin MEASUREMENT VAR_TpcMot_ElecTrqRef_f32 "TpcMot模块基准电动扭矩" FLOAT32_IEEE SWC_TPC_CM_single_Nm 0 0 0.0 310.0 ECU_ADDRESS 0x0000 /* @ECU_Address@VAR_TpcMot_ElecTrqRef_f32@ */ /end MEASUREMENT
/begin MEASUREMENT VAR_TpcMot_ElecTrqLimTsttrWoRamp_f32 "" FLOAT32_IEEE SWC_TPC_CM_single 0 0 -3.4E+38 3.4E+38 ECU_ADDRESS 0x0000 /* @ECU_Address@VAR_TpcMot_ElecTrqLimTsttrWoRamp_f32@ */ /end MEASUREMENT
/begin MEASUREMENT VAR_TpcMot_ElecTrqLimTsttr_f32 "定子温度限扭电动扭矩" FLOAT32_IEEE SWC_TPC_CM_single_Nm 0 0 0.0 310.0 ECU_ADDRESS 0x0000 /* @ECU_Address@VAR_TpcMot_ElecTrqLimTsttr_f32@ */ /end MEASUREMENT
/begin MEASUREMENT VAR_TpcTmp_ElecTrqLimTdbcWoRamp_f32 "" FLOAT32_IEEE SWC_TPC_CM_single 0 0 -3.4E+38 3.4E+38 ECU_ADDRESS 0x0000 /* @ECU_Address@VAR_TpcTmp_ElecTrqLimTdbcWoRamp_f32@ */ /end MEASUREMENT
/begin MEASUREMENT VAR_TpcTmp_ElecTrqLimTdbc_f32 "Dbc温度限扭电动扭矩" FLOAT32_IEEE SWC_TPC_CM_single_Nm 0 0 0.0 310.0 ECU_ADDRESS 0x0000 /* @ECU_Address@VAR_TpcTmp_ElecTrqLimTdbc_f32@ */ /end MEASUREMENT
/begin MEASUREMENT VAR_TpcTmp_ElecTrqLimTcoolant_f32 "冷却水温度限扭电动扭矩" FLOAT32_IEEE SWC_TPC_CM_single_Nm 0 0 0.0 310.0 ECU_ADDRESS 0x0000 /* @ECU_Address@VAR_TpcTmp_ElecTrqLimTcoolant_f32@ */ /end MEASUREMENT
/begin MEASUREMENT VAR_TpcTmp_ElecTrqLimTdrvboard_f32 "驱动板温度限扭电动扭矩" FLOAT32_IEEE SWC_TPC_CM_single_Nm 0 0 0.0 310.0 ECU_ADDRESS 0x0000 /* @ECU_Address@VAR_TpcTmp_ElecTrqLimTdrvboard_f32@ */ /end MEASUREMENT
/begin MEASUREMENT VAR_TpcTmp_ElecTrqLimTIGBTWoRamp_f32 "" FLOAT32_IEEE SWC_TPC_CM_single 0 0 -3.4E+38 3.4E+38 ECU_ADDRESS 0x0000 /* @ECU_Address@VAR_TpcTmp_ElecTrqLimTIGBTWoRamp_f32@ */ /end MEASUREMENT
/begin MEASUREMENT VAR_TpcTmp_ElecTrqLimTIGBT_f32 "" FLOAT32_IEEE SWC_TPC_CM_single 0 0 -3.4E+38 3.4E+38 ECU_ADDRESS 0x0000 /* @ECU_Address@VAR_TpcTmp_ElecTrqLimTIGBT_f32@ */ /end MEASUREMENT
/begin MEASUREMENT VAR_TpcSmp_cofDertOvrSpdElecQuad1_f32 "超速限扭第一象限查表Derating系数" FLOAT32_IEEE SWC_TPC_CM_single 0 0 0.0 1.0 ECU_ADDRESS 0x0000 /* @ECU_Address@VAR_TpcSmp_cofDertOvrSpdElecQuad1_f32@ */ /end MEASUREMENT
/begin MEASUREMENT VAR_TpcSmp_cofDertOvrSpdElecQuad3_f32 "超速限扭第三象限查表Derating系数" FLOAT32_IEEE SWC_TPC_CM_single 0 0 0.0 1.0 ECU_ADDRESS 0x0000 /* @ECU_Address@VAR_TpcSmp_cofDertOvrSpdElecQuad3_f32@ */ /end MEASUREMENT
/begin MEASUREMENT VAR_TpcSmp_ElecTrqLimOvrSpd_f32 "超速限扭电动扭矩" FLOAT32_IEEE SWC_TPC_CM_single 0 0 -3.4E+38 3.4E+38 ECU_ADDRESS 0x0000 /* @ECU_Address@VAR_TpcSmp_ElecTrqLimOvrSpd_f32@ */ /end MEASUREMENT
/begin MEASUREMENT VAR_TpcMot_GenTrqRef_f32 "TpcMot模块基准发电扭矩" FLOAT32_IEEE SWC_TPC_CM_single_Nm 0 0 -310.0 0.0 ECU_ADDRESS 0x0000 /* @ECU_Address@VAR_TpcMot_GenTrqRef_f32@ */ /end MEASUREMENT
/begin MEASUREMENT VAR_tpcsmp_ElecPwrDert_f32 "" FLOAT32_IEEE SWC_TPC_CM_single 0 0 -3.4E+38 3.4E+38 ECU_ADDRESS 0x0000 /* @ECU_Address@VAR_tpcsmp_ElecPwrDert_f32@ */ /end MEASUREMENT
/begin MEASUREMENT VAR_TpcSmp_ElecPwrLinearDertOvrCurt_f32 "母线过流线性降电动功率" FLOAT32_IEEE SWC_TPC_CM_single_KW 0 0 0.0 150.0 ECU_ADDRESS 0x0000 /* @ECU_Address@VAR_TpcSmp_ElecPwrLinearDertOvrCurt_f32@ */ /end MEASUREMENT
/begin MEASUREMENT VAR_TpcSmp_ElecPwrLimOvrCurt_f32 "母线过流降电动功率" FLOAT32_IEEE SWC_TPC_CM_single_KW 0 0 -3.4E+38 3.4E+38 ECU_ADDRESS 0x0000 /* @ECU_Address@VAR_TpcSmp_ElecPwrLimOvrCurt_f32@ */ /end MEASUREMENT
/begin MEASUREMENT VAR_TpcCod_ElecTrqCalcOvrCurt_f32 "过流降电动功率值计算扭矩" FLOAT32_IEEE SWC_TPC_CM_single_Nm 0 0 -3.4E+38 3.4E+38 ECU_ADDRESS 0x0000 /* @ECU_Address@VAR_TpcCod_ElecTrqCalcOvrCurt_f32@ */ /end MEASUREMENT
/begin MEASUREMENT VAR_TpcSmp_ElecPwrLinearDertUdrVolt_f32 "母线欠压线性降电动功率" FLOAT32_IEEE SWC_TPC_CM_single_KW 0 0 -3.4E+38 3.4E+38 ECU_ADDRESS 0x0000 /* @ECU_Address@VAR_TpcSmp_ElecPwrLinearDertUdrVolt_f32@ */ /end MEASUREMENT
/begin MEASUREMENT VAR_TpcSmp_ElecPwrLimUdrVolt_f32 "母线欠压降电动功率" FLOAT32_IEEE SWC_TPC_CM_single_KW 0 0 -3.4E+38 3.4E+38 ECU_ADDRESS 0x0000 /* @ECU_Address@VAR_TpcSmp_ElecPwrLimUdrVolt_f32@ */ /end MEASUREMENT
/begin MEASUREMENT VAR_TpcCod_ElecTrqCalcUdrVolt_f32 "欠压降电动功率值计算扭矩" FLOAT32_IEEE SWC_TPC_CM_single_Nm 0 0 -3.4E+38 3.4E+38 ECU_ADDRESS 0x0000 /* @ECU_Address@VAR_TpcCod_ElecTrqCalcUdrVolt_f32@ */ /end MEASUREMENT
/begin MEASUREMENT VAR_TpcCod_ElecTrqCalcDiag_f32 "故障等级降电动功率值计算扭矩" FLOAT32_IEEE SWC_TPC_CM_single_Nm 0 0 -3.4E+38 3.4E+38 ECU_ADDRESS 0x0000 /* @ECU_Address@VAR_TpcCod_ElecTrqCalcDiag_f32@ */ /end MEASUREMENT
/begin MEASUREMENT VAR_TpcMot_GenTrqLimTsttrWoRamp_f32 "" FLOAT32_IEEE SWC_TPC_CM_single 0 0 -3.4E+38 3.4E+38 ECU_ADDRESS 0x0000 /* @ECU_Address@VAR_TpcMot_GenTrqLimTsttrWoRamp_f32@ */ /end MEASUREMENT
/begin MEASUREMENT VAR_TpcMot_GenTrqLimTsttr_f32 "定子温度限扭发电扭矩" FLOAT32_IEEE SWC_TPC_CM_single_Nm 0 0 -310.0 0.0 ECU_ADDRESS 0x0000 /* @ECU_Address@VAR_TpcMot_GenTrqLimTsttr_f32@ */ /end MEASUREMENT
/begin MEASUREMENT VAR_TpcTmp_GenTrqLimTdbcWoRamp_f32 "" FLOAT32_IEEE SWC_TPC_CM_single 0 0 -3.4E+38 3.4E+38 ECU_ADDRESS 0x0000 /* @ECU_Address@VAR_TpcTmp_GenTrqLimTdbcWoRamp_f32@ */ /end MEASUREMENT
/begin MEASUREMENT VAR_TpcTmp_GenTrqLimTdbc_f32 "Dbc温度限扭发电扭矩" FLOAT32_IEEE SWC_TPC_CM_single_Nm 0 0 -310.0 0.0 ECU_ADDRESS 0x0000 /* @ECU_Address@VAR_TpcTmp_GenTrqLimTdbc_f32@ */ /end MEASUREMENT
/begin MEASUREMENT VAR_TpcTmp_GenTrqLimTcoolant_f32 "冷却水温度限扭发电扭矩" FLOAT32_IEEE SWC_TPC_CM_single_Nm 0 0 -310.0 0.0 ECU_ADDRESS 0x0000 /* @ECU_Address@VAR_TpcTmp_GenTrqLimTcoolant_f32@ */ /end MEASUREMENT
/begin MEASUREMENT VAR_TpcTmp_GenTrqLimTdrvboard_f32 "驱动板温度限扭发电扭矩" FLOAT32_IEEE SWC_TPC_CM_single_Nm 0 0 -310.0 0.0 ECU_ADDRESS 0x0000 /* @ECU_Address@VAR_TpcTmp_GenTrqLimTdrvboard_f32@ */ /end MEASUREMENT
/begin MEASUREMENT VAR_TpcTmp_GenTrqLimTIGBTWoRamp_f32 "" FLOAT32_IEEE SWC_TPC_CM_single 0 0 -3.4E+38 3.4E+38 ECU_ADDRESS 0x0000 /* @ECU_Address@VAR_TpcTmp_GenTrqLimTIGBTWoRamp_f32@ */ /end MEASUREMENT
/begin MEASUREMENT VAR_TpcTmp_GenTrqLimTIGBT_f32 "" FLOAT32_IEEE SWC_TPC_CM_single 0 0 -3.4E+38 3.4E+38 ECU_ADDRESS 0x0000 /* @ECU_Address@VAR_TpcTmp_GenTrqLimTIGBT_f32@ */ /end MEASUREMENT
/begin MEASUREMENT VAR_TpcSmp_cofDertOvrSpdGenQuad4_f32 "超速限扭第四象限查表Derating系数" FLOAT32_IEEE SWC_TPC_CM_single 0 0 0.0 1.0 ECU_ADDRESS 0x0000 /* @ECU_Address@VAR_TpcSmp_cofDertOvrSpdGenQuad4_f32@ */ /end MEASUREMENT
/begin MEASUREMENT VAR_TpcSmp_cofDertOvrSpdGenQuad2_f32 "超速限扭第二象限查表Derating系数" FLOAT32_IEEE SWC_TPC_CM_single 0 0 0.0 1.0 ECU_ADDRESS 0x0000 /* @ECU_Address@VAR_TpcSmp_cofDertOvrSpdGenQuad2_f32@ */ /end MEASUREMENT
/begin MEASUREMENT VAR_TpcSmp_GenTrqLimOvrSpd_f32 "超速限扭发电扭矩" FLOAT32_IEEE SWC_TPC_CM_single 0 0 -3.4E+38 3.4E+38 ECU_ADDRESS 0x0000 /* @ECU_Address@VAR_TpcSmp_GenTrqLimOvrSpd_f32@ */ /end MEASUREMENT
/begin MEASUREMENT VAR_tpcsmp_GenPwrDert_f32 "" FLOAT32_IEEE SWC_TPC_CM_single 0 0 -3.4E+38 3.4E+38 ECU_ADDRESS 0x0000 /* @ECU_Address@VAR_tpcsmp_GenPwrDert_f32@ */ /end MEASUREMENT
/begin MEASUREMENT VAR_TpcSmp_GenPwrPIDertOvrCurt_f32 "母线过流PI降发电功率" FLOAT32_IEEE SWC_TPC_CM_single_KW 0 0 -3.4E+38 3.4E+38 ECU_ADDRESS 0x0000 /* @ECU_Address@VAR_TpcSmp_GenPwrPIDertOvrCurt_f32@ */ /end MEASUREMENT
/begin MEASUREMENT VAR_TpcSmp_GenPwrLinearDertOvrCurt_f32 "母线过流线性降发电功率" FLOAT32_IEEE SWC_TPC_CM_single_KW 0 0 -150.0 0.0 ECU_ADDRESS 0x0000 /* @ECU_Address@VAR_TpcSmp_GenPwrLinearDertOvrCurt_f32@ */ /end MEASUREMENT
/begin MEASUREMENT VAR_TpcSmp_GenPwrLimOvrCurt_f32 "母线过流降发电功率" FLOAT32_IEEE SWC_TPC_CM_single_KW 0 0 -3.4E+38 3.4E+38 ECU_ADDRESS 0x0000 /* @ECU_Address@VAR_TpcSmp_GenPwrLimOvrCurt_f32@ */ /end MEASUREMENT
/begin MEASUREMENT VAR_TpcCod_GenTrqCalcOvrCurt_f32 "过流降发电功率值计算扭矩" FLOAT32_IEEE SWC_TPC_CM_single_Nm 0 0 -3.4E+38 3.4E+38 ECU_ADDRESS 0x0000 /* @ECU_Address@VAR_TpcCod_GenTrqCalcOvrCurt_f32@ */ /end MEASUREMENT
/begin MEASUREMENT VAR_TpcSmp_GenPwrLinearDertOvrVolt_f32 "母线过压线性降发电功率" FLOAT32_IEEE SWC_TPC_CM_single 0 0 -3.4E+38 3.4E+38 ECU_ADDRESS 0x0000 /* @ECU_Address@VAR_TpcSmp_GenPwrLinearDertOvrVolt_f32@ */ /end MEASUREMENT
/begin MEASUREMENT VAR_TpcSmp_GenPwrPIDertOvrVolt_f32 "母线过压PI降发电功率" FLOAT32_IEEE SWC_TPC_CM_single 0 0 -3.4E+38 3.4E+38 ECU_ADDRESS 0x0000 /* @ECU_Address@VAR_TpcSmp_GenPwrPIDertOvrVolt_f32@ */ /end MEASUREMENT
/begin MEASUREMENT VAR_TpcSmp_GenPwrLimOvrVolt_f32 "母线过压降发电功率" FLOAT32_IEEE SWC_TPC_CM_single 0 0 -3.4E+38 3.4E+38 ECU_ADDRESS 0x0000 /* @ECU_Address@VAR_TpcSmp_GenPwrLimOvrVolt_f32@ */ /end MEASUREMENT
/begin MEASUREMENT VAR_TpcCod_GenTrqCalcOvrVolt_f32 "欠压降发电功率值计算扭矩" FLOAT32_IEEE SWC_TPC_CM_single_Nm 0 0 -3.4E+38 3.4E+38 ECU_ADDRESS 0x0000 /* @ECU_Address@VAR_TpcCod_GenTrqCalcOvrVolt_f32@ */ /end MEASUREMENT
/begin MEASUREMENT VAR_TpcCod_GenTrqCalcDiag_f32 "故障等级降发电功率值计算扭矩" FLOAT32_IEEE SWC_TPC_CM_single_Nm 0 0 -3.4E+38 3.4E+38 ECU_ADDRESS 0x0000 /* @ECU_Address@VAR_TpcCod_GenTrqCalcDiag_f32@ */ /end MEASUREMENT
/begin MEASUREMENT VAR_TpcSmp_TrqMaxCanSet_f32 "CAN指令限扭最大扭矩" FLOAT32_IEEE SWC_TPC_CM_single 0 0 -3.4E+38 3.4E+38 ECU_ADDRESS 0x0000 /* @ECU_Address@VAR_TpcSmp_TrqMaxCanSet_f32@ */ /end MEASUREMENT
/begin MEASUREMENT VAR_TpcSmp_TrqMinCanSet_f32 "CAN指令限扭最小扭矩" FLOAT32_IEEE SWC_TPC_CM_single 0 0 -3.4E+38 3.4E+38 ECU_ADDRESS 0x0000 /* @ECU_Address@VAR_TpcSmp_TrqMinCanSet_f32@ */ /end MEASUREMENT
/begin MEASUREMENT VAR_TpcBlk_IsValid_f32 "" FLOAT32_IEEE SWC_TPC_CM_single 0 0 -3.4E+38 3.4E+38 ECU_ADDRESS 0x0000 /* @ECU_Address@VAR_TpcBlk_IsValid_f32@ */ /end MEASUREMENT
/begin MEASUREMENT VAR_Tpcblk_TrqLim_f32 "" FLOAT32_IEEE SWC_TPC_CM_single 0 0 -3.4E+38 3.4E+38 ECU_ADDRESS 0x0000 /* @ECU_Address@VAR_Tpcblk_TrqLim_f32@ */ /end MEASUREMENT
/begin MEASUREMENT VAR_Tpcblk_TrqLim01_f32 "" FLOAT32_IEEE SWC_TPC_CM_single 0 0 -3.4E+38 3.4E+38 ECU_ADDRESS 0x0000 /* @ECU_Address@VAR_Tpcblk_TrqLim01_f32@ */ /end MEASUREMENT
/begin MEASUREMENT VAR_Tpcblk_TrqMax_f32 "" FLOAT32_IEEE SWC_TPC_CM_single 0 0 -3.4E+38 3.4E+38 ECU_ADDRESS 0x0000 /* @ECU_Address@VAR_Tpcblk_TrqMax_f32@ */ /end MEASUREMENT
/begin MEASUREMENT VAR_Tpcblk_TrqMin_f32 "" FLOAT32_IEEE SWC_TPC_CM_single 0 0 -3.4E+38 3.4E+38 ECU_ADDRESS 0x0000 /* @ECU_Address@VAR_Tpcblk_TrqMin_f32@ */ /end MEASUREMENT
/begin MEASUREMENT VAR_tpcsmp_posOutputjudge_f32 "" FLOAT32_IEEE SWC_TPC_CM_single 0 0 -3.4E+38 3.4E+38 ECU_ADDRESS 0x0000 /* @ECU_Address@VAR_tpcsmp_posOutputjudge_f32@ */ /end MEASUREMENT
/begin MEASUREMENT VAR_tpcsmp_negOutputjudge_f32 "" FLOAT32_IEEE SWC_TPC_CM_single 0 0 -3.4E+38 3.4E+38 ECU_ADDRESS 0x0000 /* @ECU_Address@VAR_tpcsmp_negOutputjudge_f32@ */ /end MEASUREMENT
/begin MEASUREMENT VAR_tpcsmp_yi_f32 "" FLOAT32_IEEE SWC_TPC_CM_single 0 0 -3.4E+38 3.4E+38 ECU_ADDRESS 0x0000 /* @ECU_Address@VAR_tpcsmp_yi_f32@ */ /end MEASUREMENT
/begin MEASUREMENT VAR_TpcFuv_ElecTrqLimDiag_f32 "故障等级限扭电动扭矩" FLOAT32_IEEE SWC_TPC_CM_single_Nm 0 0 -3.4E+38 3.4E+38 ECU_ADDRESS 0x0000 /* @ECU_Address@VAR_TpcFuv_ElecTrqLimDiag_f32@ */ /end MEASUREMENT
/begin MEASUREMENT VAR_TpcFuv_GenTrqLimDiag_f32 "故障等级限扭发电扭矩" FLOAT32_IEEE SWC_TPC_CM_single_Nm 0 0 -3.4E+38 3.4E+38 ECU_ADDRESS 0x0000 /* @ECU_Address@VAR_TpcFuv_GenTrqLimDiag_f32@ */ /end MEASUREMENT
/begin MEASUREMENT VAR_TpcFuv_ElecPwrLimDiag_f32 "故障等级限扭电动功率" FLOAT32_IEEE SWC_TPC_CM_single_KW 0 0 -3.4E+38 3.4E+38 ECU_ADDRESS 0x0000 /* @ECU_Address@VAR_TpcFuv_ElecPwrLimDiag_f32@ */ /end MEASUREMENT
/begin MEASUREMENT VAR_TpcFuv_GenPwrLimDiag_f32 "故障等级限扭发电功率" FLOAT32_IEEE SWC_TPC_CM_single_KW 0 0 -3.4E+38 3.4E+38 ECU_ADDRESS 0x0000 /* @ECU_Address@VAR_TpcFuv_GenPwrLimDiag_f32@ */ /end MEASUREMENT
/begin MEASUREMENT VAR_TpcBlk_IsSum_f32 "" FLOAT32_IEEE SWC_TPC_CM_single 0 0 -3.4E+38 3.4E+38 ECU_ADDRESS 0x0000 /* @ECU_Address@VAR_TpcBlk_IsSum_f32@ */ /end MEASUREMENT
/begin MEASUREMENT VAR_TpcCod_GenTrqLim_f32 "发电扭矩限值" FLOAT32_IEEE SWC_TPC_CM_single_Nm 0 0 -3.4E+38 3.4E+38 ECU_ADDRESS 0x0000 /* @ECU_Address@VAR_TpcCod_GenTrqLim_f32@ */ /end MEASUREMENT
/begin MEASUREMENT VAR_TpcCod_ElecTrqLim_f32 "电动扭矩限值" FLOAT32_IEEE SWC_TPC_CM_single_Nm 0 0 -3.4E+38 3.4E+38 ECU_ADDRESS 0x0000 /* @ECU_Address@VAR_TpcCod_ElecTrqLim_f32@ */ /end MEASUREMENT
/begin MEASUREMENT VAR_TpcCod_CoolantFlowReq_f32 "" FLOAT32_IEEE SWC_TPC_CM_single 0 0 -3.4E+38 3.4E+38 ECU_ADDRESS 0x0000 /* @ECU_Address@VAR_TpcCod_CoolantFlowReq_f32@ */ /end MEASUREMENT
/begin MEASUREMENT VAR_TpcTmp_tCoolTempFlt_u16 "" SWORD SWC_TPC_CM_int16 0 0 -32768 32767 ECU_ADDRESS 0x0000 /* @ECU_Address@VAR_TpcTmp_tCoolTempFlt_u16@ */ /end MEASUREMENT
/begin MEASUREMENT VAR_TpcTmp_TCoolStableDiff_u16 "" SWORD SWC_TPC_CM_int16 0 0 -32768 32767 ECU_ADDRESS 0x0000 /* @ECU_Address@VAR_TpcTmp_TCoolStableDiff_u16@ */ /end MEASUREMENT
/begin MEASUREMENT VAR_TpcTmp_tDbcTempFlt_u16 "" SWORD SWC_TPC_CM_int16 0 0 -32768 32767 ECU_ADDRESS 0x0000 /* @ECU_Address@VAR_TpcTmp_tDbcTempFlt_u16@ */ /end MEASUREMENT
/begin MEASUREMENT VAR_TpcTmp_TDbcStableDiff_u16 "" SWORD SWC_TPC_CM_int16 0 0 -32768 32767 ECU_ADDRESS 0x0000 /* @ECU_Address@VAR_TpcTmp_TDbcStableDiff_u16@ */ /end MEASUREMENT
/begin MEASUREMENT VAR_TpcTmp_tDbcRiseTempFlt_u16 "" SWORD SWC_TPC_CM_int16 0 0 -32768 32767 ECU_ADDRESS 0x0000 /* @ECU_Address@VAR_TpcTmp_tDbcRiseTempFlt_u16@ */ /end MEASUREMENT
/begin MEASUREMENT VAR_TpcTmp_TDbcRiseStableDiff_u16 "" SWORD SWC_TPC_CM_int16 0 0 -32768 32767 ECU_ADDRESS 0x0000 /* @ECU_Address@VAR_TpcTmp_TDbcRiseStableDiff_u16@ */ /end MEASUREMENT
/begin MEASUREMENT VAR_TpcTmp_tIgbtTempFlt_u16 "" SWORD SWC_TPC_CM_int16 0 0 -32768 32767 ECU_ADDRESS 0x0000 /* @ECU_Address@VAR_TpcTmp_tIgbtTempFlt_u16@ */ /end MEASUREMENT
/begin MEASUREMENT VAR_TpcTmp_TIgbtStableDiff_u16 "" SWORD SWC_TPC_CM_int16 0 0 -32768 32767 ECU_ADDRESS 0x0000 /* @ECU_Address@VAR_TpcTmp_TIgbtStableDiff_u16@ */ /end MEASUREMENT
/begin MEASUREMENT VAR_TpcTmp_tIgbtRiseTempFlt_u16 "" SWORD SWC_TPC_CM_int16 0 0 -32768 32767 ECU_ADDRESS 0x0000 /* @ECU_Address@VAR_TpcTmp_tIgbtRiseTempFlt_u16@ */ /end MEASUREMENT
/begin MEASUREMENT VAR_TpcTmp_TIgbtRiseStableDiff_u16 "" SWORD SWC_TPC_CM_int16 0 0 -32768 32767 ECU_ADDRESS 0x0000 /* @ECU_Address@VAR_TpcTmp_TIgbtRiseStableDiff_u16@ */ /end MEASUREMENT
/begin MEASUREMENT VAR_TpcMot_tSttrTempFlt_u16 "" SWORD SWC_TPC_CM_int16 0 0 -32768 32767 ECU_ADDRESS 0x0000 /* @ECU_Address@VAR_TpcMot_tSttrTempFlt_u16@ */ /end MEASUREMENT
/begin MEASUREMENT VAR_TpcMot_TsttrStableDiff_u16 "" SWORD SWC_TPC_CM_int16 0 0 -32768 32767 ECU_ADDRESS 0x0000 /* @ECU_Address@VAR_TpcMot_TsttrStableDiff_u16@ */ /end MEASUREMENT
/begin MEASUREMENT VAR_TpcSmp_SpdOvHiLimErrState_u8 "DEM触发状态_超速故障" UBYTE SWC_TPC_CM_uint8 0 0 0 255 ECU_ADDRESS 0x0000 /* @ECU_Address@VAR_TpcSmp_SpdOvHiLimErrState_u8@ */ /end MEASUREMENT
/begin MEASUREMENT VAR_TpcSmp_SpdOvHiWarnState_u8 "DEM触发状态_超速报警" UBYTE SWC_TPC_CM_uint8 0 0 0 255 ECU_ADDRESS 0x0000 /* @ECU_Address@VAR_TpcSmp_SpdOvHiWarnState_u8@ */ /end MEASUREMENT
/begin MEASUREMENT VAR_TpcTmp_TCoolantOvHiWarnState_u8 "DEM触发状态_冷却水过温报警" UBYTE SWC_TPC_CM_uint8 0 0 0 255 ECU_ADDRESS 0x0000 /* @ECU_Address@VAR_TpcTmp_TCoolantOvHiWarnState_u8@ */ /end MEASUREMENT
/begin MEASUREMENT VAR_TpcTmp_TDbcOvHiWarnState_u8 "DEM触发状态_DBC过温报警" UBYTE SWC_TPC_CM_uint8 0 0 0 255 ECU_ADDRESS 0x0000 /* @ECU_Address@VAR_TpcTmp_TDbcOvHiWarnState_u8@ */ /end MEASUREMENT
/begin MEASUREMENT VAR_TpcTmp_TDbcOvLoWarnState_u8 "DEM触发状态_DBC温度过低报警" UBYTE SWC_TPC_CM_uint8 0 0 0 255 ECU_ADDRESS 0x0000 /* @ECU_Address@VAR_TpcTmp_TDbcOvLoWarnState_u8@ */ /end MEASUREMENT
/begin MEASUREMENT VAR_TpcTmp_TDbcUHiLimErrState_u8 "DEM触发状态_U相过温故障" UBYTE SWC_TPC_CM_uint8 0 0 0 255 ECU_ADDRESS 0x0000 /* @ECU_Address@VAR_TpcTmp_TDbcUHiLimErrState_u8@ */ /end MEASUREMENT
/begin MEASUREMENT VAR_TpcTmp_TDbcULoLimErrState_u8 "DEM触发状态_U相温度过低故障" UBYTE SWC_TPC_CM_uint8 0 0 0 255 ECU_ADDRESS 0x0000 /* @ECU_Address@VAR_TpcTmp_TDbcULoLimErrState_u8@ */ /end MEASUREMENT
/begin MEASUREMENT VAR_TpcTmp_TDbcVHiLimErrState_u8 "DEM触发状态_V相过温故障" UBYTE SWC_TPC_CM_uint8 0 0 0 255 ECU_ADDRESS 0x0000 /* @ECU_Address@VAR_TpcTmp_TDbcVHiLimErrState_u8@ */ /end MEASUREMENT
/begin MEASUREMENT VAR_TpcTmp_TDbcVLoLimErrState_u8 "DEM触发状态_V相温度过低故障" UBYTE SWC_TPC_CM_uint8 0 0 0 255 ECU_ADDRESS 0x0000 /* @ECU_Address@VAR_TpcTmp_TDbcVLoLimErrState_u8@ */ /end MEASUREMENT
/begin MEASUREMENT VAR_TpcTmp_TDbcWHiLimErrState_u8 "DEM触发状态_W相过温故障" UBYTE SWC_TPC_CM_uint8 0 0 0 255 ECU_ADDRESS 0x0000 /* @ECU_Address@VAR_TpcTmp_TDbcWHiLimErrState_u8@ */ /end MEASUREMENT
/begin MEASUREMENT VAR_TpcTmp_TDbcWLoLimErrState_u8 "DEM触发状态_W相温度过低故障" UBYTE SWC_TPC_CM_uint8 0 0 0 255 ECU_ADDRESS 0x0000 /* @ECU_Address@VAR_TpcTmp_TDbcWLoLimErrState_u8@ */ /end MEASUREMENT
/begin MEASUREMENT VAR_TpcTmp_TDrvBoardOvHiWarnState_u8 "DEM触发状态_驱动板过温报警" UBYTE SWC_TPC_CM_uint8 0 0 0 255 ECU_ADDRESS 0x0000 /* @ECU_Address@VAR_TpcTmp_TDrvBoardOvHiWarnState_u8@ */ /end MEASUREMENT
/begin MEASUREMENT VAR_TpcTmp_TIGBTOvHiErrState_u8 "" UBYTE SWC_TPC_CM_uint8 0 0 0 255 ECU_ADDRESS 0x0000 /* @ECU_Address@VAR_TpcTmp_TIGBTOvHiErrState_u8@ */ /end MEASUREMENT
/begin MEASUREMENT VAR_TpcTmp_TIGBTOvHiWarnState_u8 "" UBYTE SWC_TPC_CM_uint8 0 0 0 255 ECU_ADDRESS 0x0000 /* @ECU_Address@VAR_TpcTmp_TIGBTOvHiWarnState_u8@ */ /end MEASUREMENT
/begin MEASUREMENT VAR_TpcTmp_TIGBTOvLoWarnState_u8 "" UBYTE SWC_TPC_CM_uint8 0 0 0 255 ECU_ADDRESS 0x0000 /* @ECU_Address@VAR_TpcTmp_TIGBTOvLoWarnState_u8@ */ /end MEASUREMENT
/begin MEASUREMENT VAR_TpcMot_TSttrOvHiLimErrState_u8 "DEM触发状态_定子过温故障" UBYTE SWC_TPC_CM_uint8 0 0 0 255 ECU_ADDRESS 0x0000 /* @ECU_Address@VAR_TpcMot_TSttrOvHiLimErrState_u8@ */ /end MEASUREMENT
/begin MEASUREMENT VAR_TpcMot_TSttrOvHiWarnState_u8 "DEM触发状态_定子过温报警" UBYTE SWC_TPC_CM_uint8 0 0 0 255 ECU_ADDRESS 0x0000 /* @ECU_Address@VAR_TpcMot_TSttrOvHiWarnState_u8@ */ /end MEASUREMENT
/begin MEASUREMENT VAR_TpcMot_TSttrOvLoWarnState_u8 "DEM触发状态_定子温度过低报警" UBYTE SWC_TPC_CM_uint8 0 0 0 255 ECU_ADDRESS 0x0000 /* @ECU_Address@VAR_TpcMot_TSttrOvLoWarnState_u8@ */ /end MEASUREMENT
/begin MEASUREMENT VAR_TpcSmp_iDcLnkOvCLimErrState_u8 "DEM触发状态_过流故障" UBYTE SWC_TPC_CM_uint8 0 0 0 255 ECU_ADDRESS 0x0000 /* @ECU_Address@VAR_TpcSmp_iDcLnkOvCLimErrState_u8@ */ /end MEASUREMENT
/begin MEASUREMENT VAR_TpcSmp_iDcLnkOvcWarnState_u8 "DEM触发状态_过流报警" UBYTE SWC_TPC_CM_uint8 0 0 0 255 ECU_ADDRESS 0x0000 /* @ECU_Address@VAR_TpcSmp_iDcLnkOvcWarnState_u8@ */ /end MEASUREMENT
/begin MEASUREMENT VAR_TpcSmp_uDcLnkOvVLimErrState_u8 "DEM触发状态_过压故障" UBYTE SWC_TPC_CM_uint8 0 0 0 255 ECU_ADDRESS 0x0000 /* @ECU_Address@VAR_TpcSmp_uDcLnkOvVLimErrState_u8@ */ /end MEASUREMENT
/begin MEASUREMENT VAR_TpcSmp_uDcLnkOvWarnState_u8 "DEM触发状态_过压报警" UBYTE SWC_TPC_CM_uint8 0 0 0 255 ECU_ADDRESS 0x0000 /* @ECU_Address@VAR_TpcSmp_uDcLnkOvWarnState_u8@ */ /end MEASUREMENT
/begin MEASUREMENT VAR_TpcSmp_uDcLnkUnVLimErrState_u8 "DEM触发状态_欠压故障" UBYTE SWC_TPC_CM_uint8 0 0 0 255 ECU_ADDRESS 0x0000 /* @ECU_Address@VAR_TpcSmp_uDcLnkUnVLimErrState_u8@ */ /end MEASUREMENT
/begin MEASUREMENT VAR_TpcSmp_uDcLnkUnvWarnState_u8 "DEM触发状态_欠压报警" UBYTE SWC_TPC_CM_uint8 0 0 0 255 ECU_ADDRESS 0x0000 /* @ECU_Address@VAR_TpcSmp_uDcLnkUnvWarnState_u8@ */ /end MEASUREMENT
/begin MEASUREMENT VAR_TpcTmp_tRiseIGBTOperationMode_u8 "" UBYTE SWC_TPC_CM_uint8 0 0 0 255 ECU_ADDRESS 0x0000 /* @ECU_Address@VAR_TpcTmp_tRiseIGBTOperationMode_u8@ */ /end MEASUREMENT
/begin MEASUREMENT VAR_TpcTmp_tIGBTOperationMode_u8 "" UBYTE SWC_TPC_CM_uint8 0 0 0 255 ECU_ADDRESS 0x0000 /* @ECU_Address@VAR_TpcTmp_tIGBTOperationMode_u8@ */ /end MEASUREMENT
/begin MEASUREMENT VAR_TpcTmp_tRiseDbcOperationMode_u8 "" UBYTE SWC_TPC_CM_uint8 0 0 0 255 ECU_ADDRESS 0x0000 /* @ECU_Address@VAR_TpcTmp_tRiseDbcOperationMode_u8@ */ /end MEASUREMENT
/begin MEASUREMENT VAR_TpcTmp_tDbcOperationMode_u8 "" UBYTE SWC_TPC_CM_uint8 0 0 0 255 ECU_ADDRESS 0x0000 /* @ECU_Address@VAR_TpcTmp_tDbcOperationMode_u8@ */ /end MEASUREMENT
/begin MEASUREMENT VAR_TpcTmp_tCoolantOperationMode_u8 "" UBYTE SWC_TPC_CM_uint8 0 0 0 255 ECU_ADDRESS 0x0000 /* @ECU_Address@VAR_TpcTmp_tCoolantOperationMode_u8@ */ /end MEASUREMENT
/begin MEASUREMENT VAR_TpcMot_tSttrOperationMode_u8 "" UBYTE SWC_TPC_CM_uint8 0 0 0 255 ECU_ADDRESS 0x0000 /* @ECU_Address@VAR_TpcMot_tSttrOperationMode_u8@ */ /end MEASUREMENT
/begin MEASUREMENT VAR_TpcMot_tRiseSttrOperationMode_u8 "" UBYTE SWC_TPC_CM_uint8 0 0 0 255 ECU_ADDRESS 0x0000 /* @ECU_Address@VAR_TpcMot_tRiseSttrOperationMode_u8@ */ /end MEASUREMENT
/begin MEASUREMENT VAR_TpcTmp_flgTrqLimTcoolantActv_b "冷却水温度限扭触发状态标志位" UBYTE SWC_TPC_CM_boolean 0 0 0.0 1.0 ECU_ADDRESS 0x0000 /* @ECU_Address@VAR_TpcTmp_flgTrqLimTcoolantActv_b@ */ /end MEASUREMENT
/begin MEASUREMENT VAR_TpcTmp_flgTrqLimTdbcActv_b "Dbc温度限扭触发状态标志位" UBYTE SWC_TPC_CM_boolean 0 0 0.0 1.0 ECU_ADDRESS 0x0000 /* @ECU_Address@VAR_TpcTmp_flgTrqLimTdbcActv_b@ */ /end MEASUREMENT
/begin MEASUREMENT VAR_TpcTmp_flgTrqLimTdrvboardActv_b "驱动板温度限扭触发状态标志位" UBYTE SWC_TPC_CM_boolean 0 0 0.0 1.0 ECU_ADDRESS 0x0000 /* @ECU_Address@VAR_TpcTmp_flgTrqLimTdrvboardActv_b@ */ /end MEASUREMENT
/begin MEASUREMENT VAR_TpcTmp_flgTrqLimTIGBTActv_b "" UBYTE SWC_TPC_CM_boolean 0 0 0 1 ECU_ADDRESS 0x0000 /* @ECU_Address@VAR_TpcTmp_flgTrqLimTIGBTActv_b@ */ /end MEASUREMENT
/begin MEASUREMENT VAR_TpcMot_flgTrqLimTsttrActv_b "定子温度限扭触发状态标志位" UBYTE SWC_TPC_CM_boolean 0 0 0.0 1.0 ECU_ADDRESS 0x0000 /* @ECU_Address@VAR_TpcMot_flgTrqLimTsttrActv_b@ */ /end MEASUREMENT
/begin MEASUREMENT VAR_TpcSmp_flgLinearDertOvrCurtElec_b "母线过流线性降电动功率触发状态标志位" UBYTE SWC_TPC_CM_boolean 0 0 0.0 1.0 ECU_ADDRESS 0x0000 /* @ECU_Address@VAR_TpcSmp_flgLinearDertOvrCurtElec_b@ */ /end MEASUREMENT
/begin MEASUREMENT VAR_TpcSmp_flgPIDertOvrCurtElec_b "母线过流PI降电动功率触发状态标志位" UBYTE SWC_TPC_CM_boolean 0 0 0.0 1.0 ECU_ADDRESS 0x0000 /* @ECU_Address@VAR_TpcSmp_flgPIDertOvrCurtElec_b@ */ /end MEASUREMENT
/begin MEASUREMENT VAR_TpcSmp_flgElecPwrLimOvrCurtActv_b "母线过流降电动功率触发状态标志" UBYTE SWC_TPC_CM_boolean 0 0 0.0 1.0 ECU_ADDRESS 0x0000 /* @ECU_Address@VAR_TpcSmp_flgElecPwrLimOvrCurtActv_b@ */ /end MEASUREMENT
/begin MEASUREMENT VAR_TpcSmp_flgLinearDertOveCurtGen_b "母线过流线性降发电功率触发状态标志位" UBYTE SWC_TPC_CM_boolean 0 0 0.0 1.0 ECU_ADDRESS 0x0000 /* @ECU_Address@VAR_TpcSmp_flgLinearDertOveCurtGen_b@ */ /end MEASUREMENT
/begin MEASUREMENT VAR_TpcSmp_flgPIDertOvrCurtGen_b "母线过流PI降发电功率触发状态标志位" UBYTE SWC_TPC_CM_boolean 0 0 0.0 1.0 ECU_ADDRESS 0x0000 /* @ECU_Address@VAR_TpcSmp_flgPIDertOvrCurtGen_b@ */ /end MEASUREMENT
/begin MEASUREMENT VAR_TpcSmp_flgGenPwrLimCurtActv_b "母线过流降发电功率触发状态标志" UBYTE SWC_TPC_CM_boolean 0 0 0.0 1.0 ECU_ADDRESS 0x0000 /* @ECU_Address@VAR_TpcSmp_flgGenPwrLimCurtActv_b@ */ /end MEASUREMENT
/begin MEASUREMENT VAR_TpcSmp_flgLinearDertOvrVoltGen_b "母线过压线性降发电功率触发状态标志位" UBYTE SWC_TPC_CM_boolean 0 0 0.0 1.0 ECU_ADDRESS 0x0000 /* @ECU_Address@VAR_TpcSmp_flgLinearDertOvrVoltGen_b@ */ /end MEASUREMENT
/begin MEASUREMENT VAR_TpcMot_flgStartExcLimRamp_b "" UBYTE SWC_TPC_CM_boolean 0 0 0 1 ECU_ADDRESS 0x0000 /* @ECU_Address@VAR_TpcMot_flgStartExcLimRamp_b@ */ /end MEASUREMENT
/begin MEASUREMENT VAR_TpcSmp_flgPIDertOvrVoltGen_b "母线过压PI降发电功率触发状态标志位" UBYTE SWC_TPC_CM_boolean 0 0 0.0 1.0 ECU_ADDRESS 0x0000 /* @ECU_Address@VAR_TpcSmp_flgPIDertOvrVoltGen_b@ */ /end MEASUREMENT
/begin MEASUREMENT VAR_TpcSmp_flgGenPwrLimOvrVoltActv_b "母线过压降发电功率触发状态标志" UBYTE SWC_TPC_CM_boolean 0 0 0.0 1.0 ECU_ADDRESS 0x0000 /* @ECU_Address@VAR_TpcSmp_flgGenPwrLimOvrVoltActv_b@ */ /end MEASUREMENT
/begin MEASUREMENT VAR_TpcSmp_flgLinearDertUdrVoltElec_b "母线欠压线性降电动功率触发状态标志位" UBYTE SWC_TPC_CM_boolean 0 0 0.0 1.0 ECU_ADDRESS 0x0000 /* @ECU_Address@VAR_TpcSmp_flgLinearDertUdrVoltElec_b@ */ /end MEASUREMENT
/begin MEASUREMENT VAR_TpcSmp_flgPIDertUdrVoltElec_b "母线欠压PI降电动功率触发状态标志位" UBYTE SWC_TPC_CM_boolean 0 0 0.0 1.0 ECU_ADDRESS 0x0000 /* @ECU_Address@VAR_TpcSmp_flgPIDertUdrVoltElec_b@ */ /end MEASUREMENT
/begin MEASUREMENT VAR_TpcSmp_flgElecPwrLimUdrVoltActv_b "母线欠压降电动功率触发状态标志" UBYTE SWC_TPC_CM_boolean 0 0 0.0 1.0 ECU_ADDRESS 0x0000 /* @ECU_Address@VAR_TpcSmp_flgElecPwrLimUdrVoltActv_b@ */ /end MEASUREMENT
/begin MEASUREMENT VAR_TpcCod_flgMotorElecMode_b "电机处于电动模式标志位" UBYTE SWC_TPC_CM_boolean 0 0 0.0 1.0 ECU_ADDRESS 0x0000 /* @ECU_Address@VAR_TpcCod_flgMotorElecMode_b@ */ /end MEASUREMENT
/begin MEASUREMENT VAR_TpcFuv_FimTrqLimLv1_b "一级故障限扭矩FIM状态" UBYTE SWC_TPC_CM_boolean 0 0 0 1 ECU_ADDRESS 0x0000 /* @ECU_Address@VAR_TpcFuv_FimTrqLimLv1_b@ */ /end MEASUREMENT
/begin MEASUREMENT VAR_TpcFuv_FimTrqLimLv2_b "二级故障限扭矩FIM状态" UBYTE SWC_TPC_CM_boolean 0 0 0 1 ECU_ADDRESS 0x0000 /* @ECU_Address@VAR_TpcFuv_FimTrqLimLv2_b@ */ /end MEASUREMENT
/begin MEASUREMENT VAR_TpcFuv_FimTrqLimLv3_b "三级故障限扭矩FIM状态" UBYTE SWC_TPC_CM_boolean 0 0 0 1 ECU_ADDRESS 0x0000 /* @ECU_Address@VAR_TpcFuv_FimTrqLimLv3_b@ */ /end MEASUREMENT
/begin MEASUREMENT VAR_TpcFuv_FimTrqLimLv4_b "四级故障限扭矩FIM状态" UBYTE SWC_TPC_CM_boolean 0 0 0 1 ECU_ADDRESS 0x0000 /* @ECU_Address@VAR_TpcFuv_FimTrqLimLv4_b@ */ /end MEASUREMENT
/begin MEASUREMENT VAR_TpcFuv_FimPwrLimLv1_b "一级故障限功率FIM状态" UBYTE SWC_TPC_CM_boolean 0 0 0 1 ECU_ADDRESS 0x0000 /* @ECU_Address@VAR_TpcFuv_FimPwrLimLv1_b@ */ /end MEASUREMENT
/begin MEASUREMENT VAR_TpcFuv_FimPwrLimLv2_b "二级故障限功率FIM状态" UBYTE SWC_TPC_CM_boolean 0 0 0 1 ECU_ADDRESS 0x0000 /* @ECU_Address@VAR_TpcFuv_FimPwrLimLv2_b@ */ /end MEASUREMENT
/begin MEASUREMENT VAR_TpcFuv_FimPwrLimLv3_b "三级故障限功率FIM状态" UBYTE SWC_TPC_CM_boolean 0 0 0 1 ECU_ADDRESS 0x0000 /* @ECU_Address@VAR_TpcFuv_FimPwrLimLv3_b@ */ /end MEASUREMENT
/begin MEASUREMENT VAR_TpcFuv_FimPwrLimLv4_b "四级故障限功率FIM状态" UBYTE SWC_TPC_CM_boolean 0 0 0 1 ECU_ADDRESS 0x0000 /* @ECU_Address@VAR_TpcFuv_FimPwrLimLv4_b@ */ /end MEASUREMENT
/begin MEASUREMENT VAR_TpcSmp_flgElecTrqLimOvrSpdActv_b "超速降电动扭矩触发状态标志位" UBYTE SWC_TPC_CM_boolean 0 0 0.0 1.0 ECU_ADDRESS 0x0000 /* @ECU_Address@VAR_TpcSmp_flgElecTrqLimOvrSpdActv_b@ */ /end MEASUREMENT
/begin MEASUREMENT VAR_TpcSmp_flgGenTrqLimOvrSpdActv_b "超速降发电扭矩触发状态标志位" UBYTE SWC_TPC_CM_boolean 0 0 0.0 1.0 ECU_ADDRESS 0x0000 /* @ECU_Address@VAR_TpcSmp_flgGenTrqLimOvrSpdActv_b@ */ /end MEASUREMENT
/begin MEASUREMENT VAR_tpccod_flgMaxDertExCTrq_b "" UBYTE SWC_TPC_CM_boolean 0 0 0 1 ECU_ADDRESS 0x0000 /* @ECU_Address@VAR_tpccod_flgMaxDertExCTrq_b@ */ /end MEASUREMENT
/begin MEASUREMENT VAR_tpccod_flgMaxDertStrTemp_b "" UBYTE SWC_TPC_CM_boolean 0 0 0 1 ECU_ADDRESS 0x0000 /* @ECU_Address@VAR_tpccod_flgMaxDertStrTemp_b@ */ /end MEASUREMENT
/begin MEASUREMENT VAR_tpccod_flgMaxDertTempDBC_b "" UBYTE SWC_TPC_CM_boolean 0 0 0 1 ECU_ADDRESS 0x0000 /* @ECU_Address@VAR_tpccod_flgMaxDertTempDBC_b@ */ /end MEASUREMENT
/begin MEASUREMENT VAR_tpccod_flgMaxDertTCoolant_b "" UBYTE SWC_TPC_CM_boolean 0 0 0 1 ECU_ADDRESS 0x0000 /* @ECU_Address@VAR_tpccod_flgMaxDertTCoolant_b@ */ /end MEASUREMENT
/begin MEASUREMENT VAR_tpccod_flgMaxDertTDrvBoard_b "" UBYTE SWC_TPC_CM_boolean 0 0 0 1 ECU_ADDRESS 0x0000 /* @ECU_Address@VAR_tpccod_flgMaxDertTDrvBoard_b@ */ /end MEASUREMENT
/begin MEASUREMENT VAR_tpccod_flgMaxDertTIGBT_b "" UBYTE SWC_TPC_CM_boolean 0 0 0 1 ECU_ADDRESS 0x0000 /* @ECU_Address@VAR_tpccod_flgMaxDertTIGBT_b@ */ /end MEASUREMENT
/begin MEASUREMENT VAR_tpccod_flgMaxDertMtrSpd_b "" UBYTE SWC_TPC_CM_boolean 0 0 0 1 ECU_ADDRESS 0x0000 /* @ECU_Address@VAR_tpccod_flgMaxDertMtrSpd_b@ */ /end MEASUREMENT
/begin MEASUREMENT VAR_tpccod_flgMaxDertOvrIdc_b "" UBYTE SWC_TPC_CM_boolean 0 0 0 1 ECU_ADDRESS 0x0000 /* @ECU_Address@VAR_tpccod_flgMaxDertOvrIdc_b@ */ /end MEASUREMENT
/begin MEASUREMENT VAR_tpccod_flgMaxDertUndrUdc_b "" UBYTE SWC_TPC_CM_boolean 0 0 0 1 ECU_ADDRESS 0x0000 /* @ECU_Address@VAR_tpccod_flgMaxDertUndrUdc_b@ */ /end MEASUREMENT
/begin MEASUREMENT VAR_tpccod_flgMaxDertOvrUdc_b "" UBYTE SWC_TPC_CM_boolean 0 0 0 1 ECU_ADDRESS 0x0000 /* @ECU_Address@VAR_tpccod_flgMaxDertOvrUdc_b@ */ /end MEASUREMENT
/begin MEASUREMENT VAR_tpccod_flgMaxDertCAN_b "" UBYTE SWC_TPC_CM_boolean 0 0 0 1 ECU_ADDRESS 0x0000 /* @ECU_Address@VAR_tpccod_flgMaxDertCAN_b@ */ /end MEASUREMENT
/begin MEASUREMENT VAR_tpccod_flgMinDertExCTrq_b "" UBYTE SWC_TPC_CM_boolean 0 0 0 1 ECU_ADDRESS 0x0000 /* @ECU_Address@VAR_tpccod_flgMinDertExCTrq_b@ */ /end MEASUREMENT
/begin MEASUREMENT VAR_tpccod_flgMinDertStrTemp_b "" UBYTE SWC_TPC_CM_boolean 0 0 0 1 ECU_ADDRESS 0x0000 /* @ECU_Address@VAR_tpccod_flgMinDertStrTemp_b@ */ /end MEASUREMENT
/begin MEASUREMENT VAR_tpccod_flgMinDertTempDBC_b "" UBYTE SWC_TPC_CM_boolean 0 0 0 1 ECU_ADDRESS 0x0000 /* @ECU_Address@VAR_tpccod_flgMinDertTempDBC_b@ */ /end MEASUREMENT
/begin MEASUREMENT VAR_tpccod_flgMinDertTCoolant_b "" UBYTE SWC_TPC_CM_boolean 0 0 0 1 ECU_ADDRESS 0x0000 /* @ECU_Address@VAR_tpccod_flgMinDertTCoolant_b@ */ /end MEASUREMENT
/begin MEASUREMENT VAR_tpccod_flgMinDertTDrvBoard_b "" UBYTE SWC_TPC_CM_boolean 0 0 0 1 ECU_ADDRESS 0x0000 /* @ECU_Address@VAR_tpccod_flgMinDertTDrvBoard_b@ */ /end MEASUREMENT
/begin MEASUREMENT VAR_tpccod_flgMinDertTIGBT_b "" UBYTE SWC_TPC_CM_boolean 0 0 0 1 ECU_ADDRESS 0x0000 /* @ECU_Address@VAR_tpccod_flgMinDertTIGBT_b@ */ /end MEASUREMENT
/begin MEASUREMENT VAR_tpccod_flgMinDertMtrSpd_b "" UBYTE SWC_TPC_CM_boolean 0 0 0 1 ECU_ADDRESS 0x0000 /* @ECU_Address@VAR_tpccod_flgMinDertMtrSpd_b@ */ /end MEASUREMENT
/begin MEASUREMENT VAR_tpccod_flgMinDertOvrIdc_b "" UBYTE SWC_TPC_CM_boolean 0 0 0 1 ECU_ADDRESS 0x0000 /* @ECU_Address@VAR_tpccod_flgMinDertOvrIdc_b@ */ /end MEASUREMENT
/begin MEASUREMENT VAR_tpccod_flgMinDertUndrUdc_b "" UBYTE SWC_TPC_CM_boolean 0 0 0 1 ECU_ADDRESS 0x0000 /* @ECU_Address@VAR_tpccod_flgMinDertUndrUdc_b@ */ /end MEASUREMENT
/begin MEASUREMENT VAR_tpccod_flgMinDertOvrUdc_b "" UBYTE SWC_TPC_CM_boolean 0 0 0 1 ECU_ADDRESS 0x0000 /* @ECU_Address@VAR_tpccod_flgMinDertOvrUdc_b@ */ /end MEASUREMENT
/begin MEASUREMENT VAR_tpccod_flgMinDertCAN_b "" UBYTE SWC_TPC_CM_boolean 0 0 0 1 ECU_ADDRESS 0x0000 /* @ECU_Address@VAR_tpccod_flgMinDertCAN_b@ */ /end MEASUREMENT
/begin COMPU_METHOD SWC_TPC_CM_single "Q = V" RAT_FUNC "%8.6" "" COEFFS 0 1 0 0 0 1 /end COMPU_METHOD
/begin COMPU_METHOD SWC_TPC_CM_uint16 "Q = V" RAT_FUNC "%5.0" "" COEFFS 0 1 0 0 0 1 /end COMPU_METHOD
/begin COMPU_METHOD SWC_TPC_CM_boolean "Q = V" RAT_FUNC "%1.0" "" COEFFS 0 1 0 0 0 1 /end COMPU_METHOD
/begin COMPU_METHOD SWC_TPC_CM_uint8 "Q = V" RAT_FUNC "%3.0" "" COEFFS 0 1 0 0 0 1 /end COMPU_METHOD
/begin COMPU_METHOD SWC_TPC_CM_single__ "Q = V" RAT_FUNC "%8.6" "℃" COEFFS 0 1 0 0 0 1 /end COMPU_METHOD
/begin COMPU_METHOD SWC_TPC_CM_single_A "Q = V" RAT_FUNC "%8.6" "A" COEFFS 0 1 0 0 0 1 /end COMPU_METHOD
/begin COMPU_METHOD SWC_TPC_CM_single_KW "Q = V" RAT_FUNC "%8.6" "KW" COEFFS 0 1 0 0 0 1 /end COMPU_METHOD
/begin COMPU_METHOD SWC_TPC_CM_single_V "Q = V" RAT_FUNC "%8.6" "V" COEFFS 0 1 0 0 0 1 /end COMPU_METHOD
/begin COMPU_METHOD SWC_TPC_CM_single_Nm "Q = V" RAT_FUNC "%8.6" "Nm" COEFFS 0 1 0 0 0 1 /end COMPU_METHOD
/begin COMPU_METHOD SWC_TPC_CM_int16 "Q = V" RAT_FUNC "%5.0" "" COEFFS 0 1 0 0 0 1 /end COMPU_METHOD
/begin GROUP SWC_TPC "SWC_TPC" /* Root */ ROOT /begin SUB_GROUP Root_RE_SWC_TPC_10ms_sys /end SUB_GROUP /end GROUP
/begin GROUP Root_RE_SWC_TPC_10ms_sys "SWC_TPC/RE_SWC_TPC_10ms_sys" /begin SUB_GROUP S1_TPC /end SUB_GROUP /end GROUP
/begin GROUP S1_TPC "SWC_TPC/RE_SWC_TPC_10ms_sys/TPC" /begin SUB_GROUP S3_TpcCod S3_TpcJudge /end SUB_GROUP /end GROUP
/begin GROUP S3_TpcCod "SWC_TPC/RE_SWC_TPC_10ms_sys/TPC/TpcCod"
 /begin SUB_GROUP S5_CoolantFlowControl S5_Coordinate S5_GetElecAndGenTrqLim S5_MotorModeJudgement S5_TorqueLimitationReason /end SUB_GROUP
/end GROUP
/begin GROUP S3_TpcJudge "SWC_TPC/RE_SWC_TPC_10ms_sys/TPC/TpcJudge" /begin SUB_GROUP S6_TpcBlk S6_TpcFuv S6_TpcMot S6_TpcSmp S6_TpcTmp /end SUB_GROUP /end GROUP
/begin GROUP S5_CoolantFlowControl "SWC_TPC/RE_SWC_TPC_10ms_sys/TPC/TpcCod/CoolantFlowControl" /begin SUB_GROUP S7_GetPowerIncreasrRate S7_Subsystem1 /end SUB_GROUP
 /begin REF_CHARACTERISTIC CAL_TpcCod_CntHysteresislop_u16 CAL_TpcCod_CoolFlow1LReq_f32 CAL_TpcCod_CoolFlow2LTableZ_Trq_af32 CAL_TpcCod_CoolFlow4LTableZ_Trq_af32 CAL_TpcCod_CoolFlow6LTableZ_Trq_af32 CAL_TpcCod_IGBTSampErr_b CAL_TpcCod_MotorSampErr_b CAL_TpcCod_MotorStallWarn_b CAL_TpcCod_PowIncRatLim_f32 CAL_TpcCod_TrqRelay_f32 /end REF_CHARACTERISTIC
 /begin REF_MEASUREMENT VAR_TpcCod_CoolantFlowFinReq_f32 VAR_TpcCod_CoolantFlowReq_f32 /end REF_MEASUREMENT
/end GROUP
/begin GROUP S5_Coordinate "SWC_TPC/RE_SWC_TPC_10ms_sys/TPC/TpcCod/Coordinate"
 /begin SUB_GROUP S8_If_Action_Subsystem S8_If_Action_Subsystem1 S8_TrqLimRampSet S8_TrqLimRampSet1 /end SUB_GROUP
 /begin REF_CHARACTERISTIC CAL_TpcCod_FlgUseTrqLimRampSet_b /end REF_CHARACTERISTIC
 /begin REF_MEASUREMENT VAR_TpcCod_flgMotorElecMode_b /end REF_MEASUREMENT
/end GROUP
/begin GROUP S5_GetElecAndGenTrqLim "SWC_TPC/RE_SWC_TPC_10ms_sys/TPC/TpcCod/GetElecAndGenTrqLim" /begin SUB_GROUP S10_GetElecTorqueLim S10_GetGenTorqueLim /end SUB_GROUP /end GROUP
/begin GROUP S5_MotorModeJudgement "SWC_TPC/RE_SWC_TPC_10ms_sys/TPC/TpcCod/MotorModeJudgement" /begin SUB_GROUP S12_GetSpdDirection S12_GetTorqueDirection /end SUB_GROUP /end GROUP
/begin GROUP S5_TorqueLimitationReason "SWC_TPC/RE_SWC_TPC_10ms_sys/TPC/TpcCod/TorqueLimitationReason" /begin SUB_GROUP S13_TorqLimReasonJudge /end SUB_GROUP /end GROUP
/begin GROUP S6_TpcBlk "SWC_TPC/RE_SWC_TPC_10ms_sys/TPC/TpcJudge/TpcBlk"
 /begin REF_CHARACTERISTIC CAL_TpcBlk_BlkRevTimSet_u16 CAL_TpcBlk_BlkTimSet_u16 CAL_TpcBlk_MtrBlkIsFirstSet_f32 CAL_TpcBlk_MtrBlkIsSecondSet_f32 CAL_TpcBlk_MtrBlkSpdHighSet_f32 CAL_TpcBlk_MtrBlkSpdLowSet_f32 CAL_TpcBlk_TrqBlkStab_f32 CAL_TpcBlk_TrqDecRamp_f32 CAL_TpcBlk_TrqIncRamp_f32 CAL_TpcBlk_flgEnBlkFun_b /end REF_CHARACTERISTIC
 /begin REF_MEASUREMENT VAR_TpcBlk_IsSum_f32 VAR_TpcBlk_IsValid_f32 VAR_Tpcblk_TrqLim01_f32 VAR_Tpcblk_TrqLim_f32 VAR_Tpcblk_TrqMax_f32 VAR_Tpcblk_TrqMin_f32 /end REF_MEASUREMENT
/end GROUP
/begin GROUP S6_TpcFuv "SWC_TPC/RE_SWC_TPC_10ms_sys/TPC/TpcJudge/TpcFuv" /begin SUB_GROUP S106_DeratingStrategy_FultLv S106_GetFaultLevelStatus /end SUB_GROUP /end GROUP
/begin GROUP S6_TpcMot "SWC_TPC/RE_SWC_TPC_10ms_sys/TPC/TpcJudge/TpcMot"
 /begin SUB_GROUP S107_ExternalCharacteristicDerating S107_GetTrqPwrBenchmark S107_SttrTemperatureDerating /end SUB_GROUP
/end GROUP
/begin GROUP S6_TpcSmp "SWC_TPC/RE_SWC_TPC_10ms_sys/TPC/TpcJudge/TpcSmp"
 /begin SUB_GROUP S108_DeratingStrategyCurrent S108_DeratingStrategyVoltage S108_DeratingStrategy_OverSpeed S108_GetBatteryCapacity S108_GetVcuTrqDertCommand /end SUB_GROUP
/end GROUP
/begin GROUP S6_TpcTmp "SWC_TPC/RE_SWC_TPC_10ms_sys/TPC/TpcJudge/TpcTmp"
 /begin SUB_GROUP S109_CoolantTemperatureDerating S109_DbcTemperatureDerating S109_DrvBoardTemperatureDerating S109_IGBTTemperatureDerating /end SUB_GROUP
 /begin REF_MEASUREMENT VAR_TpcTmp_tCoolTempFlt_u16 /end REF_MEASUREMENT
/end GROUP
/begin GROUP S7_GetPowerIncreasrRate "SWC_TPC/RE_SWC_TPC_10ms_sys/TPC/TpcCod/CoolantFlowControl/GetPowerIncreasrRate" /begin REF_MEASUREMENT VAR_TpcCod_PowerAdd_f32 VAR_TpcCod_PowerIncreaseRate_f32 /end REF_MEASUREMENT /end GROUP
/begin GROUP S7_Subsystem1 "SWC_TPC/RE_SWC_TPC_10ms_sys/TPC/TpcCod/CoolantFlowControl/Subsystem1" /begin REF_CHARACTERISTIC CAL_TpcCod_NTCHighTemp_f32 CAL_TpcCod_NTCLowTemp_f32 /end REF_CHARACTERISTIC /end GROUP
/begin GROUP S8_If_Action_Subsystem "SWC_TPC/RE_SWC_TPC_10ms_sys/TPC/TpcCod/Coordinate/If Action Subsystem" /begin SUB_GROUP S17_Chart /end SUB_GROUP /begin REF_CHARACTERISTIC CAL_TpcCod_PosSpdHold_f32 CAL_TpcCod_PosSpdStart_f32 /end REF_CHARACTERISTIC /end GROUP
/begin GROUP S8_If_Action_Subsystem1 "SWC_TPC/RE_SWC_TPC_10ms_sys/TPC/TpcCod/Coordinate/If Action Subsystem1" /begin SUB_GROUP S18_Chart /end SUB_GROUP /begin REF_CHARACTERISTIC CAL_TpcCod_PosSpdHold_f32 CAL_TpcCod_PosSpdStart_f32 /end REF_CHARACTERISTIC /end GROUP
/begin GROUP S8_TrqLimRampSet "SWC_TPC/RE_SWC_TPC_10ms_sys/TPC/TpcCod/Coordinate/TrqLimRampSet" /begin REF_CHARACTERISTIC CAL_Tpc_TrqRevStep_f32 /end REF_CHARACTERISTIC /end GROUP
/begin GROUP S8_TrqLimRampSet1 "SWC_TPC/RE_SWC_TPC_10ms_sys/TPC/TpcCod/Coordinate/TrqLimRampSet1" /begin REF_CHARACTERISTIC CAL_Tpc_TrqRevStep_f32 /end REF_CHARACTERISTIC /end GROUP
/begin GROUP S10_GetElecTorqueLim "SWC_TPC/RE_SWC_TPC_10ms_sys/TPC/TpcCod/GetElecAndGenTrqLim/GetElecTorqueLim" /begin SUB_GROUP S33_GetTrqFromPwr S33_GetTrqFromPwr1 S33_GetTrqFromPwr2 /end SUB_GROUP /begin REF_MEASUREMENT VAR_TpcCod_ElecTrqLim_f32 /end REF_MEASUREMENT /end GROUP
/begin GROUP S10_GetGenTorqueLim "SWC_TPC/RE_SWC_TPC_10ms_sys/TPC/TpcCod/GetElecAndGenTrqLim/GetGenTorqueLim" /begin SUB_GROUP S34_GetTrqFromPwr S34_GetTrqFromPwr1 S34_GetTrqFromPwr2 /end SUB_GROUP /begin REF_MEASUREMENT VAR_TpcCod_GenTrqLim_f32 /end REF_MEASUREMENT /end GROUP
/begin GROUP S12_GetSpdDirection "SWC_TPC/RE_SWC_TPC_10ms_sys/TPC/TpcCod/MotorModeJudgement/GetSpdDirection" /begin REF_CHARACTERISTIC CAL_TpcCod_NegSpdDirStop_f32 CAL_TpcCod_PosSpdDirStop_f32 /end REF_CHARACTERISTIC /end GROUP
/begin GROUP S12_GetTorqueDirection "SWC_TPC/RE_SWC_TPC_10ms_sys/TPC/TpcCod/MotorModeJudgement/GetTorqueDirection" /begin REF_CHARACTERISTIC CAL_TpcCod_NegTrqDirStop_f32 CAL_TpcCod_PosTrqDirStop_f32 /end REF_CHARACTERISTIC /end GROUP
/begin GROUP S13_TorqLimReasonJudge "SWC_TPC/RE_SWC_TPC_10ms_sys/TPC/TpcCod/TorqueLimitationReason/TorqLimReasonJudge"
 /begin SUB_GROUP S53_TorqLimReason_Can S53_TorqLimReason_ExcTrq S53_TorqLimReason_Idc S53_TorqLimReason_MtrSpd S53_TorqLimReason_OvUdc S53_TorqLimReason_TCool S53_TorqLimReason_TDbc S53_TorqLimReason_TDrvBoard S53_TorqLimReason_TIGBT S53_TorqLimReason_Tsttr S53_TorqLimReason_UnUdc /end SUB_GROUP
/end GROUP
/begin GROUP S106_DeratingStrategy_FultLv "SWC_TPC/RE_SWC_TPC_10ms_sys/TPC/TpcJudge/TpcFuv/DeratingStrategy_FultLv"
 /begin REF_CHARACTERISTIC CAL_TpcFuv_CofPwrLimLv1_f32 CAL_TpcFuv_CofPwrLimLv2_f32 CAL_TpcFuv_CofPwrLimLv3_f32 CAL_TpcFuv_CofPwrLimLv4_f32 CAL_TpcFuv_CofTrqLimLv1_f32 CAL_TpcFuv_CofTrqLimLv2_f32 CAL_TpcFuv_CofTrqLimLv3_f32 CAL_TpcFuv_CofTrqLimLv4_f32 /end REF_CHARACTERISTIC
 /begin REF_MEASUREMENT VAR_TpcFuv_ElecPwrLimDiag_f32 VAR_TpcFuv_ElecTrqLimDiag_f32 VAR_TpcFuv_GenPwrLimDiag_f32 VAR_TpcFuv_GenTrqLimDiag_f32 /end REF_MEASUREMENT
/end GROUP
/begin GROUP S106_GetFaultLevelStatus "SWC_TPC/RE_SWC_TPC_10ms_sys/TPC/TpcJudge/TpcFuv/GetFaultLevelStatus"
 /begin REF_MEASUREMENT VAR_TpcFuv_FimPwrLimLv1_b VAR_TpcFuv_FimPwrLimLv2_b VAR_TpcFuv_FimPwrLimLv3_b VAR_TpcFuv_FimPwrLimLv4_b VAR_TpcFuv_FimTrqLimLv1_b VAR_TpcFuv_FimTrqLimLv2_b VAR_TpcFuv_FimTrqLimLv3_b VAR_TpcFuv_FimTrqLimLv4_b /end REF_MEASUREMENT
/end GROUP
/begin GROUP S107_ExternalCharacteristicDerating "SWC_TPC/RE_SWC_TPC_10ms_sys/TPC/TpcJudge/TpcMot/ExternalCharacteristicDerating"
 /begin SUB_GROUP S116_TrqLimRampRiseAndReduceSet S116_TrqLimRampRiseAndReduceSet1 /end SUB_GROUP
 /begin REF_CHARACTERISTIC CAL_TpcMot_ExCElecTableZ_Trq_af32 CAL_TpcMot_ExCGenTableZ_Trq_af32 CAL_Tpcmot_CofuDclnk_u8 CAL_Tpcmot_TrqDiffExc_f32 CAL_Tpcmot_TrqDiffGen_f32 CAL_Tpcmot_flgOpenExcLimRamp_b CAL_Tpcmot_uDcHiset_f32 CAL_Tpcmot_uDcLoset_f32 /end REF_CHARACTERISTIC
 /begin REF_MEASUREMENT VAR_TpcMot_TrqElecExCOrg_f32 VAR_TpcMot_TrqElecExC_f32 VAR_TpcMot_TrqGenExCOrg_f32 VAR_TpcMot_TrqGenExC_f32 VAR_TpcMot_flgStartExcLimRamp_b /end REF_MEASUREMENT
/end GROUP
/begin GROUP S107_GetTrqPwrBenchmark "SWC_TPC/RE_SWC_TPC_10ms_sys/TPC/TpcJudge/TpcMot/GetTrqPwrBenchmark" /begin REF_CHARACTERISTIC CAL_TpcMot_flgPwrRefSwt_b CAL_TpcMot_flgTrqRefSwt_b /end REF_CHARACTERISTIC
 /begin REF_MEASUREMENT VAR_TpcMot_ElecPwrRef_f32 VAR_TpcMot_ElecTrqRef_f32 VAR_TpcMot_GenPwrRef_f32 VAR_TpcMot_GenTrqRef_f32 /end REF_MEASUREMENT
/end GROUP
/begin GROUP S107_SttrTemperatureDerating "SWC_TPC/RE_SWC_TPC_10ms_sys/TPC/TpcJudge/TpcMot/SttrTemperatureDerating"
 /begin SUB_GROUP S119_DemStatorTemperature S119_GetRampElecTrqLim S119_GetRampGenTrqLim S119_GetSttrTempLimTorq S119_GetTRiseSttrDeratingCof S119_GetTsttrDeratingCof S119_SttrTempFlt /end SUB_GROUP
 /begin REF_CHARACTERISTIC CAL_TpcMot_SttrTempAdds_f32 CAL_TpcMot_SttrTempDecDiff_f32 CAL_TpcMot_SttrTempKp_f32 CAL_TpcMot_SttrTempMinus_f32 CAL_TpcMot_SttrTempRiseDiff_f32 CAL_TpcMot_tSttrTrqLimRamp_f32 /end REF_CHARACTERISTIC
/end GROUP
/begin GROUP S108_DeratingStrategyCurrent "SWC_TPC/RE_SWC_TPC_10ms_sys/TPC/TpcJudge/TpcSmp/DeratingStrategyCurrent"
 /begin SUB_GROUP S140_DemBusCurrent S140_DeratingStrategy_OvercurrentElec S140_DeratingStrategy_OvercurrentGen /end SUB_GROUP
/end GROUP
/begin GROUP S108_DeratingStrategyVoltage "SWC_TPC/RE_SWC_TPC_10ms_sys/TPC/TpcJudge/TpcSmp/DeratingStrategyVoltage"
 /begin SUB_GROUP S141_DeratingStrategy_Overvoltage S141_DeratingStrategy_Undervoltage /end SUB_GROUP
/end GROUP
/begin GROUP S108_DeratingStrategy_OverSpeed "SWC_TPC/RE_SWC_TPC_10ms_sys/TPC/TpcJudge/TpcSmp/DeratingStrategy_OverSpeed" /begin SUB_GROUP S142_Subsystem S142_Subsystem1 /end SUB_GROUP /end GROUP
/begin GROUP S108_GetBatteryCapacity "SWC_TPC/RE_SWC_TPC_10ms_sys/TPC/TpcJudge/TpcSmp/GetBatteryCapacity"
 /begin REF_CHARACTERISTIC CAL_TpcSmp_iDcLnkMaxMax_f32 CAL_TpcSmp_iDcLnkMaxMin_f32 CAL_TpcSmp_iDcLnkMinMax_f32 CAL_TpcSmp_iDcLnkMinMin_f32 CAL_TpcSmp_uDcLnkMaxMax_f32 CAL_TpcSmp_uDcLnkMaxMin_f32 CAL_TpcSmp_uDcLnkMinMax_f32 CAL_TpcSmp_uDcLnkMinMin_f32 /end REF_CHARACTERISTIC
 /begin REF_MEASUREMENT VAR_TpcSmp_iDcLnkMax_f32 VAR_TpcSmp_iDcLnkMin_f32 VAR_TpcSmp_uDcLnkMax_f32 VAR_TpcSmp_uDcLnkMin_f32 /end REF_MEASUREMENT
/end GROUP
/begin GROUP S108_GetVcuTrqDertCommand "SWC_TPC/RE_SWC_TPC_10ms_sys/TPC/TpcJudge/TpcSmp/GetVcuTrqDertCommand" /begin REF_CHARACTERISTIC CAL_TpcSmp_nCtlExtReq_u8 CAL_TpcSmp_nCtlIntReq_u8 /end REF_CHARACTERISTIC /begin REF_MEASUREMENT VAR_TpcSmp_TrqMaxCanSet_f32 VAR_TpcSmp_TrqMinCanSet_f32 /end REF_MEASUREMENT /end GROUP
/begin GROUP S109_CoolantTemperatureDerating "SWC_TPC/RE_SWC_TPC_10ms_sys/TPC/TpcJudge/TpcTmp/CoolantTemperatureDerating"
 /begin SUB_GROUP S194_DemCoolantTemperature S194_DeratingStrategy_TCoolant S194_GetDeratingFlag_TCoolant /end SUB_GROUP
/end GROUP
/begin GROUP S109_DbcTemperatureDerating "SWC_TPC/RE_SWC_TPC_10ms_sys/TPC/TpcJudge/TpcTmp/DbcTemperatureDerating"
 /begin SUB_GROUP S195_DBCTemperatureDerating S195_DbcTempFlt S195_DemDbcTemperature S195_GetDeratingFlag_Tdbc S195_GetMaxDbcTemp S195_GetRampElecTrqLim S195_GetRampGenTrqLim /end SUB_GROUP
 /begin REF_CHARACTERISTIC CAL_TpcTmp_DBCTempAdds_f32 CAL_TpcTmp_DBCTempDecDiff_f32 CAL_TpcTmp_DBCTempKp_f32 CAL_TpcTmp_DBCTempMinus_f32 CAL_TpcTmp_DBCTempRiseDiff_f32 CAL_TpcTmp_tDBCTrqLimRamp_f32 /end REF_CHARACTERISTIC
/end GROUP
/begin GROUP S109_DrvBoardTemperatureDerating "SWC_TPC/RE_SWC_TPC_10ms_sys/TPC/TpcJudge/TpcTmp/DrvBoardTemperatureDerating"
 /begin SUB_GROUP S196_DemDrvBoardTemperature S196_DeratingStrategy_TDrvBoard S196_GetDeratingFlag_TDrvBoard /end SUB_GROUP
/end GROUP
/begin GROUP S109_IGBTTemperatureDerating "SWC_TPC/RE_SWC_TPC_10ms_sys/TPC/TpcJudge/TpcTmp/IGBTTemperatureDerating"
 /begin SUB_GROUP S197_DemIGBTTemperature S197_GetIGBTTempLimTorq S197_GetRampElecTrqLim S197_GetRampGenTrqLim S197_GetTIGBTDeratingCof S197_GetTRiseIGBTDeratingCof S197_IgbtTempFlt /end SUB_GROUP
 /begin REF_CHARACTERISTIC CAL_TpcTmp_IGBTTempAdds_f32 CAL_TpcTmp_IGBTTempDecDiff_f32 CAL_TpcTmp_IGBTTempKp_f32 CAL_TpcTmp_IGBTTempMinus_f32 CAL_TpcTmp_IGBTTempRiseDiff_f32 CAL_TpcTmp_tIGBTTrqLimRamp_f32 /end REF_CHARACTERISTIC
/end GROUP
/begin GROUP S17_Chart "SWC_TPC/RE_SWC_TPC_10ms_sys/TPC/TpcCod/Coordinate/If Action Subsystem/Chart" /begin SUB_GROUP S23_fun /end SUB_GROUP /end GROUP
/begin GROUP S18_Chart "SWC_TPC/RE_SWC_TPC_10ms_sys/TPC/TpcCod/Coordinate/If Action Subsystem1/Chart" /begin SUB_GROUP S25_fun /end SUB_GROUP /end GROUP
/begin GROUP S33_GetTrqFromPwr "SWC_TPC/RE_SWC_TPC_10ms_sys/TPC/TpcCod/GetElecAndGenTrqLim/GetElecTorqueLim/GetTrqFromPwr" /begin REF_MEASUREMENT VAR_TpcCod_ElecTrqCalcOvrCurt_f32 /end REF_MEASUREMENT /end GROUP
/begin GROUP S33_GetTrqFromPwr1 "SWC_TPC/RE_SWC_TPC_10ms_sys/TPC/TpcCod/GetElecAndGenTrqLim/GetElecTorqueLim/GetTrqFromPwr1" /begin REF_MEASUREMENT VAR_TpcCod_ElecTrqCalcUdrVolt_f32 /end REF_MEASUREMENT /end GROUP
/begin GROUP S33_GetTrqFromPwr2 "SWC_TPC/RE_SWC_TPC_10ms_sys/TPC/TpcCod/GetElecAndGenTrqLim/GetElecTorqueLim/GetTrqFromPwr2" /begin REF_MEASUREMENT VAR_TpcCod_ElecTrqCalcDiag_f32 /end REF_MEASUREMENT /end GROUP
/begin GROUP S34_GetTrqFromPwr "SWC_TPC/RE_SWC_TPC_10ms_sys/TPC/TpcCod/GetElecAndGenTrqLim/GetGenTorqueLim/GetTrqFromPwr" /begin REF_MEASUREMENT VAR_TpcCod_GenTrqCalcOvrCurt_f32 /end REF_MEASUREMENT /end GROUP
/begin GROUP S34_GetTrqFromPwr1 "SWC_TPC/RE_SWC_TPC_10ms_sys/TPC/TpcCod/GetElecAndGenTrqLim/GetGenTorqueLim/GetTrqFromPwr1" /begin REF_MEASUREMENT VAR_TpcCod_GenTrqCalcOvrVolt_f32 /end REF_MEASUREMENT /end GROUP
/begin GROUP S34_GetTrqFromPwr2 "SWC_TPC/RE_SWC_TPC_10ms_sys/TPC/TpcCod/GetElecAndGenTrqLim/GetGenTorqueLim/GetTrqFromPwr2" /begin REF_MEASUREMENT VAR_TpcCod_GenTrqCalcDiag_f32 /end REF_MEASUREMENT /end GROUP
/begin GROUP S53_TorqLimReason_Can "SWC_TPC/RE_SWC_TPC_10ms_sys/TPC/TpcCod/TorqueLimitationReason/TorqLimReasonJudge/TorqLimReason_Can" /begin SUB_GROUP S55_AEqualB24 S55_AEqualB33 /end SUB_GROUP /end GROUP
/begin GROUP S53_TorqLimReason_ExcTrq "SWC_TPC/RE_SWC_TPC_10ms_sys/TPC/TpcCod/TorqueLimitationReason/TorqLimReasonJudge/TorqLimReason_ExcTrq"
 /begin REF_MEASUREMENT VAR_tpccod_flgMaxDertExCTrq_b VAR_tpccod_flgMinDertExCTrq_b /end REF_MEASUREMENT
/end GROUP
/begin GROUP S53_TorqLimReason_Idc "SWC_TPC/RE_SWC_TPC_10ms_sys/TPC/TpcCod/TorqueLimitationReason/TorqLimReasonJudge/TorqLimReason_Idc"
 /begin REF_MEASUREMENT VAR_tpccod_flgMaxDertOvrIdc_b VAR_tpccod_flgMinDertOvrIdc_b /end REF_MEASUREMENT
/end GROUP
/begin GROUP S53_TorqLimReason_MtrSpd "SWC_TPC/RE_SWC_TPC_10ms_sys/TPC/TpcCod/TorqueLimitationReason/TorqLimReasonJudge/TorqLimReason_MtrSpd"
 /begin REF_MEASUREMENT VAR_tpccod_flgMaxDertMtrSpd_b VAR_tpccod_flgMinDertMtrSpd_b /end REF_MEASUREMENT
/end GROUP
/begin GROUP S53_TorqLimReason_OvUdc "SWC_TPC/RE_SWC_TPC_10ms_sys/TPC/TpcCod/TorqueLimitationReason/TorqLimReasonJudge/TorqLimReason_OvUdc"
 /begin REF_MEASUREMENT VAR_tpccod_flgMaxDertOvrUdc_b VAR_tpccod_flgMinDertOvrUdc_b /end REF_MEASUREMENT
/end GROUP
/begin GROUP S53_TorqLimReason_TCool "SWC_TPC/RE_SWC_TPC_10ms_sys/TPC/TpcCod/TorqueLimitationReason/TorqLimReasonJudge/TorqLimReason_TCool"
 /begin REF_MEASUREMENT VAR_tpccod_flgMaxDertTCoolant_b VAR_tpccod_flgMinDertTCoolant_b /end REF_MEASUREMENT
/end GROUP
/begin GROUP S53_TorqLimReason_TDbc "SWC_TPC/RE_SWC_TPC_10ms_sys/TPC/TpcCod/TorqueLimitationReason/TorqLimReasonJudge/TorqLimReason_TDbc"
 /begin REF_MEASUREMENT VAR_tpccod_flgMaxDertTempDBC_b VAR_tpccod_flgMinDertTempDBC_b /end REF_MEASUREMENT
/end GROUP
/begin GROUP S53_TorqLimReason_TDrvBoard "SWC_TPC/RE_SWC_TPC_10ms_sys/TPC/TpcCod/TorqueLimitationReason/TorqLimReasonJudge/TorqLimReason_TDrvBoard"
 /begin REF_MEASUREMENT VAR_tpccod_flgMaxDertTDrvBoard_b VAR_tpccod_flgMinDertTDrvBoard_b /end REF_MEASUREMENT
/end GROUP
/begin GROUP S53_TorqLimReason_TIGBT "SWC_TPC/RE_SWC_TPC_10ms_sys/TPC/TpcCod/TorqueLimitationReason/TorqLimReasonJudge/TorqLimReason_TIGBT" /begin REF_MEASUREMENT VAR_tpccod_flgMaxDertTIGBT_b VAR_tpccod_flgMinDertTIGBT_b /end REF_MEASUREMENT /end GROUP
/begin GROUP S53_TorqLimReason_Tsttr "SWC_TPC/RE_SWC_TPC_10ms_sys/TPC/TpcCod/TorqueLimitationReason/TorqLimReasonJudge/TorqLimReason_Tsttr"
 /begin REF_MEASUREMENT VAR_tpccod_flgMaxDertStrTemp_b VAR_tpccod_flgMinDertStrTemp_b /end REF_MEASUREMENT
/end GROUP
/begin GROUP S53_TorqLimReason_UnUdc "SWC_TPC/RE_SWC_TPC_10ms_sys/TPC/TpcCod/TorqueLimitationReason/TorqLimReasonJudge/TorqLimReason_UnUdc"
 /begin REF_MEASUREMENT VAR_tpccod_flgMaxDertUndrUdc_b VAR_tpccod_flgMinDertUndrUdc_b /end REF_MEASUREMENT
/end GROUP
/begin GROUP S116_TrqLimRampRiseAndReduceSet "SWC_TPC/RE_SWC_TPC_10ms_sys/TPC/TpcJudge/TpcMot/ExternalCharacteristicDerating/TrqLimRampRiseAndReduceSet" /begin SUB_GROUP S122_Subsystem1 /end SUB_GROUP /end GROUP
/begin GROUP S116_TrqLimRampRiseAndReduceSet1 "SWC_TPC/RE_SWC_TPC_10ms_sys/TPC/TpcJudge/TpcMot/ExternalCharacteristicDerating/TrqLimRampRiseAndReduceSet1" /begin SUB_GROUP S123_Subsystem1 /end SUB_GROUP /end GROUP
/begin GROUP S119_DemStatorTemperature "SWC_TPC/RE_SWC_TPC_10ms_sys/TPC/TpcJudge/TpcMot/SttrTemperatureDerating/DemStatorTemperature" /begin REF_CHARACTERISTIC CAL_TpcMot_tSttrHiLim_f32 CAL_TpcMot_tSttrLoLim_f32 /end REF_CHARACTERISTIC
 /begin REF_MEASUREMENT VAR_TpcMot_TSttrOvHiLimErrState_u8 VAR_TpcMot_TSttrOvHiWarnState_u8 VAR_TpcMot_TSttrOvLoWarnState_u8 /end REF_MEASUREMENT
/end GROUP
/begin GROUP S119_GetRampElecTrqLim "SWC_TPC/RE_SWC_TPC_10ms_sys/TPC/TpcJudge/TpcMot/SttrTemperatureDerating/GetRampElecTrqLim" /begin REF_MEASUREMENT VAR_TpcMot_ElecTrqLimTsttr_f32 /end REF_MEASUREMENT /end GROUP
/begin GROUP S119_GetRampGenTrqLim "SWC_TPC/RE_SWC_TPC_10ms_sys/TPC/TpcJudge/TpcMot/SttrTemperatureDerating/GetRampGenTrqLim" /begin REF_MEASUREMENT VAR_TpcMot_GenTrqLimTsttr_f32 /end REF_MEASUREMENT /end GROUP
/begin GROUP S119_GetSttrTempLimTorq "SWC_TPC/RE_SWC_TPC_10ms_sys/TPC/TpcJudge/TpcMot/SttrTemperatureDerating/GetSttrTempLimTorq" /begin SUB_GROUP S129_GetDeratingFlag_TIGBT /end SUB_GROUP
 /begin REF_MEASUREMENT VAR_TpcMot_ElecTrqLimTsttrWoRamp_f32 VAR_TpcMot_GenTrqLimTsttrWoRamp_f32 /end REF_MEASUREMENT
/end GROUP
/begin GROUP S119_GetTRiseSttrDeratingCof "SWC_TPC/RE_SWC_TPC_10ms_sys/TPC/TpcJudge/TpcMot/SttrTemperatureDerating/GetTRiseSttrDeratingCof"
 /begin REF_CHARACTERISTIC CAL_TpcMot_tRiseSttrDertSave1TableY_Cof_af32 CAL_TpcMot_tRiseSttrDertSave2TableY_Cof_af32 CAL_TpcMot_tRiseSttrTraNormalToSave1_f32 CAL_TpcMot_tRiseSttrTraSave1ToNormal_f32 CAL_TpcMot_tRiseSttrTraSave1ToSave2_f32 CAL_TpcMot_tRiseSttrTraSave2ToOverheating_f32 CAL_Tpc_NormalMode_u8 CAL_Tpc_OverheatingMode_u8 CAL_Tpc_Powersave1Mode_u8 CAL_Tpc_Powersave2Mode_u8 /end REF_CHARACTERISTIC
 /begin REF_MEASUREMENT VAR_TpcMot_CofDertTRiseSttrSave1_f32 VAR_TpcMot_CofDertTRiseSttrSave2_f32 VAR_TpcMot_CofDertTRiseSttr_f32 VAR_TpcMot_tRiseSttrOperationMode_u8 VAR_TpcMot_tRiseSttr_f32 /end REF_MEASUREMENT
/end GROUP
/begin GROUP S119_GetTsttrDeratingCof "SWC_TPC/RE_SWC_TPC_10ms_sys/TPC/TpcJudge/TpcMot/SttrTemperatureDerating/GetTsttrDeratingCof"
 /begin REF_CHARACTERISTIC CAL_TpcMot_tSttrDertSave1TableY_Cof_af32 CAL_TpcMot_tSttrDertSave2TableY_Cof_af32 CAL_TpcMot_tSttrTraNormalToSave1_f32 CAL_TpcMot_tSttrTraSave1ToNormal_f32 CAL_TpcMot_tSttrTraSave1ToSave2_f32 CAL_TpcMot_tSttrTraSave2ToOverheating_f32 CAL_Tpc_NormalMode_u8 CAL_Tpc_OverheatingMode_u8 CAL_Tpc_Powersave1Mode_u8 CAL_Tpc_Powersave2Mode_u8 /end REF_CHARACTERISTIC
 /begin REF_MEASUREMENT VAR_TpcMot_CofDertTSttrSave1_f32 VAR_TpcMot_CofDertTSttrSave2_f32 VAR_TpcMot_CofDertTsttr_f32 VAR_TpcMot_tSttrOperationMode_u8 /end REF_MEASUREMENT
/end GROUP
/begin GROUP S119_SttrTempFlt "SWC_TPC/RE_SWC_TPC_10ms_sys/TPC/TpcJudge/TpcMot/SttrTemperatureDerating/SttrTempFlt"
 /begin REF_CHARACTERISTIC CAL_TpcMot_SttrChgTempDownDiff_f32 CAL_TpcMot_SttrChgTempUpDiff_f32 /end REF_CHARACTERISTIC
 /begin REF_MEASUREMENT VAR_TpcMot_TsttrStableDiff_u16 VAR_TpcMot_tSttrTempFlt_f32 VAR_TpcMot_tSttrTempFlt_u16 /end REF_MEASUREMENT
/end GROUP
/begin GROUP S140_DemBusCurrent "SWC_TPC/RE_SWC_TPC_10ms_sys/TPC/TpcJudge/TpcSmp/DeratingStrategyCurrent/DemBusCurrent"
 /begin REF_CHARACTERISTIC CAL_TpcSmp_iDcLnkOvCElecLim_f32 CAL_TpcSmp_iDcLnkOvCGenLim_f32 /end REF_CHARACTERISTIC
 /begin REF_MEASUREMENT VAR_TpcSmp_iDcLnkOvCLimErrState_u8 VAR_TpcSmp_iDcLnkOvcWarnState_u8 /end REF_MEASUREMENT
/end GROUP
/begin GROUP S140_DeratingStrategy_OvercurrentElec "SWC_TPC/RE_SWC_TPC_10ms_sys/TPC/TpcJudge/TpcSmp/DeratingStrategyCurrent/DeratingStrategy_OvercurrentElec"
 /begin SUB_GROUP S147_Coordinate S147_LinearRegionPowerDerating S147_PIRegionPowerDerting S147_Subsystem /end SUB_GROUP
/end GROUP
/begin GROUP S140_DeratingStrategy_OvercurrentGen "SWC_TPC/RE_SWC_TPC_10ms_sys/TPC/TpcJudge/TpcSmp/DeratingStrategyCurrent/DeratingStrategy_OvercurrentGen"
 /begin SUB_GROUP S148_Coordinate S148_LinearRegionPowerDerating S148_PIRegionPowerDerting S148_Subsystem /end SUB_GROUP
/end GROUP
/begin GROUP S141_DeratingStrategy_Overvoltage "SWC_TPC/RE_SWC_TPC_10ms_sys/TPC/TpcJudge/TpcSmp/DeratingStrategyVoltage/DeratingStrategy_Overvoltage"
 /begin SUB_GROUP S167_Coordinate S167_DemBusOvrVoltage S167_LinearRegionPowerDerating S167_PIRegionPowerDerting /end SUB_GROUP
/end GROUP
/begin GROUP S141_DeratingStrategy_Undervoltage "SWC_TPC/RE_SWC_TPC_10ms_sys/TPC/TpcJudge/TpcSmp/DeratingStrategyVoltage/DeratingStrategy_Undervoltage"
 /begin SUB_GROUP S168_Coordinate S168_DemBusUndrVoltage S168_LinearRegionPowerDerating S168_PIRegionPowerDerting /end SUB_GROUP
/end GROUP
/begin GROUP S142_Subsystem "SWC_TPC/RE_SWC_TPC_10ms_sys/TPC/TpcJudge/TpcSmp/DeratingStrategy_OverSpeed/Subsystem"
 /begin REF_CHARACTERISTIC CAL_TpcSmp_OvrSpdQurd1TableY_Cof_af32 CAL_TpcSmp_OvrSpdQurd2TableY_Cof_af32 CAL_TpcSmp_OvrSpdQurd3TableY_Cof_af32 CAL_TpcSmp_OvrSpdQurd4TableY_Cof_af32 /end REF_CHARACTERISTIC
 /begin REF_MEASUREMENT VAR_TpcSmp_ElecTrqLimOvrSpd_f32 VAR_TpcSmp_GenTrqLimOvrSpd_f32 VAR_TpcSmp_cofDertOvrSpdElecQuad1_f32 VAR_TpcSmp_cofDertOvrSpdElecQuad3_f32 VAR_TpcSmp_cofDertOvrSpdGenQuad2_f32 VAR_TpcSmp_cofDertOvrSpdGenQuad4_f32 VAR_TpcSmp_flgElecTrqLimOvrSpdActv_b VAR_TpcSmp_flgGenTrqLimOvrSpdActv_b /end REF_MEASUREMENT
/end GROUP
/begin GROUP S142_Subsystem1 "SWC_TPC/RE_SWC_TPC_10ms_sys/TPC/TpcJudge/TpcSmp/DeratingStrategy_OverSpeed/Subsystem1"
 /begin REF_CHARACTERISTIC CAL_TpcSmp_OvSpdWarnHiLim_f32 CAL_TpcSmp_OvSpdWarnLoLim_f32 CAL_TpcSmp_ThresOverSpd_f32 /end REF_CHARACTERISTIC
 /begin REF_MEASUREMENT VAR_TpcSmp_SpdOvHiLimErrState_u8 VAR_TpcSmp_SpdOvHiWarnState_u8 /end REF_MEASUREMENT
/end GROUP
/begin GROUP S194_DemCoolantTemperature "SWC_TPC/RE_SWC_TPC_10ms_sys/TPC/TpcJudge/TpcTmp/CoolantTemperatureDerating/DemCoolantTemperature" /begin REF_MEASUREMENT VAR_TpcTmp_TCoolantOvHiWarnState_u8 /end REF_MEASUREMENT /end GROUP
/begin GROUP S194_DeratingStrategy_TCoolant "SWC_TPC/RE_SWC_TPC_10ms_sys/TPC/TpcJudge/TpcTmp/CoolantTemperatureDerating/DeratingStrategy_TCoolant" /begin SUB_GROUP S200_CoolantTempFlt S200_GetTDbcDeratingCof /end SUB_GROUP
 /begin REF_CHARACTERISTIC CAL_TpcTmp_CoolTempAdds_f32 CAL_TpcTmp_CoolTempDecDiff_f32 CAL_TpcTmp_CoolTempKp_f32 CAL_TpcTmp_CoolTempMinus_f32 CAL_TpcTmp_CoolTempRiseDiff_f32 /end REF_CHARACTERISTIC
 /begin REF_MEASUREMENT VAR_TpcTmp_ElecTrqLimTcoolant_f32 VAR_TpcTmp_GenTrqLimTcoolant_f32 /end REF_MEASUREMENT
/end GROUP
/begin GROUP S194_GetDeratingFlag_TCoolant "SWC_TPC/RE_SWC_TPC_10ms_sys/TPC/TpcJudge/TpcTmp/CoolantTemperatureDerating/GetDeratingFlag_TCoolant" /begin REF_MEASUREMENT VAR_TpcTmp_flgTrqLimTcoolantActv_b /end REF_MEASUREMENT /end GROUP
/begin GROUP S195_DBCTemperatureDerating "SWC_TPC/RE_SWC_TPC_10ms_sys/TPC/TpcJudge/TpcTmp/DbcTemperatureDerating/DBCTemperatureDerating"
 /begin SUB_GROUP S208_GetDbcTempLimTorq S208_GetTDbcDeratingCof S208_GetTRiseDbcDeratingCof /end SUB_GROUP
/end GROUP
/begin GROUP S195_DbcTempFlt "SWC_TPC/RE_SWC_TPC_10ms_sys/TPC/TpcJudge/TpcTmp/DbcTemperatureDerating/DbcTempFlt"
 /begin REF_CHARACTERISTIC CAL_TpcTmp_DbcChgTempDownDiff_f32 CAL_TpcTmp_DbcChgTempUpDiff_f32 /end REF_CHARACTERISTIC
 /begin REF_MEASUREMENT VAR_TpcTmp_TDbcStableDiff_u16 VAR_TpcTmp_tDbcTempFlt_f32 VAR_TpcTmp_tDbcTempFlt_u16 /end REF_MEASUREMENT
/end GROUP
/begin GROUP S195_DemDbcTemperature "SWC_TPC/RE_SWC_TPC_10ms_sys/TPC/TpcJudge/TpcTmp/DbcTemperatureDerating/DemDbcTemperature"
 /begin REF_CHARACTERISTIC CAL_TpcTmp_tDbcTempUHiLim_f32 CAL_TpcTmp_tDbcTempULoLim_f32 CAL_TpcTmp_tDbcTempVHiLim_f32 CAL_TpcTmp_tDbcTempVLoLim_f32 CAL_TpcTmp_tDbcTempWHiLim_f32 CAL_TpcTmp_tDbcTempWLoLim_f32 CAL_TpcTmp_tDbcThrPhLoLim_f32 /end REF_CHARACTERISTIC
 /begin REF_MEASUREMENT VAR_TpcTmp_TDbcOvHiWarnState_u8 VAR_TpcTmp_TDbcOvLoWarnState_u8 VAR_TpcTmp_TDbcUHiLimErrState_u8 VAR_TpcTmp_TDbcULoLimErrState_u8 VAR_TpcTmp_TDbcVHiLimErrState_u8 VAR_TpcTmp_TDbcVLoLimErrState_u8 VAR_TpcTmp_TDbcWHiLimErrState_u8 VAR_TpcTmp_TDbcWLoLimErrState_u8 /end REF_MEASUREMENT
/end GROUP
/begin GROUP S195_GetDeratingFlag_Tdbc "SWC_TPC/RE_SWC_TPC_10ms_sys/TPC/TpcJudge/TpcTmp/DbcTemperatureDerating/GetDeratingFlag_Tdbc" /begin REF_MEASUREMENT VAR_TpcTmp_flgTrqLimTdbcActv_b /end REF_MEASUREMENT /end GROUP
/begin GROUP S195_GetMaxDbcTemp "SWC_TPC/RE_SWC_TPC_10ms_sys/TPC/TpcJudge/TpcTmp/DbcTemperatureDerating/GetMaxDbcTemp" /begin REF_MEASUREMENT VAR_TpcTmp_tDbcMax_f32 /end REF_MEASUREMENT /end GROUP
/begin GROUP S195_GetRampElecTrqLim "SWC_TPC/RE_SWC_TPC_10ms_sys/TPC/TpcJudge/TpcTmp/DbcTemperatureDerating/GetRampElecTrqLim" /begin REF_MEASUREMENT VAR_TpcTmp_ElecTrqLimTdbc_f32 /end REF_MEASUREMENT /end GROUP
/begin GROUP S195_GetRampGenTrqLim "SWC_TPC/RE_SWC_TPC_10ms_sys/TPC/TpcJudge/TpcTmp/DbcTemperatureDerating/GetRampGenTrqLim" /begin REF_MEASUREMENT VAR_TpcTmp_GenTrqLimTdbc_f32 /end REF_MEASUREMENT /end GROUP
/begin GROUP S196_DemDrvBoardTemperature "SWC_TPC/RE_SWC_TPC_10ms_sys/TPC/TpcJudge/TpcTmp/DrvBoardTemperatureDerating/DemDrvBoardTemperature" /begin REF_MEASUREMENT VAR_TpcTmp_TDrvBoardOvHiWarnState_u8 /end REF_MEASUREMENT /end GROUP
/begin GROUP S196_DeratingStrategy_TDrvBoard "SWC_TPC/RE_SWC_TPC_10ms_sys/TPC/TpcJudge/TpcTmp/DrvBoardTemperatureDerating/DeratingStrategy_TDrvBoard" /begin REF_CHARACTERISTIC CAL_TpcTmp_tDrvboardDertTableY_Cof_af32 /end REF_CHARACTERISTIC
 /begin REF_MEASUREMENT VAR_TpcTmp_CofDertTdrvboard_f32 VAR_TpcTmp_ElecTrqLimTdrvboard_f32 VAR_TpcTmp_GenTrqLimTdrvboard_f32 /end REF_MEASUREMENT
/end GROUP
/begin GROUP S196_GetDeratingFlag_TDrvBoard "SWC_TPC/RE_SWC_TPC_10ms_sys/TPC/TpcJudge/TpcTmp/DrvBoardTemperatureDerating/GetDeratingFlag_TDrvBoard" /begin REF_MEASUREMENT VAR_TpcTmp_flgTrqLimTdrvboardActv_b /end REF_MEASUREMENT /end GROUP
/begin GROUP S197_DemIGBTTemperature "SWC_TPC/RE_SWC_TPC_10ms_sys/TPC/TpcJudge/TpcTmp/IGBTTemperatureDerating/DemIGBTTemperature"
 /begin REF_CHARACTERISTIC CAL_TpcTmp_tIGBTTempHiLim_f32 CAL_TpcTmp_tIGBTTempLoLim_f32 /end REF_CHARACTERISTIC
 /begin REF_MEASUREMENT VAR_TpcTmp_TIGBTOvHiErrState_u8 VAR_TpcTmp_TIGBTOvHiWarnState_u8 VAR_TpcTmp_TIGBTOvLoWarnState_u8 /end REF_MEASUREMENT
/end GROUP
/begin GROUP S197_GetIGBTTempLimTorq "SWC_TPC/RE_SWC_TPC_10ms_sys/TPC/TpcJudge/TpcTmp/IGBTTemperatureDerating/GetIGBTTempLimTorq" /begin SUB_GROUP S231_GetDeratingFlag_TIGBT /end SUB_GROUP
 /begin REF_MEASUREMENT VAR_TpcTmp_ElecTrqLimTIGBTWoRamp_f32 VAR_TpcTmp_GenTrqLimTIGBTWoRamp_f32 /end REF_MEASUREMENT
/end GROUP
/begin GROUP S197_GetRampElecTrqLim "SWC_TPC/RE_SWC_TPC_10ms_sys/TPC/TpcJudge/TpcTmp/IGBTTemperatureDerating/GetRampElecTrqLim" /begin REF_MEASUREMENT VAR_TpcTmp_ElecTrqLimTIGBT_f32 /end REF_MEASUREMENT /end GROUP
/begin GROUP S197_GetRampGenTrqLim "SWC_TPC/RE_SWC_TPC_10ms_sys/TPC/TpcJudge/TpcTmp/IGBTTemperatureDerating/GetRampGenTrqLim" /begin REF_MEASUREMENT VAR_TpcTmp_GenTrqLimTIGBT_f32 /end REF_MEASUREMENT /end GROUP
/begin GROUP S197_GetTIGBTDeratingCof "SWC_TPC/RE_SWC_TPC_10ms_sys/TPC/TpcJudge/TpcTmp/IGBTTemperatureDerating/GetTIGBTDeratingCof"
 /begin REF_CHARACTERISTIC CAL_TpcTmp_tIGBTDertSave1TableY_Cof_af32 CAL_TpcTmp_tIGBTDertSave2TableY_Cof_af32 CAL_TpcTmp_tIGBTTraNormalToSave1_f32 CAL_TpcTmp_tIGBTTraSave1ToNormal_f32 CAL_TpcTmp_tIGBTTraSave1ToSave2_f32 CAL_TpcTmp_tIGBTTraSave2ToOverheating_f32 CAL_Tpc_NormalMode_u8 CAL_Tpc_OverheatingMode_u8 CAL_Tpc_Powersave1Mode_u8 CAL_Tpc_Powersave2Mode_u8 /end REF_CHARACTERISTIC
 /begin REF_MEASUREMENT VAR_TpcTmp_CofDertIGBT_f32 VAR_TpcTmp_CofDertTIGBTSave1_f32 VAR_TpcTmp_CofDertTIGBTSave2_f32 VAR_TpcTmp_tIGBTOperationMode_u8 /end REF_MEASUREMENT
/end GROUP
/begin GROUP S197_GetTRiseIGBTDeratingCof "SWC_TPC/RE_SWC_TPC_10ms_sys/TPC/TpcJudge/TpcTmp/IGBTTemperatureDerating/GetTRiseIGBTDeratingCof" /begin SUB_GROUP S235_IgbtTempFlt /end SUB_GROUP
 /begin REF_CHARACTERISTIC CAL_TpcTmp_IGBRiseTTempAdds_f32 CAL_TpcTmp_IGBTRiseTempDecDiff_f32 CAL_TpcTmp_IGBTRiseTempKp_f32 CAL_TpcTmp_IGBTRiseTempMinus_f32 CAL_TpcTmp_IGBTRiseTempRiseDiff_f32 CAL_TpcTmp_tRiseIGBTDertSave1TableY_Cof_af32 CAL_TpcTmp_tRiseIGBTDertSave2TableY_Cof_af32 CAL_TpcTmp_tRiseIGBTTraNormalToSave1_f32 CAL_TpcTmp_tRiseIGBTTraSave1ToNormal_f32 CAL_TpcTmp_tRiseIGBTTraSave1ToSave2_f32 CAL_TpcTmp_tRiseIGBTTraSave2ToOverheating_f32 CAL_Tpc_NormalMode_u8 CAL_Tpc_OverheatingMode_u8 CAL_Tpc_Powersave1Mode_u8 CAL_Tpc_Powersave2Mode_u8 /end REF_CHARACTERISTIC
 /begin REF_MEASUREMENT VAR_TpcTmp_CofDertTRiseIGBTSave1_f32 VAR_TpcTmp_CofDertTRiseIGBTSave2_f32 VAR_TpcTmp_CofDertTRiseIGBT_f32 VAR_TpcTmp_tRiseIGBTOperationMode_u8 VAR_TpcTmp_tRiseIGBT_f32 /end REF_MEASUREMENT
/end GROUP
/begin GROUP S197_IgbtTempFlt "SWC_TPC/RE_SWC_TPC_10ms_sys/TPC/TpcJudge/TpcTmp/IGBTTemperatureDerating/IgbtTempFlt"
 /begin REF_CHARACTERISTIC CAL_TpcTmp_IgbtChgTempDownDiff_f32 CAL_TpcTmp_IgbtChgTempUpDiff_f32 /end REF_CHARACTERISTIC
 /begin REF_MEASUREMENT VAR_TpcTmp_TIgbtStableDiff_u16 VAR_TpcTmp_tIGBTTempFlt_f32 VAR_TpcTmp_tIgbtTempFlt_u16 /end REF_MEASUREMENT
/end GROUP
/begin GROUP S23_fun "SWC_TPC/RE_SWC_TPC_10ms_sys/TPC/TpcCod/Coordinate/If Action Subsystem/Chart/fun" /begin REF_CHARACTERISTIC CAL_TpcCod_PosSpdHold_f32 CAL_TpcCod_PosSpdStart_f32 /end REF_CHARACTERISTIC /end GROUP
/begin GROUP S25_fun "SWC_TPC/RE_SWC_TPC_10ms_sys/TPC/TpcCod/Coordinate/If Action Subsystem1/Chart/fun" /begin REF_CHARACTERISTIC CAL_TpcCod_PosSpdHold_f32 CAL_TpcCod_PosSpdStart_f32 /end REF_CHARACTERISTIC /end GROUP
/begin GROUP S55_AEqualB24 "SWC_TPC/RE_SWC_TPC_10ms_sys/TPC/TpcCod/TorqueLimitationReason/TorqLimReasonJudge/TorqLimReason_Can/AEqualB24" /begin REF_MEASUREMENT VAR_tpccod_flgMaxDertCAN_b /end REF_MEASUREMENT /end GROUP
/begin GROUP S55_AEqualB33 "SWC_TPC/RE_SWC_TPC_10ms_sys/TPC/TpcCod/TorqueLimitationReason/TorqLimReasonJudge/TorqLimReason_Can/AEqualB33" /begin REF_MEASUREMENT VAR_tpccod_flgMinDertCAN_b /end REF_MEASUREMENT /end GROUP
/begin GROUP S122_Subsystem1 "SWC_TPC/RE_SWC_TPC_10ms_sys/TPC/TpcJudge/TpcMot/ExternalCharacteristicDerating/TrqLimRampRiseAndReduceSet/Subsystem1" /begin REF_CHARACTERISTIC CAL_Tpc_TrqReduceRevStep_f32 CAL_Tpc_TrqRiseRevStep_f32 /end REF_CHARACTERISTIC /end GROUP
/begin GROUP S123_Subsystem1 "SWC_TPC/RE_SWC_TPC_10ms_sys/TPC/TpcJudge/TpcMot/ExternalCharacteristicDerating/TrqLimRampRiseAndReduceSet1/Subsystem1" /begin REF_CHARACTERISTIC CAL_Tpc_TrqReduceRevStep_f32 CAL_Tpc_TrqRiseRevStep_f32 /end REF_CHARACTERISTIC /end GROUP
/begin GROUP S129_GetDeratingFlag_TIGBT "SWC_TPC/RE_SWC_TPC_10ms_sys/TPC/TpcJudge/TpcMot/SttrTemperatureDerating/GetSttrTempLimTorq/GetDeratingFlag_TIGBT" /begin REF_MEASUREMENT VAR_TpcMot_flgTrqLimTsttrActv_b /end REF_MEASUREMENT /end GROUP
/begin GROUP S147_Coordinate "SWC_TPC/RE_SWC_TPC_10ms_sys/TPC/TpcJudge/TpcSmp/DeratingStrategyCurrent/DeratingStrategy_OvercurrentElec/Coordinate" /begin SUB_GROUP S149_Debounce /end SUB_GROUP
 /begin REF_CHARACTERISTIC CAL_TpcSmp_CntElecOvrCurt_u8 CAL_TpcSmp_CurtModeSelc_b CAL_TpcSmp_FacElecOvrCurt_u8 /end REF_CHARACTERISTIC
 /begin REF_MEASUREMENT VAR_TpcSmp_ElecPwrLimOvrCurt_f32 /end REF_MEASUREMENT
/end GROUP
/begin GROUP S147_LinearRegionPowerDerating "SWC_TPC/RE_SWC_TPC_10ms_sys/TPC/TpcJudge/TpcSmp/DeratingStrategyCurrent/DeratingStrategy_OvercurrentElec/LinearRegionPowerDerating" /begin REF_CHARACTERISTIC CAL_TpcSmp_OvrCurtLimElecTableY_Cof_af32 /end REF_CHARACTERISTIC
 /begin REF_MEASUREMENT VAR_TpcSmp_ElecPwrLinearDertOvrCurt_f32 VAR_TpcSmp_cofDertOvrCurtElec_f32 VAR_TpcSmp_flgLinearDertOvrCurtElec_b /end REF_MEASUREMENT
/end GROUP
/begin GROUP S147_PIRegionPowerDerting "SWC_TPC/RE_SWC_TPC_10ms_sys/TPC/TpcJudge/TpcSmp/DeratingStrategyCurrent/DeratingStrategy_OvercurrentElec/PIRegionPowerDerting" /begin SUB_GROUP S152_PI /end SUB_GROUP
 /begin REF_CHARACTERISTIC CAL_TpcSmp_ElecOvrCurtKi_f32 CAL_TpcSmp_ElecOvrCurtKp_f32 CAL_TpcSmp_ElecOvrCurtypLim_f32 CAL_TpcSmp_PwrAddMax_f32 CAL_TpcSmp_TrqAddMax_f32 CAL_TpcSmp_flgUsePwrLoss_b /end REF_CHARACTERISTIC
 /begin REF_MEASUREMENT VAR_TpcSmp_ElecPwrAlowMax_f32 VAR_TpcSmp_ErrElecOvrCurt_f32 VAR_tpcsmp_AddPwrElecOvrCurt_f32 VAR_tpcsmp_PwrLoss_f32 VAR_tpcsmp_RefPwrElecOvrCurt_f32 /end REF_MEASUREMENT
/end GROUP
/begin GROUP S147_Subsystem "SWC_TPC/RE_SWC_TPC_10ms_sys/TPC/TpcJudge/TpcSmp/DeratingStrategyCurrent/DeratingStrategy_OvercurrentElec/Subsystem" /begin REF_CHARACTERISTIC CAL_TpcSmp_SystemEffiElec_f32 /end REF_CHARACTERISTIC /begin REF_MEASUREMENT VAR_tpcsmp_ElecPwrDert_f32 /end REF_MEASUREMENT /end GROUP
/begin GROUP S148_Coordinate "SWC_TPC/RE_SWC_TPC_10ms_sys/TPC/TpcJudge/TpcSmp/DeratingStrategyCurrent/DeratingStrategy_OvercurrentGen/Coordinate" /begin SUB_GROUP S158_Debounce /end SUB_GROUP
 /begin REF_CHARACTERISTIC CAL_TpcSmp_CntGenOvrCurt_u8 CAL_TpcSmp_CurtModeSelc_b CAL_TpcSmp_FacGenOvrCurt_u8 /end REF_CHARACTERISTIC
 /begin REF_MEASUREMENT VAR_TpcSmp_GenPwrLimOvrCurt_f32 /end REF_MEASUREMENT
/end GROUP
/begin GROUP S148_LinearRegionPowerDerating "SWC_TPC/RE_SWC_TPC_10ms_sys/TPC/TpcJudge/TpcSmp/DeratingStrategyCurrent/DeratingStrategy_OvercurrentGen/LinearRegionPowerDerating" /begin REF_CHARACTERISTIC CAL_TpcSmp_OvrCurtLimGenTableY_Cof_af32 /end REF_CHARACTERISTIC
 /begin REF_MEASUREMENT VAR_TpcSmp_GenPwrLinearDertOvrCurt_f32 VAR_TpcSmp_cofDertOvrCurtGen_f32 VAR_TpcSmp_flgLinearDertOveCurtGen_b /end REF_MEASUREMENT
/end GROUP
/begin GROUP S148_PIRegionPowerDerting "SWC_TPC/RE_SWC_TPC_10ms_sys/TPC/TpcJudge/TpcSmp/DeratingStrategyCurrent/DeratingStrategy_OvercurrentGen/PIRegionPowerDerting" /begin SUB_GROUP S161_PI /end SUB_GROUP
 /begin REF_CHARACTERISTIC CAL_TpcSmp_GenOvrCurtKi_f32 CAL_TpcSmp_GenOvrCurtKp_f32 CAL_TpcSmp_GenOvrCurtypLim_f32 CAL_TpcSmp_PwrAddMaxGen_f32 CAL_TpcSmp_TrqAddMaxGen_f32 CAL_TpcSmp_flgUsePwrLossGen_b /end REF_CHARACTERISTIC
 /begin REF_MEASUREMENT VAR_TpcSmp_ErrGenOvrCurt_f32 VAR_TpcSmp_GenPwrAlowMax_f32 VAR_tpcsmp_PwrLossGen_f32 VAR_tpcsmp_RefPwrGenOvrCurt_f32 /end REF_MEASUREMENT
/end GROUP
/begin GROUP S148_Subsystem "SWC_TPC/RE_SWC_TPC_10ms_sys/TPC/TpcJudge/TpcSmp/DeratingStrategyCurrent/DeratingStrategy_OvercurrentGen/Subsystem" /begin REF_CHARACTERISTIC CAL_TpcSmp_SystemEffiGen_f32 /end REF_CHARACTERISTIC /begin REF_MEASUREMENT VAR_tpcsmp_GenPwrDert_f32 /end REF_MEASUREMENT /end GROUP
/begin GROUP S167_Coordinate "SWC_TPC/RE_SWC_TPC_10ms_sys/TPC/TpcJudge/TpcSmp/DeratingStrategyVoltage/DeratingStrategy_Overvoltage/Coordinate" /begin SUB_GROUP S169_Debounce /end SUB_GROUP /begin REF_CHARACTERISTIC CAL_TpcSmp_CntGenOvrVolt_u8 CAL_TpcSmp_FacGenOvrVolt_u8 /end REF_CHARACTERISTIC /begin REF_MEASUREMENT VAR_TpcSmp_GenPwrLimOvrVolt_f32 /end REF_MEASUREMENT /end GROUP
/begin GROUP S167_DemBusOvrVoltage "SWC_TPC/RE_SWC_TPC_10ms_sys/TPC/TpcJudge/TpcSmp/DeratingStrategyVoltage/DeratingStrategy_Overvoltage/DemBusOvrVoltage" /begin REF_CHARACTERISTIC CAL_TpcSmp_uDcLnkOvVLim_f32 /end REF_CHARACTERISTIC
 /begin REF_MEASUREMENT VAR_TpcSmp_uDcLnkOvVLimErrState_u8 VAR_TpcSmp_uDcLnkOvWarnState_u8 /end REF_MEASUREMENT
/end GROUP
/begin GROUP S167_LinearRegionPowerDerating "SWC_TPC/RE_SWC_TPC_10ms_sys/TPC/TpcJudge/TpcSmp/DeratingStrategyVoltage/DeratingStrategy_Overvoltage/LinearRegionPowerDerating" /begin REF_CHARACTERISTIC CAL_TpcSmp_OvrVoltGenTableY_Cof_af32 /end REF_CHARACTERISTIC
 /begin REF_MEASUREMENT VAR_TpcSmp_GenPwrLinearDertOvrVolt_f32 VAR_TpcSmp_cofDertOvrVoltGen_f32 VAR_TpcSmp_flgLinearDertOvrVoltGen_b /end REF_MEASUREMENT
/end GROUP
/begin GROUP S167_PIRegionPowerDerting "SWC_TPC/RE_SWC_TPC_10ms_sys/TPC/TpcJudge/TpcSmp/DeratingStrategyVoltage/DeratingStrategy_Overvoltage/PIRegionPowerDerting" /begin SUB_GROUP S172_PI /end SUB_GROUP
 /begin REF_CHARACTERISTIC CAL_TpcSmp_GenOvrVoltKi_f32 CAL_TpcSmp_GenOvrVoltKp_f32 CAL_TpcSmp_GenOvrVoltypLim_f32 /end REF_CHARACTERISTIC
/end GROUP
/begin GROUP S168_Coordinate "SWC_TPC/RE_SWC_TPC_10ms_sys/TPC/TpcJudge/TpcSmp/DeratingStrategyVoltage/DeratingStrategy_Undervoltage/Coordinate" /begin REF_CHARACTERISTIC CAL_TpcSmp_CntElecUdrVolt_u8 CAL_TpcSmp_FacElecUdrVolt_u8 /end REF_CHARACTERISTIC
 /begin REF_MEASUREMENT VAR_TpcSmp_ElecPwrLimUdrVolt_f32 VAR_TpcSmp_flgElecPwrLimUdrVoltActv_b /end REF_MEASUREMENT
/end GROUP
/begin GROUP S168_DemBusUndrVoltage "SWC_TPC/RE_SWC_TPC_10ms_sys/TPC/TpcJudge/TpcSmp/DeratingStrategyVoltage/DeratingStrategy_Undervoltage/DemBusUndrVoltage" /begin REF_CHARACTERISTIC CAL_TpcSmp_uDcLnkUnVLim_f32 /end REF_CHARACTERISTIC
 /begin REF_MEASUREMENT VAR_TpcSmp_uDcLnkUnVLimErrState_u8 VAR_TpcSmp_uDcLnkUnvWarnState_u8 /end REF_MEASUREMENT
/end GROUP
/begin GROUP S168_LinearRegionPowerDerating "SWC_TPC/RE_SWC_TPC_10ms_sys/TPC/TpcJudge/TpcSmp/DeratingStrategyVoltage/DeratingStrategy_Undervoltage/LinearRegionPowerDerating" /begin REF_CHARACTERISTIC CAL_TpcSmp_UdrVoltElecTableY_Cof_af32 /end REF_CHARACTERISTIC
 /begin REF_MEASUREMENT VAR_TpcSmp_ElecPwrLinearDertUdrVolt_f32 VAR_TpcSmp_cofDertUdrVoltElec_f32 VAR_TpcSmp_flgLinearDertUdrVoltElec_b /end REF_MEASUREMENT
/end GROUP
/begin GROUP S168_PIRegionPowerDerting "SWC_TPC/RE_SWC_TPC_10ms_sys/TPC/TpcJudge/TpcSmp/DeratingStrategyVoltage/DeratingStrategy_Undervoltage/PIRegionPowerDerting" /begin SUB_GROUP S180_PI /end SUB_GROUP
 /begin REF_CHARACTERISTIC CAL_TpcSmp_ElecUdrVoltKi_f32 CAL_TpcSmp_ElecUdrVoltKp_f32 CAL_TpcSmp_ElecUdrVoltypLim_f32 /end REF_CHARACTERISTIC
/end GROUP
/begin GROUP S200_CoolantTempFlt "SWC_TPC/RE_SWC_TPC_10ms_sys/TPC/TpcJudge/TpcTmp/CoolantTemperatureDerating/DeratingStrategy_TCoolant/CoolantTempFlt"
 /begin REF_CHARACTERISTIC CAL_TpcTmp_CoolChgTempDownDiff_f32 CAL_TpcTmp_CoolChgTempUpDiff_f32 /end REF_CHARACTERISTIC
 /begin REF_MEASUREMENT VAR_TpcTmp_TCoolStableDiff_u16 VAR_TpcTmp_tCoolantTempFlt_f32 /end REF_MEASUREMENT
/end GROUP
/begin GROUP S200_GetTDbcDeratingCof "SWC_TPC/RE_SWC_TPC_10ms_sys/TPC/TpcJudge/TpcTmp/CoolantTemperatureDerating/DeratingStrategy_TCoolant/GetTDbcDeratingCof"
 /begin REF_CHARACTERISTIC CAL_TpcTmp_tCoolantDertSave1TableY_Cof_af32 CAL_TpcTmp_tCoolantDertSave2TableY_Cof_af32 CAL_TpcTmp_tCoolantTraNormalToSave1_f32 CAL_TpcTmp_tCoolantTraSave1ToNormal_f32 CAL_TpcTmp_tCoolantTraSave1ToSave2_f32 CAL_TpcTmp_tCoolantTraSave2ToOverheating_f32 CAL_Tpc_NormalMode_u8 CAL_Tpc_OverheatingMode_u8 CAL_Tpc_Powersave1Mode_u8 CAL_Tpc_Powersave2Mode_u8 /end REF_CHARACTERISTIC
 /begin REF_MEASUREMENT VAR_TpcTmp_CofDertTCoolantSave1_f32 VAR_TpcTmp_CofDertTCoolantSave2_f32 VAR_TpcTmp_CofDertTcoolant_f32 VAR_TpcTmp_tCoolantOperationMode_u8 /end REF_MEASUREMENT
/end GROUP
/begin GROUP S208_GetDbcTempLimTorq "SWC_TPC/RE_SWC_TPC_10ms_sys/TPC/TpcJudge/TpcTmp/DbcTemperatureDerating/DBCTemperatureDerating/GetDbcTempLimTorq"
 /begin REF_MEASUREMENT VAR_TpcTmp_ElecTrqLimTdbcWoRamp_f32 VAR_TpcTmp_GenTrqLimTdbcWoRamp_f32 /end REF_MEASUREMENT
/end GROUP
/begin GROUP S208_GetTDbcDeratingCof "SWC_TPC/RE_SWC_TPC_10ms_sys/TPC/TpcJudge/TpcTmp/DbcTemperatureDerating/DBCTemperatureDerating/GetTDbcDeratingCof"
 /begin REF_CHARACTERISTIC CAL_TpcTmp_tDbcDertSave1TableY_Cof_af32 CAL_TpcTmp_tDbcDertSave2TableY_Cof_af32 CAL_TpcTmp_tDbcTraNormalToSave1_f32 CAL_TpcTmp_tDbcTraSave1ToNormal_f32 CAL_TpcTmp_tDbcTraSave1ToSave2_f32 CAL_TpcTmp_tDbcTraSave2ToOverheating_f32 CAL_Tpc_NormalMode_u8 CAL_Tpc_OverheatingMode_u8 CAL_Tpc_Powersave1Mode_u8 CAL_Tpc_Powersave2Mode_u8 /end REF_CHARACTERISTIC
 /begin REF_MEASUREMENT VAR_TpcTmp_CofDertDbc_f32 VAR_TpcTmp_CofDertTDbcSave1_f32 VAR_TpcTmp_CofDertTDbcSave2_f32 VAR_TpcTmp_tDbcOperationMode_u8 /end REF_MEASUREMENT
/end GROUP
/begin GROUP S208_GetTRiseDbcDeratingCof "SWC_TPC/RE_SWC_TPC_10ms_sys/TPC/TpcJudge/TpcTmp/DbcTemperatureDerating/DBCTemperatureDerating/GetTRiseDbcDeratingCof" /begin SUB_GROUP S217_DbcTempFlt /end SUB_GROUP
 /begin REF_CHARACTERISTIC CAL_TpcTmp_DBCRiseTempAdds_f32 CAL_TpcTmp_DBCRiseTempDecDiff_f32 CAL_TpcTmp_DBCRiseTempKp_f32 CAL_TpcTmp_DBCRiseTempMinus_f32 CAL_TpcTmp_DBCRiseTempRiseDiff_f32 CAL_TpcTmp_tRiseDbcDertSave1TableY_Cof_af32 CAL_TpcTmp_tRiseDbcDertSave2TableY_Cof_af32 CAL_TpcTmp_tRiseDbcTraNormalToSave1_f32 CAL_TpcTmp_tRiseDbcTraSave1ToNormal_f32 CAL_TpcTmp_tRiseDbcTraSave1ToSave2_f32 CAL_TpcTmp_tRiseDbcTraSave2ToOverheating_f32 CAL_Tpc_NormalMode_u8 CAL_Tpc_OverheatingMode_u8 CAL_Tpc_Powersave1Mode_u8 CAL_Tpc_Powersave2Mode_u8 /end REF_CHARACTERISTIC
 /begin REF_MEASUREMENT VAR_TpcTmp_CofDertTRiseDbcSave1_f32 VAR_TpcTmp_CofDertTRiseDbcSave2_f32 VAR_TpcTmp_CofDertTRiseDbc_f32 VAR_TpcTmp_tRiseDbcOperationMode_u8 VAR_TpcTmp_tRiseDbc_f32 /end REF_MEASUREMENT
/end GROUP
/begin GROUP S231_GetDeratingFlag_TIGBT "SWC_TPC/RE_SWC_TPC_10ms_sys/TPC/TpcJudge/TpcTmp/IGBTTemperatureDerating/GetIGBTTempLimTorq/GetDeratingFlag_TIGBT" /begin REF_MEASUREMENT VAR_TpcTmp_flgTrqLimTIGBTActv_b /end REF_MEASUREMENT /end GROUP
/begin GROUP S235_IgbtTempFlt "SWC_TPC/RE_SWC_TPC_10ms_sys/TPC/TpcJudge/TpcTmp/IGBTTemperatureDerating/GetTRiseIGBTDeratingCof/IgbtTempFlt"
 /begin REF_CHARACTERISTIC CAL_TpcTmp_IgbtRiseChgTempDownDiff_f32 CAL_TpcTmp_IgbtRiseChgTempUpDiff_f32 /end REF_CHARACTERISTIC
 /begin REF_MEASUREMENT VAR_TpcTmp_TIgbtRiseStableDiff_u16 VAR_TpcTmp_tIgbtRiseTempFlt_u16 VAR_TpcTmp_tRiseIGBTFlt_f32 /end REF_MEASUREMENT
/end GROUP
/begin GROUP S149_Debounce "SWC_TPC/RE_SWC_TPC_10ms_sys/TPC/TpcJudge/TpcSmp/DeratingStrategyCurrent/DeratingStrategy_OvercurrentElec/Coordinate/Debounce" /begin REF_MEASUREMENT VAR_TpcSmp_flgElecPwrLimOvrCurtActv_b /end REF_MEASUREMENT /end GROUP
/begin GROUP S152_PI "SWC_TPC/RE_SWC_TPC_10ms_sys/TPC/TpcJudge/TpcSmp/DeratingStrategyCurrent/DeratingStrategy_OvercurrentElec/PIRegionPowerDerting/PI"
 /begin REF_MEASUREMENT VAR_TpcSmp_ElecPwrPIDertOvrCurt_f32 VAR_TpcSmp_flgPIDertOvrCurtElec_b VAR_tpcsmp_KiProductSum_f32 VAR_tpcsmp_KiProduct_f32 VAR_tpcsmp_KpProductSau_f32 VAR_tpcsmp_KpProduct_f32 VAR_tpcsmp_PIOutput_f32 VAR_tpcsmp_negOutputjudge_f32 VAR_tpcsmp_posOutputjudge_f32 VAR_tpcsmp_yiDelay_f32 VAR_tpcsmp_yi_f32 /end REF_MEASUREMENT
/end GROUP
/begin GROUP S158_Debounce "SWC_TPC/RE_SWC_TPC_10ms_sys/TPC/TpcJudge/TpcSmp/DeratingStrategyCurrent/DeratingStrategy_OvercurrentGen/Coordinate/Debounce" /begin REF_MEASUREMENT VAR_TpcSmp_flgGenPwrLimCurtActv_b /end REF_MEASUREMENT /end GROUP
/begin GROUP S161_PI "SWC_TPC/RE_SWC_TPC_10ms_sys/TPC/TpcJudge/TpcSmp/DeratingStrategyCurrent/DeratingStrategy_OvercurrentGen/PIRegionPowerDerting/PI"
 /begin REF_MEASUREMENT VAR_TpcSmp_GenPwrPIDertOvrCurt_f32 VAR_TpcSmp_flgPIDertOvrCurtGen_b /end REF_MEASUREMENT
/end GROUP
/begin GROUP S169_Debounce "SWC_TPC/RE_SWC_TPC_10ms_sys/TPC/TpcJudge/TpcSmp/DeratingStrategyVoltage/DeratingStrategy_Overvoltage/Coordinate/Debounce" /begin REF_MEASUREMENT VAR_TpcSmp_flgGenPwrLimOvrVoltActv_b /end REF_MEASUREMENT /end GROUP
/begin GROUP S172_PI "SWC_TPC/RE_SWC_TPC_10ms_sys/TPC/TpcJudge/TpcSmp/DeratingStrategyVoltage/DeratingStrategy_Overvoltage/PIRegionPowerDerting/PI"
 /begin REF_MEASUREMENT VAR_TpcSmp_GenPwrPIDertOvrVolt_f32 VAR_TpcSmp_flgPIDertOvrVoltGen_b /end REF_MEASUREMENT
/end GROUP
/begin GROUP S180_PI "SWC_TPC/RE_SWC_TPC_10ms_sys/TPC/TpcJudge/TpcSmp/DeratingStrategyVoltage/DeratingStrategy_Undervoltage/PIRegionPowerDerting/PI"
 /begin REF_MEASUREMENT VAR_TpcSmp_ElecPwrPIDertUdrVolt_f32 VAR_TpcSmp_flgPIDertUdrVoltElec_b /end REF_MEASUREMENT
/end GROUP
/begin GROUP S217_DbcTempFlt "SWC_TPC/RE_SWC_TPC_10ms_sys/TPC/TpcJudge/TpcTmp/DbcTemperatureDerating/DBCTemperatureDerating/GetTRiseDbcDeratingCof/DbcTempFlt"
 /begin REF_CHARACTERISTIC CAL_TpcTmp_DbcRiseChgTempDownDiff_f32 CAL_TpcTmp_DbcRiseChgTempUpDiff_f32 /end REF_CHARACTERISTIC
 /begin REF_MEASUREMENT VAR_TpcTmp_TDbcRiseStableDiff_u16 VAR_TpcTmp_tDbcRiseTempFlt_u16 VAR_TpcTmp_tRiseDbcFlt_f32 /end REF_MEASUREMENT
/end GROUP
/end MODULE
/end PROJECT
/* (add any file trailer comments here) */
/* EOF SWC_TPC.a2l */
