/******************************************************************************
* ASAP2 file: SWC_TDC.a2l
* Code generation for model "SWC_TDC".
* Model version : 1.3
* Simulink Coder version : 9.3 (R2020a) 18-Nov-2019
* C source code generated on : Tue Sep 22 13:16:51 2020
* Target selection: autosar.tlc
* Embedded hardware selection: Intel->x86-64 (Windows64)
* Code generation objectives: Unspecified
* Validation result: Not run
* (add additional file header information here)
******************************************************************************/ ASAP2_VERSION 1 31
/* Version 1.31 */
/begin PROJECT ProjectName "Project Comment Goes Here"
/begin HEADER "Header Comments go here" /end HEADER
/begin MODULE ModuleName "Module Comment Goes Here"
/begin MOD_PAR "MOD PAR Comment Goes Here" /end MOD_PAR
/begin MOD_COMMON "Mod Common Comment Here" BYTE_ORDER MSB_LAST /end MOD_COMMON
/begin RECORD_LAYOUT Scalar_BOOLEAN FNC_VALUES 1 UBYTE COLUMN_DIR DIRECT /end RECORD_LAYOUT
/begin RECORD_LAYOUT Scalar_UBYTE FNC_VALUES 1 UBYTE COLUMN_DIR DIRECT /end RECORD_LAYOUT
/begin RECORD_LAYOUT Scalar_BYTE FNC_VALUES 1 SBYTE COLUMN_DIR DIRECT /end RECORD_LAYOUT
/begin RECORD_LAYOUT Scalar_UWORD FNC_VALUES 1 UWORD COLUMN_DIR DIRECT /end RECORD_LAYOUT
/begin RECORD_LAYOUT Scalar_SWORD FNC_VALUES 1 SWORD COLUMN_DIR DIRECT /end RECORD_LAYOUT
/begin RECORD_LAYOUT Scalar_ULONG FNC_VALUES 1 ULONG COLUMN_DIR DIRECT /end RECORD_LAYOUT
/begin RECORD_LAYOUT Scalar_LONG FNC_VALUES 1 SLONG COLUMN_DIR DIRECT /end RECORD_LAYOUT
/begin RECORD_LAYOUT Scalar_FLOAT32_IEEE FNC_VALUES 1 FLOAT32_IEEE COLUMN_DIR DIRECT /end RECORD_LAYOUT
/begin RECORD_LAYOUT Scalar_FLOAT64_IEEE FNC_VALUES 1 FLOAT64_IEEE COLUMN_DIR DIRECT /end RECORD_LAYOUT
/begin RECORD_LAYOUT Lookup1D_BOOLEAN FNC_VALUES 1 UBYTE COLUMN_DIR DIRECT /end RECORD_LAYOUT
/begin RECORD_LAYOUT Lookup1D_X_BOOLEAN AXIS_PTS_X 1 UBYTE INDEX_INCR DIRECT /end RECORD_LAYOUT
/begin RECORD_LAYOUT Lookup1D_BYTE FNC_VALUES 1 SBYTE COLUMN_DIR DIRECT /end RECORD_LAYOUT
/begin RECORD_LAYOUT Lookup1D_X_BYTE AXIS_PTS_X 1 SBYTE INDEX_INCR DIRECT /end RECORD_LAYOUT
/begin RECORD_LAYOUT Lookup1D_UBYTE FNC_VALUES 1 UBYTE COLUMN_DIR DIRECT /end RECORD_LAYOUT
/begin RECORD_LAYOUT Lookup1D_X_UBYTE AXIS_PTS_X 1 UBYTE INDEX_INCR DIRECT /end RECORD_LAYOUT
/begin RECORD_LAYOUT Lookup1D_UWORD FNC_VALUES 1 UWORD COLUMN_DIR DIRECT /end RECORD_LAYOUT
/begin RECORD_LAYOUT Lookup1D_X_UWORD AXIS_PTS_X 1 UWORD INDEX_INCR DIRECT /end RECORD_LAYOUT
/begin RECORD_LAYOUT Lookup1D_WORD FNC_VALUES 1 SWORD COLUMN_DIR DIRECT /end RECORD_LAYOUT
/begin RECORD_LAYOUT Lookup1D_X_WORD AXIS_PTS_X 1 SWORD INDEX_INCR DIRECT /end RECORD_LAYOUT
/begin RECORD_LAYOUT Lookup1D_ULONG FNC_VALUES 1 ULONG COLUMN_DIR DIRECT /end RECORD_LAYOUT
/begin RECORD_LAYOUT Lookup1D_X_ULONG AXIS_PTS_X 1 ULONG INDEX_INCR DIRECT /end RECORD_LAYOUT
/begin RECORD_LAYOUT Lookup1D_SLONG FNC_VALUES 1 SLONG COLUMN_DIR DIRECT /end RECORD_LAYOUT
/begin RECORD_LAYOUT Lookup1D_X_LONG AXIS_PTS_X 1 SLONG INDEX_INCR DIRECT /end RECORD_LAYOUT
/begin RECORD_LAYOUT Lookup1D_FLOAT32_IEEE FNC_VALUES 1 FLOAT32_IEEE COLUMN_DIR DIRECT /end RECORD_LAYOUT
/begin RECORD_LAYOUT Lookup1D_X_FLOAT32_IEEE AXIS_PTS_X 1 FLOAT32_IEEE INDEX_INCR DIRECT /end RECORD_LAYOUT
/begin RECORD_LAYOUT Lookup1D_FLOAT64_IEEE FNC_VALUES 1 FLOAT64_IEEE COLUMN_DIR DIRECT /end RECORD_LAYOUT
/begin RECORD_LAYOUT Lookup1D_X_FLOAT64_IEEE AXIS_PTS_X 1 FLOAT64_IEEE INDEX_INCR DIRECT /end RECORD_LAYOUT
/begin RECORD_LAYOUT Lookup2D_BOOLEAN FNC_VALUES 1 UBYTE COLUMN_DIR DIRECT /end RECORD_LAYOUT
/begin RECORD_LAYOUT Lookup2D_X_BOOLEAN AXIS_PTS_X 1 UBYTE INDEX_INCR DIRECT /end RECORD_LAYOUT
/begin RECORD_LAYOUT Lookup2D_UBYTE FNC_VALUES 1 UBYTE COLUMN_DIR DIRECT /end RECORD_LAYOUT
/begin RECORD_LAYOUT Lookup2D_X_UBYTE AXIS_PTS_X 1 UBYTE INDEX_INCR DIRECT /end RECORD_LAYOUT
/begin RECORD_LAYOUT Lookup2D_BYTE FNC_VALUES 1 SBYTE COLUMN_DIR DIRECT /end RECORD_LAYOUT
/begin RECORD_LAYOUT Lookup2D_X_BYTE AXIS_PTS_X 1 SBYTE INDEX_INCR DIRECT /end RECORD_LAYOUT
/begin RECORD_LAYOUT Lookup2D_UWORD FNC_VALUES 1 UWORD COLUMN_DIR DIRECT /end RECORD_LAYOUT
/begin RECORD_LAYOUT Lookup2D_X_UWORD AXIS_PTS_X 1 UWORD INDEX_INCR DIRECT /end RECORD_LAYOUT
/begin RECORD_LAYOUT Lookup2D_WORD FNC_VALUES 1 SWORD COLUMN_DIR DIRECT /end RECORD_LAYOUT
/begin RECORD_LAYOUT Lookup2D_X_WORD AXIS_PTS_X 1 SWORD INDEX_INCR DIRECT /end RECORD_LAYOUT
/begin RECORD_LAYOUT Lookup2D_ULONG FNC_VALUES 1 ULONG COLUMN_DIR DIRECT /end RECORD_LAYOUT
/begin RECORD_LAYOUT Lookup2D_X_ULONG AXIS_PTS_X 1 ULONG INDEX_INCR DIRECT /end RECORD_LAYOUT
/begin RECORD_LAYOUT Lookup2D_LONG FNC_VALUES 1 SLONG COLUMN_DIR DIRECT /end RECORD_LAYOUT
/begin RECORD_LAYOUT Lookup2D_X_LONG AXIS_PTS_X 1 SLONG INDEX_INCR DIRECT /end RECORD_LAYOUT
/begin RECORD_LAYOUT Lookup2D_FLOAT32_IEEE FNC_VALUES 1 FLOAT32_IEEE COLUMN_DIR DIRECT /end RECORD_LAYOUT
/begin RECORD_LAYOUT Lookup2D_X_FLOAT32_IEEE AXIS_PTS_X 1 FLOAT32_IEEE INDEX_INCR DIRECT /end RECORD_LAYOUT
/begin RECORD_LAYOUT Lookup2D_FLOAT64_IEEE FNC_VALUES 1 FLOAT64_IEEE COLUMN_DIR DIRECT /end RECORD_LAYOUT
/begin RECORD_LAYOUT Lookup2D_X_FLOAT64_IEEE AXIS_PTS_X 1 FLOAT64_IEEE INDEX_INCR DIRECT /end RECORD_LAYOUT
/begin CHARACTERISTIC CAL_TDC_KiNCtl_Y_Af32 "根据转速偏差得到ki的值" /* Characteristic Type */ CURVE 0x0000 /* @ECU_Address@CAL_TDC_KiNCtl_Y_Af32@ */ Lookup1D_FLOAT32_IEEE /* Maxdiff */ 0 SWC_TDC_CM_single -3.4E+38 3.4E+38
 /begin AXIS_DESCR /* Description of X-Axis Points */ /* Axis Type */ COM_AXIS /* Reference to Input */ NO_INPUT_QUANTITY SWC_TDC_CM_single 10 -3.4E+38 3.4E+38 AXIS_PTS_REF CAL_TDC_n_Error_X_Af32 /end AXIS_DESCR
/end CHARACTERISTIC
/begin AXIS_PTS CAL_TDC_n_Error_X_Af32 "转速偏差的绝对值" 0x0000 /* @ECU_Address@CAL_TDC_n_Error_X_Af32@ */ /* Input Quantity */ NO_INPUT_QUANTITY Lookup1D_X_FLOAT32_IEEE 0 SWC_TDC_CM_single 10 -3.4E+38 3.4E+38 /end AXIS_PTS
/begin CHARACTERISTIC CAL_TDC_KpNCtl_Y_Af32 "根据转速偏差得到kp的值" /* Characteristic Type */ CURVE 0x0000 /* @ECU_Address@CAL_TDC_KpNCtl_Y_Af32@ */ Lookup1D_FLOAT32_IEEE /* Maxdiff */ 0 SWC_TDC_CM_single -3.4E+38 3.4E+38
 /begin AXIS_DESCR /* Description of X-Axis Points */ /* Axis Type */ COM_AXIS /* Reference to Input */ NO_INPUT_QUANTITY SWC_TDC_CM_single 10 -3.4E+38 3.4E+38 AXIS_PTS_REF CAL_TDC_n_Error_X_Af32 /end AXIS_DESCR
/end CHARACTERISTIC
/begin CHARACTERISTIC CAL_TDC_DeltaT_f32 "TDC模块的运行周期（目前只用于PID控制器计算）" /* Type */ VALUE 0x0000 /* @ECU_Address@CAL_TDC_DeltaT_f32@ */ Scalar_FLOAT32_IEEE 0 SWC_TDC_CM_single_m_0 1.0E-5 0.01 /end CHARACTERISTIC
/begin CHARACTERISTIC CAL_TDC_trqIncMax_f32 "增量式PID控制器每周期允许的最大增量量" /* Type */ VALUE 0x0000 /* @ECU_Address@CAL_TDC_trqIncMax_f32@ */ Scalar_FLOAT32_IEEE 0 SWC_TDC_CM_single_nm 0.0 100.0 /end CHARACTERISTIC
/begin MEASUREMENT VAR_TDC_trqRmp_f32 "扭矩Ramp值" /* Data type */ FLOAT32_IEEE /* Conversion method */ SWC_TDC_CM_single /* Resolution (Not used) */ 0 /* Accuracy (Not used) */ 0 /* Lower limit */ -65535.0 /* Upper limit */ 65535.0 ECU_ADDRESS 0x0000 /* @ECU_Address@VAR_TDC_trqRmp_f32@ */ /end MEASUREMENT
/begin COMPU_METHOD SWC_TDC_CM_single "Q = V" RAT_FUNC "%8.6" "" COEFFS 0 1 0 0 0 1 /end COMPU_METHOD
/begin COMPU_METHOD SWC_TDC_CM_single_m_0 "Q = V" RAT_FUNC "%8.6" "m^0" COEFFS 0 1 0 0 0 1 /end COMPU_METHOD
/begin COMPU_METHOD SWC_TDC_CM_single_nm "Q = V" RAT_FUNC "%8.6" "nm" COEFFS 0 1 0 0 0 1 /end COMPU_METHOD
/begin GROUP SWC_TDC "SWC_TDC" /* Root */ ROOT /begin SUB_GROUP Root_RE_SWC_TDC_2ms_sys /end SUB_GROUP /end GROUP
/begin GROUP Root_RE_SWC_TDC_2ms_sys "SWC_TDC/RE_SWC_TDC_2ms_sys" /begin SUB_GROUP S1_Subsystem /end SUB_GROUP /end GROUP
/begin GROUP S1_Subsystem "SWC_TDC/RE_SWC_TDC_2ms_sys/Subsystem" /begin SUB_GROUP S3_TDC_Coord /end SUB_GROUP /end GROUP
/begin GROUP S3_TDC_Coord "SWC_TDC/RE_SWC_TDC_2ms_sys/Subsystem/TDC_Coord" /begin SUB_GROUP S4_Tdc_ModeSelect S4_Tdc_Pretreatment /end SUB_GROUP /end GROUP
/begin GROUP S4_Tdc_ModeSelect "SWC_TDC/RE_SWC_TDC_2ms_sys/Subsystem/TDC_Coord/Tdc_ModeSelect" /begin REF_CHARACTERISTIC CAL_TDC_trqIncMax_f32 /end REF_CHARACTERISTIC /end GROUP
/begin GROUP S4_Tdc_Pretreatment "SWC_TDC/RE_SWC_TDC_2ms_sys/Subsystem/TDC_Coord/Tdc_Pretreatment" /begin SUB_GROUP S8_PiParameter /end SUB_GROUP /begin REF_MEASUREMENT VAR_TDC_trqRmp_f32 /end REF_MEASUREMENT /end GROUP
/begin GROUP S8_PiParameter "SWC_TDC/RE_SWC_TDC_2ms_sys/Subsystem/TDC_Coord/Tdc_Pretreatment/PiParameter"
 /begin REF_CHARACTERISTIC CAL_TDC_DeltaT_f32 CAL_TDC_KiNCtl_Y_Af32 CAL_TDC_KpNCtl_Y_Af32 /end REF_CHARACTERISTIC
/end GROUP
/end MODULE
/end PROJECT
/* (add any file trailer comments here) */
/* EOF SWC_TDC.a2l */
